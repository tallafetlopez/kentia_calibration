/* ASAP2 file for OpenECU and ETAS INCA calibration tool.
* Auto-generated from 'capi.py' (version 2.9.0 (r2020-1)) at Mon Nov 10 13:44:24 2025 (local time).
* Information taken from:
* Gasoline.dde_group.tmp
* automatic library DDEs
*/
ASAP2_VERSION 1 31
/begin PROJECT M670_Engine_Control_1.2.0_M670_000 "BeGas B430LG Turbocharged engine"
/begin HEADER "Begas Motor 2017-2022 (c)" VERSION "1_2_0" /end HEADER
/begin MODULE OpenECU_M670_000 ""
/begin MOD_PAR ""
 /begin MEMORY_SEGMENT Strategy "Strategy/application code" CODE FLASH INTERN 0x100000 0x300000 -1 -1 -1 -1 -1
  /begin IF_DATA ETK_XETK
   /begin ETK_XETK_ACCESS SERIAL_INTERFACE PHYSICAL_ADDRESS 0x100000 ETK_XETK_REF 1 /end ETK_XETK_ACCESS
  /end IF_DATA
 /end MEMORY_SEGMENT
 /begin MEMORY_SEGMENT Calibration "Calibration data" DATA FLASH INTERN 0x80000 0x20000 -1 -1 -1 -1 -1
  /begin IF_DATA ETK_XETK
   /begin ETK_XETK_ACCESS SERIAL_INTERFACE PHYSICAL_ADDRESS 0x80000 ETK_XETK_REF 1 /end ETK_XETK_ACCESS
  /end IF_DATA
 /end MEMORY_SEGMENT
 /begin MEMORY_SEGMENT RAM "" VARIABLES RAM INTERN 0x40000000 0x20000 -1 -1 -1 -1 -1
  /begin IF_DATA ETK_XETK
   /begin ETK_XETK_ACCESS SERIAL_INTERFACE PHYSICAL_ADDRESS 0x40000000 ETK_XETK_REF 1 /end ETK_XETK_ACCESS
  /end IF_DATA
 /end MEMORY_SEGMENT
/end MOD_PAR
/begin IF_DATA ETK_XETK
 /begin ETK_XETK_LIST ETK_XETK_AML_VERSION_2_0_0
  /begin XETK 1 CONFIG "BaseId" "4" /* XETKV2 */ CONFIG "Extension" "1" CONFIG "CpuType" "MPC5674F_Rev2" CONFIG "EcuVoltageLevel" "33" CONFIG "AutoPowerSaveEnabled" "1" CONFIG "ThresholdVoltageA" "2258" CONFIG "ThresholdVoltageB" "2258" CONFIG "HandshakeTimeout" "-1" CONFIG "TriggerInterface" "dai" CONFIG "JtagClockSpeed" "40" CONFIG "StandbyTimeout" "0" CONFIG "EcuChipSelect" "0" CONFIG "CalBusDataWidth" "32" CONFIG "ResetOut" "0" CONFIG "WpMemBaseAddress" "0x40020000" CONFIG "WpMemSize" "0x20000" CONFIG "MuxData31" "SCS2" CONFIG "MuxAddr11" "DAT11" CONFIG "ReadyPin" "3" /end XETK
  /begin RASTER_CHECK OFFLINE_DEVICE 1 ONLINE_RESPECT_OFFLINE_LIMIT /end RASTER_CHECK
 /end ETK_XETK_LIST
 /begin TP_BLOB BYTE_ORDER_MSB_FIRST /begin DISTAB_CFG 13 /end DISTAB_CFG
  /begin PAGE_SWITCH_METHOD 0x1 MAILBOX 1 100 0x40003e9c AUTOSTART_BEHAVIOR ALWAYS_RP ETK_XETK_REF 1 /end PAGE_SWITCH_METHOD
  /begin COLDSTART_HANDSHAKE 0x40003e99 WAIT 0xCC READY 0x33 ETK_XETK_REF 1 /end COLDSTART_HANDSHAKE
 /end TP_BLOB
 /begin SOURCE "task_10ms" 0 10000
  /begin QP_BLOB 3 3 10000
   /begin ETK_XETK_SPECIFIC TRG_NBR 15 INDIRECT 0x40003b88 /begin DISTAB_LAYOUT 0x40003b90 0x0 0x0 0x0 /end DISTAB_LAYOUT ETK_XETK_REF 1 /end ETK_XETK_SPECIFIC
  /end QP_BLOB
 /end SOURCE
 /begin SOURCE "task_100ms" 0 100000
  /begin QP_BLOB 2 2 100000
   /begin ETK_XETK_SPECIFIC TRG_NBR 16 INDIRECT 0x40003b78 /begin DISTAB_LAYOUT 0x40003b80 0x0 0x0 0x0 /end DISTAB_LAYOUT ETK_XETK_REF 1 /end ETK_XETK_SPECIFIC
  /end QP_BLOB
 /end SOURCE
 /begin SOURCE "task_1000ms" 0 1000000
  /begin QP_BLOB 1 1 1000000
   /begin ETK_XETK_SPECIFIC TRG_NBR 15 INDIRECT 0x40003b68 /begin DISTAB_LAYOUT 0x40003b70 0x0 0x0 0x0 /end DISTAB_LAYOUT ETK_XETK_REF 1 /end ETK_XETK_SPECIFIC
  /end QP_BLOB
 /end SOURCE
/end IF_DATA
/begin IF_DATA ASAP1B_CCP
 /begin SOURCE "10_ms" 3 10 /* Rate in Scaling Unit: 10*1 ms */ /begin QP_BLOB 0 LENGTH 30 CAN_ID_FIXED 1784 RASTER 2 FIRST_PID 0 /end QP_BLOB /end SOURCE
 /begin SOURCE "100_ms" 3 100 /* Rate in Scaling Unit: 100*1 ms */ /begin QP_BLOB 1 LENGTH 30 CAN_ID_FIXED 1784 RASTER 5 FIRST_PID 30 /end QP_BLOB /end SOURCE
 /begin SOURCE "200_ms" 3 200 /* Rate in Scaling Unit: 200*1 ms */ /begin QP_BLOB 2 LENGTH 30 CAN_ID_FIXED 1784 RASTER 6 FIRST_PID 60 /end QP_BLOB /end SOURCE
 /begin SOURCE "1000_ms" 3 1000 /* Rate in Scaling Unit: 1000*1 ms */ /begin QP_BLOB 3 LENGTH 30 CAN_ID_FIXED 1784 RASTER 8 FIRST_PID 90 /end QP_BLOB /end SOURCE
 /begin RASTER "Time synchronous event channel - 10 ms" "10_ms" 2 /* Raster 2 (Reference from signal SOURCE)*/ 3 10 /* Rate in Scaling Unit: 10*1 ms */ /end RASTER
 /begin RASTER "Time synchronous event channel - 100 ms" "100_ms" 5 /* Raster 5 (Reference from signal SOURCE)*/ 3 100 /* Rate in Scaling Unit: 100*1 ms */ /end RASTER
 /begin RASTER "Time synchronous event channel - 200 ms" "200_ms" 6 /* Raster 6 (Reference from signal SOURCE)*/ 3 200 /* Rate in Scaling Unit: 200*1 ms */ /end RASTER
 /begin RASTER "Time synchronous event channel - 1000 ms" "1000_ms" 8 /* Raster 8 (Reference from signal SOURCE)*/ 3 1000 /* Rate in Scaling Unit: 1000*1 ms */ /end RASTER
 /begin TP_BLOB /* CCP version */ 0x201 /* Blob version */ 0x202 /* CAN msg ID - send */ 1785 /* CAN msg ID - recv */ 1784 /* station address */ 0 /* byte order */ 1
  /begin CAN_PARAM /* crystal frequency */ 0x1F4 /* timing register 0 */ 0x41 /* timing register 1 */ 0x25 /end CAN_PARAM
  /* Global measurement mode settings */ DAQ_MODE BURST CONSISTENCY ODT ADDRESS_EXTENSION ODT
  /begin CHECKSUM_PARAM /* algorithm */ 0x8006 /* limit */ 0xFFFFFFFF CHECKSUM_CALCULATION ACTIVE_PAGE /end CHECKSUM_PARAM
  /begin DEFINED_PAGES 1 "working page" /* address ext. */ 0x0 /* base address */ 0x80000 /* page length */ 0x12ab4 RAM RAM_INIT_BY_ECU /end DEFINED_PAGES
  OPTIONAL_CMD 0x08 /* START_STOP_ALL */ OPTIONAL_CMD 0x0C /* SET_S_STATUS */ OPTIONAL_CMD 0x0D /* GET_S_STATUS */ OPTIONAL_CMD 0x0E /* BUILD_CHKSUM */ OPTIONAL_CMD 0x0F /* SHORT_UP */ OPTIONAL_CMD 0x10 /* CLEAR_MEMORY */ OPTIONAL_CMD 0x18 /* PROGRAM */ OPTIONAL_CMD 0x23 /* DNLOAD_6 */ OPTIONAL_CMD 0x22 /* PROGRAM_6 */ /end TP_BLOB
/end IF_DATA
/* Scalar measurable for DDE 'ADM_NU_Alpha'. */
/begin MEASUREMENT ADM_NU_Alpha "Displayable" FLOAT32_IEEE CU_ADM_NU_ALPHA 1 100 0.0 0.0 ECU_ADDRESS 0x40003390 BYTE_ORDER MSB_FIRST /end MEASUREMENT
/begin COMPU_METHOD CU_ADM_NU_ALPHA "Conversion method for ADM_NU_Alpha" RAT_FUNC "%10.2" "NU" COEFFS 0.000000 1.000000 0.000000 0.000000 0.000000 1.000000 /end COMPU_METHOD
/* Scalar measurable for DDE 'ADM_NU_BoostIGain'. */
/begin MEASUREMENT ADM_NU_BoostIGain "Integral gain for MAF target feedback control" FLOAT32_IEEE CU_ADM_NU_BOOSTIGAIN 1 100 0.0 0.0 ECU_ADDRESS 0x400033cc BYTE_ORDER MSB_FIRST /end MEASUREMENT
/begin COMPU_METHOD CU_ADM_NU_BOOSTIGAIN "Conversion method for ADM_NU_BoostIGain" RAT_FUNC "%10.3" "NU" COEFFS 0.000000 1.000000 0.000000 0.000000 0.000000 1.000000 /end COMPU_METHOD
/* Scalar measurable for DDE 'ADM_NU_ComprInDens'. */
/begin MEASUREMENT ADM_NU_ComprInDens "(kg/m3) Air density estimate" FLOAT32_IEEE CU_ADM_NU_COMPRINDENS 1 100 0.0 0.0 ECU_ADDRESS 0x4000343c BYTE_ORDER MSB_FIRST /end MEASUREMENT
/begin COMPU_METHOD CU_ADM_NU_COMPRINDENS "Conversion method for ADM_NU_ComprInDens" RAT_FUNC "%10.3" "NU" COEFFS 0.000000 1.000000 0.000000 0.000000 0.000000 1.000000 /end COMPU_METHOD
/* Scalar measurable for DDE 'ADM_NU_ComprOutDens'. */
/begin MEASUREMENT ADM_NU_ComprOutDens "(kg/m3) Air density estimate" FLOAT32_IEEE CU_ADM_NU_COMPROUTDENS 1 100 0.0 0.0 ECU_ADDRESS 0x40003428 BYTE_ORDER MSB_FIRST /end MEASUREMENT
/begin COMPU_METHOD CU_ADM_NU_COMPROUTDENS "Conversion method for ADM_NU_ComprOutDens" RAT_FUNC "%10.3" "NU" COEFFS 0.000000 1.000000 0.000000 0.000000 0.000000 1.000000 /end COMPU_METHOD
/* Scalar measurable for DDE 'ADM_NU_ComprPressRatio'. */
/begin MEASUREMENT ADM_NU_ComprPressRatio "Estimated pressure ratio" FLOAT32_IEEE CU_ADM_NU_COMPRPRESSRATIO 1 100 0.0 0.0 ECU_ADDRESS 0x40003418 BYTE_ORDER MSB_FIRST /end MEASUREMENT
/begin COMPU_METHOD CU_ADM_NU_COMPRPRESSRATIO "Conversion method for ADM_NU_ComprPressRatio" RAT_FUNC "%10.2" "NU" COEFFS 0.000000 1.000000 0.000000 0.000000 0.000000 1.000000 /end COMPU_METHOD
/* Scalar measurable for DDE 'ADM_NU_ComprSurgeProx'. */
/begin MEASUREMENT ADM_NU_ComprSurgeProx "Pressure-ratio-delta between current operation and surge limit" FLOAT32_IEEE CU_ADM_NU_COMPRSURGEPROX 1 100 0.0 0.0 ECU_ADDRESS 0x40003414 BYTE_ORDER MSB_FIRST /end MEASUREMENT
/begin COMPU_METHOD CU_ADM_NU_COMPRSURGEPROX "Conversion method for ADM_NU_ComprSurgeProx" RAT_FUNC "%10.2" "NU" COEFFS 0.000000 1.000000 0.000000 0.000000 0.000000 1.000000 /end COMPU_METHOD
/* Scalar measurable for DDE 'ADM_NU_ISFC'. */
/begin MEASUREMENT ADM_NU_ISFC "(not defined)" FLOAT32_IEEE CU_ADM_NU_ISFC 1 100 0.0 0.0 ECU_ADDRESS 0x400033e4 BYTE_ORDER MSB_FIRST /end MEASUREMENT
/begin COMPU_METHOD CU_ADM_NU_ISFC "Conversion method for ADM_NU_ISFC" RAT_FUNC "%10.2" "NU" COEFFS 0.000000 1.000000 0.000000 0.000000 0.000000 1.000000 /end COMPU_METHOD
/* Scalar measurable for DDE 'ADM_NU_SurgePressRatio'. */
/begin MEASUREMENT ADM_NU_SurgePressRatio "map output displayable" FLOAT32_IEEE CU_ADM_NU_SURGEPRESSRATIO 1 100 0.0 0.0 ECU_ADDRESS 0x40003440 BYTE_ORDER MSB_FIRST /end MEASUREMENT
/begin COMPU_METHOD CU_ADM_NU_SURGEPRESSRATIO "Conversion method for ADM_NU_SurgePressRatio" RAT_FUNC "%10.2" "NU" COEFFS 0.000000 1.000000 0.000000 0.000000 0.000000 1.000000 /end COMPU_METHOD
/* Scalar measurable for DDE 'ADM_NU_ThrottleIGain'. */
/begin MEASUREMENT ADM_NU_ThrottleIGain "Integral gain for MAF target feedback control" FLOAT32_IEEE CU_ADM_NU_THROTTLEIGAIN 1 100 0.0 0.0 ECU_ADDRESS 0x400033b4 BYTE_ORDER MSB_FIRST /end MEASUREMENT
/begin COMPU_METHOD CU_ADM_NU_THROTTLEIGAIN "Conversion method for ADM_NU_ThrottleIGain" RAT_FUNC "%10.3" "NU" COEFFS 0.000000 1.000000 0.000000 0.000000 0.000000 1.000000 /end COMPU_METHOD
/* Scalar measurable for DDE 'ADM_RPM_TurSpdCorr'. */
/begin MEASUREMENT ADM_RPM_TurSpdCorr "Turboshaft speed corrected to standard compressor condition" FLOAT32_IEEE CU_ADM_RPM_TURSPDCORR 1 100 0.0 0.0 ECU_ADDRESS 0x40003410 BYTE_ORDER MSB_FIRST /end MEASUREMENT
/begin COMPU_METHOD CU_ADM_RPM_TURSPDCORR "Conversion method for ADM_RPM_TurSpdCorr" RAT_FUNC "%10.0" "RPM" COEFFS 0.000000 1.000000 0.000000 0.000000 0.000000 1.000000 /end COMPU_METHOD
/* Scalar measurable for DDE 'ADM_b_ComprSurge'. */
/begin MEASUREMENT ADM_b_ComprSurge "Surge detection result" UBYTE CU_ADM_B_COMPRSURGE 1 100 0.0 1.0 ECU_ADDRESS 0x40002ebd BYTE_ORDER MSB_FIRST /end MEASUREMENT
/begin COMPU_METHOD CU_ADM_B_COMPRSURGE "Conversion method for ADM_b_ComprSurge" RAT_FUNC "%10.0" "b" COEFFS 0.000000 1.000000 0.000000 0.000000 0.000000 1.000000 /end COMPU_METHOD
/* Scalar measurable for DDE 'ADM_b_TurOverspeed'. */
/begin MEASUREMENT ADM_b_TurOverspeed "Status displayable" UBYTE CU_ADM_B_TUROVERSPEED 1 100 0.0 1.0 ECU_ADDRESS 0x40002e90 BYTE_ORDER MSB_FIRST /end MEASUREMENT
/begin COMPU_METHOD CU_ADM_B_TUROVERSPEED "Conversion method for ADM_b_TurOverspeed" RAT_FUNC "%10.0" "b" COEFFS 0.000000 1.000000 0.000000 0.000000 0.000000 1.000000 /end COMPU_METHOD
/* Scalar measurable for DDE 'ADM_b_TurboCancelThrottleITerm'. */
/begin MEASUREMENT ADM_b_TurboCancelThrottleITerm "Status displayable" UBYTE CU_ADM_B_TURBOCANCELTHROTTLEIT0 1 100 0.0 1.0 ECU_ADDRESS 0x40002eba BYTE_ORDER MSB_FIRST /end MEASUREMENT
/begin COMPU_METHOD CU_ADM_B_TURBOCANCELTHROTTLEIT0 "Conversion method for ADM_b_TurboCancelThrottleITerm" RAT_FUNC "%10.0" "b" COEFFS 0.000000 1.000000 0.000000 0.000000 0.000000 1.000000 /end COMPU_METHOD
/* Scalar measurable for DDE 'ADM_b_UseTurbo'. */
/begin MEASUREMENT ADM_b_UseTurbo "Flag to latch throttle control (ITerm) because Turbo is regulating the mass flow" UBYTE CU_ADM_B_USETURBO 1 100 0.0 1.0 ECU_ADDRESS 0x40002ebb BYTE_ORDER MSB_FIRST /end MEASUREMENT
/begin COMPU_METHOD CU_ADM_B_USETURBO "Conversion method for ADM_b_UseTurbo" RAT_FUNC "%10.0" "b" COEFFS 0.000000 1.000000 0.000000 0.000000 0.000000 1.000000 /end COMPU_METHOD
/* Scalar measurable for DDE 'ADM_deg_EquationBasedThCorr'. */
/begin MEASUREMENT ADM_deg_EquationBasedThCorr "Displayable" FLOAT32_IEEE CU_ADM_DEG_EQUATIONBASEDTHCORR 1 100 0.0 0.0 ECU_ADDRESS 0x4000338c BYTE_ORDER MSB_FIRST /end MEASUREMENT
/begin COMPU_METHOD CU_ADM_DEG_EQUATIONBASEDTHCORR "Conversion method for ADM_deg_EquationBasedThCorr" RAT_FUNC "%10.1" "deg" COEFFS 0.000000 1.000000 0.000000 0.000000 0.000000 1.000000 /end COMPU_METHOD
/* Scalar measurable for DDE 'ADM_deg_ThrottleTrgt'. */
/begin MEASUREMENT ADM_deg_ThrottleTrgt "Corrected Throttle Angle request output" FLOAT32_IEEE CU_ADM_DEG_THROTTLETRGT 1 100 0.0 0.0 ECU_ADDRESS 0x4000333c BYTE_ORDER MSB_FIRST /end MEASUREMENT
/begin COMPU_METHOD CU_ADM_DEG_THROTTLETRGT "Conversion method for ADM_deg_ThrottleTrgt" RAT_FUNC "%10.2" "deg" COEFFS 0.000000 1.000000 0.000000 0.000000 0.000000 1.000000 /end COMPU_METHOD
/* Scalar measurable for DDE 'ADM_deg_ThrottleTrgtRaw'. */
/begin MEASUREMENT ADM_deg_ThrottleTrgtRaw "Raw throttle blade angle target" FLOAT32_IEEE CU_ADM_DEG_THROTTLETRGTRAW 1 100 0.0 0.0 ECU_ADDRESS 0x4000339c BYTE_ORDER MSB_FIRST /end MEASUREMENT
/begin COMPU_METHOD CU_ADM_DEG_THROTTLETRGTRAW "Conversion method for ADM_deg_ThrottleTrgtRaw" RAT_FUNC "%10.2" "deg" COEFFS 0.000000 1.000000 0.000000 0.000000 0.000000 1.000000 /end COMPU_METHOD
/* Scalar measurable for DDE 'ADM_deg_VCP_ThCorr'. */
/begin MEASUREMENT ADM_deg_VCP_ThCorr "Throttle angle disturbance caused by VCP" FLOAT32_IEEE CU_ADM_DEG_VCP_THCORR 1 100 0.0 0.0 ECU_ADDRESS 0x40003388 BYTE_ORDER MSB_FIRST /end MEASUREMENT
/begin COMPU_METHOD CU_ADM_DEG_VCP_THCORR "Conversion method for ADM_deg_VCP_ThCorr" RAT_FUNC "%10.1" "deg" COEFFS 0.000000 1.000000 0.000000 0.000000 0.000000 1.000000 /end COMPU_METHOD
/* Scalar measurable for DDE 'ADM_gps_AirDemandRAW'. */
/begin MEASUREMENT ADM_gps_AirDemandRAW "Torque request air demand" FLOAT32_IEEE CU_ADM_GPS_AIRDEMANDRAW 1 100 0.0 0.0 ECU_ADDRESS 0x40003200 BYTE_ORDER MSB_FIRST /end MEASUREMENT
/begin COMPU_METHOD CU_ADM_GPS_AIRDEMANDRAW "Conversion method for ADM_gps_AirDemandRAW" RAT_FUNC "%10.3" "gps" COEFFS 0.000000 1.000000 0.000000 0.000000 0.000000 1.000000 /end COMPU_METHOD
/* Scalar measurable for DDE 'ADM_gps_MAF_Corr'. */
/begin MEASUREMENT ADM_gps_MAF_Corr "Airflow corrected to standard compressor condition" FLOAT32_IEEE CU_ADM_GPS_MAF_CORR 1 100 0.0 0.0 ECU_ADDRESS 0x40003444 BYTE_ORDER MSB_FIRST /end MEASUREMENT
/begin COMPU_METHOD CU_ADM_GPS_MAF_CORR "Conversion method for ADM_gps_MAF_Corr" RAT_FUNC "%10.2" "gps" COEFFS 0.000000 1.000000 0.000000 0.000000 0.000000 1.000000 /end COMPU_METHOD
/* Scalar measurable for DDE 'ADM_gps_MAF_Trgt'. */
/begin MEASUREMENT ADM_gps_MAF_Trgt "Target mass air flow" FLOAT32_IEEE CU_ADM_GPS_MAF_TRGT 1 100 0.0 0.0 ECU_ADDRESS 0x400033d8 BYTE_ORDER MSB_FIRST /end MEASUREMENT
/begin COMPU_METHOD CU_ADM_GPS_MAF_TRGT "Conversion method for ADM_gps_MAF_Trgt" RAT_FUNC "%10.1" "gps" COEFFS 0.000000 1.000000 0.000000 0.000000 0.000000 1.000000 /end COMPU_METHOD
/* Scalar measurable for DDE 'ADM_gps_MAF_TrgtErr'. */
/begin MEASUREMENT ADM_gps_MAF_TrgtErr "MAF target error" FLOAT32_IEEE CU_ADM_GPS_MAF_TRGTERR 1 100 0.0 0.0 ECU_ADDRESS 0x400033d4 BYTE_ORDER MSB_FIRST /end MEASUREMENT
/begin COMPU_METHOD CU_ADM_GPS_MAF_TRGTERR "Conversion method for ADM_gps_MAF_TrgtErr" RAT_FUNC "%10.2" "gps" COEFFS 0.000000 1.000000 0.000000 0.000000 0.000000 1.000000 /end COMPU_METHOD
/* Scalar measurable for DDE 'ADM_gps_NominalMAF'. */
/begin MEASUREMENT ADM_gps_NominalMAF "Mass-flow reference for zero VCP" FLOAT32_IEEE CU_ADM_GPS_NOMINALMAF 1 100 0.0 0.0 ECU_ADDRESS 0x40003394 BYTE_ORDER MSB_FIRST /end MEASUREMENT
/begin COMPU_METHOD CU_ADM_GPS_NOMINALMAF "Conversion method for ADM_gps_NominalMAF" RAT_FUNC "%10.1" "gps" COEFFS 0.000000 1.000000 0.000000 0.000000 0.000000 1.000000 /end COMPU_METHOD
/* Scalar measurable for DDE 'ADM_gps_TrgtFuelFlow'. */
/begin MEASUREMENT ADM_gps_TrgtFuelFlow "Target fuel flow" FLOAT32_IEEE CU_ADM_GPS_TRGTFUELFLOW 1 100 0.0 0.0 ECU_ADDRESS 0x400033dc BYTE_ORDER MSB_FIRST /end MEASUREMENT
/begin COMPU_METHOD CU_ADM_GPS_TRGTFUELFLOW "Conversion method for ADM_gps_TrgtFuelFlow" RAT_FUNC "%10.3" "gps" COEFFS 0.000000 1.000000 0.000000 0.000000 0.000000 1.000000 /end COMPU_METHOD
/* Scalar measurable for DDE 'ADM_kPa_BoostFB'. */
/begin MEASUREMENT ADM_kPa_BoostFB "MAF PI control effort" FLOAT32_IEEE CU_ADM_KPA_BOOSTFB 1 100 0.0 0.0 ECU_ADDRESS 0x400033c4 BYTE_ORDER MSB_FIRST /end MEASUREMENT
/begin COMPU_METHOD CU_ADM_KPA_BOOSTFB "Conversion method for ADM_kPa_BoostFB" RAT_FUNC "%10.2" "kPa" COEFFS 0.000000 1.000000 0.000000 0.000000 0.000000 1.000000 /end COMPU_METHOD
/* Scalar measurable for DDE 'ADM_kPa_BoostFF'. */
/begin MEASUREMENT ADM_kPa_BoostFF "Feedforward manifold pressure target" FLOAT32_IEEE CU_ADM_KPA_BOOSTFF 1 100 0.0 0.0 ECU_ADDRESS 0x400033c0 BYTE_ORDER MSB_FIRST /end MEASUREMENT
/begin COMPU_METHOD CU_ADM_KPA_BOOSTFF "Conversion method for ADM_kPa_BoostFF" RAT_FUNC "%10.2" "kPa" COEFFS 0.000000 1.000000 0.000000 0.000000 0.000000 1.000000 /end COMPU_METHOD
/* Scalar measurable for DDE 'ADM_kPa_BoostITerm'. */
/begin MEASUREMENT ADM_kPa_BoostITerm "Integral effort for MAF target feedback control" FLOAT32_IEEE CU_ADM_KPA_BOOSTITERM 1 100 0.0 0.0 ECU_ADDRESS 0x400033c8 BYTE_ORDER MSB_FIRST /end MEASUREMENT
/begin COMPU_METHOD CU_ADM_KPA_BOOSTITERM "Conversion method for ADM_kPa_BoostITerm" RAT_FUNC "%10.2" "kPa" COEFFS 0.000000 1.000000 0.000000 0.000000 0.000000 1.000000 /end COMPU_METHOD
/* Scalar measurable for DDE 'ADM_kPa_BoostPTerm'. */
/begin MEASUREMENT ADM_kPa_BoostPTerm "Proportional effort for MAF target feedback control" FLOAT32_IEEE CU_ADM_KPA_BOOSTPTERM 1 100 0.0 0.0 ECU_ADDRESS 0x400033d0 BYTE_ORDER MSB_FIRST /end MEASUREMENT
/begin COMPU_METHOD CU_ADM_KPA_BOOSTPTERM "Conversion method for ADM_kPa_BoostPTerm" RAT_FUNC "%10.2" "kPa" COEFFS 0.000000 1.000000 0.000000 0.000000 0.000000 1.000000 /end COMPU_METHOD
/* Scalar measurable for DDE 'ADM_kPa_BoostPressTrgt'. */
/begin MEASUREMENT ADM_kPa_BoostPressTrgt "Target Boost Pressure Output" FLOAT32_IEEE CU_ADM_KPA_BOOSTPRESSTRGT 1 100 0.0 0.0 ECU_ADDRESS 0x40003294 BYTE_ORDER MSB_FIRST /end MEASUREMENT
/begin COMPU_METHOD CU_ADM_KPA_BOOSTPRESSTRGT "Conversion method for ADM_kPa_BoostPressTrgt" RAT_FUNC "%10.2" "kPa" COEFFS 0.000000 1.000000 0.000000 0.000000 0.000000 1.000000 /end COMPU_METHOD
/* Scalar measurable for DDE 'ADM_kPa_BoostPressTrgtRaw'. */
/begin MEASUREMENT ADM_kPa_BoostPressTrgtRaw "MAP target" FLOAT32_IEEE CU_ADM_KPA_BOOSTPRESSTRGTRAW 1 100 0.0 0.0 ECU_ADDRESS 0x400033bc BYTE_ORDER MSB_FIRST /end MEASUREMENT
/begin COMPU_METHOD CU_ADM_KPA_BOOSTPRESSTRGTRAW "Conversion method for ADM_kPa_BoostPressTrgtRaw" RAT_FUNC "%10.0" "kPa" COEFFS 0.000000 1.000000 0.000000 0.000000 0.000000 1.000000 /end COMPU_METHOD
/* Scalar measurable for DDE 'ADM_kPa_BoostPressTrgtRawCorr'. */
/begin MEASUREMENT ADM_kPa_BoostPressTrgtRawCorr "(not defined)" FLOAT32_IEEE CU_ADM_KPA_BOOSTPRESSTRGTRAWCO0 1 100 0.0 0.0 ECU_ADDRESS 0x400033b8 BYTE_ORDER MSB_FIRST /end MEASUREMENT
/begin COMPU_METHOD CU_ADM_KPA_BOOSTPRESSTRGTRAWCO0 "Conversion method for ADM_kPa_BoostPressTrgtRawCorr" RAT_FUNC "%10.2" "kPa" COEFFS 0.000000 1.000000 0.000000 0.000000 0.000000 1.000000 /end COMPU_METHOD
/* Scalar measurable for DDE 'ADM_kPa_ComprInDynPress'. */
/begin MEASUREMENT ADM_kPa_ComprInDynPress "Dynamic pressure term" FLOAT32_IEEE CU_ADM_KPA_COMPRINDYNPRESS 1 100 0.0 0.0 ECU_ADDRESS 0x40003430 BYTE_ORDER MSB_FIRST /end MEASUREMENT
/begin COMPU_METHOD CU_ADM_KPA_COMPRINDYNPRESS "Conversion method for ADM_kPa_ComprInDynPress" RAT_FUNC "%10.2" "kPa" COEFFS 0.000000 1.000000 0.000000 0.000000 0.000000 1.000000 /end COMPU_METHOD
/* Scalar measurable for DDE 'ADM_kPa_ComprInPressTot'. */
/begin MEASUREMENT ADM_kPa_ComprInPressTot "Total pressure estimate" FLOAT32_IEEE CU_ADM_KPA_COMPRINPRESSTOT 1 100 0.0 0.0 ECU_ADDRESS 0x4000342c BYTE_ORDER MSB_FIRST /end MEASUREMENT
/begin COMPU_METHOD CU_ADM_KPA_COMPRINPRESSTOT "Conversion method for ADM_kPa_ComprInPressTot" RAT_FUNC "%10.2" "kPa" COEFFS 0.000000 1.000000 0.000000 0.000000 0.000000 1.000000 /end COMPU_METHOD
/* Scalar measurable for DDE 'ADM_kPa_ComprOutDynPress'. */
/begin MEASUREMENT ADM_kPa_ComprOutDynPress "Dynamic pressure term" FLOAT32_IEEE CU_ADM_KPA_COMPROUTDYNPRESS 1 100 0.0 0.0 ECU_ADDRESS 0x40003420 BYTE_ORDER MSB_FIRST /end MEASUREMENT
/begin COMPU_METHOD CU_ADM_KPA_COMPROUTDYNPRESS "Conversion method for ADM_kPa_ComprOutDynPress" RAT_FUNC "%10.2" "kPa" COEFFS 0.000000 1.000000 0.000000 0.000000 0.000000 1.000000 /end COMPU_METHOD
/* Scalar measurable for DDE 'ADM_kPa_ComprOutPressTot'. */
/begin MEASUREMENT ADM_kPa_ComprOutPressTot "Total pressure estimate" FLOAT32_IEEE CU_ADM_KPA_COMPROUTPRESSTOT 1 100 0.0 0.0 ECU_ADDRESS 0x4000341c BYTE_ORDER MSB_FIRST /end MEASUREMENT
/begin COMPU_METHOD CU_ADM_KPA_COMPROUTPRESSTOT "Conversion method for ADM_kPa_ComprOutPressTot" RAT_FUNC "%10.2" "kPa" COEFFS 0.000000 1.000000 0.000000 0.000000 0.000000 1.000000 /end COMPU_METHOD
/* Scalar measurable for DDE 'ADM_kPa_NominalDP'. */
/begin MEASUREMENT ADM_kPa_NominalDP "Delta-Pressure calmap output displayable" FLOAT32_IEEE CU_ADM_KPA_NOMINALDP 1 100 0.0 0.0 ECU_ADDRESS 0x40003398 BYTE_ORDER MSB_FIRST /end MEASUREMENT
/begin COMPU_METHOD CU_ADM_KPA_NOMINALDP "Conversion method for ADM_kPa_NominalDP" RAT_FUNC "%10.1" "kPa" COEFFS 0.000000 1.000000 0.000000 0.000000 0.000000 1.000000 /end COMPU_METHOD
/* Scalar measurable for DDE 'ADM_kW_TrgtPwr'. */
/begin MEASUREMENT ADM_kW_TrgtPwr "Target power" FLOAT32_IEEE CU_ADM_KW_TRGTPWR 1 100 0.0 0.0 ECU_ADDRESS 0x400033e0 BYTE_ORDER MSB_FIRST /end MEASUREMENT
/begin COMPU_METHOD CU_ADM_KW_TRGTPWR "Conversion method for ADM_kW_TrgtPwr" RAT_FUNC "%10.2" "kW" COEFFS 0.000000 1.000000 0.000000 0.000000 0.000000 1.000000 /end COMPU_METHOD
/* Scalar measurable for DDE 'ADM_mps_ComprInVel'. */
/begin MEASUREMENT ADM_mps_ComprInVel "(m/s) Airstream velocity" FLOAT32_IEEE CU_ADM_MPS_COMPRINVEL 1 100 0.0 0.0 ECU_ADDRESS 0x40003438 BYTE_ORDER MSB_FIRST /end MEASUREMENT
/begin COMPU_METHOD CU_ADM_MPS_COMPRINVEL "Conversion method for ADM_mps_ComprInVel" RAT_FUNC "%10.2" "mps" COEFFS 0.000000 1.000000 0.000000 0.000000 0.000000 1.000000 /end COMPU_METHOD
/* Scalar measurable for DDE 'ADM_mps_ComprOutVel'. */
/begin MEASUREMENT ADM_mps_ComprOutVel "(m/s) Airstream velocity" FLOAT32_IEEE CU_ADM_MPS_COMPROUTVEL 1 100 0.0 0.0 ECU_ADDRESS 0x40003424 BYTE_ORDER MSB_FIRST /end MEASUREMENT
/begin COMPU_METHOD CU_ADM_MPS_COMPROUTVEL "Conversion method for ADM_mps_ComprOutVel" RAT_FUNC "%10.2" "mps" COEFFS 0.000000 1.000000 0.000000 0.000000 0.000000 1.000000 /end COMPU_METHOD
/* Scalar measurable for DDE 'ADM_pct_AirDemand'. */
/begin MEASUREMENT ADM_pct_AirDemand "Corrected Throttle Angle request output" FLOAT32_IEEE CU_ADM_PCT_AIRDEMAND 1 100 0.0 0.0 ECU_ADDRESS 0x400031e8 BYTE_ORDER MSB_FIRST /end MEASUREMENT
/begin COMPU_METHOD CU_ADM_PCT_AIRDEMAND "Conversion method for ADM_pct_AirDemand" RAT_FUNC "%10.2" "pct" COEFFS 0.000000 1.000000 0.000000 0.000000 0.000000 1.000000 /end COMPU_METHOD
/* Scalar measurable for DDE 'ADM_pct_ThrottleEffortRaw'. */
/begin MEASUREMENT ADM_pct_ThrottleEffortRaw "Target throttle opening" FLOAT32_IEEE CU_ADM_PCT_THROTTLEEFFORTRAW 1 100 0.0 0.0 ECU_ADDRESS 0x400033a0 BYTE_ORDER MSB_FIRST /end MEASUREMENT
/begin COMPU_METHOD CU_ADM_PCT_THROTTLEEFFORTRAW "Conversion method for ADM_pct_ThrottleEffortRaw" RAT_FUNC "%10.3" "pct" COEFFS 0.000000 1.000000 0.000000 0.000000 0.000000 1.000000 /end COMPU_METHOD
/* Scalar measurable for DDE 'ADM_pct_ThrottleFB'. */
/begin MEASUREMENT ADM_pct_ThrottleFB "MAF PI control effort" FLOAT32_IEEE CU_ADM_PCT_THROTTLEFB 1 100 0.0 0.0 ECU_ADDRESS 0x400033a4 BYTE_ORDER MSB_FIRST /end MEASUREMENT
/begin COMPU_METHOD CU_ADM_PCT_THROTTLEFB "Conversion method for ADM_pct_ThrottleFB" RAT_FUNC "%10.2" "pct" COEFFS 0.000000 1.000000 0.000000 0.000000 0.000000 1.000000 /end COMPU_METHOD
/* Scalar measurable for DDE 'ADM_pct_ThrottleITerm'. */
/begin MEASUREMENT ADM_pct_ThrottleITerm "Integral effort for MAF target feedback control" FLOAT32_IEEE CU_ADM_PCT_THROTTLEITERM 1 100 0.0 0.0 ECU_ADDRESS 0x400033b0 BYTE_ORDER MSB_FIRST /end MEASUREMENT
/begin COMPU_METHOD CU_ADM_PCT_THROTTLEITERM "Conversion method for ADM_pct_ThrottleITerm" RAT_FUNC "%10.2" "pct" COEFFS 0.000000 1.000000 0.000000 0.000000 0.000000 1.000000 /end COMPU_METHOD
/* Scalar measurable for DDE 'ADM_pct_ThrottlePGain'. */
/begin MEASUREMENT ADM_pct_ThrottlePGain "Proportional gain for MAF target feedback control" FLOAT32_IEEE CU_ADM_PCT_THROTTLEPGAIN 1 100 0.0 0.0 ECU_ADDRESS 0x400033ac BYTE_ORDER MSB_FIRST /end MEASUREMENT
/begin COMPU_METHOD CU_ADM_PCT_THROTTLEPGAIN "Conversion method for ADM_pct_ThrottlePGain" RAT_FUNC "%10.3" "pct" COEFFS 0.000000 1.000000 0.000000 0.000000 0.000000 1.000000 /end COMPU_METHOD
/* Scalar measurable for DDE 'ADM_pct_ThrottlePTerm'. */
/begin MEASUREMENT ADM_pct_ThrottlePTerm "Proportional effort for MAF target feedback control" FLOAT32_IEEE CU_ADM_PCT_THROTTLEPTERM 1 100 0.0 0.0 ECU_ADDRESS 0x400033a8 BYTE_ORDER MSB_FIRST /end MEASUREMENT
/begin COMPU_METHOD CU_ADM_PCT_THROTTLEPTERM "Conversion method for ADM_pct_ThrottlePTerm" RAT_FUNC "%10.2" "pct" COEFFS 0.000000 1.000000 0.000000 0.000000 0.000000 1.000000 /end COMPU_METHOD
/* Scalar measurable for DDE 'ADM_ret_VCP_Trgt'. */
/begin MEASUREMENT ADM_ret_VCP_Trgt "Intake Cam Angle Output for monitoring" FLOAT32_IEEE CU_ADM_RET_VCP_TRGT 1 100 0.0 0.0 ECU_ADDRESS 0x4000325c BYTE_ORDER MSB_FIRST /end MEASUREMENT
/begin COMPU_METHOD CU_ADM_RET_VCP_TRGT "Conversion method for ADM_ret_VCP_Trgt" RAT_FUNC "%10.2" "ret" COEFFS 0.000000 1.000000 0.000000 0.000000 0.000000 1.000000 /end COMPU_METHOD
/* Scalar measurable for DDE 'AFR_b_UseRateLim'. */
/begin MEASUREMENT AFR_b_UseRateLim "Displayable" UBYTE CU_AFR_B_USERATELIM 1 100 0.0 1.0 ECU_ADDRESS 0x40002ebf BYTE_ORDER MSB_FIRST /end MEASUREMENT
/begin COMPU_METHOD CU_AFR_B_USERATELIM "Conversion method for AFR_b_UseRateLim" RAT_FUNC "%10.0" "b" COEFFS 0.000000 1.000000 0.000000 0.000000 0.000000 1.000000 /end COMPU_METHOD
/* Scalar measurable for DDE 'AFR_lam_BaseTrgt'. */
/begin MEASUREMENT AFR_lam_BaseTrgt "Base AFR target" FLOAT32_IEEE CU_AFR_LAM_BASETRGT 1 100 10.0 20.0 ECU_ADDRESS 0x400034b0 BYTE_ORDER MSB_FIRST /end MEASUREMENT
/begin COMPU_METHOD CU_AFR_LAM_BASETRGT "Conversion method for AFR_lam_BaseTrgt" RAT_FUNC "%10.3" "lam" COEFFS 0.000000 1.000000 0.000000 0.000000 0.000000 1.000000 /end COMPU_METHOD
/* Scalar measurable for DDE 'AFR_lam_CrankingTrgt'. */
/begin MEASUREMENT AFR_lam_CrankingTrgt "Cranking AFR target" FLOAT32_IEEE CU_AFR_LAM_CRANKINGTRGT 1 100 0.0 0.0 ECU_ADDRESS 0x40003540 BYTE_ORDER MSB_FIRST /end MEASUREMENT
/begin COMPU_METHOD CU_AFR_LAM_CRANKINGTRGT "Conversion method for AFR_lam_CrankingTrgt" RAT_FUNC "%10.2" "lam" COEFFS 0.000000 1.000000 0.000000 0.000000 0.000000 1.000000 /end COMPU_METHOD
/* Scalar measurable for DDE 'AFR_lam_FinalTrgt1'. */
/begin MEASUREMENT AFR_lam_FinalTrgt1 "Final AFR target 1" FLOAT32_IEEE CU_AFR_LAM_FINALTRGT1 1 100 0.0 0.0 ECU_ADDRESS 0x400034ac BYTE_ORDER MSB_FIRST /end MEASUREMENT
/begin COMPU_METHOD CU_AFR_LAM_FINALTRGT1 "Conversion method for AFR_lam_FinalTrgt1" RAT_FUNC "%10.3" "lam" COEFFS 0.000000 1.000000 0.000000 0.000000 0.000000 1.000000 /end COMPU_METHOD
/* Scalar measurable for DDE 'AFR_lam_FinalTrgt2'. */
/begin MEASUREMENT AFR_lam_FinalTrgt2 "Final AFR target 2" FLOAT32_IEEE CU_AFR_LAM_FINALTRGT2 1 100 0.0 0.0 ECU_ADDRESS 0x400031e0 BYTE_ORDER MSB_FIRST /end MEASUREMENT
/begin COMPU_METHOD CU_AFR_LAM_FINALTRGT2 "Conversion method for AFR_lam_FinalTrgt2" RAT_FUNC "%10.3" "lam" COEFFS 0.000000 1.000000 0.000000 0.000000 0.000000 1.000000 /end COMPU_METHOD
/* Scalar measurable for DDE 'AFR_lam_RampedTrgt'. */
/begin MEASUREMENT AFR_lam_RampedTrgt "Ramped AFR target" FLOAT32_IEEE CU_AFR_LAM_RAMPEDTRGT 1 100 0.0 2.0 ECU_ADDRESS 0x400034b4 BYTE_ORDER MSB_FIRST /end MEASUREMENT
/begin COMPU_METHOD CU_AFR_LAM_RAMPEDTRGT "Conversion method for AFR_lam_RampedTrgt" RAT_FUNC "%10.2" "lam" COEFFS 0.000000 1.000000 0.000000 0.000000 0.000000 1.000000 /end COMPU_METHOD
/* Scalar measurable for DDE 'AFR_lam_TableResult'. */
/begin MEASUREMENT AFR_lam_TableResult "Map output displayable" FLOAT32_IEEE CU_AFR_LAM_TABLERESULT 1 100 10.0 20.0 ECU_ADDRESS 0x400034b8 BYTE_ORDER MSB_FIRST /end MEASUREMENT
/begin COMPU_METHOD CU_AFR_LAM_TABLERESULT "Conversion method for AFR_lam_TableResult" RAT_FUNC "%10.3" "lam" COEFFS 0.000000 1.000000 0.000000 0.000000 0.000000 1.000000 /end COMPU_METHOD
/* Scalar measurable for DDE 'AIN_A_ETC_CurrentB'. */
/begin MEASUREMENT AIN_A_ETC_CurrentB "Output current monitor" FLOAT32_IEEE CU_AIN_A_ETC_CURRENTB 1 100 0.0 0.0 ECU_ADDRESS 0x400037b0 BYTE_ORDER MSB_FIRST /end MEASUREMENT
/begin COMPU_METHOD CU_AIN_A_ETC_CURRENTB "Conversion method for AIN_A_ETC_CurrentB" RAT_FUNC "%10.3" "A" COEFFS 0.000000 1.000000 0.000000 0.000000 0.000000 1.000000 /end COMPU_METHOD
/* Scalar measurable for DDE 'AIN_A_Y1_Current'. */
/begin MEASUREMENT AIN_A_Y1_Current "Output current monitor" FLOAT32_IEEE CU_AIN_A_Y1_CURRENT 1 100 0.0 0.0 ECU_ADDRESS 0x400037ac BYTE_ORDER MSB_FIRST /end MEASUREMENT
/begin COMPU_METHOD CU_AIN_A_Y1_CURRENT "Conversion method for AIN_A_Y1_Current" RAT_FUNC "%10.3" "A" COEFFS 0.000000 1.000000 0.000000 0.000000 0.000000 1.000000 /end COMPU_METHOD
/* Scalar measurable for DDE 'AIN_A_Y5_Current'. */
/begin MEASUREMENT AIN_A_Y5_Current "Output current monitor" FLOAT32_IEEE CU_AIN_A_Y5_CURRENT 1 100 0.0 0.0 ECU_ADDRESS 0x400037a8 BYTE_ORDER MSB_FIRST /end MEASUREMENT
/begin COMPU_METHOD CU_AIN_A_Y5_CURRENT "Conversion method for AIN_A_Y5_Current" RAT_FUNC "%10.3" "A" COEFFS 0.000000 1.000000 0.000000 0.000000 0.000000 1.000000 /end COMPU_METHOD
/* Scalar measurable for DDE 'AIN_C_AmbientTemp'. */
/begin MEASUREMENT AIN_C_AmbientTemp "Displayable" FLOAT32_IEEE CU_AIN_C_AMBIENTTEMP 1 100 0.0 0.0 ECU_ADDRESS 0x40003880 BYTE_ORDER MSB_FIRST /end MEASUREMENT
/begin COMPU_METHOD CU_AIN_C_AMBIENTTEMP "Conversion method for AIN_C_AmbientTemp" RAT_FUNC "%10.3" "C" COEFFS 0.000000 1.000000 0.000000 0.000000 0.000000 1.000000 /end COMPU_METHOD
/* Scalar measurable for DDE 'AIN_C_CompOutTemp'. */
/begin MEASUREMENT AIN_C_CompOutTemp "Displayable" FLOAT32_IEEE CU_AIN_C_COMPOUTTEMP 1 100 -40.0 120.0 ECU_ADDRESS 0x40003860 BYTE_ORDER MSB_FIRST /end MEASUREMENT
/begin COMPU_METHOD CU_AIN_C_COMPOUTTEMP "Conversion method for AIN_C_CompOutTemp" RAT_FUNC "%10.3" "C" COEFFS 0.000000 1.000000 0.000000 0.000000 0.000000 1.000000 /end COMPU_METHOD
/* Scalar measurable for DDE 'AIN_C_CoolantTemp'. */
/begin MEASUREMENT AIN_C_CoolantTemp "Displayable" FLOAT32_IEEE CU_AIN_C_COOLANTTEMP 1 100 -40.0 120.0 ECU_ADDRESS 0x40003850 BYTE_ORDER MSB_FIRST /end MEASUREMENT
/begin COMPU_METHOD CU_AIN_C_COOLANTTEMP "Conversion method for AIN_C_CoolantTemp" RAT_FUNC "%10.0" "C" COEFFS 0.000000 1.000000 0.000000 0.000000 0.000000 1.000000 /end COMPU_METHOD
/* Scalar measurable for DDE 'AIN_C_ExhaustTemp'. */
/begin MEASUREMENT AIN_C_ExhaustTemp "Displayable" FLOAT32_IEEE CU_AIN_C_EXHAUSTTEMP 1 100 0.0 0.0 ECU_ADDRESS 0x40003908 BYTE_ORDER MSB_FIRST /end MEASUREMENT
/begin COMPU_METHOD CU_AIN_C_EXHAUSTTEMP "Conversion method for AIN_C_ExhaustTemp" RAT_FUNC "%10.3" "C" COEFFS 0.000000 1.000000 0.000000 0.000000 0.000000 1.000000 /end COMPU_METHOD
/* Scalar measurable for DDE 'AIN_C_FuelTemp'. */
/begin MEASUREMENT AIN_C_FuelTemp "Displayable" FLOAT32_IEEE CU_AIN_C_FUELTEMP 1 100 0.0 0.0 ECU_ADDRESS 0x4000385c BYTE_ORDER MSB_FIRST /end MEASUREMENT
/begin COMPU_METHOD CU_AIN_C_FUELTEMP "Conversion method for AIN_C_FuelTemp" RAT_FUNC "%10.3" "C" COEFFS 0.000000 1.000000 0.000000 0.000000 0.000000 1.000000 /end COMPU_METHOD
/* Scalar measurable for DDE 'AIN_C_ManifoldTemp'. */
/begin MEASUREMENT AIN_C_ManifoldTemp "Displayable" FLOAT32_IEEE CU_AIN_C_MANIFOLDTEMP 1 100 -40.0 120.0 ECU_ADDRESS 0x40003858 BYTE_ORDER MSB_FIRST /end MEASUREMENT
/begin COMPU_METHOD CU_AIN_C_MANIFOLDTEMP "Conversion method for AIN_C_ManifoldTemp" RAT_FUNC "%10.1" "C" COEFFS 0.000000 1.000000 0.000000 0.000000 0.000000 1.000000 /end COMPU_METHOD
/* Scalar measurable for DDE 'AIN_C_OilTemp'. */
/begin MEASUREMENT AIN_C_OilTemp "Displayable" FLOAT32_IEEE CU_AIN_C_OILTEMP 1 100 -40.0 120.0 ECU_ADDRESS 0x40003874 BYTE_ORDER MSB_FIRST /end MEASUREMENT
/begin COMPU_METHOD CU_AIN_C_OILTEMP "Conversion method for AIN_C_OilTemp" RAT_FUNC "%10.3" "C" COEFFS 0.000000 1.000000 0.000000 0.000000 0.000000 1.000000 /end COMPU_METHOD
/* Scalar measurable for DDE 'AIN_NU_APP1_Raw'. */
/begin MEASUREMENT AIN_NU_APP1_Raw "Displayable" FLOAT32_IEEE CU_AIN_NU_APP1_RAW 1 100 0.0 0.0 ECU_ADDRESS 0x40003870 BYTE_ORDER MSB_FIRST /end MEASUREMENT
/begin COMPU_METHOD CU_AIN_NU_APP1_RAW "Conversion method for AIN_NU_APP1_Raw" RAT_FUNC "%10.3" "NU" COEFFS 0.000000 1.000000 0.000000 0.000000 0.000000 1.000000 /end COMPU_METHOD
/* Scalar measurable for DDE 'AIN_NU_APP2_Raw'. */
/begin MEASUREMENT AIN_NU_APP2_Raw "Displayable" FLOAT32_IEEE CU_AIN_NU_APP2_RAW 1 100 0.0 0.0 ECU_ADDRESS 0x4000386c BYTE_ORDER MSB_FIRST /end MEASUREMENT
/begin COMPU_METHOD CU_AIN_NU_APP2_RAW "Conversion method for AIN_NU_APP2_Raw" RAT_FUNC "%10.3" "NU" COEFFS 0.000000 1.000000 0.000000 0.000000 0.000000 1.000000 /end COMPU_METHOD
/* Scalar measurable for DDE 'AIN_NU_MIL_Status'. */
/begin MEASUREMENT AIN_NU_MIL_Status "(not defined)" FLOAT32_IEEE CU_AIN_NU_MIL_STATUS 1 100 0.0 10.0 ECU_ADDRESS 0x40003670 BYTE_ORDER MSB_FIRST /end MEASUREMENT
/begin COMPU_METHOD CU_AIN_NU_MIL_STATUS "Conversion method for AIN_NU_MIL_Status" RAT_FUNC "%10.0" "NU" COEFFS 0.000000 1.000000 0.000000 0.000000 0.000000 1.000000 /end COMPU_METHOD
/* Scalar measurable for DDE 'AIN_NU_TP1_Raw'. */
/begin MEASUREMENT AIN_NU_TP1_Raw "Displayable" FLOAT32_IEEE CU_AIN_NU_TP1_RAW 1 100 0.0 0.0 ECU_ADDRESS 0x4000389c BYTE_ORDER MSB_FIRST /end MEASUREMENT
/begin COMPU_METHOD CU_AIN_NU_TP1_RAW "Conversion method for AIN_NU_TP1_Raw" RAT_FUNC "%10.1" "NU" COEFFS 0.000000 1.000000 0.000000 0.000000 0.000000 1.000000 /end COMPU_METHOD
/* Scalar measurable for DDE 'AIN_NU_TP2_Raw'. */
/begin MEASUREMENT AIN_NU_TP2_Raw "Displayable" FLOAT32_IEEE CU_AIN_NU_TP2_RAW 1 100 0.0 0.0 ECU_ADDRESS 0x40003898 BYTE_ORDER MSB_FIRST /end MEASUREMENT
/begin COMPU_METHOD CU_AIN_NU_TP2_RAW "Conversion method for AIN_NU_TP2_Raw" RAT_FUNC "%10.1" "NU" COEFFS 0.000000 1.000000 0.000000 0.000000 0.000000 1.000000 /end COMPU_METHOD
/* Scalar measurable for DDE 'AIN_V_AmbientTemp'. */
/begin MEASUREMENT AIN_V_AmbientTemp "Analog input value" FLOAT32_IEEE CU_AIN_V_AMBIENTTEMP 1 100 0.0 0.0 ECU_ADDRESS 0x40003968 BYTE_ORDER MSB_FIRST /end MEASUREMENT
/begin COMPU_METHOD CU_AIN_V_AMBIENTTEMP "Conversion method for AIN_V_AmbientTemp" RAT_FUNC "%10.3" "V" COEFFS 0.000000 1.000000 0.000000 0.000000 0.000000 1.000000 /end COMPU_METHOD
/* Scalar measurable for DDE 'AIN_V_Baro'. */
/begin MEASUREMENT AIN_V_Baro "Analog input value" FLOAT32_IEEE CU_AIN_V_BARO 1 100 0.0 0.0 ECU_ADDRESS 0x40003920 BYTE_ORDER MSB_FIRST /end MEASUREMENT
/begin COMPU_METHOD CU_AIN_V_BARO "Conversion method for AIN_V_Baro" RAT_FUNC "%10.3" "V" COEFFS 0.000000 1.000000 0.000000 0.000000 0.000000 1.000000 /end COMPU_METHOD
/* Scalar measurable for DDE 'AIN_V_CoolantTemp'. */
/begin MEASUREMENT AIN_V_CoolantTemp "Analog input value" FLOAT32_IEEE CU_AIN_V_COOLANTTEMP 1 100 0.0 0.0 ECU_ADDRESS 0x400038f8 BYTE_ORDER MSB_FIRST /end MEASUREMENT
/begin COMPU_METHOD CU_AIN_V_COOLANTTEMP "Conversion method for AIN_V_CoolantTemp" RAT_FUNC "%10.3" "V" COEFFS 0.000000 1.000000 0.000000 0.000000 0.000000 1.000000 /end COMPU_METHOD
/* Scalar measurable for DDE 'AIN_V_EGO11'. */
/begin MEASUREMENT AIN_V_EGO11 "Displayable" FLOAT32_IEEE CU_AIN_V_EGO11 1 100 0.0 5.0 ECU_ADDRESS 0x40003878 BYTE_ORDER MSB_FIRST /end MEASUREMENT
/begin COMPU_METHOD CU_AIN_V_EGO11 "Conversion method for AIN_V_EGO11" RAT_FUNC "%10.1" "V" COEFFS 0.000000 1.000000 0.000000 0.000000 0.000000 1.000000 /end COMPU_METHOD
/* Scalar measurable for DDE 'AIN_V_EGO12'. */
/begin MEASUREMENT AIN_V_EGO12 "Displayable" FLOAT32_IEEE CU_AIN_V_EGO12 1 100 0.0 5.0 ECU_ADDRESS 0x40003900 BYTE_ORDER MSB_FIRST /end MEASUREMENT
/begin COMPU_METHOD CU_AIN_V_EGO12 "Conversion method for AIN_V_EGO12" RAT_FUNC "%10.3" "V" COEFFS 0.000000 1.000000 0.000000 0.000000 0.000000 1.000000 /end COMPU_METHOD
/* Scalar measurable for DDE 'AIN_V_EGO21'. */
/begin MEASUREMENT AIN_V_EGO21 "Displayable" FLOAT32_IEEE CU_AIN_V_EGO21 1 100 0.0 5.0 ECU_ADDRESS 0x400038a0 BYTE_ORDER MSB_FIRST /end MEASUREMENT
/begin COMPU_METHOD CU_AIN_V_EGO21 "Conversion method for AIN_V_EGO21" RAT_FUNC "%10.3" "V" COEFFS 0.000000 1.000000 0.000000 0.000000 0.000000 1.000000 /end COMPU_METHOD
/* Scalar measurable for DDE 'AIN_V_EGT'. */
/begin MEASUREMENT AIN_V_EGT "Analog input value" FLOAT32_IEEE CU_AIN_V_EGT 1 100 0.0 5.0 ECU_ADDRESS 0x400038f4 BYTE_ORDER MSB_FIRST /end MEASUREMENT
/begin COMPU_METHOD CU_AIN_V_EGT "Conversion method for AIN_V_EGT" RAT_FUNC "%10.3" "V" COEFFS 0.000000 1.000000 0.000000 0.000000 0.000000 1.000000 /end COMPU_METHOD
/* Scalar measurable for DDE 'AIN_V_ETC_MonA'. */
/begin MEASUREMENT AIN_V_ETC_MonA "Output monitor" FLOAT32_IEEE CU_AIN_V_ETC_MONA 1 100 0.0 0.0 ECU_ADDRESS 0x400037d0 BYTE_ORDER MSB_FIRST /end MEASUREMENT
/begin COMPU_METHOD CU_AIN_V_ETC_MONA "Conversion method for AIN_V_ETC_MonA" RAT_FUNC "%10.2" "V" COEFFS 0.000000 1.000000 0.000000 0.000000 0.000000 1.000000 /end COMPU_METHOD
/* Scalar measurable for DDE 'AIN_V_ETC_MonB'. */
/begin MEASUREMENT AIN_V_ETC_MonB "Output monitor" FLOAT32_IEEE CU_AIN_V_ETC_MONB 1 100 0.0 0.0 ECU_ADDRESS 0x400037c0 BYTE_ORDER MSB_FIRST /end MEASUREMENT
/begin COMPU_METHOD CU_AIN_V_ETC_MONB "Conversion method for AIN_V_ETC_MonB" RAT_FUNC "%10.2" "V" COEFFS 0.000000 1.000000 0.000000 0.000000 0.000000 1.000000 /end COMPU_METHOD
/* Scalar measurable for DDE 'AIN_V_FAPRaw'. */
/begin MEASUREMENT AIN_V_FAPRaw "Displayable" FLOAT32_IEEE CU_AIN_V_FAPRAW 1 100 0.0 5.0 ECU_ADDRESS 0x400038f0 BYTE_ORDER MSB_FIRST /end MEASUREMENT
/begin COMPU_METHOD CU_AIN_V_FAPRAW "Conversion method for AIN_V_FAPRaw" RAT_FUNC "%10.3" "V" COEFFS 0.000000 1.000000 0.000000 0.000000 0.000000 1.000000 /end COMPU_METHOD
/* Scalar measurable for DDE 'AIN_V_FCV_Mon'. */
/begin MEASUREMENT AIN_V_FCV_Mon "Output monitor" FLOAT32_IEEE CU_AIN_V_FCV_MON 1 100 0.0 0.0 ECU_ADDRESS 0x400037bc BYTE_ORDER MSB_FIRST /end MEASUREMENT
/begin COMPU_METHOD CU_AIN_V_FCV_MON "Conversion method for AIN_V_FCV_Mon" RAT_FUNC "%10.2" "V" COEFFS 0.000000 1.000000 0.000000 0.000000 0.000000 1.000000 /end COMPU_METHOD
/* Scalar measurable for DDE 'AIN_V_FiltUA_A'. */
/begin MEASUREMENT AIN_V_FiltUA_A "lambda AIN filtered" FLOAT32_IEEE CU_AIN_V_FILTUA_A 1 100 0.0 0.0 ECU_ADDRESS 0x40003108 BYTE_ORDER MSB_FIRST /end MEASUREMENT
/begin COMPU_METHOD CU_AIN_V_FILTUA_A "Conversion method for AIN_V_FiltUA_A" RAT_FUNC "%10.3" "V" COEFFS 0.000000 1.000000 0.000000 0.000000 0.000000 1.000000 /end COMPU_METHOD
/* Scalar measurable for DDE 'AIN_V_FiltUA_B'. */
/begin MEASUREMENT AIN_V_FiltUA_B "lambda AIN filtered" FLOAT32_IEEE CU_AIN_V_FILTUA_B 1 100 0.0 0.0 ECU_ADDRESS 0x40003138 BYTE_ORDER MSB_FIRST /end MEASUREMENT
/begin COMPU_METHOD CU_AIN_V_FILTUA_B "Conversion method for AIN_V_FiltUA_B" RAT_FUNC "%10.3" "V" COEFFS 0.000000 1.000000 0.000000 0.000000 0.000000 1.000000 /end COMPU_METHOD
/* Scalar measurable for DDE 'AIN_V_FiltUR_A'. */
/begin MEASUREMENT AIN_V_FiltUR_A "sensor temperature AIN filtered" FLOAT32_IEEE CU_AIN_V_FILTUR_A 1 100 0.0 0.0 ECU_ADDRESS 0x40003100 BYTE_ORDER MSB_FIRST /end MEASUREMENT
/begin COMPU_METHOD CU_AIN_V_FILTUR_A "Conversion method for AIN_V_FiltUR_A" RAT_FUNC "%10.3" "V" COEFFS 0.000000 1.000000 0.000000 0.000000 0.000000 1.000000 /end COMPU_METHOD
/* Scalar measurable for DDE 'AIN_V_FiltUR_B'. */
/begin MEASUREMENT AIN_V_FiltUR_B "sensor temperature AIN filtered" FLOAT32_IEEE CU_AIN_V_FILTUR_B 1 100 0.0 0.0 ECU_ADDRESS 0x40003130 BYTE_ORDER MSB_FIRST /end MEASUREMENT
/begin COMPU_METHOD CU_AIN_V_FILTUR_B "Conversion method for AIN_V_FiltUR_B" RAT_FUNC "%10.3" "V" COEFFS 0.000000 1.000000 0.000000 0.000000 0.000000 1.000000 /end COMPU_METHOD
/* Scalar measurable for DDE 'AIN_V_FuelPressRaw'. */
/begin MEASUREMENT AIN_V_FuelPressRaw "Analog input value" FLOAT32_IEEE CU_AIN_V_FUELPRESSRAW 1 100 0.0 5.0 ECU_ADDRESS 0x400038ec BYTE_ORDER MSB_FIRST /end MEASUREMENT
/begin COMPU_METHOD CU_AIN_V_FUELPRESSRAW "Conversion method for AIN_V_FuelPressRaw" RAT_FUNC "%10.3" "V" COEFFS 0.000000 1.000000 0.000000 0.000000 0.000000 1.000000 /end COMPU_METHOD
/* Scalar measurable for DDE 'AIN_V_FuelTempRaw'. */
/begin MEASUREMENT AIN_V_FuelTempRaw "Analog input value" FLOAT32_IEEE CU_AIN_V_FUELTEMPRAW 1 100 0.0 0.0 ECU_ADDRESS 0x400038e8 BYTE_ORDER MSB_FIRST /end MEASUREMENT
/begin COMPU_METHOD CU_AIN_V_FUELTEMPRAW "Conversion method for AIN_V_FuelTempRaw" RAT_FUNC "%10.3" "V" COEFFS 0.000000 1.000000 0.000000 0.000000 0.000000 1.000000 /end COMPU_METHOD
/* Scalar measurable for DDE 'AIN_V_Highside'. */
/begin MEASUREMENT AIN_V_Highside "Output monitor" FLOAT32_IEEE CU_AIN_V_HIGHSIDE 1 100 0.0 0.0 ECU_ADDRESS 0x400037a4 BYTE_ORDER MSB_FIRST /end MEASUREMENT
/begin COMPU_METHOD CU_AIN_V_HIGHSIDE "Conversion method for AIN_V_Highside" RAT_FUNC "%10.2" "V" COEFFS 0.000000 1.000000 0.000000 0.000000 0.000000 1.000000 /end COMPU_METHOD
/* Scalar measurable for DDE 'AIN_V_KnockSignalCyl1'. */
/begin MEASUREMENT AIN_V_KnockSignalCyl1 "Analog input value" FLOAT32_IEEE CU_AIN_V_KNOCKSIGNALCYL1 1 100 0.0 5.0 ECU_ADDRESS 0x400038c4 BYTE_ORDER MSB_FIRST /end MEASUREMENT
/begin COMPU_METHOD CU_AIN_V_KNOCKSIGNALCYL1 "Conversion method for AIN_V_KnockSignalCyl1" RAT_FUNC "%10.3" "V" COEFFS 0.000000 1.000000 0.000000 0.000000 0.000000 1.000000 /end COMPU_METHOD
/* Scalar measurable for DDE 'AIN_V_MAP_BeforeThro'. */
/begin MEASUREMENT AIN_V_MAP_BeforeThro "Analog input value" FLOAT32_IEEE CU_AIN_V_MAP_BEFORETHRO 1 100 0.0 0.0 ECU_ADDRESS 0x400038a8 BYTE_ORDER MSB_FIRST /end MEASUREMENT
/begin COMPU_METHOD CU_AIN_V_MAP_BEFORETHRO "Conversion method for AIN_V_MAP_BeforeThro" RAT_FUNC "%10.3" "V" COEFFS 0.000000 1.000000 0.000000 0.000000 0.000000 1.000000 /end COMPU_METHOD
/* Scalar measurable for DDE 'AIN_V_MAP_Raw'. */
/begin MEASUREMENT AIN_V_MAP_Raw "Raw value" FLOAT32_IEEE CU_AIN_V_MAP_RAW 1 100 0.0 0.0 ECU_ADDRESS 0x40003924 BYTE_ORDER MSB_FIRST /end MEASUREMENT
/begin COMPU_METHOD CU_AIN_V_MAP_RAW "Conversion method for AIN_V_MAP_Raw" RAT_FUNC "%10.3" "V" COEFFS 0.000000 1.000000 0.000000 0.000000 0.000000 1.000000 /end COMPU_METHOD
/* Scalar measurable for DDE 'AIN_V_MAP_Sample1'. */
/begin MEASUREMENT AIN_V_MAP_Sample1 "Raw value sampled in angular domain" FLOAT32_IEEE CU_AIN_V_MAP_SAMPLE1 1 100 0.0 0.0 ECU_ADDRESS 0x40003964 BYTE_ORDER MSB_FIRST /end MEASUREMENT
/begin COMPU_METHOD CU_AIN_V_MAP_SAMPLE1 "Conversion method for AIN_V_MAP_Sample1" RAT_FUNC "%10.3" "V" COEFFS 0.000000 1.000000 0.000000 0.000000 0.000000 1.000000 /end COMPU_METHOD
/* Scalar measurable for DDE 'AIN_V_MAP_Sample10'. */
/begin MEASUREMENT AIN_V_MAP_Sample10 "Raw value sampled in angular domain" FLOAT32_IEEE CU_AIN_V_MAP_SAMPLE10 1 100 0.0 0.0 ECU_ADDRESS 0x40003928 BYTE_ORDER MSB_FIRST /end MEASUREMENT
/begin COMPU_METHOD CU_AIN_V_MAP_SAMPLE10 "Conversion method for AIN_V_MAP_Sample10" RAT_FUNC "%10.3" "V" COEFFS 0.000000 1.000000 0.000000 0.000000 0.000000 1.000000 /end COMPU_METHOD
/* Scalar measurable for DDE 'AIN_V_MAP_Sample11'. */
/begin MEASUREMENT AIN_V_MAP_Sample11 "Raw value sampled in angular domain" FLOAT32_IEEE CU_AIN_V_MAP_SAMPLE11 1 100 0.0 0.0 ECU_ADDRESS 0x4000395c BYTE_ORDER MSB_FIRST /end MEASUREMENT
/begin COMPU_METHOD CU_AIN_V_MAP_SAMPLE11 "Conversion method for AIN_V_MAP_Sample11" RAT_FUNC "%10.3" "V" COEFFS 0.000000 1.000000 0.000000 0.000000 0.000000 1.000000 /end COMPU_METHOD
/* Scalar measurable for DDE 'AIN_V_MAP_Sample12'. */
/begin MEASUREMENT AIN_V_MAP_Sample12 "Raw value sampled in angular domain" FLOAT32_IEEE CU_AIN_V_MAP_SAMPLE12 1 100 0.0 0.0 ECU_ADDRESS 0x40003958 BYTE_ORDER MSB_FIRST /end MEASUREMENT
/begin COMPU_METHOD CU_AIN_V_MAP_SAMPLE12 "Conversion method for AIN_V_MAP_Sample12" RAT_FUNC "%10.3" "V" COEFFS 0.000000 1.000000 0.000000 0.000000 0.000000 1.000000 /end COMPU_METHOD
/* Scalar measurable for DDE 'AIN_V_MAP_Sample13'. */
/begin MEASUREMENT AIN_V_MAP_Sample13 "Raw value sampled in angular domain" FLOAT32_IEEE CU_AIN_V_MAP_SAMPLE13 1 100 0.0 0.0 ECU_ADDRESS 0x40003954 BYTE_ORDER MSB_FIRST /end MEASUREMENT
/begin COMPU_METHOD CU_AIN_V_MAP_SAMPLE13 "Conversion method for AIN_V_MAP_Sample13" RAT_FUNC "%10.3" "V" COEFFS 0.000000 1.000000 0.000000 0.000000 0.000000 1.000000 /end COMPU_METHOD
/* Scalar measurable for DDE 'AIN_V_MAP_Sample14'. */
/begin MEASUREMENT AIN_V_MAP_Sample14 "Raw value sampled in angular domain" FLOAT32_IEEE CU_AIN_V_MAP_SAMPLE14 1 100 0.0 0.0 ECU_ADDRESS 0x40003950 BYTE_ORDER MSB_FIRST /end MEASUREMENT
/begin COMPU_METHOD CU_AIN_V_MAP_SAMPLE14 "Conversion method for AIN_V_MAP_Sample14" RAT_FUNC "%10.3" "V" COEFFS 0.000000 1.000000 0.000000 0.000000 0.000000 1.000000 /end COMPU_METHOD
/* Scalar measurable for DDE 'AIN_V_MAP_Sample15'. */
/begin MEASUREMENT AIN_V_MAP_Sample15 "Raw value sampled in angular domain" FLOAT32_IEEE CU_AIN_V_MAP_SAMPLE15 1 100 0.0 0.0 ECU_ADDRESS 0x4000394c BYTE_ORDER MSB_FIRST /end MEASUREMENT
/begin COMPU_METHOD CU_AIN_V_MAP_SAMPLE15 "Conversion method for AIN_V_MAP_Sample15" RAT_FUNC "%10.3" "V" COEFFS 0.000000 1.000000 0.000000 0.000000 0.000000 1.000000 /end COMPU_METHOD
/* Scalar measurable for DDE 'AIN_V_MAP_Sample16'. */
/begin MEASUREMENT AIN_V_MAP_Sample16 "Raw value sampled in angular domain" FLOAT32_IEEE CU_AIN_V_MAP_SAMPLE16 1 100 0.0 0.0 ECU_ADDRESS 0x40003948 BYTE_ORDER MSB_FIRST /end MEASUREMENT
/begin COMPU_METHOD CU_AIN_V_MAP_SAMPLE16 "Conversion method for AIN_V_MAP_Sample16" RAT_FUNC "%10.3" "V" COEFFS 0.000000 1.000000 0.000000 0.000000 0.000000 1.000000 /end COMPU_METHOD
/* Scalar measurable for DDE 'AIN_V_MAP_Sample2'. */
/begin MEASUREMENT AIN_V_MAP_Sample2 "Raw value sampled in angular domain" FLOAT32_IEEE CU_AIN_V_MAP_SAMPLE2 1 100 0.0 0.0 ECU_ADDRESS 0x40003960 BYTE_ORDER MSB_FIRST /end MEASUREMENT
/begin COMPU_METHOD CU_AIN_V_MAP_SAMPLE2 "Conversion method for AIN_V_MAP_Sample2" RAT_FUNC "%10.3" "V" COEFFS 0.000000 1.000000 0.000000 0.000000 0.000000 1.000000 /end COMPU_METHOD
/* Scalar measurable for DDE 'AIN_V_MAP_Sample3'. */
/begin MEASUREMENT AIN_V_MAP_Sample3 "Raw value sampled in angular domain" FLOAT32_IEEE CU_AIN_V_MAP_SAMPLE3 1 100 0.0 0.0 ECU_ADDRESS 0x40003944 BYTE_ORDER MSB_FIRST /end MEASUREMENT
/begin COMPU_METHOD CU_AIN_V_MAP_SAMPLE3 "Conversion method for AIN_V_MAP_Sample3" RAT_FUNC "%10.3" "V" COEFFS 0.000000 1.000000 0.000000 0.000000 0.000000 1.000000 /end COMPU_METHOD
/* Scalar measurable for DDE 'AIN_V_MAP_Sample4'. */
/begin MEASUREMENT AIN_V_MAP_Sample4 "Raw value sampled in angular domain" FLOAT32_IEEE CU_AIN_V_MAP_SAMPLE4 1 100 0.0 0.0 ECU_ADDRESS 0x40003940 BYTE_ORDER MSB_FIRST /end MEASUREMENT
/begin COMPU_METHOD CU_AIN_V_MAP_SAMPLE4 "Conversion method for AIN_V_MAP_Sample4" RAT_FUNC "%10.3" "V" COEFFS 0.000000 1.000000 0.000000 0.000000 0.000000 1.000000 /end COMPU_METHOD
/* Scalar measurable for DDE 'AIN_V_MAP_Sample5'. */
/begin MEASUREMENT AIN_V_MAP_Sample5 "Raw value sampled in angular domain" FLOAT32_IEEE CU_AIN_V_MAP_SAMPLE5 1 100 0.0 0.0 ECU_ADDRESS 0x4000393c BYTE_ORDER MSB_FIRST /end MEASUREMENT
/begin COMPU_METHOD CU_AIN_V_MAP_SAMPLE5 "Conversion method for AIN_V_MAP_Sample5" RAT_FUNC "%10.3" "V" COEFFS 0.000000 1.000000 0.000000 0.000000 0.000000 1.000000 /end COMPU_METHOD
/* Scalar measurable for DDE 'AIN_V_MAP_Sample6'. */
/begin MEASUREMENT AIN_V_MAP_Sample6 "Raw value sampled in angular domain" FLOAT32_IEEE CU_AIN_V_MAP_SAMPLE6 1 100 0.0 0.0 ECU_ADDRESS 0x40003938 BYTE_ORDER MSB_FIRST /end MEASUREMENT
/begin COMPU_METHOD CU_AIN_V_MAP_SAMPLE6 "Conversion method for AIN_V_MAP_Sample6" RAT_FUNC "%10.3" "V" COEFFS 0.000000 1.000000 0.000000 0.000000 0.000000 1.000000 /end COMPU_METHOD
/* Scalar measurable for DDE 'AIN_V_MAP_Sample7'. */
/begin MEASUREMENT AIN_V_MAP_Sample7 "Raw value sampled in angular domain" FLOAT32_IEEE CU_AIN_V_MAP_SAMPLE7 1 100 0.0 0.0 ECU_ADDRESS 0x40003934 BYTE_ORDER MSB_FIRST /end MEASUREMENT
/begin COMPU_METHOD CU_AIN_V_MAP_SAMPLE7 "Conversion method for AIN_V_MAP_Sample7" RAT_FUNC "%10.3" "V" COEFFS 0.000000 1.000000 0.000000 0.000000 0.000000 1.000000 /end COMPU_METHOD
/* Scalar measurable for DDE 'AIN_V_MAP_Sample8'. */
/begin MEASUREMENT AIN_V_MAP_Sample8 "Raw value sampled in angular domain" FLOAT32_IEEE CU_AIN_V_MAP_SAMPLE8 1 100 0.0 0.0 ECU_ADDRESS 0x40003930 BYTE_ORDER MSB_FIRST /end MEASUREMENT
/begin COMPU_METHOD CU_AIN_V_MAP_SAMPLE8 "Conversion method for AIN_V_MAP_Sample8" RAT_FUNC "%10.3" "V" COEFFS 0.000000 1.000000 0.000000 0.000000 0.000000 1.000000 /end COMPU_METHOD
/* Scalar measurable for DDE 'AIN_V_MAP_Sample9'. */
/begin MEASUREMENT AIN_V_MAP_Sample9 "Raw value sampled in angular domain" FLOAT32_IEEE CU_AIN_V_MAP_SAMPLE9 1 100 0.0 0.0 ECU_ADDRESS 0x4000392c BYTE_ORDER MSB_FIRST /end MEASUREMENT
/begin COMPU_METHOD CU_AIN_V_MAP_SAMPLE9 "Conversion method for AIN_V_MAP_Sample9" RAT_FUNC "%10.3" "V" COEFFS 0.000000 1.000000 0.000000 0.000000 0.000000 1.000000 /end COMPU_METHOD
/* Scalar measurable for DDE 'AIN_V_ManifoldTemp'. */
/begin MEASUREMENT AIN_V_ManifoldTemp "Analog input value" FLOAT32_IEEE CU_AIN_V_MANIFOLDTEMP 1 100 -40.0 120.0 ECU_ADDRESS 0x400038c8 BYTE_ORDER MSB_FIRST /end MEASUREMENT
/begin COMPU_METHOD CU_AIN_V_MANIFOLDTEMP "Conversion method for AIN_V_ManifoldTemp" RAT_FUNC "%10.3" "V" COEFFS 0.000000 1.000000 0.000000 0.000000 0.000000 1.000000 /end COMPU_METHOD
/* Scalar measurable for DDE 'AIN_V_TP1'. */
/begin MEASUREMENT AIN_V_TP1 "Raw value" FLOAT32_IEEE CU_AIN_V_TP1 1 100 0.0 0.0 ECU_ADDRESS 0x400038b0 BYTE_ORDER MSB_FIRST /end MEASUREMENT
/begin COMPU_METHOD CU_AIN_V_TP1 "Conversion method for AIN_V_TP1" RAT_FUNC "%10.3" "V" COEFFS 0.000000 1.000000 0.000000 0.000000 0.000000 1.000000 /end COMPU_METHOD
/* Scalar measurable for DDE 'AIN_V_TP2'. */
/begin MEASUREMENT AIN_V_TP2 "Raw value" FLOAT32_IEEE CU_AIN_V_TP2 1 100 0.0 0.0 ECU_ADDRESS 0x400038ac BYTE_ORDER MSB_FIRST /end MEASUREMENT
/begin COMPU_METHOD CU_AIN_V_TP2 "Conversion method for AIN_V_TP2" RAT_FUNC "%10.3" "V" COEFFS 0.000000 1.000000 0.000000 0.000000 0.000000 1.000000 /end COMPU_METHOD
/* Scalar measurable for DDE 'AIN_V_UA_A'. */
/begin MEASUREMENT AIN_V_UA_A "lambda AIN unfiltered" FLOAT32_IEEE CU_AIN_V_UA_A 1 100 0.0 0.0 ECU_ADDRESS 0x400030cc BYTE_ORDER MSB_FIRST /end MEASUREMENT
/begin COMPU_METHOD CU_AIN_V_UA_A "Conversion method for AIN_V_UA_A" RAT_FUNC "%10.3" "V" COEFFS 0.000000 1.000000 0.000000 0.000000 0.000000 1.000000 /end COMPU_METHOD
/* Scalar measurable for DDE 'AIN_V_UA_B'. */
/begin MEASUREMENT AIN_V_UA_B "lambda AIN unfiltered" FLOAT32_IEEE CU_AIN_V_UA_B 1 100 0.0 0.0 ECU_ADDRESS 0x400030d8 BYTE_ORDER MSB_FIRST /end MEASUREMENT
/begin COMPU_METHOD CU_AIN_V_UA_B "Conversion method for AIN_V_UA_B" RAT_FUNC "%10.3" "V" COEFFS 0.000000 1.000000 0.000000 0.000000 0.000000 1.000000 /end COMPU_METHOD
/* Scalar measurable for DDE 'AIN_V_UR_A'. */
/begin MEASUREMENT AIN_V_UR_A "sensor temperature AIN unfiltered" FLOAT32_IEEE CU_AIN_V_UR_A 1 100 0.0 0.0 ECU_ADDRESS 0x400030c8 BYTE_ORDER MSB_FIRST /end MEASUREMENT
/begin COMPU_METHOD CU_AIN_V_UR_A "Conversion method for AIN_V_UR_A" RAT_FUNC "%10.3" "V" COEFFS 0.000000 1.000000 0.000000 0.000000 0.000000 1.000000 /end COMPU_METHOD
/* Scalar measurable for DDE 'AIN_V_UR_B'. */
/begin MEASUREMENT AIN_V_UR_B "sensor temperature AIN unfiltered" FLOAT32_IEEE CU_AIN_V_UR_B 1 100 0.0 0.0 ECU_ADDRESS 0x400030d4 BYTE_ORDER MSB_FIRST /end MEASUREMENT
/begin COMPU_METHOD CU_AIN_V_UR_B "Conversion method for AIN_V_UR_B" RAT_FUNC "%10.3" "V" COEFFS 0.000000 1.000000 0.000000 0.000000 0.000000 1.000000 /end COMPU_METHOD
/* Scalar measurable for DDE 'AIN_V_VBatt'. */
/begin MEASUREMENT AIN_V_VBatt "Displayable" FLOAT32_IEEE CU_AIN_V_VBATT 1 100 0.0 0.0 ECU_ADDRESS 0x40003910 BYTE_ORDER MSB_FIRST /end MEASUREMENT
/begin COMPU_METHOD CU_AIN_V_VBATT "Conversion method for AIN_V_VBatt" RAT_FUNC "%10.1" "V" COEFFS 0.000000 1.000000 0.000000 0.000000 0.000000 1.000000 /end COMPU_METHOD
/* Scalar measurable for DDE 'AIN_V_VBattRaw'. */
/begin MEASUREMENT AIN_V_VBattRaw "Displayable" FLOAT32_IEEE CU_AIN_V_VBATTRAW 1 100 0.0 0.0 ECU_ADDRESS 0x40003914 BYTE_ORDER MSB_FIRST /end MEASUREMENT
/begin COMPU_METHOD CU_AIN_V_VBATTRAW "Conversion method for AIN_V_VBattRaw" RAT_FUNC "%10.3" "V" COEFFS 0.000000 1.000000 0.000000 0.000000 0.000000 1.000000 /end COMPU_METHOD
/* Scalar measurable for DDE 'AIN_V_VRefA'. */
/begin MEASUREMENT AIN_V_VRefA "Output monitor" FLOAT32_IEEE CU_AIN_V_VREFA 1 100 0.0 0.0 ECU_ADDRESS 0x400037dc BYTE_ORDER MSB_FIRST /end MEASUREMENT
/begin COMPU_METHOD CU_AIN_V_VREFA "Conversion method for AIN_V_VRefA" RAT_FUNC "%10.2" "V" COEFFS 0.000000 1.000000 0.000000 0.000000 0.000000 1.000000 /end COMPU_METHOD
/* Scalar measurable for DDE 'AIN_V_VRefB'. */
/begin MEASUREMENT AIN_V_VRefB "Output monitor" FLOAT32_IEEE CU_AIN_V_VREFB 1 100 0.0 0.0 ECU_ADDRESS 0x400037e0 BYTE_ORDER MSB_FIRST /end MEASUREMENT
/begin COMPU_METHOD CU_AIN_V_VREFB "Conversion method for AIN_V_VRefB" RAT_FUNC "%10.2" "V" COEFFS 0.000000 1.000000 0.000000 0.000000 0.000000 1.000000 /end COMPU_METHOD
/* Scalar measurable for DDE 'AIN_V_VRefC'. */
/begin MEASUREMENT AIN_V_VRefC "Output monitor" FLOAT32_IEEE CU_AIN_V_VREFC 1 100 0.0 0.0 ECU_ADDRESS 0x400037d8 BYTE_ORDER MSB_FIRST /end MEASUREMENT
/begin COMPU_METHOD CU_AIN_V_VREFC "Conversion method for AIN_V_VRefC" RAT_FUNC "%10.2" "V" COEFFS 0.000000 1.000000 0.000000 0.000000 0.000000 1.000000 /end COMPU_METHOD
/* Scalar measurable for DDE 'AIN_V_VRefD'. */
/begin MEASUREMENT AIN_V_VRefD "Output monitor" FLOAT32_IEEE CU_AIN_V_VREFD 1 100 0.0 0.0 ECU_ADDRESS 0x400037d4 BYTE_ORDER MSB_FIRST /end MEASUREMENT
/begin COMPU_METHOD CU_AIN_V_VREFD "Conversion method for AIN_V_VRefD" RAT_FUNC "%10.2" "V" COEFFS 0.000000 1.000000 0.000000 0.000000 0.000000 1.000000 /end COMPU_METHOD
/* Scalar measurable for DDE 'AIN_V_XL1_Mon'. */
/begin MEASUREMENT AIN_V_XL1_Mon "Output monitor" FLOAT32_IEEE CU_AIN_V_XL1_MON 1 100 0.0 0.0 ECU_ADDRESS 0x400037cc BYTE_ORDER MSB_FIRST /end MEASUREMENT
/begin COMPU_METHOD CU_AIN_V_XL1_MON "Conversion method for AIN_V_XL1_Mon" RAT_FUNC "%10.2" "V" COEFFS 0.000000 1.000000 0.000000 0.000000 0.000000 1.000000 /end COMPU_METHOD
/* Scalar measurable for DDE 'AIN_V_XM1_Mon'. */
/begin MEASUREMENT AIN_V_XM1_Mon "Output monitor" FLOAT32_IEEE CU_AIN_V_XM1_MON 1 100 0.0 0.0 ECU_ADDRESS 0x400037c8 BYTE_ORDER MSB_FIRST /end MEASUREMENT
/begin COMPU_METHOD CU_AIN_V_XM1_MON "Conversion method for AIN_V_XM1_Mon" RAT_FUNC "%10.2" "V" COEFFS 0.000000 1.000000 0.000000 0.000000 0.000000 1.000000 /end COMPU_METHOD
/* Scalar measurable for DDE 'AIN_V_Y29_Mon'. */
/begin MEASUREMENT AIN_V_Y29_Mon "Output monitor" FLOAT32_IEEE CU_AIN_V_Y29_MON 1 100 0.0 0.0 ECU_ADDRESS 0x400037b8 BYTE_ORDER MSB_FIRST /end MEASUREMENT
/begin COMPU_METHOD CU_AIN_V_Y29_MON "Conversion method for AIN_V_Y29_Mon" RAT_FUNC "%10.2" "V" COEFFS 0.000000 1.000000 0.000000 0.000000 0.000000 1.000000 /end COMPU_METHOD
/* Scalar measurable for DDE 'AIN_V_Y41_Mon'. */
/begin MEASUREMENT AIN_V_Y41_Mon "Output monitor" FLOAT32_IEEE CU_AIN_V_Y41_MON 1 100 0.0 0.0 ECU_ADDRESS 0x400037b4 BYTE_ORDER MSB_FIRST /end MEASUREMENT
/begin COMPU_METHOD CU_AIN_V_Y41_MON "Conversion method for AIN_V_Y41_Mon" RAT_FUNC "%10.2" "V" COEFFS 0.000000 1.000000 0.000000 0.000000 0.000000 1.000000 /end COMPU_METHOD
/* Scalar measurable for DDE 'AIN_V_Y42_Mon'. */
/begin MEASUREMENT AIN_V_Y42_Mon "Output monitor" FLOAT32_IEEE CU_AIN_V_Y42_MON 1 100 0.0 0.0 ECU_ADDRESS 0x400037c4 BYTE_ORDER MSB_FIRST /end MEASUREMENT
/begin COMPU_METHOD CU_AIN_V_Y42_MON "Conversion method for AIN_V_Y42_Mon" RAT_FUNC "%10.2" "V" COEFFS 0.000000 1.000000 0.000000 0.000000 0.000000 1.000000 /end COMPU_METHOD
/* Scalar measurable for DDE 'AIN_V_Y6_Mon'. */
/begin MEASUREMENT AIN_V_Y6_Mon "Output monitor" FLOAT32_IEEE CU_AIN_V_Y6_MON 1 100 0.0 0.0 ECU_ADDRESS 0x4000390c BYTE_ORDER MSB_FIRST /end MEASUREMENT
/begin COMPU_METHOD CU_AIN_V_Y6_MON "Conversion method for AIN_V_Y6_Mon" RAT_FUNC "%10.2" "V" COEFFS 0.000000 1.000000 0.000000 0.000000 0.000000 1.000000 /end COMPU_METHOD
/* Scalar measurable for DDE 'AIN_adv_KnockWinStartAngA'. */
/begin MEASUREMENT AIN_adv_KnockWinStartAngA "Cyl1357 displayble" FLOAT32_IEEE CU_AIN_ADV_KNOCKWINSTARTANGA 1 100 0.0 0.0 ECU_ADDRESS 0x400038c0 BYTE_ORDER MSB_FIRST /end MEASUREMENT
/begin COMPU_METHOD CU_AIN_ADV_KNOCKWINSTARTANGA "Conversion method for AIN_adv_KnockWinStartAngA" RAT_FUNC "%10.1" "adv" COEFFS 0.000000 1.000000 0.000000 0.000000 0.000000 1.000000 /end COMPU_METHOD
/* Scalar measurable for DDE 'AIN_adv_KnockWinStopAngA'. */
/begin MEASUREMENT AIN_adv_KnockWinStopAngA "Cyl1357 displayble" FLOAT32_IEEE CU_AIN_ADV_KNOCKWINSTOPANGA 1 100 0.0 0.0 ECU_ADDRESS 0x400038bc BYTE_ORDER MSB_FIRST /end MEASUREMENT
/begin COMPU_METHOD CU_AIN_ADV_KNOCKWINSTOPANGA "Conversion method for AIN_adv_KnockWinStopAngA" RAT_FUNC "%10.1" "adv" COEFFS 0.000000 1.000000 0.000000 0.000000 0.000000 1.000000 /end COMPU_METHOD
/* Scalar measurable for DDE 'AIN_b_APP1_Valid'. */
/begin MEASUREMENT AIN_b_APP1_Valid "Displayable" UBYTE CU_AIN_B_APP1_VALID 1 100 0.0 1.0 ECU_ADDRESS 0x40002f84 BYTE_ORDER MSB_FIRST /end MEASUREMENT
/begin COMPU_METHOD CU_AIN_B_APP1_VALID "Conversion method for AIN_b_APP1_Valid" RAT_FUNC "%10.0" "b" COEFFS 0.000000 1.000000 0.000000 0.000000 0.000000 1.000000 /end COMPU_METHOD
/* Scalar measurable for DDE 'AIN_b_APP2_Valid'. */
/begin MEASUREMENT AIN_b_APP2_Valid "Displayable" UBYTE CU_AIN_B_APP2_VALID 1 100 0.0 1.0 ECU_ADDRESS 0x40002f85 BYTE_ORDER MSB_FIRST /end MEASUREMENT
/begin COMPU_METHOD CU_AIN_B_APP2_VALID "Conversion method for AIN_b_APP2_Valid" RAT_FUNC "%10.0" "b" COEFFS 0.000000 1.000000 0.000000 0.000000 0.000000 1.000000 /end COMPU_METHOD
/* Scalar measurable for DDE 'AIN_b_AmbientTemp_Fault'. */
/begin MEASUREMENT AIN_b_AmbientTemp_Fault "Displayable" UBYTE CU_AIN_B_AMBIENTTEMP_FAULT 1 100 0.0 1.0 ECU_ADDRESS 0x40002fcc BYTE_ORDER MSB_FIRST /end MEASUREMENT
/begin COMPU_METHOD CU_AIN_B_AMBIENTTEMP_FAULT "Conversion method for AIN_b_AmbientTemp_Fault" RAT_FUNC "%10.0" "b" COEFFS 0.000000 1.000000 0.000000 0.000000 0.000000 1.000000 /end COMPU_METHOD
/* Scalar measurable for DDE 'AIN_b_Baro_Fault'. */
/begin MEASUREMENT AIN_b_Baro_Fault "Displayable" UBYTE CU_AIN_B_BARO_FAULT 1 100 0.0 1.0 ECU_ADDRESS 0x40002fc1 BYTE_ORDER MSB_FIRST /end MEASUREMENT
/begin COMPU_METHOD CU_AIN_B_BARO_FAULT "Conversion method for AIN_b_Baro_Fault" RAT_FUNC "%10.0" "b" COEFFS 0.000000 1.000000 0.000000 0.000000 0.000000 1.000000 /end COMPU_METHOD
/* Scalar measurable for DDE 'AIN_b_CompOutPress_Fault'. */
/begin MEASUREMENT AIN_b_CompOutPress_Fault "Displayable" UBYTE CU_AIN_B_COMPOUTPRESS_FAULT 1 100 0.0 1.0 ECU_ADDRESS 0x40002f86 BYTE_ORDER MSB_FIRST /end MEASUREMENT
/begin COMPU_METHOD CU_AIN_B_COMPOUTPRESS_FAULT "Conversion method for AIN_b_CompOutPress_Fault" RAT_FUNC "%10.0" "b" COEFFS 0.000000 1.000000 0.000000 0.000000 0.000000 1.000000 /end COMPU_METHOD
/* Scalar measurable for DDE 'AIN_b_CoolantTemp_Fault'. */
/begin MEASUREMENT AIN_b_CoolantTemp_Fault "Displayable" UBYTE CU_AIN_B_COOLANTTEMP_FAULT 1 100 0.0 1.0 ECU_ADDRESS 0x40002fb1 BYTE_ORDER MSB_FIRST /end MEASUREMENT
/begin COMPU_METHOD CU_AIN_B_COOLANTTEMP_FAULT "Conversion method for AIN_b_CoolantTemp_Fault" RAT_FUNC "%10.0" "b" COEFFS 0.000000 1.000000 0.000000 0.000000 0.000000 1.000000 /end COMPU_METHOD
/* Scalar measurable for DDE 'AIN_b_DC_start'. */
/begin MEASUREMENT AIN_b_DC_start "Displayable" UBYTE CU_AIN_B_DC_START 1 100 0.0 1.0 ECU_ADDRESS 0x40002f33 BYTE_ORDER MSB_FIRST /end MEASUREMENT
/begin COMPU_METHOD CU_AIN_B_DC_START "Conversion method for AIN_b_DC_start" RAT_FUNC "%10.0" "b" COEFFS 0.000000 1.000000 0.000000 0.000000 0.000000 1.000000 /end COMPU_METHOD
/* Scalar measurable for DDE 'AIN_b_EGT_Fault'. */
/begin MEASUREMENT AIN_b_EGT_Fault "Displayable" UBYTE CU_AIN_B_EGT_FAULT 1 100 0.0 1.0 ECU_ADDRESS 0x40002fad BYTE_ORDER MSB_FIRST /end MEASUREMENT
/begin COMPU_METHOD CU_AIN_B_EGT_FAULT "Conversion method for AIN_b_EGT_Fault" RAT_FUNC "%10.0" "b" COEFFS 0.000000 1.000000 0.000000 0.000000 0.000000 1.000000 /end COMPU_METHOD
/* Scalar measurable for DDE 'AIN_b_Eng_running'. */
/begin MEASUREMENT AIN_b_Eng_running "Displayable" UBYTE CU_AIN_B_ENG_RUNNING 1 100 0.0 1.0 ECU_ADDRESS 0x40002f30 BYTE_ORDER MSB_FIRST /end MEASUREMENT
/begin COMPU_METHOD CU_AIN_B_ENG_RUNNING "Conversion method for AIN_b_Eng_running" RAT_FUNC "%10.0" "b" COEFFS 0.000000 1.000000 0.000000 0.000000 0.000000 1.000000 /end COMPU_METHOD
/* Scalar measurable for DDE 'AIN_b_FuelPress_Fault'. */
/begin MEASUREMENT AIN_b_FuelPress_Fault "Displayable" UBYTE CU_AIN_B_FUELPRESS_FAULT 1 100 0.0 1.0 ECU_ADDRESS 0x40002fa6 BYTE_ORDER MSB_FIRST /end MEASUREMENT
/begin COMPU_METHOD CU_AIN_B_FUELPRESS_FAULT "Conversion method for AIN_b_FuelPress_Fault" RAT_FUNC "%10.0" "b" COEFFS 0.000000 1.000000 0.000000 0.000000 0.000000 1.000000 /end COMPU_METHOD
/* Scalar measurable for DDE 'AIN_b_FuelTemp_Fault'. */
/begin MEASUREMENT AIN_b_FuelTemp_Fault "Displayable" UBYTE CU_AIN_B_FUELTEMP_FAULT 1 100 0.0 1.0 ECU_ADDRESS 0x40002fa1 BYTE_ORDER MSB_FIRST /end MEASUREMENT
/begin COMPU_METHOD CU_AIN_B_FUELTEMP_FAULT "Conversion method for AIN_b_FuelTemp_Fault" RAT_FUNC "%10.0" "b" COEFFS 0.000000 1.000000 0.000000 0.000000 0.000000 1.000000 /end COMPU_METHOD
/* Scalar measurable for DDE 'AIN_b_IC_start'. */
/begin MEASUREMENT AIN_b_IC_start "Displayable" UBYTE CU_AIN_B_IC_START 1 100 0.0 1.0 ECU_ADDRESS 0x40002f31 BYTE_ORDER MSB_FIRST /end MEASUREMENT
/begin COMPU_METHOD CU_AIN_B_IC_START "Conversion method for AIN_b_IC_start" RAT_FUNC "%10.0" "b" COEFFS 0.000000 1.000000 0.000000 0.000000 0.000000 1.000000 /end COMPU_METHOD
/* Scalar measurable for DDE 'AIN_b_ManifoldTemp_Fault'. */
/begin MEASUREMENT AIN_b_ManifoldTemp_Fault "Displayable" UBYTE CU_AIN_B_MANIFOLDTEMP_FAULT 1 100 0.0 1.0 ECU_ADDRESS 0x40002f9b BYTE_ORDER MSB_FIRST /end MEASUREMENT
/begin COMPU_METHOD CU_AIN_B_MANIFOLDTEMP_FAULT "Conversion method for AIN_b_ManifoldTemp_Fault" RAT_FUNC "%10.0" "b" COEFFS 0.000000 1.000000 0.000000 0.000000 0.000000 1.000000 /end COMPU_METHOD
/* Scalar measurable for DDE 'AIN_b_TP1_Fault'. */
/begin MEASUREMENT AIN_b_TP1_Fault "Displayable" UBYTE CU_AIN_B_TP1_FAULT 1 100 0.0 1.0 ECU_ADDRESS 0x40002f8f BYTE_ORDER MSB_FIRST /end MEASUREMENT
/begin COMPU_METHOD CU_AIN_B_TP1_FAULT "Conversion method for AIN_b_TP1_Fault" RAT_FUNC "%10.0" "b" COEFFS 0.000000 1.000000 0.000000 0.000000 0.000000 1.000000 /end COMPU_METHOD
/* Scalar measurable for DDE 'AIN_b_TP2_Fault'. */
/begin MEASUREMENT AIN_b_TP2_Fault "Displayable" UBYTE CU_AIN_B_TP2_FAULT 1 100 0.0 1.0 ECU_ADDRESS 0x40002f8c BYTE_ORDER MSB_FIRST /end MEASUREMENT
/begin COMPU_METHOD CU_AIN_B_TP2_FAULT "Conversion method for AIN_b_TP2_Fault" RAT_FUNC "%10.0" "b" COEFFS 0.000000 1.000000 0.000000 0.000000 0.000000 1.000000 /end COMPU_METHOD
/* Scalar measurable for DDE 'AIN_b_UEGO1_Valid'. */
/begin MEASUREMENT AIN_b_UEGO1_Valid "Displayable" UBYTE CU_AIN_B_UEGO1_VALID 1 100 0.0 1.0 ECU_ADDRESS 0x40002f83 BYTE_ORDER MSB_FIRST /end MEASUREMENT
/begin COMPU_METHOD CU_AIN_B_UEGO1_VALID "Conversion method for AIN_b_UEGO1_Valid" RAT_FUNC "%10.0" "b" COEFFS 0.000000 1.000000 0.000000 0.000000 0.000000 1.000000 /end COMPU_METHOD
/* Scalar measurable for DDE 'AIN_b_UEGO2_Valid'. */
/begin MEASUREMENT AIN_b_UEGO2_Valid "Displayable" UBYTE CU_AIN_B_UEGO2_VALID 1 100 0.0 1.0 ECU_ADDRESS 0x40002f82 BYTE_ORDER MSB_FIRST /end MEASUREMENT
/begin COMPU_METHOD CU_AIN_B_UEGO2_VALID "Conversion method for AIN_b_UEGO2_Valid" RAT_FUNC "%10.0" "b" COEFFS 0.000000 1.000000 0.000000 0.000000 0.000000 1.000000 /end COMPU_METHOD
/* Scalar measurable for DDE 'AIN_b_UsingPeriodic'. */
/begin MEASUREMENT AIN_b_UsingPeriodic "Displayable" UBYTE CU_AIN_B_USINGPERIODIC 1 100 0.0 1.0 ECU_ADDRESS 0x40002fc7 BYTE_ORDER MSB_FIRST /end MEASUREMENT
/begin COMPU_METHOD CU_AIN_B_USINGPERIODIC "Conversion method for AIN_b_UsingPeriodic" RAT_FUNC "%10.0" "b" COEFFS 0.000000 1.000000 0.000000 0.000000 0.000000 1.000000 /end COMPU_METHOD
/* Scalar measurable for DDE 'AIN_b_WU_start'. */
/begin MEASUREMENT AIN_b_WU_start "Displayable" UBYTE CU_AIN_B_WU_START 1 100 0.0 1.0 ECU_ADDRESS 0x40002f32 BYTE_ORDER MSB_FIRST /end MEASUREMENT
/begin COMPU_METHOD CU_AIN_B_WU_START "Conversion method for AIN_b_WU_start" RAT_FUNC "%10.0" "b" COEFFS 0.000000 1.000000 0.000000 0.000000 0.000000 1.000000 /end COMPU_METHOD
/* Scalar measurable for DDE 'AIN_bar_FuelPress'. */
/begin MEASUREMENT AIN_bar_FuelPress "AIN output will be bounded by this range" FLOAT32_IEEE CU_AIN_BAR_FUELPRESS 1 100 0.0 1000.0 ECU_ADDRESS 0x40003848 BYTE_ORDER MSB_FIRST /end MEASUREMENT
/begin COMPU_METHOD CU_AIN_BAR_FUELPRESS "Conversion method for AIN_bar_FuelPress" RAT_FUNC "%10.1" "bar" COEFFS 0.000000 1.000000 0.000000 0.000000 0.000000 1.000000 /end COMPU_METHOD
/* Scalar measurable for DDE 'AIN_cnt_CylIdxA'. */
/begin MEASUREMENT AIN_cnt_CylIdxA "Displayable" UBYTE CU_AIN_CNT_CYLIDXA 1 100 0.0 0.0 ECU_ADDRESS 0x40003024 BYTE_ORDER MSB_FIRST /end MEASUREMENT
/begin COMPU_METHOD CU_AIN_CNT_CYLIDXA "Conversion method for AIN_cnt_CylIdxA" RAT_FUNC "%10.0" "cnt" COEFFS 0.000000 1.000000 0.000000 0.000000 0.000000 1.000000 /end COMPU_METHOD
/* Scalar measurable for DDE 'AIN_cnt_CylIdxB'. */
/begin MEASUREMENT AIN_cnt_CylIdxB "Displayable" UBYTE CU_AIN_CNT_CYLIDXB 1 100 0.0 0.0 ECU_ADDRESS 0x40003023 BYTE_ORDER MSB_FIRST /end MEASUREMENT
/begin COMPU_METHOD CU_AIN_CNT_CYLIDXB "Conversion method for AIN_cnt_CylIdxB" RAT_FUNC "%10.0" "cnt" COEFFS 0.000000 1.000000 0.000000 0.000000 0.000000 1.000000 /end COMPU_METHOD
/* Scalar measurable for DDE 'AIN_cnt_HIP_SPI_Flts'. */
/begin MEASUREMENT AIN_cnt_HIP_SPI_Flts "HIP chip SPI fault counter" ULONG CU_AIN_CNT_HIP_SPI_FLTS 1 100 0.0 0.0 ECU_ADDRESS 0x40003070 BYTE_ORDER MSB_FIRST /end MEASUREMENT
/begin COMPU_METHOD CU_AIN_CNT_HIP_SPI_FLTS "Conversion method for AIN_cnt_HIP_SPI_Flts" RAT_FUNC "%10.0" "cnt" COEFFS 0.000000 1.000000 0.000000 0.000000 0.000000 1.000000 /end COMPU_METHOD
/* Scalar measurable for DDE 'AIN_kPa_Baro'. */
/begin MEASUREMENT AIN_kPa_Baro "Displayable" FLOAT32_IEEE CU_AIN_KPA_BARO 1 100 0.0 0.0 ECU_ADDRESS 0x4000387c BYTE_ORDER MSB_FIRST /end MEASUREMENT
/begin COMPU_METHOD CU_AIN_KPA_BARO "Conversion method for AIN_kPa_Baro" RAT_FUNC "%10.3" "kPa" COEFFS 0.000000 1.000000 0.000000 0.000000 0.000000 1.000000 /end COMPU_METHOD
/* Scalar measurable for DDE 'AIN_kPa_CompOutPress'. */
/begin MEASUREMENT AIN_kPa_CompOutPress "Displayable" FLOAT32_IEEE CU_AIN_KPA_COMPOUTPRESS 1 100 0.0 0.0 ECU_ADDRESS 0x40003854 BYTE_ORDER MSB_FIRST /end MEASUREMENT
/begin COMPU_METHOD CU_AIN_KPA_COMPOUTPRESS "Conversion method for AIN_kPa_CompOutPress" RAT_FUNC "%10.3" "kPa" COEFFS 0.000000 1.000000 0.000000 0.000000 0.000000 1.000000 /end COMPU_METHOD
/* Scalar measurable for DDE 'AIN_kPa_FAP'. */
/begin MEASUREMENT AIN_kPa_FAP "Displayable" FLOAT32_IEEE CU_AIN_KPA_FAP 1 100 0.0 0.0 ECU_ADDRESS 0x400038a4 BYTE_ORDER MSB_FIRST /end MEASUREMENT
/begin COMPU_METHOD CU_AIN_KPA_FAP "Conversion method for AIN_kPa_FAP" RAT_FUNC "%10.1" "kPa" COEFFS 0.000000 1.000000 0.000000 0.000000 0.000000 1.000000 /end COMPU_METHOD
/* Scalar measurable for DDE 'AIN_kPa_MAP'. */
/begin MEASUREMENT AIN_kPa_MAP "Displayable" FLOAT32_IEEE CU_AIN_KPA_MAP 1 100 0.0 0.0 ECU_ADDRESS 0x4000384c BYTE_ORDER MSB_FIRST /end MEASUREMENT
/begin COMPU_METHOD CU_AIN_KPA_MAP "Conversion method for AIN_kPa_MAP" RAT_FUNC "%10.0" "kPa" COEFFS 0.000000 1.000000 0.000000 0.000000 0.000000 1.000000 /end COMPU_METHOD
/* Scalar measurable for DDE 'AIN_kPa_OilPress'. */
/begin MEASUREMENT AIN_kPa_OilPress "Displayable" FLOAT32_IEEE CU_AIN_KPA_OILPRESS 1 100 0.0 1000.0 ECU_ADDRESS 0x40003884 BYTE_ORDER MSB_FIRST /end MEASUREMENT
/begin COMPU_METHOD CU_AIN_KPA_OILPRESS "Conversion method for AIN_kPa_OilPress" RAT_FUNC "%10.3" "kPa" COEFFS 0.000000 1.000000 0.000000 0.000000 0.000000 1.000000 /end COMPU_METHOD
/* Scalar measurable for DDE 'AIN_lam_UEGO1'. */
/begin MEASUREMENT AIN_lam_UEGO1 "Displayable" FLOAT32_IEEE CU_AIN_LAM_UEGO1 1 100 0.0 10.0 ECU_ADDRESS 0x40003868 BYTE_ORDER MSB_FIRST /end MEASUREMENT
/begin COMPU_METHOD CU_AIN_LAM_UEGO1 "Conversion method for AIN_lam_UEGO1" RAT_FUNC "%10.3" "lam" COEFFS 0.000000 1.000000 0.000000 0.000000 0.000000 1.000000 /end COMPU_METHOD
/* Scalar measurable for DDE 'AIN_lam_UEGO2'. */
/begin MEASUREMENT AIN_lam_UEGO2 "Displayable" FLOAT32_IEEE CU_AIN_LAM_UEGO2 1 100 0.0 10.0 ECU_ADDRESS 0x40003864 BYTE_ORDER MSB_FIRST /end MEASUREMENT
/begin COMPU_METHOD CU_AIN_LAM_UEGO2 "Conversion method for AIN_lam_UEGO2" RAT_FUNC "%10.1" "lam" COEFFS 0.000000 1.000000 0.000000 0.000000 0.000000 1.000000 /end COMPU_METHOD
/* Scalar measurable for DDE 'AIN_pct_Cylinder1_Knock'. */
/begin MEASUREMENT AIN_pct_Cylinder1_Knock "Displayable" FLOAT32_IEEE CU_AIN_PCT_CYLINDER1_KNOCK 1 100 0.0 0.0 ECU_ADDRESS 0x4000388c BYTE_ORDER MSB_FIRST /end MEASUREMENT
/begin COMPU_METHOD CU_AIN_PCT_CYLINDER1_KNOCK "Conversion method for AIN_pct_Cylinder1_Knock" RAT_FUNC "%10.2" "pct" COEFFS 0.000000 1.000000 0.000000 0.000000 0.000000 1.000000 /end COMPU_METHOD
/* Scalar measurable for DDE 'AIN_pct_Cylinder2_Knock'. */
/begin MEASUREMENT AIN_pct_Cylinder2_Knock "Displayable" FLOAT32_IEEE CU_AIN_PCT_CYLINDER2_KNOCK 1 100 0.0 0.0 ECU_ADDRESS 0x40003888 BYTE_ORDER MSB_FIRST /end MEASUREMENT
/begin COMPU_METHOD CU_AIN_PCT_CYLINDER2_KNOCK "Conversion method for AIN_pct_Cylinder2_Knock" RAT_FUNC "%10.2" "pct" COEFFS 0.000000 1.000000 0.000000 0.000000 0.000000 1.000000 /end COMPU_METHOD
/* Scalar measurable for DDE 'AIN_pct_Cylinder3_Knock'. */
/begin MEASUREMENT AIN_pct_Cylinder3_Knock "Displayable" FLOAT32_IEEE CU_AIN_PCT_CYLINDER3_KNOCK 1 100 0.0 0.0 ECU_ADDRESS 0x40003894 BYTE_ORDER MSB_FIRST /end MEASUREMENT
/begin COMPU_METHOD CU_AIN_PCT_CYLINDER3_KNOCK "Conversion method for AIN_pct_Cylinder3_Knock" RAT_FUNC "%10.2" "pct" COEFFS 0.000000 1.000000 0.000000 0.000000 0.000000 1.000000 /end COMPU_METHOD
/* Scalar measurable for DDE 'AIN_pct_Cylinder4_Knock'. */
/begin MEASUREMENT AIN_pct_Cylinder4_Knock "Displayable" FLOAT32_IEEE CU_AIN_PCT_CYLINDER4_KNOCK 1 100 0.0 0.0 ECU_ADDRESS 0x40003890 BYTE_ORDER MSB_FIRST /end MEASUREMENT
/begin COMPU_METHOD CU_AIN_PCT_CYLINDER4_KNOCK "Conversion method for AIN_pct_Cylinder4_Knock" RAT_FUNC "%10.2" "pct" COEFFS 0.000000 1.000000 0.000000 0.000000 0.000000 1.000000 /end COMPU_METHOD
/* Scalar measurable for DDE 'AIN_s_DelayLambdas'. */
/begin MEASUREMENT AIN_s_DelayLambdas "Analog input value" FLOAT32_IEEE CU_AIN_S_DELAYLAMBDAS 1 100 0.0 5000.0 ECU_ADDRESS 0x400038fc BYTE_ORDER MSB_FIRST /end MEASUREMENT
/begin COMPU_METHOD CU_AIN_S_DELAYLAMBDAS "Conversion method for AIN_s_DelayLambdas" RAT_FUNC "%10.3" "s" COEFFS 0.000000 1.000000 0.000000 0.000000 0.000000 1.000000 /end COMPU_METHOD
/* Scalar measurable for DDE 'AMB_b_OBDTempOK'. */
/begin MEASUREMENT AMB_b_OBDTempOK "Displayable" UBYTE CU_AMB_B_OBDTEMPOK 1 100 0.0 1.0 ECU_ADDRESS 0x40002f37 BYTE_ORDER MSB_FIRST /end MEASUREMENT
/begin COMPU_METHOD CU_AMB_B_OBDTEMPOK "Conversion method for AMB_b_OBDTempOK" RAT_FUNC "%10.0" "b" COEFFS 0.000000 1.000000 0.000000 0.000000 0.000000 1.000000 /end COMPU_METHOD
/* Scalar measurable for DDE 'AME_C_ChargeTemp'. */
/begin MEASUREMENT AME_C_ChargeTemp "Charge temperature" FLOAT32_IEEE CU_AME_C_CHARGETEMP 1 100 0.0 0.0 ECU_ADDRESS 0x40003648 BYTE_ORDER MSB_FIRST /end MEASUREMENT
/begin COMPU_METHOD CU_AME_C_CHARGETEMP "Conversion method for AME_C_ChargeTemp" RAT_FUNC "%10.0" "C" COEFFS 0.000000 1.000000 0.000000 0.000000 0.000000 1.000000 /end COMPU_METHOD
/* Scalar measurable for DDE 'AME_C_ChargeTempDelta'. */
/begin MEASUREMENT AME_C_ChargeTempDelta "Difference between engine temp and intake manifold air temp (positive when engine is hotter than air)" FLOAT32_IEEE CU_AME_C_CHARGETEMPDELTA 1 100 0.0 0.0 ECU_ADDRESS 0x4000364c BYTE_ORDER MSB_FIRST /end MEASUREMENT
/begin COMPU_METHOD CU_AME_C_CHARGETEMPDELTA "Conversion method for AME_C_ChargeTempDelta" RAT_FUNC "%10.1" "C" COEFFS 0.000000 1.000000 0.000000 0.000000 0.000000 1.000000 /end COMPU_METHOD
/* Scalar measurable for DDE 'AME_b_LearnedBaro'. */
/begin MEASUREMENT AME_b_LearnedBaro "Status flag" UBYTE CU_AME_B_LEARNEDBARO 1 100 0.0 1.0 ECU_ADDRESS 0x40002eb9 BYTE_ORDER MSB_FIRST /end MEASUREMENT
/begin COMPU_METHOD CU_AME_B_LEARNEDBARO "Conversion method for AME_b_LearnedBaro" RAT_FUNC "%10.0" "b" COEFFS 0.000000 1.000000 0.000000 0.000000 0.000000 1.000000 /end COMPU_METHOD
/* Scalar measurable for DDE 'AME_b_Transient'. */
/begin MEASUREMENT AME_b_Transient "AME transient detected" UBYTE CU_AME_B_TRANSIENT 1 100 0.0 1.0 ECU_ADDRESS 0x40002ee5 BYTE_ORDER MSB_FIRST /end MEASUREMENT
/begin COMPU_METHOD CU_AME_B_TRANSIENT "Conversion method for AME_b_Transient" RAT_FUNC "%10.0" "b" COEFFS 0.000000 1.000000 0.000000 0.000000 0.000000 1.000000 /end COMPU_METHOD
/* Scalar measurable for DDE 'AME_cc_ChargeVol'. */
/begin MEASUREMENT AME_cc_ChargeVol "Volume of air charge" FLOAT32_IEEE CU_AME_CC_CHARGEVOL 1 100 0.0 2000.0 ECU_ADDRESS 0x40003654 BYTE_ORDER MSB_FIRST /end MEASUREMENT
/begin COMPU_METHOD CU_AME_CC_CHARGEVOL "Conversion method for AME_cc_ChargeVol" RAT_FUNC "%10.2" "cc" COEFFS 0.000000 1.000000 0.000000 0.000000 0.000000 1.000000 /end COMPU_METHOD
/* Scalar measurable for DDE 'AME_gps_FreshMassAirFlow'. */
/begin MEASUREMENT AME_gps_FreshMassAirFlow "Final estimate of fresh air quantity that enters the cylinder" FLOAT32_IEEE CU_AME_GPS_FRESHMASSAIRFLOW 1 100 0.0 0.0 ECU_ADDRESS 0x40003618 BYTE_ORDER MSB_FIRST /end MEASUREMENT
/begin COMPU_METHOD CU_AME_GPS_FRESHMASSAIRFLOW "Conversion method for AME_gps_FreshMassAirFlow" RAT_FUNC "%10.1" "gps" COEFFS 0.000000 1.000000 0.000000 0.000000 0.000000 1.000000 /end COMPU_METHOD
/* Scalar measurable for DDE 'AME_gps_IdealAirAtSTP'. */
/begin MEASUREMENT AME_gps_IdealAirAtSTP "Ideal airflow at STP for the current engine speed and displacement" FLOAT32_IEEE CU_AME_GPS_IDEALAIRATSTP 1 100 0.0 0.0 ECU_ADDRESS 0x40003614 BYTE_ORDER MSB_FIRST /end MEASUREMENT
/begin COMPU_METHOD CU_AME_GPS_IDEALAIRATSTP "Conversion method for AME_gps_IdealAirAtSTP" RAT_FUNC "%10.1" "gps" COEFFS 0.000000 1.000000 0.000000 0.000000 0.000000 1.000000 /end COMPU_METHOD
/* Scalar measurable for DDE 'AME_gps_MAF_Corr'. */
/begin MEASUREMENT AME_gps_MAF_Corr "MAF sensor after speed/load correction" FLOAT32_IEEE CU_AME_GPS_MAF_CORR 1 100 0.0 0.0 ECU_ADDRESS 0x40003630 BYTE_ORDER MSB_FIRST /end MEASUREMENT
/begin COMPU_METHOD CU_AME_GPS_MAF_CORR "Conversion method for AME_gps_MAF_Corr" RAT_FUNC "%10.1" "gps" COEFFS 0.000000 1.000000 0.000000 0.000000 0.000000 1.000000 /end COMPU_METHOD
/* Scalar measurable for DDE 'AME_gps_MAF_FreshMassAirFlow'. */
/begin MEASUREMENT AME_gps_MAF_FreshMassAirFlow "Mass air flow excluding EGR reported by MAF sensor" FLOAT32_IEEE CU_AME_GPS_MAF_FRESHMASSAIRFLOW 1 100 0.0 500.0 ECU_ADDRESS 0x4000362c BYTE_ORDER MSB_FIRST /end MEASUREMENT
/begin COMPU_METHOD CU_AME_GPS_MAF_FRESHMASSAIRFLOW "Conversion method for AME_gps_MAF_FreshMassAirFlow" RAT_FUNC "%10.1" "gps" COEFFS 0.000000 1.000000 0.000000 0.000000 0.000000 1.000000 /end COMPU_METHOD
/* Scalar measurable for DDE 'AME_gps_MassAirFlowUncorr'. */
/begin MEASUREMENT AME_gps_MassAirFlowUncorr "Airflow estimate before transient correction" FLOAT32_IEEE CU_AME_GPS_MASSAIRFLOWUNCORR 1 100 0.0 0.0 ECU_ADDRESS 0x40003628 BYTE_ORDER MSB_FIRST /end MEASUREMENT
/begin COMPU_METHOD CU_AME_GPS_MASSAIRFLOWUNCORR "Conversion method for AME_gps_MassAirFlowUncorr" RAT_FUNC "%10.2" "gps" COEFFS 0.000000 1.000000 0.000000 0.000000 0.000000 1.000000 /end COMPU_METHOD
/* Scalar measurable for DDE 'AME_gps_MassAirFlowUnfiltd'. */
/begin MEASUREMENT AME_gps_MassAirFlowUnfiltd "mass flow estimate before LPF" FLOAT32_IEEE CU_AME_GPS_MASSAIRFLOWUNFILTD 1 100 0.0 0.0 ECU_ADDRESS 0x4000361c BYTE_ORDER MSB_FIRST /end MEASUREMENT
/begin COMPU_METHOD CU_AME_GPS_MASSAIRFLOWUNFILTD "Conversion method for AME_gps_MassAirFlowUnfiltd" RAT_FUNC "%10.2" "gps" COEFFS 0.000000 1.000000 0.000000 0.000000 0.000000 1.000000 /end COMPU_METHOD
/* Scalar measurable for DDE 'AME_gps_SD_FreshMassAirFlow'. */
/begin MEASUREMENT AME_gps_SD_FreshMassAirFlow "Mass air flow excluding EGR calculated using speed density" FLOAT32_IEEE CU_AME_GPS_SD_FRESHMASSAIRFLOW 1 100 0.0 500.0 ECU_ADDRESS 0x4000363c BYTE_ORDER MSB_FIRST /end MEASUREMENT
/begin COMPU_METHOD CU_AME_GPS_SD_FRESHMASSAIRFLOW "Conversion method for AME_gps_SD_FreshMassAirFlow" RAT_FUNC "%10.1" "gps" COEFFS 0.000000 1.000000 0.000000 0.000000 0.000000 1.000000 /end COMPU_METHOD
/* Scalar measurable for DDE 'AME_gps_SD_MassAirFlow'. */
/begin MEASUREMENT AME_gps_SD_MassAirFlow "Mass air flow estimate from speed density calculation" FLOAT32_IEEE CU_AME_GPS_SD_MASSAIRFLOW 1 100 0.0 500.0 ECU_ADDRESS 0x40003640 BYTE_ORDER MSB_FIRST /end MEASUREMENT
/begin COMPU_METHOD CU_AME_GPS_SD_MASSAIRFLOW "Conversion method for AME_gps_SD_MassAirFlow" RAT_FUNC "%10.1" "gps" COEFFS 0.000000 1.000000 0.000000 0.000000 0.000000 1.000000 /end COMPU_METHOD
/* Scalar measurable for DDE 'AME_kPa_Baro'. */
/begin MEASUREMENT AME_kPa_Baro "Displayable" FLOAT32_IEEE CU_AME_KPA_BARO 1 100 0.0 0.0 ECU_ADDRESS 0x400031f4 BYTE_ORDER MSB_FIRST /end MEASUREMENT
/begin COMPU_METHOD CU_AME_KPA_BARO "Conversion method for AME_kPa_Baro" RAT_FUNC "%10.1" "kPa" COEFFS 0.000000 1.000000 0.000000 0.000000 0.000000 1.000000 /end COMPU_METHOD
/* Scalar measurable for DDE 'AME_kPa_ChargePress'. */
/begin MEASUREMENT AME_kPa_ChargePress "Pressure of air charge" FLOAT32_IEEE CU_AME_KPA_CHARGEPRESS 1 100 0.0 200.0 ECU_ADDRESS 0x4000365c BYTE_ORDER MSB_FIRST /end MEASUREMENT
/begin COMPU_METHOD CU_AME_KPA_CHARGEPRESS "Conversion method for AME_kPa_ChargePress" RAT_FUNC "%10.2" "kPa" COEFFS 0.000000 1.000000 0.000000 0.000000 0.000000 1.000000 /end COMPU_METHOD
/* Scalar measurable for DDE 'AME_mg_FreshAirMass'. */
/begin MEASUREMENT AME_mg_FreshAirMass "Fresh air mass" FLOAT32_IEEE CU_AME_MG_FRESHAIRMASS 1 100 0.0 0.0 ECU_ADDRESS 0x40003544 BYTE_ORDER MSB_FIRST /end MEASUREMENT
/begin COMPU_METHOD CU_AME_MG_FRESHAIRMASS "Conversion method for AME_mg_FreshAirMass" RAT_FUNC "%10.1" "mg" COEFFS 0.000000 1.000000 0.000000 0.000000 0.000000 1.000000 /end COMPU_METHOD
/* Scalar measurable for DDE 'AME_mg_SD_AirMassPerCyl'. */
/begin MEASUREMENT AME_mg_SD_AirMassPerCyl "Speed density calculated air mass per cylinder per firing" FLOAT32_IEEE CU_AME_MG_SD_AIRMASSPERCYL 1 100 0.0 500.0 ECU_ADDRESS 0x40003644 BYTE_ORDER MSB_FIRST /end MEASUREMENT
/begin COMPU_METHOD CU_AME_MG_SD_AIRMASSPERCYL "Conversion method for AME_mg_SD_AirMassPerCyl" RAT_FUNC "%10.0" "mg" COEFFS 0.000000 1.000000 0.000000 0.000000 0.000000 1.000000 /end COMPU_METHOD
/* Scalar measurable for DDE 'AME_pct_ChargeTempCF'. */
/begin MEASUREMENT AME_pct_ChargeTempCF "Charge temperature compensation factor" FLOAT32_IEEE CU_AME_PCT_CHARGETEMPCF 1 100 0.0 0.0 ECU_ADDRESS 0x40003650 BYTE_ORDER MSB_FIRST /end MEASUREMENT
/begin COMPU_METHOD CU_AME_PCT_CHARGETEMPCF "Conversion method for AME_pct_ChargeTempCF" RAT_FUNC "%10.2" "pct" COEFFS 0.000000 1.000000 0.000000 0.000000 0.000000 1.000000 /end COMPU_METHOD
/* Scalar measurable for DDE 'AME_pct_DemandHPF_Peak'. */
/begin MEASUREMENT AME_pct_DemandHPF_Peak "Peak value of demand HPF" FLOAT32_IEEE CU_AME_PCT_DEMANDHPF_PEAK 1 100 0.0 0.0 ECU_ADDRESS 0x40003620 BYTE_ORDER MSB_FIRST /end MEASUREMENT
/begin COMPU_METHOD CU_AME_PCT_DEMANDHPF_PEAK "Conversion method for AME_pct_DemandHPF_Peak" RAT_FUNC "%10.3" "pct" COEFFS 0.000000 1.000000 0.000000 0.000000 0.000000 1.000000 /end COMPU_METHOD
/* Scalar measurable for DDE 'AME_pct_DmndHPF'. */
/begin MEASUREMENT AME_pct_DmndHPF "Filtered air demand" FLOAT32_IEEE CU_AME_PCT_DMNDHPF 1 100 0.0 0.0 ECU_ADDRESS 0x40003624 BYTE_ORDER MSB_FIRST /end MEASUREMENT
/begin COMPU_METHOD CU_AME_PCT_DMNDHPF "Conversion method for AME_pct_DmndHPF" RAT_FUNC "%10.2" "pct" COEFFS 0.000000 1.000000 0.000000 0.000000 0.000000 1.000000 /end COMPU_METHOD
/* Scalar measurable for DDE 'AME_pct_Load'. */
/begin MEASUREMENT AME_pct_Load "Airflow-based load: will be > 1.0 for boost conditions" FLOAT32_IEEE CU_AME_PCT_LOAD 1 100 0.0 0.0 ECU_ADDRESS 0x40003610 BYTE_ORDER MSB_FIRST /end MEASUREMENT
/begin COMPU_METHOD CU_AME_PCT_LOAD "Conversion method for AME_pct_Load" RAT_FUNC "%10.2" "pct" COEFFS 0.000000 1.000000 0.000000 0.000000 0.000000 1.000000 /end COMPU_METHOD
/* Scalar measurable for DDE 'AME_pct_MAF_Ofst'. */
/begin MEASUREMENT AME_pct_MAF_Ofst "Table output displayable" FLOAT32_IEEE CU_AME_PCT_MAF_OFST 1 100 0.0 0.0 ECU_ADDRESS 0x40003634 BYTE_ORDER MSB_FIRST /end MEASUREMENT
/begin COMPU_METHOD CU_AME_PCT_MAF_OFST "Conversion method for AME_pct_MAF_Ofst" RAT_FUNC "%10.2" "pct" COEFFS 0.000000 1.000000 0.000000 0.000000 0.000000 1.000000 /end COMPU_METHOD
/* Scalar measurable for DDE 'AME_pct_UseMAF'. */
/begin MEASUREMENT AME_pct_UseMAF "Airmass estimate selection displayable" FLOAT32_IEEE CU_AME_PCT_USEMAF 1 100 0.0 0.0 ECU_ADDRESS 0x40003638 BYTE_ORDER MSB_FIRST /end MEASUREMENT
/begin COMPU_METHOD CU_AME_PCT_USEMAF "Conversion method for AME_pct_UseMAF" RAT_FUNC "%10.2" "pct" COEFFS 0.000000 1.000000 0.000000 0.000000 0.000000 1.000000 /end COMPU_METHOD
/* Scalar measurable for DDE 'AME_pct_VolEff'. */
/begin MEASUREMENT AME_pct_VolEff "volumetric efficiency at current operating point" FLOAT32_IEEE CU_AME_PCT_VOLEFF 1 100 0.0 0.0 ECU_ADDRESS 0x40003658 BYTE_ORDER MSB_FIRST /end MEASUREMENT
/begin COMPU_METHOD CU_AME_PCT_VOLEFF "Conversion method for AME_pct_VolEff" RAT_FUNC "%10.2" "pct" COEFFS 0.000000 1.000000 0.000000 0.000000 0.000000 1.000000 /end COMPU_METHOD
/* Scalar measurable for DDE 'APP_Nm_DrvrDmndTq'. */
/begin MEASUREMENT APP_Nm_DrvrDmndTq "Final driver demanded torque" FLOAT32_IEEE CU_APP_NM_DRVRDMNDTQ 1 100 0.0 0.0 ECU_ADDRESS 0x4000358c BYTE_ORDER MSB_FIRST /end MEASUREMENT
/begin COMPU_METHOD CU_APP_NM_DRVRDMNDTQ "Conversion method for APP_Nm_DrvrDmndTq" RAT_FUNC "%10.2" "Nm" COEFFS 0.000000 1.000000 0.000000 0.000000 0.000000 1.000000 /end COMPU_METHOD
/* Scalar measurable for DDE 'APP_Nm_DrvrTqDmndRaw'. */
/begin MEASUREMENT APP_Nm_DrvrTqDmndRaw "Raw driver torque demand" FLOAT32_IEEE CU_APP_NM_DRVRTQDMNDRAW 1 100 0.0 0.0 ECU_ADDRESS 0x40003590 BYTE_ORDER MSB_FIRST /end MEASUREMENT
/begin COMPU_METHOD CU_APP_NM_DRVRTQDMNDRAW "Conversion method for APP_Nm_DrvrTqDmndRaw" RAT_FUNC "%10.2" "Nm" COEFFS 0.000000 1.000000 0.000000 0.000000 0.000000 1.000000 /end COMPU_METHOD
/* Scalar measurable for DDE 'APP_V_APP1_Filtd'. */
/begin MEASUREMENT APP_V_APP1_Filtd "Filtered accelerator pedal position sensor signal 1" FLOAT32_IEEE CU_APP_V_APP1_FILTD 1 100 0.0 0.0 ECU_ADDRESS 0x400035d0 BYTE_ORDER MSB_FIRST /end MEASUREMENT
/begin COMPU_METHOD CU_APP_V_APP1_FILTD "Conversion method for APP_V_APP1_Filtd" RAT_FUNC "%10.3" "V" COEFFS 0.000000 1.000000 0.000000 0.000000 0.000000 1.000000 /end COMPU_METHOD
/* Scalar measurable for DDE 'APP_V_APP2_Filtd'. */
/begin MEASUREMENT APP_V_APP2_Filtd "Filtered accelerator pedal position sensor signal 2" FLOAT32_IEEE CU_APP_V_APP2_FILTD 1 100 0.0 0.0 ECU_ADDRESS 0x400035e4 BYTE_ORDER MSB_FIRST /end MEASUREMENT
/begin COMPU_METHOD CU_APP_V_APP2_FILTD "Conversion method for APP_V_APP2_Filtd" RAT_FUNC "%10.3" "V" COEFFS 0.000000 1.000000 0.000000 0.000000 0.000000 1.000000 /end COMPU_METHOD
/* Scalar measurable for DDE 'APP_V_FullLearnNewAPP1'. */
/begin MEASUREMENT APP_V_FullLearnNewAPP1 "Accelerator pedal position 1 new full pedal learn position" FLOAT32_IEEE CU_APP_V_FULLLEARNNEWAPP1 1 100 0.0 0.0 ECU_ADDRESS 0x400035c8 BYTE_ORDER MSB_FIRST /end MEASUREMENT
/begin COMPU_METHOD CU_APP_V_FULLLEARNNEWAPP1 "Conversion method for APP_V_FullLearnNewAPP1" RAT_FUNC "%10.3" "V" COEFFS 0.000000 1.000000 0.000000 0.000000 0.000000 1.000000 /end COMPU_METHOD
/* Scalar measurable for DDE 'APP_V_FullLearnNewAPP2'. */
/begin MEASUREMENT APP_V_FullLearnNewAPP2 "Accelerator pedal position 2 new full pedal learn position" FLOAT32_IEEE CU_APP_V_FULLLEARNNEWAPP2 1 100 0.0 0.0 ECU_ADDRESS 0x400035dc BYTE_ORDER MSB_FIRST /end MEASUREMENT
/begin COMPU_METHOD CU_APP_V_FULLLEARNNEWAPP2 "Conversion method for APP_V_FullLearnNewAPP2" RAT_FUNC "%10.3" "V" COEFFS 0.000000 1.000000 0.000000 0.000000 0.000000 1.000000 /end COMPU_METHOD
/* Scalar measurable for DDE 'APP_V_ZeroLearnPosAPP1'. */
/begin MEASUREMENT APP_V_ZeroLearnPosAPP1 "Zero pedal learned value for accelerator pedal position sensor 1" FLOAT32_IEEE CU_APP_V_ZEROLEARNPOSAPP1 1 100 0.0 0.0 ECU_ADDRESS 0x400035cc BYTE_ORDER MSB_FIRST /end MEASUREMENT
/begin COMPU_METHOD CU_APP_V_ZEROLEARNPOSAPP1 "Conversion method for APP_V_ZeroLearnPosAPP1" RAT_FUNC "%10.3" "V" COEFFS 0.000000 1.000000 0.000000 0.000000 0.000000 1.000000 /end COMPU_METHOD
/* Scalar measurable for DDE 'APP_V_ZeroLearnPosAPP2'. */
/begin MEASUREMENT APP_V_ZeroLearnPosAPP2 "Zero pedal learned value for accelerator pedal position sensor 2" FLOAT32_IEEE CU_APP_V_ZEROLEARNPOSAPP2 1 100 0.0 0.0 ECU_ADDRESS 0x400035e0 BYTE_ORDER MSB_FIRST /end MEASUREMENT
/begin COMPU_METHOD CU_APP_V_ZEROLEARNPOSAPP2 "Conversion method for APP_V_ZeroLearnPosAPP2" RAT_FUNC "%10.3" "V" COEFFS 0.000000 1.000000 0.000000 0.000000 0.000000 1.000000 /end COMPU_METHOD
/* Scalar measurable for DDE 'APP_b_BrakePedal_actv'. */
/begin MEASUREMENT APP_b_BrakePedal_actv "(not defined)" UBYTE CU_APP_B_BRAKEPEDAL_ACTV 1 100 0.0 1.0 ECU_ADDRESS 0x40002ed5 BYTE_ORDER MSB_FIRST /end MEASUREMENT
/begin COMPU_METHOD CU_APP_B_BRAKEPEDAL_ACTV "Conversion method for APP_b_BrakePedal_actv" RAT_FUNC "%10.0" "b" COEFFS 0.000000 1.000000 0.000000 0.000000 0.000000 1.000000 /end COMPU_METHOD
/* Scalar measurable for DDE 'APP_b_CorrFlt'. */
/begin MEASUREMENT APP_b_CorrFlt "Corr fault active flag" UBYTE CU_APP_B_CORRFLT 1 100 0.0 1.0 ECU_ADDRESS 0x40002ed6 BYTE_ORDER MSB_FIRST /end MEASUREMENT
/begin COMPU_METHOD CU_APP_B_CORRFLT "Conversion method for APP_b_CorrFlt" RAT_FUNC "%10.0" "b" COEFFS 0.000000 1.000000 0.000000 0.000000 0.000000 1.000000 /end COMPU_METHOD
/* Scalar measurable for DDE 'APP_b_EEC1TorqueMode'. */
/begin MEASUREMENT APP_b_EEC1TorqueMode "Lectura modo de par EEC1 activación IDL o APP" UBYTE CU_APP_B_EEC1TORQUEMODE 1 100 0.0 1.0 ECU_ADDRESS 0x40003168 BYTE_ORDER MSB_FIRST /end MEASUREMENT
/begin COMPU_METHOD CU_APP_B_EEC1TORQUEMODE "Conversion method for APP_b_EEC1TorqueMode" RAT_FUNC "%10.0" "b" COEFFS 0.000000 1.000000 0.000000 0.000000 0.000000 1.000000 /end COMPU_METHOD
/* Scalar measurable for DDE 'APP_b_Fault'. */
/begin MEASUREMENT APP_b_Fault "APP faulted override value" UBYTE CU_APP_B_FAULT 1 100 0.0 1.0 ECU_ADDRESS 0x40002e80 BYTE_ORDER MSB_FIRST /end MEASUREMENT
/begin COMPU_METHOD CU_APP_B_FAULT "Conversion method for APP_b_Fault" RAT_FUNC "%10.0" "b" COEFFS 0.000000 1.000000 0.000000 0.000000 0.000000 1.000000 /end COMPU_METHOD
/* Scalar measurable for DDE 'APP_b_ZeroLearnEnAPP1'. */
/begin MEASUREMENT APP_b_ZeroLearnEnAPP1 "Zero pedal learn enabled" UBYTE CU_APP_B_ZEROLEARNENAPP1 1 100 0.0 1.0 ECU_ADDRESS 0x40002ed8 BYTE_ORDER MSB_FIRST /end MEASUREMENT
/begin COMPU_METHOD CU_APP_B_ZEROLEARNENAPP1 "Conversion method for APP_b_ZeroLearnEnAPP1" RAT_FUNC "%10.0" "b" COEFFS 0.000000 1.000000 0.000000 0.000000 0.000000 1.000000 /end COMPU_METHOD
/* Scalar measurable for DDE 'APP_b_ZeroLearnEnAPP2'. */
/begin MEASUREMENT APP_b_ZeroLearnEnAPP2 "Zero pedal learn enabled" UBYTE CU_APP_B_ZEROLEARNENAPP2 1 100 0.0 1.0 ECU_ADDRESS 0x40002eda BYTE_ORDER MSB_FIRST /end MEASUREMENT
/begin COMPU_METHOD CU_APP_B_ZEROLEARNENAPP2 "Conversion method for APP_b_ZeroLearnEnAPP2" RAT_FUNC "%10.0" "b" COEFFS 0.000000 1.000000 0.000000 0.000000 0.000000 1.000000 /end COMPU_METHOD
/* Scalar measurable for DDE 'APP_e_PdlMode'. */
/begin MEASUREMENT APP_e_PdlMode "Pdl Mode" UBYTE CU_APP_E_PDLMODE 1 100 0.0 0.0 ECU_ADDRESS 0x40002fe7 BYTE_ORDER MSB_FIRST /end MEASUREMENT
/begin COMPU_METHOD CU_APP_E_PDLMODE "Conversion method for APP_e_PdlMode" TAB_VERB "%12.0" "e" COMPU_TAB_REF CT_APP_E_PDLMODE /end COMPU_METHOD
/begin COMPU_VTAB CT_APP_E_PDLMODE "Conversion method for APP_e_PdlMode" TAB_VERB 3 0 "APPk_e_Zero" 1 "APPk_e_Partial" 2 "APPk_e_Full" /end COMPU_VTAB
/* Scalar measurable for DDE 'APP_kph_VehSpeed'. */
/begin MEASUREMENT APP_kph_VehSpeed "Condición 80KM/h speed limit" FLOAT32_IEEE CU_APP_KPH_VEHSPEED 1 100 0.0 0.0 ECU_ADDRESS 0x4000370c BYTE_ORDER MSB_FIRST /end MEASUREMENT
/begin COMPU_METHOD CU_APP_KPH_VEHSPEED "Conversion method for APP_kph_VehSpeed" RAT_FUNC "%10.2" "pct" COEFFS 0.000000 1.000000 0.000000 0.000000 0.000000 1.000000 /end COMPU_METHOD
/* Scalar measurable for DDE 'APP_pct_APP1'. */
/begin MEASUREMENT APP_pct_APP1 "Accelerator pedal position 1 percent" FLOAT32_IEEE CU_APP_PCT_APP1 1 100 0.0 0.0 ECU_ADDRESS 0x400035c0 BYTE_ORDER MSB_FIRST /end MEASUREMENT
/begin COMPU_METHOD CU_APP_PCT_APP1 "Conversion method for APP_pct_APP1" RAT_FUNC "%10.3" "pct" COEFFS 0.000000 1.000000 0.000000 0.000000 0.000000 1.000000 /end COMPU_METHOD
/* Scalar measurable for DDE 'APP_pct_APP2'. */
/begin MEASUREMENT APP_pct_APP2 "Accelerator pedal position 1 percent" FLOAT32_IEEE CU_APP_PCT_APP2 1 100 0.0 0.0 ECU_ADDRESS 0x400035d4 BYTE_ORDER MSB_FIRST /end MEASUREMENT
/begin COMPU_METHOD CU_APP_PCT_APP2 "Conversion method for APP_pct_APP2" RAT_FUNC "%10.3" "pct" COEFFS 0.000000 1.000000 0.000000 0.000000 0.000000 1.000000 /end COMPU_METHOD
/* Scalar measurable for DDE 'APP_pct_Dmnd'. */
/begin MEASUREMENT APP_pct_Dmnd "Arbitrated pedal position override value" FLOAT32_IEEE CU_APP_PCT_DMND 1 100 0.0 0.0 ECU_ADDRESS 0x40003340 BYTE_ORDER MSB_FIRST /end MEASUREMENT
/begin COMPU_METHOD CU_APP_PCT_DMND "Conversion method for APP_pct_Dmnd" RAT_FUNC "%10.2" "pct" COEFFS 0.000000 1.000000 0.000000 0.000000 0.000000 1.000000 /end COMPU_METHOD
/* Scalar measurable for DDE 'APP_rpm_IN'. */
/begin MEASUREMENT APP_rpm_IN "Displayable" FLOAT32_IEEE CU_APP_RPM_IN 1 100 0.0 0.0 ECU_ADDRESS 0x4000378c BYTE_ORDER MSB_FIRST /end MEASUREMENT
/begin COMPU_METHOD CU_APP_RPM_IN "Conversion method for APP_rpm_IN" RAT_FUNC "%10.0" "NU" COEFFS 0.000000 1.000000 0.000000 0.000000 0.000000 1.000000 /end COMPU_METHOD
/* Scalar measurable for DDE 'APP_rpm_OUT'. */
/begin MEASUREMENT APP_rpm_OUT "Displayable" FLOAT32_IEEE CU_APP_RPM_OUT 1 100 0.0 0.0 ECU_ADDRESS 0x40003790 BYTE_ORDER MSB_FIRST /end MEASUREMENT
/begin COMPU_METHOD CU_APP_RPM_OUT "Conversion method for APP_rpm_OUT" RAT_FUNC "%10.0" "NU" COEFFS 0.000000 1.000000 0.000000 0.000000 0.000000 1.000000 /end COMPU_METHOD
/* Scalar measurable for DDE 'BAF_NU_TrgtAFR1'. */
/begin MEASUREMENT BAF_NU_TrgtAFR1 "Target air fuel ratio" FLOAT32_IEEE CU_BAF_NU_TRGTAFR1 1 100 0.0 20.0 ECU_ADDRESS 0x400034a8 BYTE_ORDER MSB_FIRST /end MEASUREMENT
/begin COMPU_METHOD CU_BAF_NU_TRGTAFR1 "Conversion method for BAF_NU_TrgtAFR1" RAT_FUNC "%10.2" "NU" COEFFS 0.000000 1.000000 0.000000 0.000000 0.000000 1.000000 /end COMPU_METHOD
/* Scalar measurable for DDE 'BAF_mg_FuelRqst1'. */
/begin MEASUREMENT BAF_mg_FuelRqst1 "(mg/cyl/firing) Torque-making fuel mass request for Bank 1" FLOAT32_IEEE CU_BAF_MG_FUELRQST1 1 100 0.0 0.0 ECU_ADDRESS 0x400034a0 BYTE_ORDER MSB_FIRST /end MEASUREMENT
/begin COMPU_METHOD CU_BAF_MG_FUELRQST1 "Conversion method for BAF_mg_FuelRqst1" RAT_FUNC "%10.2" "mg" COEFFS 0.000000 1.000000 0.000000 0.000000 0.000000 1.000000 /end COMPU_METHOD
/* Scalar measurable for DDE 'BAF_mg_FuelRqst1Raw'. */
/begin MEASUREMENT BAF_mg_FuelRqst1Raw "(mg/cyl/firing) Raw torque-making fuel mass request" FLOAT32_IEEE CU_BAF_MG_FUELRQST1RAW 1 100 0.0 0.0 ECU_ADDRESS 0x400034a4 BYTE_ORDER MSB_FIRST /end MEASUREMENT
/begin COMPU_METHOD CU_BAF_MG_FUELRQST1RAW "Conversion method for BAF_mg_FuelRqst1Raw" RAT_FUNC "%10.2" "mg" COEFFS 0.000000 1.000000 0.000000 0.000000 0.000000 1.000000 /end COMPU_METHOD
/* Scalar measurable for DDE 'BAR_b_OBDPressOK'. */
/begin MEASUREMENT BAR_b_OBDPressOK "Displayable" UBYTE CU_BAR_B_OBDPRESSOK 1 100 0.0 1.0 ECU_ADDRESS 0x40002f35 BYTE_ORDER MSB_FIRST /end MEASUREMENT
/begin COMPU_METHOD CU_BAR_B_OBDPRESSOK "Conversion method for BAR_b_OBDPressOK" RAT_FUNC "%10.0" "b" COEFFS 0.000000 1.000000 0.000000 0.000000 0.000000 1.000000 /end COMPU_METHOD
/* Scalar measurable for DDE 'BAS_adv_BaseSpark'. */
/begin MEASUREMENT BAS_adv_BaseSpark "Final Ignition Advance Angle from BAS feature" FLOAT32_IEEE CU_BAS_ADV_BASESPARK 1 100 0.0 0.0 ECU_ADDRESS 0x40003604 BYTE_ORDER MSB_FIRST /end MEASUREMENT
/begin COMPU_METHOD CU_BAS_ADV_BASESPARK "Conversion method for BAS_adv_BaseSpark" RAT_FUNC "%10.1" "adv" COEFFS 0.000000 1.000000 0.000000 0.000000 0.000000 1.000000 /end COMPU_METHOD
/* Scalar measurable for DDE 'BAS_adv_CrankingSpark'. */
/begin MEASUREMENT BAS_adv_CrankingSpark "Cranking spark advance" FLOAT32_IEEE CU_BAS_ADV_CRANKINGSPARK 1 100 -40.0 0.0 ECU_ADDRESS 0x40003660 BYTE_ORDER MSB_FIRST /end MEASUREMENT
/begin COMPU_METHOD CU_BAS_ADV_CRANKINGSPARK "Conversion method for BAS_adv_CrankingSpark" RAT_FUNC "%10.1" "adv" COEFFS 0.000000 1.000000 0.000000 0.000000 0.000000 1.000000 /end COMPU_METHOD
/* Scalar measurable for DDE 'BAS_adv_MBT_Spark'. */
/begin MEASUREMENT BAS_adv_MBT_Spark "Running point displayable" FLOAT32_IEEE CU_BAS_ADV_MBT_SPARK 1 100 0.0 0.0 ECU_ADDRESS 0x40003608 BYTE_ORDER MSB_FIRST /end MEASUREMENT
/begin COMPU_METHOD CU_BAS_ADV_MBT_SPARK "Conversion method for BAS_adv_MBT_Spark" RAT_FUNC "%10.1" "adv" COEFFS 0.000000 1.000000 0.000000 0.000000 0.000000 1.000000 /end COMPU_METHOD
/* Scalar measurable for DDE 'BAS_adv_MBT_SparkLowGradeFuel'. */
/begin MEASUREMENT BAS_adv_MBT_SparkLowGradeFuel "Running point displayable" FLOAT32_IEEE CU_BAS_ADV_MBT_SPARKLOWGRADEFU0 1 100 0.0 0.0 ECU_ADDRESS 0x4000360c BYTE_ORDER MSB_FIRST /end MEASUREMENT
/begin COMPU_METHOD CU_BAS_ADV_MBT_SPARKLOWGRADEFU0 "Conversion method for BAS_adv_MBT_SparkLowGradeFuel" RAT_FUNC "%10.1" "adv" COEFFS 0.000000 1.000000 0.000000 0.000000 0.000000 1.000000 /end COMPU_METHOD
/* Scalar measurable for DDE 'BAS_b_LowGradeFuel'. */
/begin MEASUREMENT BAS_b_LowGradeFuel "Displayable" UBYTE CU_BAS_B_LOWGRADEFUEL 1 100 0.0 1.0 ECU_ADDRESS 0x40002ee3 BYTE_ORDER MSB_FIRST /end MEASUREMENT
/begin COMPU_METHOD CU_BAS_B_LOWGRADEFUEL "Conversion method for BAS_b_LowGradeFuel" RAT_FUNC "%10.0" "b" COEFFS 0.000000 1.000000 0.000000 0.000000 0.000000 1.000000 /end COMPU_METHOD
/* Scalar measurable for DDE 'BAS_cnt_KnockEvents'. */
/begin MEASUREMENT BAS_cnt_KnockEvents "Calibratable number of times Eng has knocked during one Eng duration" UWORD CU_BAS_CNT_KNOCKEVENTS 1 100 0.0 0.0 ECU_ADDRESS 0x4000302a BYTE_ORDER MSB_FIRST /end MEASUREMENT
/begin COMPU_METHOD CU_BAS_CNT_KNOCKEVENTS "Conversion method for BAS_cnt_KnockEvents" RAT_FUNC "%10.0" "cnt" COEFFS 0.000000 1.000000 0.000000 0.000000 0.000000 1.000000 /end COMPU_METHOD
/* Scalar measurable for DDE 'CAL_V_Uoffset_A'. */
/begin MEASUREMENT CAL_V_Uoffset_A "NVM offset value used for Lambda calculation" FLOAT32_IEEE CU_CAL_V_UOFFSET_A 1 100 0.0 0.0 ECU_ADDRESS 0x40003104 BYTE_ORDER MSB_FIRST /end MEASUREMENT
/begin COMPU_METHOD CU_CAL_V_UOFFSET_A "Conversion method for CAL_V_Uoffset_A" RAT_FUNC "%10.3" "V" COEFFS 0.000000 1.000000 0.000000 0.000000 0.000000 1.000000 /end COMPU_METHOD
/* Scalar measurable for DDE 'CAL_V_Uoffset_B'. */
/begin MEASUREMENT CAL_V_Uoffset_B "NVM offset value used for Lambda calculation" FLOAT32_IEEE CU_CAL_V_UOFFSET_B 1 100 0.0 0.0 ECU_ADDRESS 0x40003134 BYTE_ORDER MSB_FIRST /end MEASUREMENT
/begin COMPU_METHOD CU_CAL_V_UOFFSET_B "Conversion method for CAL_V_Uoffset_B" RAT_FUNC "%10.3" "V" COEFFS 0.000000 1.000000 0.000000 0.000000 0.000000 1.000000 /end COMPU_METHOD
/* Scalar measurable for DDE 'CAL_b_CalibrationModeActv_A'. */
/begin MEASUREMENT CAL_b_CalibrationModeActv_A "Calibration mode active flag" UBYTE CU_CAL_B_CALIBRATIONMODEACTV_A 1 100 0.0 1.0 ECU_ADDRESS 0x40002e4b BYTE_ORDER MSB_FIRST /end MEASUREMENT
/begin COMPU_METHOD CU_CAL_B_CALIBRATIONMODEACTV_A "Conversion method for CAL_b_CalibrationModeActv_A" RAT_FUNC "%10.0" "b" COEFFS 0.000000 1.000000 0.000000 0.000000 0.000000 1.000000 /end COMPU_METHOD
/* Scalar measurable for DDE 'CAL_b_CalibrationModeActv_B'. */
/begin MEASUREMENT CAL_b_CalibrationModeActv_B "Calibration mode active flag" UBYTE CU_CAL_B_CALIBRATIONMODEACTV_B 1 100 0.0 1.0 ECU_ADDRESS 0x40002e5c BYTE_ORDER MSB_FIRST /end MEASUREMENT
/begin COMPU_METHOD CU_CAL_B_CALIBRATIONMODEACTV_B "Conversion method for CAL_b_CalibrationModeActv_B" RAT_FUNC "%10.0" "b" COEFFS 0.000000 1.000000 0.000000 0.000000 0.000000 1.000000 /end COMPU_METHOD
/* Scalar measurable for DDE 'CAL_b_CalibrationModeRqst_A'. */
/begin MEASUREMENT CAL_b_CalibrationModeRqst_A "Calibration mode request flag" UBYTE CU_CAL_B_CALIBRATIONMODERQST_A 1 100 0.0 1.0 ECU_ADDRESS 0x40002e4c BYTE_ORDER MSB_FIRST /end MEASUREMENT
/begin COMPU_METHOD CU_CAL_B_CALIBRATIONMODERQST_A "Conversion method for CAL_b_CalibrationModeRqst_A" RAT_FUNC "%10.0" "b" COEFFS 0.000000 1.000000 0.000000 0.000000 0.000000 1.000000 /end COMPU_METHOD
/* Scalar measurable for DDE 'CAL_b_CalibrationModeRqst_B'. */
/begin MEASUREMENT CAL_b_CalibrationModeRqst_B "Calibration mode request flag" UBYTE CU_CAL_B_CALIBRATIONMODERQST_B 1 100 0.0 1.0 ECU_ADDRESS 0x40002e5d BYTE_ORDER MSB_FIRST /end MEASUREMENT
/begin COMPU_METHOD CU_CAL_B_CALIBRATIONMODERQST_B "Conversion method for CAL_b_CalibrationModeRqst_B" RAT_FUNC "%10.0" "b" COEFFS 0.000000 1.000000 0.000000 0.000000 0.000000 1.000000 /end COMPU_METHOD
/* Scalar measurable for DDE 'CIN_NU_EngOvrCtrMd_ESP'. */
/begin MEASUREMENT CIN_NU_EngOvrCtrMd_ESP "Displayable" FLOAT32_IEEE CU_CIN_NU_ENGOVRCTRMD_ESP 1 100 0.0 0.0 ECU_ADDRESS 0x4000383c BYTE_ORDER MSB_FIRST /end MEASUREMENT
/begin COMPU_METHOD CU_CIN_NU_ENGOVRCTRMD_ESP "Conversion method for CIN_NU_EngOvrCtrMd_ESP" RAT_FUNC "%10.0" "NU" COEFFS 0.000000 1.000000 0.000000 0.000000 0.000000 1.000000 /end COMPU_METHOD
/* Scalar measurable for DDE 'CIN_NU_EngOvrCtrMd_ESP_B'. */
/begin MEASUREMENT CIN_NU_EngOvrCtrMd_ESP_B "Displayable" FLOAT32_IEEE CU_CIN_NU_ENGOVRCTRMD_ESP_B 1 100 0.0 0.0 ECU_ADDRESS 0x40003708 BYTE_ORDER MSB_FIRST /end MEASUREMENT
/begin COMPU_METHOD CU_CIN_NU_ENGOVRCTRMD_ESP_B "Conversion method for CIN_NU_EngOvrCtrMd_ESP_B" RAT_FUNC "%10.0" "NU" COEFFS 0.000000 1.000000 0.000000 0.000000 0.000000 1.000000 /end COMPU_METHOD
/* Scalar measurable for DDE 'CIN_NU_EngOvrCtrMd_TCM'. */
/begin MEASUREMENT CIN_NU_EngOvrCtrMd_TCM "Displayable" FLOAT32_IEEE CU_CIN_NU_ENGOVRCTRMD_TCM 1 100 0.0 0.0 ECU_ADDRESS 0x40003830 BYTE_ORDER MSB_FIRST /end MEASUREMENT
/begin COMPU_METHOD CU_CIN_NU_ENGOVRCTRMD_TCM "Conversion method for CIN_NU_EngOvrCtrMd_TCM" RAT_FUNC "%10.0" "NU" COEFFS 0.000000 1.000000 0.000000 0.000000 0.000000 1.000000 /end COMPU_METHOD
/* Scalar measurable for DDE 'CIN_NU_EngOvrCtrMd_TCM_B'. */
/begin MEASUREMENT CIN_NU_EngOvrCtrMd_TCM_B "Displayable" FLOAT32_IEEE CU_CIN_NU_ENGOVRCTRMD_TCM_B 1 100 0.0 0.0 ECU_ADDRESS 0x40003704 BYTE_ORDER MSB_FIRST /end MEASUREMENT
/begin COMPU_METHOD CU_CIN_NU_ENGOVRCTRMD_TCM_B "Conversion method for CIN_NU_EngOvrCtrMd_TCM_B" RAT_FUNC "%10.0" "NU" COEFFS 0.000000 1.000000 0.000000 0.000000 0.000000 1.000000 /end COMPU_METHOD
/* Scalar measurable for DDE 'CIN_NU_OvrCtrMd_ESP'. */
/begin MEASUREMENT CIN_NU_OvrCtrMd_ESP "Displayable" FLOAT32_IEEE CU_CIN_NU_OVRCTRMD_ESP 1 100 0.0 0.0 ECU_ADDRESS 0x40003844 BYTE_ORDER MSB_FIRST /end MEASUREMENT
/begin COMPU_METHOD CU_CIN_NU_OVRCTRMD_ESP "Conversion method for CIN_NU_OvrCtrMd_ESP" RAT_FUNC "%10.0" "NU" COEFFS 0.000000 1.000000 0.000000 0.000000 0.000000 1.000000 /end COMPU_METHOD
/* Scalar measurable for DDE 'CIN_NU_OvrCtrMd_ESP_B'. */
/begin MEASUREMENT CIN_NU_OvrCtrMd_ESP_B "Displayable" FLOAT32_IEEE CU_CIN_NU_OVRCTRMD_ESP_B 1 100 0.0 0.0 ECU_ADDRESS 0x400036f4 BYTE_ORDER MSB_FIRST /end MEASUREMENT
/begin COMPU_METHOD CU_CIN_NU_OVRCTRMD_ESP_B "Conversion method for CIN_NU_OvrCtrMd_ESP_B" RAT_FUNC "%10.0" "NU" COEFFS 0.000000 1.000000 0.000000 0.000000 0.000000 1.000000 /end COMPU_METHOD
/* Scalar measurable for DDE 'CIN_NU_OvrCtrMd_TCM'. */
/begin MEASUREMENT CIN_NU_OvrCtrMd_TCM "Displayable" FLOAT32_IEEE CU_CIN_NU_OVRCTRMD_TCM 1 100 0.0 0.0 ECU_ADDRESS 0x40003838 BYTE_ORDER MSB_FIRST /end MEASUREMENT
/begin COMPU_METHOD CU_CIN_NU_OVRCTRMD_TCM "Conversion method for CIN_NU_OvrCtrMd_TCM" RAT_FUNC "%10.0" "NU" COEFFS 0.000000 1.000000 0.000000 0.000000 0.000000 1.000000 /end COMPU_METHOD
/* Scalar measurable for DDE 'CIN_NU_OvrCtrMd_TCM_B'. */
/begin MEASUREMENT CIN_NU_OvrCtrMd_TCM_B "Displayable" FLOAT32_IEEE CU_CIN_NU_OVRCTRMD_TCM_B 1 100 0.0 0.0 ECU_ADDRESS 0x400036fc BYTE_ORDER MSB_FIRST /end MEASUREMENT
/begin COMPU_METHOD CU_CIN_NU_OVRCTRMD_TCM_B "Conversion method for CIN_NU_OvrCtrMd_TCM_B" RAT_FUNC "%10.0" "NU" COEFFS 0.000000 1.000000 0.000000 0.000000 0.000000 1.000000 /end COMPU_METHOD
/* Scalar measurable for DDE 'CIN_Nm_TqCtrRq_ESP'. */
/begin MEASUREMENT CIN_Nm_TqCtrRq_ESP "(not defined)" FLOAT32_IEEE CU_CIN_NM_TQCTRRQ_ESP 1 100 0.0 0.0 ECU_ADDRESS 0x40003558 BYTE_ORDER MSB_FIRST /end MEASUREMENT
/begin COMPU_METHOD CU_CIN_NM_TQCTRRQ_ESP "Conversion method for CIN_Nm_TqCtrRq_ESP" RAT_FUNC "%10.0" "Nm" COEFFS 0.000000 1.000000 0.000000 0.000000 0.000000 1.000000 /end COMPU_METHOD
/* Scalar measurable for DDE 'CIN_Nm_TqCtrRq_TCM'. */
/begin MEASUREMENT CIN_Nm_TqCtrRq_TCM "(not defined)" FLOAT32_IEEE CU_CIN_NM_TQCTRRQ_TCM 1 100 0.0 0.0 ECU_ADDRESS 0x40003554 BYTE_ORDER MSB_FIRST /end MEASUREMENT
/begin COMPU_METHOD CU_CIN_NM_TQCTRRQ_TCM "Conversion method for CIN_Nm_TqCtrRq_TCM" RAT_FUNC "%10.0" "Nm" COEFFS 0.000000 1.000000 0.000000 0.000000 0.000000 1.000000 /end COMPU_METHOD
/* Scalar measurable for DDE 'CIN_pct_TqCtrRq_ESP'. */
/begin MEASUREMENT CIN_pct_TqCtrRq_ESP "Displayable" FLOAT32_IEEE CU_CIN_PCT_TQCTRRQ_ESP 1 100 0.0 0.0 ECU_ADDRESS 0x40003840 BYTE_ORDER MSB_FIRST /end MEASUREMENT
/begin COMPU_METHOD CU_CIN_PCT_TQCTRRQ_ESP "Conversion method for CIN_pct_TqCtrRq_ESP" RAT_FUNC "%10.0" "pct" COEFFS 0.000000 1.000000 0.000000 0.000000 0.000000 1.000000 /end COMPU_METHOD
/* Scalar measurable for DDE 'CIN_pct_TqCtrRq_ESP_B'. */
/begin MEASUREMENT CIN_pct_TqCtrRq_ESP_B "Displayable" FLOAT32_IEEE CU_CIN_PCT_TQCTRRQ_ESP_B 1 100 0.0 0.0 ECU_ADDRESS 0x400036f8 BYTE_ORDER MSB_FIRST /end MEASUREMENT
/begin COMPU_METHOD CU_CIN_PCT_TQCTRRQ_ESP_B "Conversion method for CIN_pct_TqCtrRq_ESP_B" RAT_FUNC "%10.0" "pct" COEFFS 0.000000 1.000000 0.000000 0.000000 0.000000 1.000000 /end COMPU_METHOD
/* Scalar measurable for DDE 'CIN_pct_TqCtrRq_TCM'. */
/begin MEASUREMENT CIN_pct_TqCtrRq_TCM "Displayable" FLOAT32_IEEE CU_CIN_PCT_TQCTRRQ_TCM 1 100 0.0 0.0 ECU_ADDRESS 0x40003834 BYTE_ORDER MSB_FIRST /end MEASUREMENT
/begin COMPU_METHOD CU_CIN_PCT_TQCTRRQ_TCM "Conversion method for CIN_pct_TqCtrRq_TCM" RAT_FUNC "%10.0" "pct" COEFFS 0.000000 1.000000 0.000000 0.000000 0.000000 1.000000 /end COMPU_METHOD
/* Scalar measurable for DDE 'CIN_pct_TqCtrRq_TCM_B'. */
/begin MEASUREMENT CIN_pct_TqCtrRq_TCM_B "Displayable" FLOAT32_IEEE CU_CIN_PCT_TQCTRRQ_TCM_B 1 100 0.0 0.0 ECU_ADDRESS 0x40003700 BYTE_ORDER MSB_FIRST /end MEASUREMENT
/begin COMPU_METHOD CU_CIN_PCT_TQCTRRQ_TCM_B "Conversion method for CIN_pct_TqCtrRq_TCM_B" RAT_FUNC "%10.0" "pct" COEFFS 0.000000 1.000000 0.000000 0.000000 0.000000 1.000000 /end COMPU_METHOD
/* Scalar measurable for DDE 'CLF_NU_DGainFast1'. */
/begin MEASUREMENT CLF_NU_DGainFast1 "Convenience displayable" FLOAT32_IEEE CU_CLF_NU_DGAINFAST1 1 100 0.0 0.0 ECU_ADDRESS 0x40003520 BYTE_ORDER MSB_FIRST /end MEASUREMENT
/begin COMPU_METHOD CU_CLF_NU_DGAINFAST1 "Conversion method for CLF_NU_DGainFast1" RAT_FUNC "%10.4" "NU" COEFFS 0.000000 1.000000 0.000000 0.000000 0.000000 1.000000 /end COMPU_METHOD
/* Scalar measurable for DDE 'CLF_NU_DGainFast2'. */
/begin MEASUREMENT CLF_NU_DGainFast2 "Convenience displayable" FLOAT32_IEEE CU_CLF_NU_DGAINFAST2 1 100 0.0 0.0 ECU_ADDRESS 0x400034f8 BYTE_ORDER MSB_FIRST /end MEASUREMENT
/begin COMPU_METHOD CU_CLF_NU_DGAINFAST2 "Conversion method for CLF_NU_DGainFast2" RAT_FUNC "%10.4" "NU" COEFFS 0.000000 1.000000 0.000000 0.000000 0.000000 1.000000 /end COMPU_METHOD
/* Scalar measurable for DDE 'CLF_NU_DGainSlow1'. */
/begin MEASUREMENT CLF_NU_DGainSlow1 "Convenience displayable" FLOAT32_IEEE CU_CLF_NU_DGAINSLOW1 1 100 0.0 0.0 ECU_ADDRESS 0x40003514 BYTE_ORDER MSB_FIRST /end MEASUREMENT
/begin COMPU_METHOD CU_CLF_NU_DGAINSLOW1 "Conversion method for CLF_NU_DGainSlow1" RAT_FUNC "%10.4" "NU" COEFFS 0.000000 1.000000 0.000000 0.000000 0.000000 1.000000 /end COMPU_METHOD
/* Scalar measurable for DDE 'CLF_NU_DGainSlow2'. */
/begin MEASUREMENT CLF_NU_DGainSlow2 "Convenience displayable" FLOAT32_IEEE CU_CLF_NU_DGAINSLOW2 1 100 0.0 0.0 ECU_ADDRESS 0x400034e8 BYTE_ORDER MSB_FIRST /end MEASUREMENT
/begin COMPU_METHOD CU_CLF_NU_DGAINSLOW2 "Conversion method for CLF_NU_DGainSlow2" RAT_FUNC "%10.4" "NU" COEFFS 0.000000 1.000000 0.000000 0.000000 0.000000 1.000000 /end COMPU_METHOD
/* Scalar measurable for DDE 'CLF_NU_FB1_ErrorDot'. */
/begin MEASUREMENT CLF_NU_FB1_ErrorDot "Error derivative" FLOAT32_IEEE CU_CLF_NU_FB1_ERRORDOT 1 100 0.0 0.0 ECU_ADDRESS 0x40003508 BYTE_ORDER MSB_FIRST /end MEASUREMENT
/begin COMPU_METHOD CU_CLF_NU_FB1_ERRORDOT "Conversion method for CLF_NU_FB1_ErrorDot" RAT_FUNC "%10.3" "NU" COEFFS 0.000000 1.000000 0.000000 0.000000 0.000000 1.000000 /end COMPU_METHOD
/* Scalar measurable for DDE 'CLF_NU_FB2_ErrorDot'. */
/begin MEASUREMENT CLF_NU_FB2_ErrorDot "Error derivative" FLOAT32_IEEE CU_CLF_NU_FB2_ERRORDOT 1 100 0.0 0.0 ECU_ADDRESS 0x400034d8 BYTE_ORDER MSB_FIRST /end MEASUREMENT
/begin COMPU_METHOD CU_CLF_NU_FB2_ERRORDOT "Conversion method for CLF_NU_FB2_ErrorDot" RAT_FUNC "%10.3" "NU" COEFFS 0.000000 1.000000 0.000000 0.000000 0.000000 1.000000 /end COMPU_METHOD
/* Scalar measurable for DDE 'CLF_NU_IGainFast1'. */
/begin MEASUREMENT CLF_NU_IGainFast1 "Convenience displayable" FLOAT32_IEEE CU_CLF_NU_IGAINFAST1 1 100 0.0 0.0 ECU_ADDRESS 0x40003524 BYTE_ORDER MSB_FIRST /end MEASUREMENT
/begin COMPU_METHOD CU_CLF_NU_IGAINFAST1 "Conversion method for CLF_NU_IGainFast1" RAT_FUNC "%10.4" "NU" COEFFS 0.000000 1.000000 0.000000 0.000000 0.000000 1.000000 /end COMPU_METHOD
/* Scalar measurable for DDE 'CLF_NU_IGainFast2'. */
/begin MEASUREMENT CLF_NU_IGainFast2 "Convenience displayable" FLOAT32_IEEE CU_CLF_NU_IGAINFAST2 1 100 0.0 0.0 ECU_ADDRESS 0x400034fc BYTE_ORDER MSB_FIRST /end MEASUREMENT
/begin COMPU_METHOD CU_CLF_NU_IGAINFAST2 "Conversion method for CLF_NU_IGainFast2" RAT_FUNC "%10.4" "NU" COEFFS 0.000000 1.000000 0.000000 0.000000 0.000000 1.000000 /end COMPU_METHOD
/* Scalar measurable for DDE 'CLF_NU_IGainSlow1'. */
/begin MEASUREMENT CLF_NU_IGainSlow1 "Convenience displayable" FLOAT32_IEEE CU_CLF_NU_IGAINSLOW1 1 100 0.0 0.0 ECU_ADDRESS 0x40003518 BYTE_ORDER MSB_FIRST /end MEASUREMENT
/begin COMPU_METHOD CU_CLF_NU_IGAINSLOW1 "Conversion method for CLF_NU_IGainSlow1" RAT_FUNC "%10.4" "NU" COEFFS 0.000000 1.000000 0.000000 0.000000 0.000000 1.000000 /end COMPU_METHOD
/* Scalar measurable for DDE 'CLF_NU_IGainSlow2'. */
/begin MEASUREMENT CLF_NU_IGainSlow2 "Convenience displayable" FLOAT32_IEEE CU_CLF_NU_IGAINSLOW2 1 100 0.0 0.0 ECU_ADDRESS 0x400034ec BYTE_ORDER MSB_FIRST /end MEASUREMENT
/begin COMPU_METHOD CU_CLF_NU_IGAINSLOW2 "Conversion method for CLF_NU_IGainSlow2" RAT_FUNC "%10.4" "NU" COEFFS 0.000000 1.000000 0.000000 0.000000 0.000000 1.000000 /end COMPU_METHOD
/* Scalar measurable for DDE 'CLF_NU_PGainFast1'. */
/begin MEASUREMENT CLF_NU_PGainFast1 "Convenience displayable" FLOAT32_IEEE CU_CLF_NU_PGAINFAST1 1 100 0.0 0.0 ECU_ADDRESS 0x40003528 BYTE_ORDER MSB_FIRST /end MEASUREMENT
/begin COMPU_METHOD CU_CLF_NU_PGAINFAST1 "Conversion method for CLF_NU_PGainFast1" RAT_FUNC "%10.4" "NU" COEFFS 0.000000 1.000000 0.000000 0.000000 0.000000 1.000000 /end COMPU_METHOD
/* Scalar measurable for DDE 'CLF_NU_PGainFast2'. */
/begin MEASUREMENT CLF_NU_PGainFast2 "Convenience displayable" FLOAT32_IEEE CU_CLF_NU_PGAINFAST2 1 100 0.0 0.0 ECU_ADDRESS 0x40003500 BYTE_ORDER MSB_FIRST /end MEASUREMENT
/begin COMPU_METHOD CU_CLF_NU_PGAINFAST2 "Conversion method for CLF_NU_PGainFast2" RAT_FUNC "%10.4" "NU" COEFFS 0.000000 1.000000 0.000000 0.000000 0.000000 1.000000 /end COMPU_METHOD
/* Scalar measurable for DDE 'CLF_NU_PGainSlow1'. */
/begin MEASUREMENT CLF_NU_PGainSlow1 "Convenience displayable" FLOAT32_IEEE CU_CLF_NU_PGAINSLOW1 1 100 0.0 0.0 ECU_ADDRESS 0x4000351c BYTE_ORDER MSB_FIRST /end MEASUREMENT
/begin COMPU_METHOD CU_CLF_NU_PGAINSLOW1 "Conversion method for CLF_NU_PGainSlow1" RAT_FUNC "%10.4" "NU" COEFFS 0.000000 1.000000 0.000000 0.000000 0.000000 1.000000 /end COMPU_METHOD
/* Scalar measurable for DDE 'CLF_NU_PGainSlow2'. */
/begin MEASUREMENT CLF_NU_PGainSlow2 "Convenience displayable" FLOAT32_IEEE CU_CLF_NU_PGAINSLOW2 1 100 0.0 0.0 ECU_ADDRESS 0x400034f0 BYTE_ORDER MSB_FIRST /end MEASUREMENT
/begin COMPU_METHOD CU_CLF_NU_PGAINSLOW2 "Conversion method for CLF_NU_PGainSlow2" RAT_FUNC "%10.4" "NU" COEFFS 0.000000 1.000000 0.000000 0.000000 0.000000 1.000000 /end COMPU_METHOD
/* Scalar measurable for DDE 'CLF_RPM_EngSpdHPF'. */
/begin MEASUREMENT CLF_RPM_EngSpdHPF "HPF result displayable" FLOAT32_IEEE CU_CLF_RPM_ENGSPDHPF 1 100 0.0 0.0 ECU_ADDRESS 0x40003538 BYTE_ORDER MSB_FIRST /end MEASUREMENT
/begin COMPU_METHOD CU_CLF_RPM_ENGSPDHPF "Conversion method for CLF_RPM_EngSpdHPF" RAT_FUNC "%10.1" "RPM" COEFFS 0.000000 1.000000 0.000000 0.000000 0.000000 1.000000 /end COMPU_METHOD
/* Scalar measurable for DDE 'CLF_b_Dither1Active'. */
/begin MEASUREMENT CLF_b_Dither1Active "Displayable" UBYTE CU_CLF_B_DITHER1ACTIVE 1 100 0.0 1.0 ECU_ADDRESS 0x40002eb7 BYTE_ORDER MSB_FIRST /end MEASUREMENT
/begin COMPU_METHOD CU_CLF_B_DITHER1ACTIVE "Conversion method for CLF_b_Dither1Active" RAT_FUNC "%10.0" "b" COEFFS 0.000000 1.000000 0.000000 0.000000 0.000000 1.000000 /end COMPU_METHOD
/* Scalar measurable for DDE 'CLF_b_Dither1Lean'. */
/begin MEASUREMENT CLF_b_Dither1Lean "Displayable" UBYTE CU_CLF_B_DITHER1LEAN 1 100 0.0 1.0 ECU_ADDRESS 0x40002e6b BYTE_ORDER MSB_FIRST /end MEASUREMENT
/begin COMPU_METHOD CU_CLF_B_DITHER1LEAN "Conversion method for CLF_b_Dither1Lean" RAT_FUNC "%10.0" "b" COEFFS 0.000000 1.000000 0.000000 0.000000 0.000000 1.000000 /end COMPU_METHOD
/* Scalar measurable for DDE 'CLF_b_Dither1Rich'. */
/begin MEASUREMENT CLF_b_Dither1Rich "Displayable" UBYTE CU_CLF_B_DITHER1RICH 1 100 0.0 1.0 ECU_ADDRESS 0x40002e6a BYTE_ORDER MSB_FIRST /end MEASUREMENT
/begin COMPU_METHOD CU_CLF_B_DITHER1RICH "Conversion method for CLF_b_Dither1Rich" RAT_FUNC "%10.0" "b" COEFFS 0.000000 1.000000 0.000000 0.000000 0.000000 1.000000 /end COMPU_METHOD
/* Scalar measurable for DDE 'CLF_b_Dither2Active'. */
/begin MEASUREMENT CLF_b_Dither2Active "Displayable" UBYTE CU_CLF_B_DITHER2ACTIVE 1 100 0.0 1.0 ECU_ADDRESS 0x40002eb6 BYTE_ORDER MSB_FIRST /end MEASUREMENT
/begin COMPU_METHOD CU_CLF_B_DITHER2ACTIVE "Conversion method for CLF_b_Dither2Active" RAT_FUNC "%10.0" "b" COEFFS 0.000000 1.000000 0.000000 0.000000 0.000000 1.000000 /end COMPU_METHOD
/* Scalar measurable for DDE 'CLF_b_Dither2Lean'. */
/begin MEASUREMENT CLF_b_Dither2Lean "Displayable" UBYTE CU_CLF_B_DITHER2LEAN 1 100 0.0 1.0 ECU_ADDRESS 0x40002e6d BYTE_ORDER MSB_FIRST /end MEASUREMENT
/begin COMPU_METHOD CU_CLF_B_DITHER2LEAN "Conversion method for CLF_b_Dither2Lean" RAT_FUNC "%10.0" "b" COEFFS 0.000000 1.000000 0.000000 0.000000 0.000000 1.000000 /end COMPU_METHOD
/* Scalar measurable for DDE 'CLF_b_Dither2Rich'. */
/begin MEASUREMENT CLF_b_Dither2Rich "Displayable" UBYTE CU_CLF_B_DITHER2RICH 1 100 0.0 1.0 ECU_ADDRESS 0x40002e6c BYTE_ORDER MSB_FIRST /end MEASUREMENT
/begin COMPU_METHOD CU_CLF_B_DITHER2RICH "Conversion method for CLF_b_Dither2Rich" RAT_FUNC "%10.0" "b" COEFFS 0.000000 1.000000 0.000000 0.000000 0.000000 1.000000 /end COMPU_METHOD
/* Scalar measurable for DDE 'CLF_b_DitherLamErrorActv'. */
/begin MEASUREMENT CLF_b_DitherLamErrorActv "Displayable" UBYTE CU_CLF_B_DITHERLAMERRORACTV 1 100 0.0 1.0 ECU_ADDRESS 0x40002ecd BYTE_ORDER MSB_FIRST /end MEASUREMENT
/begin COMPU_METHOD CU_CLF_B_DITHERLAMERRORACTV "Conversion method for CLF_b_DitherLamErrorActv" RAT_FUNC "%10.0" "b" COEFFS 0.000000 1.000000 0.000000 0.000000 0.000000 1.000000 /end COMPU_METHOD
/* Scalar measurable for DDE 'CLF_b_FB1_Active'. */
/begin MEASUREMENT CLF_b_FB1_Active "Displayable" UBYTE CU_CLF_B_FB1_ACTIVE 1 100 0.0 1.0 ECU_ADDRESS 0x40002e7e BYTE_ORDER MSB_FIRST /end MEASUREMENT
/begin COMPU_METHOD CU_CLF_B_FB1_ACTIVE "Conversion method for CLF_b_FB1_Active" RAT_FUNC "%10.0" "b" COEFFS 0.000000 1.000000 0.000000 0.000000 0.000000 1.000000 /end COMPU_METHOD
/* Scalar measurable for DDE 'CLF_b_FB1_Enbld'. */
/begin MEASUREMENT CLF_b_FB1_Enbld "FB status" UBYTE CU_CLF_B_FB1_ENBLD 1 100 0.0 1.0 ECU_ADDRESS 0x40002ecb BYTE_ORDER MSB_FIRST /end MEASUREMENT
/begin COMPU_METHOD CU_CLF_B_FB1_ENBLD "Conversion method for CLF_b_FB1_Enbld" RAT_FUNC "%10.0" "b" COEFFS 0.000000 1.000000 0.000000 0.000000 0.000000 1.000000 /end COMPU_METHOD
/* Scalar measurable for DDE 'CLF_b_FB2_Active'. */
/begin MEASUREMENT CLF_b_FB2_Active "Displayable" UBYTE CU_CLF_B_FB2_ACTIVE 1 100 0.0 1.0 ECU_ADDRESS 0x40002e7d BYTE_ORDER MSB_FIRST /end MEASUREMENT
/begin COMPU_METHOD CU_CLF_B_FB2_ACTIVE "Conversion method for CLF_b_FB2_Active" RAT_FUNC "%10.0" "b" COEFFS 0.000000 1.000000 0.000000 0.000000 0.000000 1.000000 /end COMPU_METHOD
/* Scalar measurable for DDE 'CLF_b_FB2_Enbld'. */
/begin MEASUREMENT CLF_b_FB2_Enbld "FB status" UBYTE CU_CLF_B_FB2_ENBLD 1 100 0.0 1.0 ECU_ADDRESS 0x40002ec6 BYTE_ORDER MSB_FIRST /end MEASUREMENT
/begin COMPU_METHOD CU_CLF_B_FB2_ENBLD "Conversion method for CLF_b_FB2_Enbld" RAT_FUNC "%10.0" "b" COEFFS 0.000000 1.000000 0.000000 0.000000 0.000000 1.000000 /end COMPU_METHOD
/* Scalar measurable for DDE 'CLF_b_FastFB1'. */
/begin MEASUREMENT CLF_b_FastFB1 "State displayable" UBYTE CU_CLF_B_FASTFB1 1 100 0.0 1.0 ECU_ADDRESS 0x40002e67 BYTE_ORDER MSB_FIRST /end MEASUREMENT
/begin COMPU_METHOD CU_CLF_B_FASTFB1 "Conversion method for CLF_b_FastFB1" RAT_FUNC "%10.0" "b" COEFFS 0.000000 1.000000 0.000000 0.000000 0.000000 1.000000 /end COMPU_METHOD
/* Scalar measurable for DDE 'CLF_b_FastFB2'. */
/begin MEASUREMENT CLF_b_FastFB2 "State displayable" UBYTE CU_CLF_B_FASTFB2 1 100 0.0 1.0 ECU_ADDRESS 0x40002e69 BYTE_ORDER MSB_FIRST /end MEASUREMENT
/begin COMPU_METHOD CU_CLF_B_FASTFB2 "Conversion method for CLF_b_FastFB2" RAT_FUNC "%10.0" "b" COEFFS 0.000000 1.000000 0.000000 0.000000 0.000000 1.000000 /end COMPU_METHOD
/* Scalar measurable for DDE 'CLF_b_InitialFB1_Stable'. */
/begin MEASUREMENT CLF_b_InitialFB1_Stable "Displayable" UBYTE CU_CLF_B_INITIALFB1_STABLE 1 100 0.0 1.0 ECU_ADDRESS 0x40002eca BYTE_ORDER MSB_FIRST /end MEASUREMENT
/begin COMPU_METHOD CU_CLF_B_INITIALFB1_STABLE "Conversion method for CLF_b_InitialFB1_Stable" RAT_FUNC "%10.0" "b" COEFFS 0.000000 1.000000 0.000000 0.000000 0.000000 1.000000 /end COMPU_METHOD
/* Scalar measurable for DDE 'CLF_b_InitialFB2_Stable'. */
/begin MEASUREMENT CLF_b_InitialFB2_Stable "Displayable" UBYTE CU_CLF_B_INITIALFB2_STABLE 1 100 0.0 1.0 ECU_ADDRESS 0x40002ec5 BYTE_ORDER MSB_FIRST /end MEASUREMENT
/begin COMPU_METHOD CU_CLF_B_INITIALFB2_STABLE "Conversion method for CLF_b_InitialFB2_Stable" RAT_FUNC "%10.0" "b" COEFFS 0.000000 1.000000 0.000000 0.000000 0.000000 1.000000 /end COMPU_METHOD
/* Scalar measurable for DDE 'CLF_b_LTFT1_Active'. */
/begin MEASUREMENT CLF_b_LTFT1_Active "LTFT criteria met" UBYTE CU_CLF_B_LTFT1_ACTIVE 1 100 0.0 1.0 ECU_ADDRESS 0x40002ec8 BYTE_ORDER MSB_FIRST /end MEASUREMENT
/begin COMPU_METHOD CU_CLF_B_LTFT1_ACTIVE "Conversion method for CLF_b_LTFT1_Active" RAT_FUNC "%10.0" "b" COEFFS 0.000000 1.000000 0.000000 0.000000 0.000000 1.000000 /end COMPU_METHOD
/* Scalar measurable for DDE 'CLF_b_LTFT1_AdaptFlag'. */
/begin MEASUREMENT CLF_b_LTFT1_AdaptFlag "Adapt status displayable" UBYTE CU_CLF_B_LTFT1_ADAPTFLAG 1 100 0.0 1.0 ECU_ADDRESS 0x40002ec7 BYTE_ORDER MSB_FIRST /end MEASUREMENT
/begin COMPU_METHOD CU_CLF_B_LTFT1_ADAPTFLAG "Conversion method for CLF_b_LTFT1_AdaptFlag" RAT_FUNC "%10.0" "b" COEFFS 0.000000 1.000000 0.000000 0.000000 0.000000 1.000000 /end COMPU_METHOD
/* Scalar measurable for DDE 'CLF_b_LTFT2_Active'. */
/begin MEASUREMENT CLF_b_LTFT2_Active "LTFT criteria met" UBYTE CU_CLF_B_LTFT2_ACTIVE 1 100 0.0 1.0 ECU_ADDRESS 0x40002ec3 BYTE_ORDER MSB_FIRST /end MEASUREMENT
/begin COMPU_METHOD CU_CLF_B_LTFT2_ACTIVE "Conversion method for CLF_b_LTFT2_Active" RAT_FUNC "%10.0" "b" COEFFS 0.000000 1.000000 0.000000 0.000000 0.000000 1.000000 /end COMPU_METHOD
/* Scalar measurable for DDE 'CLF_b_LTFT2_AdaptFlag'. */
/begin MEASUREMENT CLF_b_LTFT2_AdaptFlag "Adapt status displayable" UBYTE CU_CLF_B_LTFT2_ADAPTFLAG 1 100 0.0 1.0 ECU_ADDRESS 0x40002ec2 BYTE_ORDER MSB_FIRST /end MEASUREMENT
/begin COMPU_METHOD CU_CLF_B_LTFT2_ADAPTFLAG "Conversion method for CLF_b_LTFT2_AdaptFlag" RAT_FUNC "%10.0" "b" COEFFS 0.000000 1.000000 0.000000 0.000000 0.000000 1.000000 /end COMPU_METHOD
/* Scalar measurable for DDE 'CLF_b_SlowFB1'. */
/begin MEASUREMENT CLF_b_SlowFB1 "State displayable" UBYTE CU_CLF_B_SLOWFB1 1 100 0.0 1.0 ECU_ADDRESS 0x40002e66 BYTE_ORDER MSB_FIRST /end MEASUREMENT
/begin COMPU_METHOD CU_CLF_B_SLOWFB1 "Conversion method for CLF_b_SlowFB1" RAT_FUNC "%10.0" "b" COEFFS 0.000000 1.000000 0.000000 0.000000 0.000000 1.000000 /end COMPU_METHOD
/* Scalar measurable for DDE 'CLF_b_SlowFB1_Unstable'. */
/begin MEASUREMENT CLF_b_SlowFB1_Unstable "Displayable" UBYTE CU_CLF_B_SLOWFB1_UNSTABLE 1 100 0.0 1.0 ECU_ADDRESS 0x40002ec9 BYTE_ORDER MSB_FIRST /end MEASUREMENT
/begin COMPU_METHOD CU_CLF_B_SLOWFB1_UNSTABLE "Conversion method for CLF_b_SlowFB1_Unstable" RAT_FUNC "%10.0" "b" COEFFS 0.000000 1.000000 0.000000 0.000000 0.000000 1.000000 /end COMPU_METHOD
/* Scalar measurable for DDE 'CLF_b_SlowFB2'. */
/begin MEASUREMENT CLF_b_SlowFB2 "State displayable" UBYTE CU_CLF_B_SLOWFB2 1 100 0.0 1.0 ECU_ADDRESS 0x40002e68 BYTE_ORDER MSB_FIRST /end MEASUREMENT
/begin COMPU_METHOD CU_CLF_B_SLOWFB2 "Conversion method for CLF_b_SlowFB2" RAT_FUNC "%10.0" "b" COEFFS 0.000000 1.000000 0.000000 0.000000 0.000000 1.000000 /end COMPU_METHOD
/* Scalar measurable for DDE 'CLF_b_SlowFB2_Unstable'. */
/begin MEASUREMENT CLF_b_SlowFB2_Unstable "Displayable" UBYTE CU_CLF_B_SLOWFB2_UNSTABLE 1 100 0.0 1.0 ECU_ADDRESS 0x40002ec4 BYTE_ORDER MSB_FIRST /end MEASUREMENT
/begin COMPU_METHOD CU_CLF_B_SLOWFB2_UNSTABLE "Conversion method for CLF_b_SlowFB2_Unstable" RAT_FUNC "%10.0" "b" COEFFS 0.000000 1.000000 0.000000 0.000000 0.000000 1.000000 /end COMPU_METHOD
/* Scalar measurable for DDE 'CLF_cnt_LeanFiringsRqst1'. */
/begin MEASUREMENT CLF_cnt_LeanFiringsRqst1 "Map output displayable" UBYTE CU_CLF_CNT_LEANFIRINGSRQST1 1 100 0.0 0.0 ECU_ADDRESS 0x40002fe5 BYTE_ORDER MSB_FIRST /end MEASUREMENT
/begin COMPU_METHOD CU_CLF_CNT_LEANFIRINGSRQST1 "Conversion method for CLF_cnt_LeanFiringsRqst1" RAT_FUNC "%10.0" "cnt" COEFFS 0.000000 1.000000 0.000000 0.000000 0.000000 1.000000 /end COMPU_METHOD
/* Scalar measurable for DDE 'CLF_cnt_LeanFiringsRqst2'. */
/begin MEASUREMENT CLF_cnt_LeanFiringsRqst2 "Map output displayable" UBYTE CU_CLF_CNT_LEANFIRINGSRQST2 1 100 0.0 0.0 ECU_ADDRESS 0x40002fe3 BYTE_ORDER MSB_FIRST /end MEASUREMENT
/begin COMPU_METHOD CU_CLF_CNT_LEANFIRINGSRQST2 "Conversion method for CLF_cnt_LeanFiringsRqst2" RAT_FUNC "%10.0" "cnt" COEFFS 0.000000 1.000000 0.000000 0.000000 0.000000 1.000000 /end COMPU_METHOD
/* Scalar measurable for DDE 'CLF_cnt_RichFiringsRqst1'. */
/begin MEASUREMENT CLF_cnt_RichFiringsRqst1 "Map output displayable" UBYTE CU_CLF_CNT_RICHFIRINGSRQST1 1 100 0.0 0.0 ECU_ADDRESS 0x40002fe6 BYTE_ORDER MSB_FIRST /end MEASUREMENT
/begin COMPU_METHOD CU_CLF_CNT_RICHFIRINGSRQST1 "Conversion method for CLF_cnt_RichFiringsRqst1" RAT_FUNC "%10.0" "cnt" COEFFS 0.000000 1.000000 0.000000 0.000000 0.000000 1.000000 /end COMPU_METHOD
/* Scalar measurable for DDE 'CLF_cnt_RichFiringsRqst2'. */
/begin MEASUREMENT CLF_cnt_RichFiringsRqst2 "Map output displayable" UBYTE CU_CLF_CNT_RICHFIRINGSRQST2 1 100 0.0 0.0 ECU_ADDRESS 0x40002fe4 BYTE_ORDER MSB_FIRST /end MEASUREMENT
/begin COMPU_METHOD CU_CLF_CNT_RICHFIRINGSRQST2 "Conversion method for CLF_cnt_RichFiringsRqst2" RAT_FUNC "%10.0" "cnt" COEFFS 0.000000 1.000000 0.000000 0.000000 0.000000 1.000000 /end COMPU_METHOD
/* Scalar measurable for DDE 'CLF_lam_DTermLPF1'. */
/begin MEASUREMENT CLF_lam_DTermLPF1 "LPF result displayable" FLOAT32_IEEE CU_CLF_LAM_DTERMLPF1 1 100 0.0 0.0 ECU_ADDRESS 0x4000350c BYTE_ORDER MSB_FIRST /end MEASUREMENT
/begin COMPU_METHOD CU_CLF_LAM_DTERMLPF1 "Conversion method for CLF_lam_DTermLPF1" RAT_FUNC "%10.3" "lam" COEFFS 0.000000 1.000000 0.000000 0.000000 0.000000 1.000000 /end COMPU_METHOD
/* Scalar measurable for DDE 'CLF_lam_DTermLPF2'. */
/begin MEASUREMENT CLF_lam_DTermLPF2 "LPF result displayable" FLOAT32_IEEE CU_CLF_LAM_DTERMLPF2 1 100 0.0 0.0 ECU_ADDRESS 0x400034dc BYTE_ORDER MSB_FIRST /end MEASUREMENT
/begin COMPU_METHOD CU_CLF_LAM_DTERMLPF2 "Conversion method for CLF_lam_DTermLPF2" RAT_FUNC "%10.3" "lam" COEFFS 0.000000 1.000000 0.000000 0.000000 0.000000 1.000000 /end COMPU_METHOD
/* Scalar measurable for DDE 'CLF_lam_Error1ThrshLPF'. */
/begin MEASUREMENT CLF_lam_Error1ThrshLPF "LPF result displayable" FLOAT32_IEEE CU_CLF_LAM_ERROR1THRSHLPF 1 100 0.0 0.0 ECU_ADDRESS 0x40003530 BYTE_ORDER MSB_FIRST /end MEASUREMENT
/begin COMPU_METHOD CU_CLF_LAM_ERROR1THRSHLPF "Conversion method for CLF_lam_Error1ThrshLPF" RAT_FUNC "%10.3" "lam" COEFFS 0.000000 1.000000 0.000000 0.000000 0.000000 1.000000 /end COMPU_METHOD
/* Scalar measurable for DDE 'CLF_lam_Error2ThrshLPF'. */
/begin MEASUREMENT CLF_lam_Error2ThrshLPF "LPF result displayable" FLOAT32_IEEE CU_CLF_LAM_ERROR2THRSHLPF 1 100 0.0 0.0 ECU_ADDRESS 0x400034f4 BYTE_ORDER MSB_FIRST /end MEASUREMENT
/begin COMPU_METHOD CU_CLF_LAM_ERROR2THRSHLPF "Conversion method for CLF_lam_Error2ThrshLPF" RAT_FUNC "%10.3" "lam" COEFFS 0.000000 1.000000 0.000000 0.000000 0.000000 1.000000 /end COMPU_METHOD
/* Scalar measurable for DDE 'CLF_lam_FB1_Ctrl'. */
/begin MEASUREMENT CLF_lam_FB1_Ctrl "Delta-lambda displayable" FLOAT32_IEEE CU_CLF_LAM_FB1_CTRL 1 100 0.0 0.0 ECU_ADDRESS 0x400034d4 BYTE_ORDER MSB_FIRST /end MEASUREMENT
/begin COMPU_METHOD CU_CLF_LAM_FB1_CTRL "Conversion method for CLF_lam_FB1_Ctrl" RAT_FUNC "%10.3" "lam" COEFFS 0.000000 1.000000 0.000000 0.000000 0.000000 1.000000 /end COMPU_METHOD
/* Scalar measurable for DDE 'CLF_lam_FB1_Error'. */
/begin MEASUREMENT CLF_lam_FB1_Error "Displayable" FLOAT32_IEEE CU_CLF_LAM_FB1_ERROR 1 100 0.0 0.0 ECU_ADDRESS 0x4000353c BYTE_ORDER MSB_FIRST /end MEASUREMENT
/begin COMPU_METHOD CU_CLF_LAM_FB1_ERROR "Conversion method for CLF_lam_FB1_Error" RAT_FUNC "%10.3" "lam" COEFFS 0.000000 1.000000 0.000000 0.000000 0.000000 1.000000 /end COMPU_METHOD
/* Scalar measurable for DDE 'CLF_lam_FB1_ITerm'. */
/begin MEASUREMENT CLF_lam_FB1_ITerm "PID effort displayable" FLOAT32_IEEE CU_CLF_LAM_FB1_ITERM 1 100 0.0 0.0 ECU_ADDRESS 0x4000352c BYTE_ORDER MSB_FIRST /end MEASUREMENT
/begin COMPU_METHOD CU_CLF_LAM_FB1_ITERM "Conversion method for CLF_lam_FB1_ITerm" RAT_FUNC "%10.3" "lam" COEFFS 0.000000 1.000000 0.000000 0.000000 0.000000 1.000000 /end COMPU_METHOD
/* Scalar measurable for DDE 'CLF_lam_FB1_PTerm'. */
/begin MEASUREMENT CLF_lam_FB1_PTerm "PID effort displayable" FLOAT32_IEEE CU_CLF_LAM_FB1_PTERM 1 100 0.0 0.0 ECU_ADDRESS 0x40003510 BYTE_ORDER MSB_FIRST /end MEASUREMENT
/begin COMPU_METHOD CU_CLF_LAM_FB1_PTERM "Conversion method for CLF_lam_FB1_PTerm" RAT_FUNC "%10.3" "lam" COEFFS 0.000000 1.000000 0.000000 0.000000 0.000000 1.000000 /end COMPU_METHOD
/* Scalar measurable for DDE 'CLF_lam_FB2_Ctrl'. */
/begin MEASUREMENT CLF_lam_FB2_Ctrl "Delta-lambda displayable" FLOAT32_IEEE CU_CLF_LAM_FB2_CTRL 1 100 0.0 0.0 ECU_ADDRESS 0x40003384 BYTE_ORDER MSB_FIRST /end MEASUREMENT
/begin COMPU_METHOD CU_CLF_LAM_FB2_CTRL "Conversion method for CLF_lam_FB2_Ctrl" RAT_FUNC "%10.3" "lam" COEFFS 0.000000 1.000000 0.000000 0.000000 0.000000 1.000000 /end COMPU_METHOD
/* Scalar measurable for DDE 'CLF_lam_FB2_Error'. */
/begin MEASUREMENT CLF_lam_FB2_Error "Displayable" FLOAT32_IEEE CU_CLF_LAM_FB2_ERROR 1 100 0.0 0.0 ECU_ADDRESS 0x40003504 BYTE_ORDER MSB_FIRST /end MEASUREMENT
/begin COMPU_METHOD CU_CLF_LAM_FB2_ERROR "Conversion method for CLF_lam_FB2_Error" RAT_FUNC "%10.3" "lam" COEFFS 0.000000 1.000000 0.000000 0.000000 0.000000 1.000000 /end COMPU_METHOD
/* Scalar measurable for DDE 'CLF_lam_FB2_ITerm'. */
/begin MEASUREMENT CLF_lam_FB2_ITerm "PID effort displayable" FLOAT32_IEEE CU_CLF_LAM_FB2_ITERM 1 100 0.0 0.0 ECU_ADDRESS 0x400034e0 BYTE_ORDER MSB_FIRST /end MEASUREMENT
/begin COMPU_METHOD CU_CLF_LAM_FB2_ITERM "Conversion method for CLF_lam_FB2_ITerm" RAT_FUNC "%10.3" "lam" COEFFS 0.000000 1.000000 0.000000 0.000000 0.000000 1.000000 /end COMPU_METHOD
/* Scalar measurable for DDE 'CLF_lam_FB2_PTerm'. */
/begin MEASUREMENT CLF_lam_FB2_PTerm "PID effort displayable" FLOAT32_IEEE CU_CLF_LAM_FB2_PTERM 1 100 0.0 0.0 ECU_ADDRESS 0x400034e4 BYTE_ORDER MSB_FIRST /end MEASUREMENT
/begin COMPU_METHOD CU_CLF_LAM_FB2_PTERM "Conversion method for CLF_lam_FB2_PTerm" RAT_FUNC "%10.3" "lam" COEFFS 0.000000 1.000000 0.000000 0.000000 0.000000 1.000000 /end COMPU_METHOD
/* Scalar measurable for DDE 'CLF_lam_LTFT1'. */
/begin MEASUREMENT CLF_lam_LTFT1 "Longterm trim delta-lambda displayable" FLOAT32_IEEE CU_CLF_LAM_LTFT1 1 100 0.0 0.0 ECU_ADDRESS 0x400034d0 BYTE_ORDER MSB_FIRST /end MEASUREMENT
/begin COMPU_METHOD CU_CLF_LAM_LTFT1 "Conversion method for CLF_lam_LTFT1" RAT_FUNC "%10.3" "lam" COEFFS 0.000000 1.000000 0.000000 0.000000 0.000000 1.000000 /end COMPU_METHOD
/* Scalar measurable for DDE 'CLF_lam_LTFT2'. */
/begin MEASUREMENT CLF_lam_LTFT2 "Longterm trim delta-lambda displayable" FLOAT32_IEEE CU_CLF_LAM_LTFT2 1 100 0.0 0.0 ECU_ADDRESS 0x40003380 BYTE_ORDER MSB_FIRST /end MEASUREMENT
/begin COMPU_METHOD CU_CLF_LAM_LTFT2 "Conversion method for CLF_lam_LTFT2" RAT_FUNC "%10.3" "lam" COEFFS 0.000000 1.000000 0.000000 0.000000 0.000000 1.000000 /end COMPU_METHOD
/* Scalar measurable for DDE 'CLF_lam_O2_Dither1'. */
/begin MEASUREMENT CLF_lam_O2_Dither1 "Delta-lambda displayable" FLOAT32_IEEE CU_CLF_LAM_O2_DITHER1 1 100 0.0 0.0 ECU_ADDRESS 0x400031ec BYTE_ORDER MSB_FIRST /end MEASUREMENT
/begin COMPU_METHOD CU_CLF_LAM_O2_DITHER1 "Conversion method for CLF_lam_O2_Dither1" RAT_FUNC "%10.3" "lam" COEFFS 0.000000 1.000000 0.000000 0.000000 0.000000 1.000000 /end COMPU_METHOD
/* Scalar measurable for DDE 'CLF_lam_O2_Dither2'. */
/begin MEASUREMENT CLF_lam_O2_Dither2 "Delta-lambda displayable" FLOAT32_IEEE CU_CLF_LAM_O2_DITHER2 1 100 0.0 0.0 ECU_ADDRESS 0x400031e4 BYTE_ORDER MSB_FIRST /end MEASUREMENT
/begin COMPU_METHOD CU_CLF_LAM_O2_DITHER2 "Conversion method for CLF_lam_O2_Dither2" RAT_FUNC "%10.3" "lam" COEFFS 0.000000 1.000000 0.000000 0.000000 0.000000 1.000000 /end COMPU_METHOD
/* Scalar measurable for DDE 'CLF_lam_UEGO1_DitherAvg'. */
/begin MEASUREMENT CLF_lam_UEGO1_DitherAvg "Sensor value averaged across the most recent dither period" FLOAT32_IEEE CU_CLF_LAM_UEGO1_DITHERAVG 1 100 0.0 0.0 ECU_ADDRESS 0x4000337c BYTE_ORDER MSB_FIRST /end MEASUREMENT
/begin COMPU_METHOD CU_CLF_LAM_UEGO1_DITHERAVG "Conversion method for CLF_lam_UEGO1_DitherAvg" RAT_FUNC "%10.3" "lam" COEFFS 0.000000 1.000000 0.000000 0.000000 0.000000 1.000000 /end COMPU_METHOD
/* Scalar measurable for DDE 'CLF_lam_UEGO2_DitherAvg'. */
/begin MEASUREMENT CLF_lam_UEGO2_DitherAvg "Sensor value averaged across the most recent dither period" FLOAT32_IEEE CU_CLF_LAM_UEGO2_DITHERAVG 1 100 0.0 0.0 ECU_ADDRESS 0x40003378 BYTE_ORDER MSB_FIRST /end MEASUREMENT
/begin COMPU_METHOD CU_CLF_LAM_UEGO2_DITHERAVG "Conversion method for CLF_lam_UEGO2_DitherAvg" RAT_FUNC "%10.3" "lam" COEFFS 0.000000 1.000000 0.000000 0.000000 0.000000 1.000000 /end COMPU_METHOD
/* Scalar measurable for DDE 'CLF_pct_LoadHPF'. */
/begin MEASUREMENT CLF_pct_LoadHPF "HPF result displayable" FLOAT32_IEEE CU_CLF_PCT_LOADHPF 1 100 0.0 0.0 ECU_ADDRESS 0x40003534 BYTE_ORDER MSB_FIRST /end MEASUREMENT
/begin COMPU_METHOD CU_CLF_PCT_LOADHPF "Conversion method for CLF_pct_LoadHPF" RAT_FUNC "%10.3" "pct" COEFFS 0.000000 1.000000 0.000000 0.000000 0.000000 1.000000 /end COMPU_METHOD
/* Scalar measurable for DDE 'CPL_b_CutSpark'. */
/begin MEASUREMENT CPL_b_CutSpark "Displayable" UBYTE CU_CPL_B_CUTSPARK 1 100 0.0 1.0 ECU_ADDRESS 0x40002e91 BYTE_ORDER MSB_FIRST /end MEASUREMENT
/begin COMPU_METHOD CU_CPL_B_CUTSPARK "Conversion method for CPL_b_CutSpark" RAT_FUNC "%10.0" "b" COEFFS 0.000000 1.000000 0.000000 0.000000 0.000000 1.000000 /end COMPU_METHOD
/* Scalar measurable for DDE 'CPL_kPa_BoostDelta'. */
/begin MEASUREMENT CPL_kPa_BoostDelta "Difference between MAP and current boost limit (positive implies overboost)" FLOAT32_IEEE CU_CPL_KPA_BOOSTDELTA 1 100 0.0 0.0 ECU_ADDRESS 0x4000345c BYTE_ORDER MSB_FIRST /end MEASUREMENT
/begin COMPU_METHOD CU_CPL_KPA_BOOSTDELTA "Conversion method for CPL_kPa_BoostDelta" RAT_FUNC "%10.0" "kPa" COEFFS 0.000000 1.000000 0.000000 0.000000 0.000000 1.000000 /end COMPU_METHOD
/* Scalar measurable for DDE 'CPL_ret_SparkRetardRqst'. */
/begin MEASUREMENT CPL_ret_SparkRetardRqst "Displayable" FLOAT32_IEEE CU_CPL_RET_SPARKRETARDRQST 1 100 0.0 0.0 ECU_ADDRESS 0x40003458 BYTE_ORDER MSB_FIRST /end MEASUREMENT
/begin COMPU_METHOD CU_CPL_RET_SPARKRETARDRQST "Conversion method for CPL_ret_SparkRetardRqst" RAT_FUNC "%10.1" "ret" COEFFS 0.000000 1.000000 0.000000 0.000000 0.000000 1.000000 /end COMPU_METHOD
/* Scalar measurable for DDE 'CRU_NU_CurrSpeed'. */
/begin MEASUREMENT CRU_NU_CurrSpeed "(not defined)" FLOAT32_IEEE CU_CRU_NU_CURRSPEED 1 100 0.0 250.0 ECU_ADDRESS 0x400035fc BYTE_ORDER MSB_FIRST /end MEASUREMENT
/begin COMPU_METHOD CU_CRU_NU_CURRSPEED "Conversion method for CRU_NU_CurrSpeed" RAT_FUNC "%10.0" "NU" COEFFS 0.000000 1.000000 0.000000 0.000000 0.000000 1.000000 /end COMPU_METHOD
/* Scalar measurable for DDE 'CRU_NU_LimSpeed'. */
/begin MEASUREMENT CRU_NU_LimSpeed "(not defined)" FLOAT32_IEEE CU_CRU_NU_LIMSPEED 1 100 0.0 250.0 ECU_ADDRESS 0x400035f0 BYTE_ORDER MSB_FIRST /end MEASUREMENT
/begin COMPU_METHOD CU_CRU_NU_LIMSPEED "Conversion method for CRU_NU_LimSpeed" RAT_FUNC "%10.0" "NU" COEFFS 0.000000 1.000000 0.000000 0.000000 0.000000 1.000000 /end COMPU_METHOD
/* Scalar measurable for DDE 'CRU_NU_TargetSpeed'. */
/begin MEASUREMENT CRU_NU_TargetSpeed "(not defined)" FLOAT32_IEEE CU_CRU_NU_TARGETSPEED 1 100 0.0 250.0 ECU_ADDRESS 0x400035ec BYTE_ORDER MSB_FIRST /end MEASUREMENT
/begin COMPU_METHOD CU_CRU_NU_TARGETSPEED "Conversion method for CRU_NU_TargetSpeed" RAT_FUNC "%10.0" "NU" COEFFS 0.000000 1.000000 0.000000 0.000000 0.000000 1.000000 /end COMPU_METHOD
/* Scalar measurable for DDE 'CRU_V_CruiserSET'. */
/begin MEASUREMENT CRU_V_CruiserSET "(not defined)" FLOAT32_IEEE CU_CRU_V_CRUISERSET 1 100 0.0 0.0 ECU_ADDRESS 0x400035f4 BYTE_ORDER MSB_FIRST /end MEASUREMENT
/begin COMPU_METHOD CU_CRU_V_CRUISERSET "Conversion method for CRU_V_CruiserSET" RAT_FUNC "%10.2" "V" COEFFS 0.000000 1.000000 0.000000 0.000000 0.000000 1.000000 /end COMPU_METHOD
/* Scalar measurable for DDE 'CRU_b_Active'. */
/begin MEASUREMENT CRU_b_Active "(not defined)" UBYTE CU_CRU_B_ACTIVE 1 100 0.0 1.0 ECU_ADDRESS 0x400035f8 BYTE_ORDER MSB_FIRST /end MEASUREMENT
/begin COMPU_METHOD CU_CRU_B_ACTIVE "Conversion method for CRU_b_Active" RAT_FUNC "%10.0" "NU" COEFFS 0.000000 1.000000 0.000000 0.000000 0.000000 1.000000 /end COMPU_METHOD
/* Scalar measurable for DDE 'CRU_b_BrakeON'. */
/begin MEASUREMENT CRU_b_BrakeON "(not defined)" UBYTE CU_CRU_B_BRAKEON 1 100 0.0 1.0 ECU_ADDRESS 0x40002ee0 BYTE_ORDER MSB_FIRST /end MEASUREMENT
/begin COMPU_METHOD CU_CRU_B_BRAKEON "Conversion method for CRU_b_BrakeON" RAT_FUNC "%10.0" "NU" COEFFS 0.000000 1.000000 0.000000 0.000000 0.000000 1.000000 /end COMPU_METHOD
/* Scalar measurable for DDE 'CRU_b_Cancel'. */
/begin MEASUREMENT CRU_b_Cancel "(not defined)" UBYTE CU_CRU_B_CANCEL 1 100 0.0 1.0 ECU_ADDRESS 0x40002ede BYTE_ORDER MSB_FIRST /end MEASUREMENT
/begin COMPU_METHOD CU_CRU_B_CANCEL "Conversion method for CRU_b_Cancel" RAT_FUNC "%10.0" "NU" COEFFS 0.000000 1.000000 0.000000 0.000000 0.000000 1.000000 /end COMPU_METHOD
/* Scalar measurable for DDE 'CRU_b_ClunchON'. */
/begin MEASUREMENT CRU_b_ClunchON "(not defined)" UBYTE CU_CRU_B_CLUNCHON 1 100 0.0 1.0 ECU_ADDRESS 0x40002edf BYTE_ORDER MSB_FIRST /end MEASUREMENT
/begin COMPU_METHOD CU_CRU_B_CLUNCHON "Conversion method for CRU_b_ClunchON" RAT_FUNC "%10.0" "NU" COEFFS 0.000000 1.000000 0.000000 0.000000 0.000000 1.000000 /end COMPU_METHOD
/* Scalar measurable for DDE 'CRU_b_DownSpeed'. */
/begin MEASUREMENT CRU_b_DownSpeed "(not defined)" UBYTE CU_CRU_B_DOWNSPEED 1 100 0.0 1.0 ECU_ADDRESS 0x40002edc BYTE_ORDER MSB_FIRST /end MEASUREMENT
/begin COMPU_METHOD CU_CRU_B_DOWNSPEED "Conversion method for CRU_b_DownSpeed" RAT_FUNC "%10.0" "NU" COEFFS 0.000000 1.000000 0.000000 0.000000 0.000000 1.000000 /end COMPU_METHOD
/* Scalar measurable for DDE 'CRU_b_Enable'. */
/begin MEASUREMENT CRU_b_Enable "(not defined)" UBYTE CU_CRU_B_ENABLE 1 100 0.0 1.0 ECU_ADDRESS 0x40002edb BYTE_ORDER MSB_FIRST /end MEASUREMENT
/begin COMPU_METHOD CU_CRU_B_ENABLE "Conversion method for CRU_b_Enable" RAT_FUNC "%10.0" "NU" COEFFS 0.000000 1.000000 0.000000 0.000000 0.000000 1.000000 /end COMPU_METHOD
/* Scalar measurable for DDE 'CRU_b_FootBrake'. */
/begin MEASUREMENT CRU_b_FootBrake "(not defined)" UBYTE CU_CRU_B_FOOTBRAKE 1 100 0.0 1.0 ECU_ADDRESS 0x40002eb4 BYTE_ORDER MSB_FIRST /end MEASUREMENT
/begin COMPU_METHOD CU_CRU_B_FOOTBRAKE "Conversion method for CRU_b_FootBrake" RAT_FUNC "%10.0" "NU" COEFFS 0.000000 1.000000 0.000000 0.000000 0.000000 1.000000 /end COMPU_METHOD
/* Scalar measurable for DDE 'CRU_b_ParkingBrake'. */
/begin MEASUREMENT CRU_b_ParkingBrake "(not defined)" UBYTE CU_CRU_B_PARKINGBRAKE 1 100 0.0 1.0 ECU_ADDRESS 0x40002eb5 BYTE_ORDER MSB_FIRST /end MEASUREMENT
/begin COMPU_METHOD CU_CRU_B_PARKINGBRAKE "Conversion method for CRU_b_ParkingBrake" RAT_FUNC "%10.0" "NU" COEFFS 0.000000 1.000000 0.000000 0.000000 0.000000 1.000000 /end COMPU_METHOD
/* Scalar measurable for DDE 'CRU_b_UpSpeed'. */
/begin MEASUREMENT CRU_b_UpSpeed "(not defined)" UBYTE CU_CRU_B_UPSPEED 1 100 0.0 1.0 ECU_ADDRESS 0x40002edd BYTE_ORDER MSB_FIRST /end MEASUREMENT
/begin COMPU_METHOD CU_CRU_B_UPSPEED "Conversion method for CRU_b_UpSpeed" RAT_FUNC "%10.0" "NU" COEFFS 0.000000 1.000000 0.000000 0.000000 0.000000 1.000000 /end COMPU_METHOD
/* Scalar measurable for DDE 'CTC_lam_FuelEnrichment'. */
/begin MEASUREMENT CTC_lam_FuelEnrichment "Raw charge temp fuel modifier angle" FLOAT32_IEEE CU_CTC_LAM_FUELENRICHMENT 1 100 0.0 0.0 ECU_ADDRESS 0x400034c0 BYTE_ORDER MSB_FIRST /end MEASUREMENT
/begin COMPU_METHOD CU_CTC_LAM_FUELENRICHMENT "Conversion method for CTC_lam_FuelEnrichment" RAT_FUNC "%10.3" "lam" COEFFS 0.000000 1.000000 0.000000 0.000000 0.000000 1.000000 /end COMPU_METHOD
/* Scalar measurable for DDE 'CTC_lam_FuelOfst'. */
/begin MEASUREMENT CTC_lam_FuelOfst "Final charge temp fuel modifier angle" FLOAT32_IEEE CU_CTC_LAM_FUELOFST 1 100 0.0 0.0 ECU_ADDRESS 0x400034bc BYTE_ORDER MSB_FIRST /end MEASUREMENT
/begin COMPU_METHOD CU_CTC_LAM_FUELOFST "Conversion method for CTC_lam_FuelOfst" RAT_FUNC "%10.3" "lam" COEFFS 0.000000 1.000000 0.000000 0.000000 0.000000 1.000000 /end COMPU_METHOD
/* Scalar measurable for DDE 'CTC_ret_SparkRqst'. */
/begin MEASUREMENT CTC_ret_SparkRqst "Final charge temp spark modifier angle" FLOAT32_IEEE CU_CTC_RET_SPARKRQST 1 100 0.0 0.0 ECU_ADDRESS 0x4000348c BYTE_ORDER MSB_FIRST /end MEASUREMENT
/begin COMPU_METHOD CU_CTC_RET_SPARKRQST "Conversion method for CTC_ret_SparkRqst" RAT_FUNC "%10.2" "ret" COEFFS 0.000000 1.000000 0.000000 0.000000 0.000000 1.000000 /end COMPU_METHOD
/* Scalar measurable for DDE 'CTC_ret_SparkRqstRaw'. */
/begin MEASUREMENT CTC_ret_SparkRqstRaw "Raw charge temp spark modifier angle" FLOAT32_IEEE CU_CTC_RET_SPARKRQSTRAW 1 100 0.0 0.0 ECU_ADDRESS 0x40003490 BYTE_ORDER MSB_FIRST /end MEASUREMENT
/begin COMPU_METHOD CU_CTC_RET_SPARKRQSTRAW "Conversion method for CTC_ret_SparkRqstRaw" RAT_FUNC "%10.2" "ret" COEFFS 0.000000 1.000000 0.000000 0.000000 0.000000 1.000000 /end COMPU_METHOD
/* Scalar measurable for DDE 'DFC_RPM_EntryThrsh'. */
/begin MEASUREMENT DFC_RPM_EntryThrsh "DFC enable engine speed threshold value" FLOAT32_IEEE CU_DFC_RPM_ENTRYTHRSH 1 100 0.0 0.0 ECU_ADDRESS 0x4000354c BYTE_ORDER MSB_FIRST /end MEASUREMENT
/begin COMPU_METHOD CU_DFC_RPM_ENTRYTHRSH "Conversion method for DFC_RPM_EntryThrsh" RAT_FUNC "%10.0" "RPM" COEFFS 0.000000 1.000000 0.000000 0.000000 0.000000 1.000000 /end COMPU_METHOD
/* Scalar measurable for DDE 'DFC_RPM_ExitThrsh'. */
/begin MEASUREMENT DFC_RPM_ExitThrsh "DFC disable engine speed threshold value" FLOAT32_IEEE CU_DFC_RPM_EXITTHRSH 1 100 0.0 0.0 ECU_ADDRESS 0x40003548 BYTE_ORDER MSB_FIRST /end MEASUREMENT
/begin COMPU_METHOD CU_DFC_RPM_EXITTHRSH "Conversion method for DFC_RPM_ExitThrsh" RAT_FUNC "%10.0" "RPM" COEFFS 0.000000 1.000000 0.000000 0.000000 0.000000 1.000000 /end COMPU_METHOD
/* Scalar measurable for DDE 'DFC_b_BurningDFC_Active'. */
/begin MEASUREMENT DFC_b_BurningDFC_Active "DFC fuel cut flag" UBYTE CU_DFC_B_BURNINGDFC_ACTIVE 1 100 0.0 1.0 ECU_ADDRESS 0x40002e6e BYTE_ORDER MSB_FIRST /end MEASUREMENT
/begin COMPU_METHOD CU_DFC_B_BURNINGDFC_ACTIVE "Conversion method for DFC_b_BurningDFC_Active" RAT_FUNC "%10.0" "b" COEFFS 0.000000 1.000000 0.000000 0.000000 0.000000 1.000000 /end COMPU_METHOD
/* Scalar measurable for DDE 'DFC_b_DTC_Condition'. */
/begin MEASUREMENT DFC_b_DTC_Condition "Displayable" UBYTE CU_DFC_B_DTC_CONDITION 1 100 0.0 1.0 ECU_ADDRESS 0x40002ed0 BYTE_ORDER MSB_FIRST /end MEASUREMENT
/begin COMPU_METHOD CU_DFC_B_DTC_CONDITION "Conversion method for DFC_b_DTC_Condition" RAT_FUNC "%10.0" "b" COEFFS 0.000000 1.000000 0.000000 0.000000 0.000000 1.000000 /end COMPU_METHOD
/* Scalar measurable for DDE 'DFC_b_FuelCut'. */
/begin MEASUREMENT DFC_b_FuelCut "DFC fuel cut flag" UBYTE CU_DFC_B_FUELCUT 1 100 0.0 1.0 ECU_ADDRESS 0x40002ecf BYTE_ORDER MSB_FIRST /end MEASUREMENT
/begin COMPU_METHOD CU_DFC_B_FUELCUT "Conversion method for DFC_b_FuelCut" RAT_FUNC "%10.0" "b" COEFFS 0.000000 1.000000 0.000000 0.000000 0.000000 1.000000 /end COMPU_METHOD
/* Scalar measurable for DDE 'DFC_e_State'. */
/begin MEASUREMENT DFC_e_State "DFC state" UBYTE CU_DFC_E_STATE 1 100 0.0 0.0 ECU_ADDRESS 0x40002fe2 BYTE_ORDER MSB_FIRST /end MEASUREMENT
/begin COMPU_METHOD CU_DFC_E_STATE "Conversion method for DFC_e_State" TAB_VERB "%12.0" "e" COMPU_TAB_REF CT_DFC_E_STATE /end COMPU_METHOD
/begin COMPU_VTAB CT_DFC_E_STATE "Conversion method for DFC_e_State" TAB_VERB 3 0 "DFCk_e_Inactive" 1 "DFCk_e_RetardSpark" 3 "DFCk_e_CutFuel" /end COMPU_VTAB
/* Scalar measurable for DDE 'DFC_ret_SparkRetard'. */
/begin MEASUREMENT DFC_ret_SparkRetard "Spark retard before fuel is cut when DFC is active" FLOAT32_IEEE CU_DFC_RET_SPARKRETARD 1 100 0.0 0.0 ECU_ADDRESS 0x40003450 BYTE_ORDER MSB_FIRST /end MEASUREMENT
/begin COMPU_METHOD CU_DFC_RET_SPARKRETARD "Conversion method for DFC_ret_SparkRetard" RAT_FUNC "%10.1" "ret" COEFFS 0.000000 1.000000 0.000000 0.000000 0.000000 1.000000 /end COMPU_METHOD
/* Scalar measurable for DDE 'DIN_Hz_MAF'. */
/begin MEASUREMENT DIN_Hz_MAF "Raw value" FLOAT32_IEEE CU_DIN_HZ_MAF 1 100 0.0 0.0 ECU_ADDRESS 0x4000303c BYTE_ORDER MSB_FIRST /end MEASUREMENT
/begin COMPU_METHOD CU_DIN_HZ_MAF "Conversion method for DIN_Hz_MAF" RAT_FUNC "%10.3" "Hz" COEFFS 0.000000 1.000000 0.000000 0.000000 0.000000 1.000000 /end COMPU_METHOD
/* Scalar measurable for DDE 'DIN_NU_Gear'. */
/begin MEASUREMENT DIN_NU_Gear "Displayable" FLOAT32_IEEE CU_DIN_NU_GEAR 1 100 0.0 0.0 ECU_ADDRESS 0x40003800 BYTE_ORDER MSB_FIRST /end MEASUREMENT
/begin COMPU_METHOD CU_DIN_NU_GEAR "Conversion method for DIN_NU_Gear" RAT_FUNC "%10.0" "NU" COEFFS 0.000000 1.000000 0.000000 0.000000 0.000000 1.000000 /end COMPU_METHOD
/* Scalar measurable for DDE 'DIN_RPM_EngSpd'. */
/begin MEASUREMENT DIN_RPM_EngSpd "Displayable" FLOAT32_IEEE CU_DIN_RPM_ENGSPD 1 100 0.0 0.0 ECU_ADDRESS 0x40003804 BYTE_ORDER MSB_FIRST /end MEASUREMENT
/begin COMPU_METHOD CU_DIN_RPM_ENGSPD "Conversion method for DIN_RPM_EngSpd" RAT_FUNC "%10.0" "RPM" COEFFS 0.000000 1.000000 0.000000 0.000000 0.000000 1.000000 /end COMPU_METHOD
/* Scalar measurable for DDE 'DIN_RPM_Per720'. */
/begin MEASUREMENT DIN_RPM_Per720 "Displayable" FLOAT32_IEEE CU_DIN_RPM_PER720 1 100 0.0 0.0 ECU_ADDRESS 0x400037fc BYTE_ORDER MSB_FIRST /end MEASUREMENT
/begin COMPU_METHOD CU_DIN_RPM_PER720 "Conversion method for DIN_RPM_Per720" RAT_FUNC "%10.0" "RPM" COEFFS 0.000000 1.000000 0.000000 0.000000 0.000000 1.000000 /end COMPU_METHOD
/* Scalar measurable for DDE 'DIN_RPM_PerCyl'. */
/begin MEASUREMENT DIN_RPM_PerCyl "Displayable" FLOAT32_IEEE CU_DIN_RPM_PERCYL 1 100 0.0 0.0 ECU_ADDRESS 0x400037f8 BYTE_ORDER MSB_FIRST /end MEASUREMENT
/begin COMPU_METHOD CU_DIN_RPM_PERCYL "Conversion method for DIN_RPM_PerCyl" RAT_FUNC "%10.0" "RPM" COEFFS 0.000000 1.000000 0.000000 0.000000 0.000000 1.000000 /end COMPU_METHOD
/* Scalar measurable for DDE 'DIN_RPM_TOSS'. */
/begin MEASUREMENT DIN_RPM_TOSS "Displayable" FLOAT32_IEEE CU_DIN_RPM_TOSS 1 100 0.0 0.0 ECU_ADDRESS 0x400037f0 BYTE_ORDER MSB_FIRST /end MEASUREMENT
/begin COMPU_METHOD CU_DIN_RPM_TOSS "Conversion method for DIN_RPM_TOSS" RAT_FUNC "%10.0" "RPM" COEFFS 0.000000 1.000000 0.000000 0.000000 0.000000 1.000000 /end COMPU_METHOD
/* Scalar measurable for DDE 'DIN_b_AC_PressSw'. */
/begin MEASUREMENT DIN_b_AC_PressSw "Displayable" UBYTE CU_DIN_B_AC_PRESSSW 1 100 0.0 1.0 ECU_ADDRESS 0x40002f6c BYTE_ORDER MSB_FIRST /end MEASUREMENT
/begin COMPU_METHOD CU_DIN_B_AC_PRESSSW "Conversion method for DIN_b_AC_PressSw" RAT_FUNC "%10.0" "b" COEFFS 0.000000 1.000000 0.000000 0.000000 0.000000 1.000000 /end COMPU_METHOD
/* Scalar measurable for DDE 'DIN_b_AC_ReqSw'. */
/begin MEASUREMENT DIN_b_AC_ReqSw "Displayable" UBYTE CU_DIN_B_AC_REQSW 1 100 0.0 1.0 ECU_ADDRESS 0x40002f6b BYTE_ORDER MSB_FIRST /end MEASUREMENT
/begin COMPU_METHOD CU_DIN_B_AC_REQSW "Conversion method for DIN_b_AC_ReqSw" RAT_FUNC "%10.0" "b" COEFFS 0.000000 1.000000 0.000000 0.000000 0.000000 1.000000 /end COMPU_METHOD
/* Scalar measurable for DDE 'DIN_b_Belt'. */
/begin MEASUREMENT DIN_b_Belt "(not defined)" UBYTE CU_DIN_B_BELT 1 100 0.0 1.0 ECU_ADDRESS 0x40002f69 BYTE_ORDER MSB_FIRST /end MEASUREMENT
/begin COMPU_METHOD CU_DIN_B_BELT "Conversion method for DIN_b_Belt" RAT_FUNC "%10.0" "b" COEFFS 0.000000 1.000000 0.000000 0.000000 0.000000 1.000000 /end COMPU_METHOD
/* Scalar measurable for DDE 'DIN_b_CamPhaseValid'. */
/begin MEASUREMENT DIN_b_CamPhaseValid "Displayable" UBYTE CU_DIN_B_CAMPHASEVALID 1 100 0.0 1.0 ECU_ADDRESS 0x40002f77 BYTE_ORDER MSB_FIRST /end MEASUREMENT
/begin COMPU_METHOD CU_DIN_B_CAMPHASEVALID "Conversion method for DIN_b_CamPhaseValid" RAT_FUNC "%10.0" "b" COEFFS 0.000000 1.000000 0.000000 0.000000 0.000000 1.000000 /end COMPU_METHOD
/* Scalar measurable for DDE 'DIN_b_CamTO'. */
/begin MEASUREMENT DIN_b_CamTO "Intake cam timeout flag" UBYTE CU_DIN_B_CAMTO 1 100 0.0 1.0 ECU_ADDRESS 0x40002f78 BYTE_ORDER MSB_FIRST /end MEASUREMENT
/begin COMPU_METHOD CU_DIN_B_CAMTO "Conversion method for DIN_b_CamTO" RAT_FUNC "%10.0" "b" COEFFS 0.000000 1.000000 0.000000 0.000000 0.000000 1.000000 /end COMPU_METHOD
/* Scalar measurable for DDE 'DIN_b_Door'. */
/begin MEASUREMENT DIN_b_Door "(not defined)" UBYTE CU_DIN_B_DOOR 1 100 0.0 1.0 ECU_ADDRESS 0x40002f68 BYTE_ORDER MSB_FIRST /end MEASUREMENT
/begin COMPU_METHOD CU_DIN_B_DOOR "Conversion method for DIN_b_Door" RAT_FUNC "%10.0" "b" COEFFS 0.000000 1.000000 0.000000 0.000000 0.000000 1.000000 /end COMPU_METHOD
/* Scalar measurable for DDE 'DIN_b_EngSync'. */
/begin MEASUREMENT DIN_b_EngSync "Displayable" UBYTE CU_DIN_B_ENGSYNC 1 100 0.0 1.0 ECU_ADDRESS 0x40002f66 BYTE_ORDER MSB_FIRST /end MEASUREMENT
/begin COMPU_METHOD CU_DIN_B_ENGSYNC "Conversion method for DIN_b_EngSync" RAT_FUNC "%10.0" "b" COEFFS 0.000000 1.000000 0.000000 0.000000 0.000000 1.000000 /end COMPU_METHOD
/* Scalar measurable for DDE 'DIN_b_Ign'. */
/begin MEASUREMENT DIN_b_Ign "Displayable" UBYTE CU_DIN_B_IGN 1 100 0.0 1.0 ECU_ADDRESS 0x40002f79 BYTE_ORDER MSB_FIRST /end MEASUREMENT
/begin COMPU_METHOD CU_DIN_B_IGN "Conversion method for DIN_b_Ign" RAT_FUNC "%10.0" "b" COEFFS 0.000000 1.000000 0.000000 0.000000 0.000000 1.000000 /end COMPU_METHOD
/* Scalar measurable for DDE 'DIN_b_MAF_To'. */
/begin MEASUREMENT DIN_b_MAF_To "Timeout flag" UBYTE CU_DIN_B_MAF_TO 1 100 0.0 1.0 ECU_ADDRESS 0x40002f71 BYTE_ORDER MSB_FIRST /end MEASUREMENT
/begin COMPU_METHOD CU_DIN_B_MAF_TO "Conversion method for DIN_b_MAF_To" RAT_FUNC "%10.0" "b" COEFFS 0.000000 1.000000 0.000000 0.000000 0.000000 1.000000 /end COMPU_METHOD
/* Scalar measurable for DDE 'DIN_b_OilPrSw'. */
/begin MEASUREMENT DIN_b_OilPrSw "(not defined)" UBYTE CU_DIN_B_OILPRSW 1 100 0.0 1.0 ECU_ADDRESS 0x40002f6d BYTE_ORDER MSB_FIRST /end MEASUREMENT
/begin COMPU_METHOD CU_DIN_B_OILPRSW "Conversion method for DIN_b_OilPrSw" RAT_FUNC "%10.0" "b" COEFFS 0.000000 1.000000 0.000000 0.000000 0.000000 1.000000 /end COMPU_METHOD
/* Scalar measurable for DDE 'DIN_b_ParkingBrake'. */
/begin MEASUREMENT DIN_b_ParkingBrake "(not defined)" UBYTE CU_DIN_B_PARKINGBRAKE 1 100 0.0 1.0 ECU_ADDRESS 0x40002f67 BYTE_ORDER MSB_FIRST /end MEASUREMENT
/begin COMPU_METHOD CU_DIN_B_PARKINGBRAKE "Conversion method for DIN_b_ParkingBrake" RAT_FUNC "%10.0" "b" COEFFS 0.000000 1.000000 0.000000 0.000000 0.000000 1.000000 /end COMPU_METHOD
/* Scalar measurable for DDE 'DIN_b_PedalBrake'. */
/begin MEASUREMENT DIN_b_PedalBrake "(not defined)" UBYTE CU_DIN_B_PEDALBRAKE 1 100 0.0 1.0 ECU_ADDRESS 0x40002f6a BYTE_ORDER MSB_FIRST /end MEASUREMENT
/begin COMPU_METHOD CU_DIN_B_PEDALBRAKE "Conversion method for DIN_b_PedalBrake" RAT_FUNC "%10.0" "b" COEFFS 0.000000 1.000000 0.000000 0.000000 0.000000 1.000000 /end COMPU_METHOD
/* Scalar measurable for DDE 'DIN_b_RearGear'. */
/begin MEASUREMENT DIN_b_RearGear "Displayable" UBYTE CU_DIN_B_REARGEAR 1 100 0.0 1.0 ECU_ADDRESS 0x40002f75 BYTE_ORDER MSB_FIRST /end MEASUREMENT
/begin COMPU_METHOD CU_DIN_B_REARGEAR "Conversion method for DIN_b_RearGear" RAT_FUNC "%10.0" "b" COEFFS 0.000000 1.000000 0.000000 0.000000 0.000000 1.000000 /end COMPU_METHOD
/* Scalar measurable for DDE 'DIN_b_Y13_SB_OL'. */
/begin MEASUREMENT DIN_b_Y13_SB_OL "(not defined)" UBYTE CU_DIN_B_Y13_SB_OL 1 100 0.0 1.0 ECU_ADDRESS 0x40002f3f BYTE_ORDER MSB_FIRST /end MEASUREMENT
/begin COMPU_METHOD CU_DIN_B_Y13_SB_OL "Conversion method for DIN_b_Y13_SB_OL" RAT_FUNC "%10.0" "b" COEFFS 0.000000 1.000000 0.000000 0.000000 0.000000 1.000000 /end COMPU_METHOD
/* Scalar measurable for DDE 'DIN_b_Y17_Enabled'. */
/begin MEASUREMENT DIN_b_Y17_Enabled "(not defined)" UBYTE CU_DIN_B_Y17_ENABLED 1 100 0.0 1.0 ECU_ADDRESS 0x40002f4a BYTE_ORDER MSB_FIRST /end MEASUREMENT
/begin COMPU_METHOD CU_DIN_B_Y17_ENABLED "Conversion method for DIN_b_Y17_Enabled" RAT_FUNC "%10.0" "b" COEFFS 0.000000 1.000000 0.000000 0.000000 0.000000 1.000000 /end COMPU_METHOD
/* Scalar measurable for DDE 'DIN_b_Y17_Fault'. */
/begin MEASUREMENT DIN_b_Y17_Fault "(not defined)" UBYTE CU_DIN_B_Y17_FAULT 1 100 0.0 1.0 ECU_ADDRESS 0x40002f49 BYTE_ORDER MSB_FIRST /end MEASUREMENT
/begin COMPU_METHOD CU_DIN_B_Y17_FAULT "Conversion method for DIN_b_Y17_Fault" RAT_FUNC "%10.0" "b" COEFFS 0.000000 1.000000 0.000000 0.000000 0.000000 1.000000 /end COMPU_METHOD
/* Scalar measurable for DDE 'DIN_b_Y17_OFF_OL'. */
/begin MEASUREMENT DIN_b_Y17_OFF_OL "(not defined)" UBYTE CU_DIN_B_Y17_OFF_OL 1 100 0.0 1.0 ECU_ADDRESS 0x40002f48 BYTE_ORDER MSB_FIRST /end MEASUREMENT
/begin COMPU_METHOD CU_DIN_B_Y17_OFF_OL "Conversion method for DIN_b_Y17_OFF_OL" RAT_FUNC "%10.0" "b" COEFFS 0.000000 1.000000 0.000000 0.000000 0.000000 1.000000 /end COMPU_METHOD
/* Scalar measurable for DDE 'DIN_b_Y17_ON_OL'. */
/begin MEASUREMENT DIN_b_Y17_ON_OL "(not defined)" UBYTE CU_DIN_B_Y17_ON_OL 1 100 0.0 1.0 ECU_ADDRESS 0x40002f47 BYTE_ORDER MSB_FIRST /end MEASUREMENT
/begin COMPU_METHOD CU_DIN_B_Y17_ON_OL "Conversion method for DIN_b_Y17_ON_OL" RAT_FUNC "%10.0" "b" COEFFS 0.000000 1.000000 0.000000 0.000000 0.000000 1.000000 /end COMPU_METHOD
/* Scalar measurable for DDE 'DIN_b_Y17_OV'. */
/begin MEASUREMENT DIN_b_Y17_OV "(not defined)" UBYTE CU_DIN_B_Y17_OV 1 100 0.0 1.0 ECU_ADDRESS 0x40002f46 BYTE_ORDER MSB_FIRST /end MEASUREMENT
/begin COMPU_METHOD CU_DIN_B_Y17_OV "Conversion method for DIN_b_Y17_OV" RAT_FUNC "%10.0" "b" COEFFS 0.000000 1.000000 0.000000 0.000000 0.000000 1.000000 /end COMPU_METHOD
/* Scalar measurable for DDE 'DIN_b_Y17_Reset'. */
/begin MEASUREMENT DIN_b_Y17_Reset "(not defined)" UBYTE CU_DIN_B_Y17_RESET 1 100 0.0 1.0 ECU_ADDRESS 0x40002f45 BYTE_ORDER MSB_FIRST /end MEASUREMENT
/begin COMPU_METHOD CU_DIN_B_Y17_RESET "Conversion method for DIN_b_Y17_Reset" RAT_FUNC "%10.0" "b" COEFFS 0.000000 1.000000 0.000000 0.000000 0.000000 1.000000 /end COMPU_METHOD
/* Scalar measurable for DDE 'DIN_b_Y17_SB'. */
/begin MEASUREMENT DIN_b_Y17_SB "(not defined)" UBYTE CU_DIN_B_Y17_SB 1 100 0.0 1.0 ECU_ADDRESS 0x40002f43 BYTE_ORDER MSB_FIRST /end MEASUREMENT
/begin COMPU_METHOD CU_DIN_B_Y17_SB "Conversion method for DIN_b_Y17_SB" RAT_FUNC "%10.0" "b" COEFFS 0.000000 1.000000 0.000000 0.000000 0.000000 1.000000 /end COMPU_METHOD
/* Scalar measurable for DDE 'DIN_b_Y17_SB_Tested'. */
/begin MEASUREMENT DIN_b_Y17_SB_Tested "(not defined)" UBYTE CU_DIN_B_Y17_SB_TESTED 1 100 0.0 1.0 ECU_ADDRESS 0x40002f44 BYTE_ORDER MSB_FIRST /end MEASUREMENT
/begin COMPU_METHOD CU_DIN_B_Y17_SB_TESTED "Conversion method for DIN_b_Y17_SB_Tested" RAT_FUNC "%10.0" "b" COEFFS 0.000000 1.000000 0.000000 0.000000 0.000000 1.000000 /end COMPU_METHOD
/* Scalar measurable for DDE 'DIN_b_Y17_SG'. */
/begin MEASUREMENT DIN_b_Y17_SG "(not defined)" UBYTE CU_DIN_B_Y17_SG 1 100 0.0 1.0 ECU_ADDRESS 0x40002f42 BYTE_ORDER MSB_FIRST /end MEASUREMENT
/begin COMPU_METHOD CU_DIN_B_Y17_SG "Conversion method for DIN_b_Y17_SG" RAT_FUNC "%10.0" "b" COEFFS 0.000000 1.000000 0.000000 0.000000 0.000000 1.000000 /end COMPU_METHOD
/* Scalar measurable for DDE 'DIN_b_Y17_SG_OL'. */
/begin MEASUREMENT DIN_b_Y17_SG_OL "(not defined)" UBYTE CU_DIN_B_Y17_SG_OL 1 100 0.0 1.0 ECU_ADDRESS 0x40002f41 BYTE_ORDER MSB_FIRST /end MEASUREMENT
/begin COMPU_METHOD CU_DIN_B_Y17_SG_OL "Conversion method for DIN_b_Y17_SG_OL" RAT_FUNC "%10.0" "b" COEFFS 0.000000 1.000000 0.000000 0.000000 0.000000 1.000000 /end COMPU_METHOD
/* Scalar measurable for DDE 'DIN_cnt_CamExtraTeeth'. */
/begin MEASUREMENT DIN_cnt_CamExtraTeeth "Number of extra cam teeth counted" FLOAT32_IEEE CU_DIN_CNT_CAMEXTRATEETH 1 100 0.0 0.0 ECU_ADDRESS 0x40003820 BYTE_ORDER MSB_FIRST /end MEASUREMENT
/begin COMPU_METHOD CU_DIN_CNT_CAMEXTRATEETH "Conversion method for DIN_cnt_CamExtraTeeth" RAT_FUNC "%10.0" "cnt" COEFFS 0.000000 1.000000 0.000000 0.000000 0.000000 1.000000 /end COMPU_METHOD
/* Scalar measurable for DDE 'DIN_cnt_CamMissTeeth'. */
/begin MEASUREMENT DIN_cnt_CamMissTeeth "Number of cam teeth missed" FLOAT32_IEEE CU_DIN_CNT_CAMMISSTEETH 1 100 0.0 0.0 ECU_ADDRESS 0x40003824 BYTE_ORDER MSB_FIRST /end MEASUREMENT
/begin COMPU_METHOD CU_DIN_CNT_CAMMISSTEETH "Conversion method for DIN_cnt_CamMissTeeth" RAT_FUNC "%10.0" "cnt" COEFFS 0.000000 1.000000 0.000000 0.000000 0.000000 1.000000 /end COMPU_METHOD
/* Scalar measurable for DDE 'DIN_deg_CamTooth1'. */
/begin MEASUREMENT DIN_deg_CamTooth1 "Tooth angle for Tooth 1 of intake cam" FLOAT32_IEEE CU_DIN_DEG_CAMTOOTH1 1 100 0.0 0.0 ECU_ADDRESS 0x40003810 BYTE_ORDER MSB_FIRST /end MEASUREMENT
/begin COMPU_METHOD CU_DIN_DEG_CAMTOOTH1 "Conversion method for DIN_deg_CamTooth1" RAT_FUNC "%10.2" "deg" COEFFS 0.000000 1.000000 0.000000 0.000000 0.000000 1.000000 /end COMPU_METHOD
/* Scalar measurable for DDE 'DIN_deg_CamTooth2'. */
/begin MEASUREMENT DIN_deg_CamTooth2 "Tooth angle for Tooth 2 of intake cam" FLOAT32_IEEE CU_DIN_DEG_CAMTOOTH2 1 100 0.0 0.0 ECU_ADDRESS 0x4000381c BYTE_ORDER MSB_FIRST /end MEASUREMENT
/begin COMPU_METHOD CU_DIN_DEG_CAMTOOTH2 "Conversion method for DIN_deg_CamTooth2" RAT_FUNC "%10.2" "deg" COEFFS 0.000000 1.000000 0.000000 0.000000 0.000000 1.000000 /end COMPU_METHOD
/* Scalar measurable for DDE 'DIN_deg_CamTooth3'. */
/begin MEASUREMENT DIN_deg_CamTooth3 "Tooth angle for Tooth 3 of intake cam" FLOAT32_IEEE CU_DIN_DEG_CAMTOOTH3 1 100 0.0 0.0 ECU_ADDRESS 0x40003818 BYTE_ORDER MSB_FIRST /end MEASUREMENT
/begin COMPU_METHOD CU_DIN_DEG_CAMTOOTH3 "Conversion method for DIN_deg_CamTooth3" RAT_FUNC "%10.2" "deg" COEFFS 0.000000 1.000000 0.000000 0.000000 0.000000 1.000000 /end COMPU_METHOD
/* Scalar measurable for DDE 'DIN_deg_CamTooth4'. */
/begin MEASUREMENT DIN_deg_CamTooth4 "Tooth angle for Tooth 4 of intake cam" FLOAT32_IEEE CU_DIN_DEG_CAMTOOTH4 1 100 0.0 0.0 ECU_ADDRESS 0x4000380c BYTE_ORDER MSB_FIRST /end MEASUREMENT
/begin COMPU_METHOD CU_DIN_DEG_CAMTOOTH4 "Conversion method for DIN_deg_CamTooth4" RAT_FUNC "%10.2" "deg" COEFFS 0.000000 1.000000 0.000000 0.000000 0.000000 1.000000 /end COMPU_METHOD
/* Scalar measurable for DDE 'DIN_deg_CamToothDelta'. */
/begin MEASUREMENT DIN_deg_CamToothDelta "Displayable" FLOAT32_IEEE CU_DIN_DEG_CAMTOOTHDELTA 1 100 0.0 0.0 ECU_ADDRESS 0x40003814 BYTE_ORDER MSB_FIRST /end MEASUREMENT
/begin COMPU_METHOD CU_DIN_DEG_CAMTOOTHDELTA "Conversion method for DIN_deg_CamToothDelta" RAT_FUNC "%10.0" "deg" COEFFS 0.000000 1.000000 0.000000 0.000000 0.000000 1.000000 /end COMPU_METHOD
/* Scalar measurable for DDE 'DIN_e_CurrentCyl'. */
/begin MEASUREMENT DIN_e_CurrentCyl "Angular cylinder number" UBYTE CU_DIN_E_CURRENTCYL 1 100 0.0 0.0 ECU_ADDRESS 0x4000301e BYTE_ORDER MSB_FIRST /end MEASUREMENT
/begin COMPU_METHOD CU_DIN_E_CURRENTCYL "Conversion method for DIN_e_CurrentCyl" RAT_FUNC "%10.0" "e" COEFFS 0.000000 1.000000 0.000000 0.000000 0.000000 1.000000 /end COMPU_METHOD
/* Scalar measurable for DDE 'DIN_gps_MAF'. */
/begin MEASUREMENT DIN_gps_MAF "Displayable" FLOAT32_IEEE CU_DIN_GPS_MAF 1 100 0.0 0.0 ECU_ADDRESS 0x400037e8 BYTE_ORDER MSB_FIRST /end MEASUREMENT
/begin COMPU_METHOD CU_DIN_GPS_MAF "Conversion method for DIN_gps_MAF" RAT_FUNC "%10.0" "gps" COEFFS 0.000000 1.000000 0.000000 0.000000 0.000000 1.000000 /end COMPU_METHOD
/* Scalar measurable for DDE 'DIN_kph_VehSpd'. */
/begin MEASUREMENT DIN_kph_VehSpd "Displayable" FLOAT32_IEEE CU_DIN_KPH_VEHSPD 1 100 0.0 0.0 ECU_ADDRESS 0x400037f4 BYTE_ORDER MSB_FIRST /end MEASUREMENT
/begin COMPU_METHOD CU_DIN_KPH_VEHSPD "Conversion method for DIN_kph_VehSpd" RAT_FUNC "%10.0" "kph" COEFFS 0.000000 1.000000 0.000000 0.000000 0.000000 1.000000 /end COMPU_METHOD
/* Scalar measurable for DDE 'DIN_pct_AltLoad'. */
/begin MEASUREMENT DIN_pct_AltLoad "Displayable" FLOAT32_IEEE CU_DIN_PCT_ALTLOAD 1 100 0.0 0.0 ECU_ADDRESS 0x400037e4 BYTE_ORDER MSB_FIRST /end MEASUREMENT
/begin COMPU_METHOD CU_DIN_PCT_ALTLOAD "Conversion method for DIN_pct_AltLoad" RAT_FUNC "%10.0" "pct" COEFFS 0.000000 1.000000 0.000000 0.000000 0.000000 1.000000 /end COMPU_METHOD
/* Scalar measurable for DDE 'DIN_ret_CamPhase'. */
/begin MEASUREMENT DIN_ret_CamPhase "Intake cam phase angle" FLOAT32_IEEE CU_DIN_RET_CAMPHASE 1 100 0.0 0.0 ECU_ADDRESS 0x400037ec BYTE_ORDER MSB_FIRST /end MEASUREMENT
/begin COMPU_METHOD CU_DIN_RET_CAMPHASE "Conversion method for DIN_ret_CamPhase" RAT_FUNC "%10.2" "ret" COEFFS 0.000000 1.000000 0.000000 0.000000 0.000000 1.000000 /end COMPU_METHOD
/* Scalar measurable for DDE 'DRL_b_Active'. */
/begin MEASUREMENT DRL_b_Active "Displayable" UBYTE CU_DRL_B_ACTIVE 1 100 0.0 1.0 ECU_ADDRESS 0x40002ebc BYTE_ORDER MSB_FIRST /end MEASUREMENT
/begin COMPU_METHOD CU_DRL_B_ACTIVE "Conversion method for DRL_b_Active" RAT_FUNC "%10.0" "b" COEFFS 0.000000 1.000000 0.000000 0.000000 0.000000 1.000000 /end COMPU_METHOD
/* Scalar measurable for DDE 'DRL_gps_DynoAirRqst'. */
/begin MEASUREMENT DRL_gps_DynoAirRqst "Displayable" FLOAT32_IEEE CU_DRL_GPS_DYNOAIRRQST 1 100 0.0 0.0 ECU_ADDRESS 0x4000340c BYTE_ORDER MSB_FIRST /end MEASUREMENT
/begin COMPU_METHOD CU_DRL_GPS_DYNOAIRRQST "Conversion method for DRL_gps_DynoAirRqst" RAT_FUNC "%10.1" "gps" COEFFS 0.000000 1.000000 0.000000 0.000000 0.000000 1.000000 /end COMPU_METHOD
/begin FUNCTION adm "Group /ByDataDictionaryPrefix/adm"
 /begin LOC_MEASUREMENT ADM_NU_Alpha ADM_NU_BoostIGain ADM_NU_ComprInDens ADM_NU_ComprOutDens ADM_NU_ComprPressRatio ADM_NU_ComprSurgeProx ADM_NU_ISFC ADM_NU_SurgePressRatio ADM_NU_ThrottleIGain ADM_RPM_TurSpdCorr ADM_b_ComprSurge ADM_b_TurOverspeed ADM_b_TurboCancelThrottleITerm ADM_b_UseTurbo ADM_deg_EquationBasedThCorr ADM_deg_ThrottleTrgt ADM_deg_ThrottleTrgtRaw ADM_deg_VCP_ThCorr ADM_gps_AirDemandRAW ADM_gps_MAF_Corr ADM_gps_MAF_Trgt ADM_gps_MAF_TrgtErr ADM_gps_NominalMAF ADM_gps_TrgtFuelFlow ADM_kPa_BoostFB ADM_kPa_BoostFF ADM_kPa_BoostITerm ADM_kPa_BoostPTerm ADM_kPa_BoostPressTrgt ADM_kPa_BoostPressTrgtRaw ADM_kPa_BoostPressTrgtRawCorr ADM_kPa_ComprInDynPress ADM_kPa_ComprInPressTot ADM_kPa_ComprOutDynPress ADM_kPa_ComprOutPressTot ADM_kPa_NominalDP ADM_kW_TrgtPwr ADM_mps_ComprInVel ADM_mps_ComprOutVel ADM_pct_AirDemand ADM_pct_ThrottleEffortRaw ADM_pct_ThrottleFB ADM_pct_ThrottleITerm ADM_pct_ThrottlePGain ADM_pct_ThrottlePTerm ADM_ret_VCP_Trgt /end LOC_MEASUREMENT
 /begin REF_CHARACTERISTIC ADMc_C_ComprNormRefTemp ADMc_NU_AlphaL1 ADMc_NU_AlphaL2 ADMc_NU_AlphaL3 ADMc_NU_AlphaL4 ADMc_NU_AlphaL5 ADMc_NU_AlphaL6 ADMc_NU_BoostITermMax ADMc_NU_BoostITermMin ADMc_NU_ComprSurgeProxLim ADMc_NU_ThRqstFallRate ADMc_NU_ThRqstRiseRate ADMc_NU_TqToMassAirFlowGain_k2 ADMc_RPM_TurSpdThrsh ADMc_b_ResetBoostITerm ADMc_b_ResetThrottleITerm ADMc_b_TurOverspeed ADMc_b_TurboCancelThrottleITerm ADMc_b_UseLUT_ThCorr ADMc_cm2_ComprInArea ADMc_cm2_ComprOutArea ADMc_deg_CorrThAngCranking ADMc_deg_DFC_ThAngTrgt ADMc_deg_ThrottleTrgt ADMc_e_VCP_Method ADMc_gps_AirDemandRAW ADMc_gps_BoostFB_ErrorDbnd ADMc_gps_MAF_Trgt ADMc_gps_ThrottleFB_Dbnd ADMc_kPa_BoostFB_Dbnd ADMc_kPa_BoostFB_Max ADMc_kPa_BoostFB_Min ADMc_kPa_BoostPressTrgt ADMc_kPa_ComprNormRefPress ADMc_kPa_CrankingBoostPressTrgt ADMc_kPa_SrgChkTrgtBoost ADMc_lam_MaxLimit ADMc_lam_MinLimit ADMc_o_AirDemand ADMc_o_AirDemandRAW ADMc_o_BoostPressTrgt ADMc_o_MAF_Trgt ADMc_o_ThrottleTrgt ADMc_o_TurOverspeed ADMc_o_TurboCancelThrottleITerm ADMc_o_VCP_Trgt ADMc_pct_AirDemand ADMc_pct_ThrottleFB_Dbnd ADMc_pct_ThrottleFB_Max ADMc_pct_ThrottleFB_Min ADMc_pct_ThrottleITermMax ADMc_pct_ThrottleITermMin ADMc_ret_DFC_VCP_Trgt ADMc_ret_VCP_FixedTrgt ADMc_ret_VCP_Trgt ADMc_s_OverspeedDbnc ADMc_s_SurgeDbnc ADMc_s_UseTurboDbnc ADMm_C_ExahustTemplimp_x ADMm_C_ExahustTemplimp_z ADMm_NU_BoostIGain_x ADMm_NU_BoostIGain_y ADMm_NU_BoostIGain_z ADMm_NU_BoostLimit_x ADMm_NU_BoostLimit_z ADMm_NU_BoostPGain_x ADMm_NU_BoostPGain_y ADMm_NU_BoostPGain_z ADMm_NU_BoostPressTrgtFF_x ADMm_NU_BoostPressTrgtFF_y ADMm_NU_BoostPressTrgtFF_z ADMm_NU_ComprSurgeMap_x ADMm_NU_ComprSurgeMap_z ADMm_NU_CrankingVCP_x ADMm_NU_CrankingVCP_z ADMm_NU_FF_ThrottleTrgt_x ADMm_NU_FF_ThrottleTrgt_y ADMm_NU_FF_ThrottleTrgt_z ADMm_NU_ISFC_x ADMm_NU_ISFC_y ADMm_NU_ISFC_z ADMm_NU_LUT_ThCorr_x ADMm_NU_LUT_ThCorr_y ADMm_NU_LUT_ThCorr_z ADMm_NU_NominalDP_x ADMm_NU_NominalDP_y ADMm_NU_NominalDP_z ADMm_NU_ThrottleFlowToAng_x ADMm_NU_ThrottleFlowToAng_z ADMm_NU_ThrottleIGain_x ADMm_NU_ThrottleIGain_y ADMm_NU_ThrottleIGain_z ADMm_NU_ThrottlePGain_x ADMm_NU_ThrottlePGain_y ADMm_NU_ThrottlePGain_z ADMm_NU_VCP_Temp_x ADMm_NU_VCP_Temp_z ADMm_NU_VCP_ThCorr_x ADMm_NU_VCP_ThCorr_z ADMm_NU_VCP_Trgt_x ADMm_NU_VCP_Trgt_y ADMm_NU_VCP_Trgt_z /end REF_CHARACTERISTIC
/end FUNCTION
/begin FUNCTION afr "Group /ByDataDictionaryPrefix/afr"
 /begin LOC_MEASUREMENT AFR_b_UseRateLim AFR_lam_BaseTrgt AFR_lam_CrankingTrgt AFR_lam_FinalTrgt1 AFR_lam_FinalTrgt2 AFR_lam_RampedTrgt AFR_lam_TableResult /end LOC_MEASUREMENT
 /begin REF_CHARACTERISTIC AFRc_lam_BaseAFR_Trim AFRc_lam_BaseTrgt AFRc_lam_ExitDFCEnrichment AFRc_lam_FinalTrgt1 AFRc_lam_FinalTrgt2 AFRc_lam_TIT_EnrichDelta AFRc_lam_TableResult AFRc_lam_TrgtMax AFRc_lam_TrgtMin AFRc_o_BaseTrgt AFRc_o_FinalTrgt1 AFRc_o_FinalTrgt2 AFRc_o_TableResult AFRc_pct_EnrichLoadThresh AFRc_s_DelayEnrichDelta AFRc_s_HoldDFCOpenLoop AFRm_NU_BaseTrgt_x AFRm_NU_BaseTrgt_y AFRm_NU_BaseTrgt_z AFRm_NU_CSI_Trgt_x AFRm_NU_CSI_Trgt_y AFRm_NU_CSI_Trgt_z AFRm_NU_CrankingTrgt_x AFRm_NU_CrankingTrgt_y AFRm_NU_CrankingTrgt_z AFRm_NU_RampRate_x AFRm_NU_RampRate_z /end REF_CHARACTERISTIC
/end FUNCTION
/begin FUNCTION ain "Group /ByDataDictionaryPrefix/ain"
 /begin LOC_MEASUREMENT AIN_A_ETC_CurrentB AIN_A_Y1_Current AIN_A_Y5_Current AIN_C_AmbientTemp AIN_C_CompOutTemp AIN_C_CoolantTemp AIN_C_ExhaustTemp AIN_C_FuelTemp AIN_C_ManifoldTemp AIN_C_OilTemp AIN_NU_APP1_Raw AIN_NU_APP2_Raw AIN_NU_MIL_Status AIN_NU_TP1_Raw AIN_NU_TP2_Raw AIN_V_AmbientTemp AIN_V_Baro AIN_V_CoolantTemp AIN_V_EGO11 AIN_V_EGO12 AIN_V_EGO21 AIN_V_EGT AIN_V_ETC_MonA AIN_V_ETC_MonB AIN_V_FAPRaw AIN_V_FCV_Mon AIN_V_FiltUA_A AIN_V_FiltUA_B AIN_V_FiltUR_A AIN_V_FiltUR_B AIN_V_FuelPressRaw AIN_V_FuelTempRaw AIN_V_Highside AIN_V_KnockSignalCyl1 AIN_V_MAP_BeforeThro AIN_V_MAP_Raw AIN_V_MAP_Sample1 AIN_V_MAP_Sample10 AIN_V_MAP_Sample11 AIN_V_MAP_Sample12 AIN_V_MAP_Sample13 AIN_V_MAP_Sample14 AIN_V_MAP_Sample15 AIN_V_MAP_Sample16 AIN_V_MAP_Sample2 AIN_V_MAP_Sample3 AIN_V_MAP_Sample4 AIN_V_MAP_Sample5 AIN_V_MAP_Sample6 AIN_V_MAP_Sample7 AIN_V_MAP_Sample8 AIN_V_MAP_Sample9 AIN_V_ManifoldTemp AIN_V_TP1 AIN_V_TP2 AIN_V_UA_A AIN_V_UA_B AIN_V_UR_A AIN_V_UR_B AIN_V_VBatt AIN_V_VBattRaw AIN_V_VRefA AIN_V_VRefB AIN_V_VRefC AIN_V_VRefD AIN_V_XL1_Mon AIN_V_XM1_Mon AIN_V_Y29_Mon AIN_V_Y41_Mon AIN_V_Y42_Mon AIN_V_Y6_Mon AIN_adv_KnockWinStartAngA AIN_adv_KnockWinStopAngA AIN_b_APP1_Valid AIN_b_APP2_Valid AIN_b_AmbientTemp_Fault AIN_b_Baro_Fault AIN_b_CompOutPress_Fault AIN_b_CoolantTemp_Fault AIN_b_DC_start AIN_b_EGT_Fault AIN_b_Eng_running AIN_b_FuelPress_Fault AIN_b_FuelTemp_Fault AIN_b_IC_start AIN_b_ManifoldTemp_Fault AIN_b_TP1_Fault AIN_b_TP2_Fault AIN_b_UEGO1_Valid AIN_b_UEGO2_Valid AIN_b_UsingPeriodic AIN_b_WU_start AIN_bar_FuelPress AIN_cnt_CylIdxA AIN_cnt_CylIdxB AIN_cnt_HIP_SPI_Flts AIN_kPa_Baro AIN_kPa_CompOutPress AIN_kPa_FAP AIN_kPa_MAP AIN_kPa_OilPress AIN_lam_UEGO1 AIN_lam_UEGO2 AIN_pct_Cylinder1_Knock AIN_pct_Cylinder2_Knock AIN_pct_Cylinder3_Knock AIN_pct_Cylinder4_Knock AIN_s_DelayLambdas /end LOC_MEASUREMENT
 /begin REF_CHARACTERISTIC AINc_A_HighsideCurrentMonOfst AINc_C_AmbientTemp AINc_C_AmbientTemp_Dflt AINc_C_AmbientTemp_Max AINc_C_AmbientTemp_Min AINc_C_CompOutTemp AINc_C_CoolantTemp AINc_C_CoolantTemp_Dflt AINc_C_CoolantTemp_Max AINc_C_CoolantTemp_Max_Begas AINc_C_CoolantTemp_Min AINc_C_CoolantTemp_Min_Begas AINc_C_ExTemp_Dflt AINc_C_ExTemp_Max AINc_C_ExTemp_Min AINc_C_ExhaustTemp AINc_C_FuelTemp AINc_C_FuelTemp_Dflt AINc_C_FuelTemp_Max AINc_C_FuelTemp_Min AINc_C_GLPTemp_Dflt AINc_C_ManifoldTemp AINc_C_ManifoldTemp_Dflt AINc_C_ManifoldTemp_Max AINc_C_ManifoldTemp_Min AINc_C_OilTemp AINc_HZ_acel_pdl2_dat_nok_FR AINc_HZ_acel_pdl2_dat_nok_RR AINc_HZ_pdl1_dat_nok_FR AINc_HZ_pdl1_dat_nok_RR AINc_Hz_AmbientTemp_BktFR AINc_Hz_AmbientTemp_BktRR AINc_Hz_Baro_BktFR AINc_Hz_Baro_BktRR AINc_Hz_CompOutPress_BktFR AINc_Hz_CompOutPress_BktRR AINc_Hz_CoolantTemp_BktFR AINc_Hz_CoolantTemp_BktRR AINc_Hz_ETC_fail_FR AINc_Hz_ETC_fail_RR AINc_Hz_ExTemp_BktFR AINc_Hz_ExTemp_BktRR AINc_Hz_FAPPress_BktFR AINc_Hz_FAPPress_BktRR AINc_Hz_FR_TurboErr AINc_Hz_FuelLevel1_LPF AINc_Hz_FuelLevel2_LPF AINc_Hz_FuelPress_BktFR AINc_Hz_FuelPress_BktRR AINc_Hz_FuelPress_LPF AINc_Hz_FuelTemp_BktFR AINc_Hz_FuelTemp_BktRR AINc_Hz_LB12_fail_FR AINc_Hz_LB12_fail_RR AINc_Hz_LB12_vl_FR AINc_Hz_LB12_vl_RR AINc_Hz_ManifoldTemp_BktFR AINc_Hz_ManifoldTemp_BktRR AINc_Hz_RT_TurboErr AINc_Hz_TP1_BktFR AINc_Hz_TP1_BktRR AINc_Hz_TP2_BktFR AINc_Hz_TP2_BktRR AINc_Hz_bat_dat_nok_FR AINc_Hz_bat_dat_nok_RR AINc_Hz_eng_oil_pres_dat_l3_FR AINc_Hz_eng_oil_pres_dat_l3_RR AINc_Hz_eng_oil_pres_oc_FR AINc_Hz_eng_oil_pres_oc_RR AINc_Hz_fuel_lvl_dat_FR AINc_Hz_fuel_lvl_dat_RR AINc_Hz_map_dath_FR AINc_Hz_map_dath_RR AINc_Hz_map_datl_FR AINc_Hz_map_datl_RR AINc_Hz_map_lh_FR AINc_Hz_map_lh_RR AINc_Hz_map_vh_FR AINc_Hz_map_vh_RR AINc_Hz_vsup_nok_FR AINc_Hz_vsup_nok_RR AINc_NU_APP1_Raw AINc_NU_APP2_Raw AINc_NU_AmbientTemp_BktHys AINc_NU_AmbientTemp_SlewLim AINc_NU_Baro_BktHys AINc_NU_Baro_Gain AINc_NU_Baro_SlewLim AINc_NU_CompOutPress_BktHys AINc_NU_CompOutPress_Gain AINc_NU_CompOutPress_SlewLim AINc_NU_CoolantTemp_BktHys AINc_NU_CoolantTemp_SlewLim AINc_NU_DOT_VMonGain AINc_NU_EngPower AINc_NU_ExTemp_BktHys AINc_NU_ExTemp_SlewLim AINc_NU_FAPPress_BktHys AINc_NU_FAPPress_Gain AINc_NU_FAPPress_SlewLim AINc_NU_FuelLevel1_Gain_PctToL AINc_NU_FuelLevel1_Gain_VToPct AINc_NU_FuelLevel2_Gain_PctToL AINc_NU_FuelLevel2_Gain_VToPct AINc_NU_FuelPress_BktHys AINc_NU_FuelPress_SlewLim AINc_NU_FuelTemp_BktHys AINc_NU_FuelTemp_SlewLim AINc_NU_HBridgeCurrentMonGain AINc_NU_HighsideCurrentMonGain AINc_NU_HighsideGain AINc_NU_MAP_Gain AINc_NU_MIL_Status AINc_NU_ManifoldTemp_BktHys AINc_NU_ManifoldTemp_SlewLim AINc_NU_MinRPMCaCr AINc_NU_TP1_BktHys AINc_NU_TP1_Dflt AINc_NU_TP1_Gain AINc_NU_TP1_Raw AINc_NU_TP1_SlewLim AINc_NU_TP2_BktHys AINc_NU_TP2_Dflt AINc_NU_TP2_Gain AINc_NU_TP2_Raw AINc_NU_TP2_SlewLim AINc_NU_VBattGain AINc_NU_VRefMonGain AINc_Nm_EngTor AINc_V_APP1_Max AINc_V_APP1_Min AINc_V_APP2_Max AINc_V_APP2_Min AINc_V_AmbientTemp_Max AINc_V_AmbientTemp_Min AINc_V_Baro_Max AINc_V_Baro_Min AINc_V_Baro_Ofst AINc_V_CompOutPress_Max AINc_V_CompOutPress_Min AINc_V_CompOutPress_Ofst AINc_V_CoolantTemp_Max AINc_V_CoolantTemp_Min AINc_V_EGO11 AINc_V_EGO12 AINc_V_EGO21 AINc_V_ExTemp_Max AINc_V_ExTemp_Min AINc_V_FAPPress_Max AINc_V_FAPPress_Min AINc_V_FAPPress_Ofst AINc_V_FuelLevel1_Ofst_PctToL AINc_V_FuelLevel1_Ofst_VToPct AINc_V_FuelLevel2_Ofst_PctToL AINc_V_FuelLevel2_Ofst_VToPct AINc_V_FuelPress_Max AINc_V_FuelPress_Min AINc_V_FuelTemp_Max AINc_V_FuelTemp_Min AINc_V_GLPHV AINc_V_HBridgeCurrentMonOfst AINc_V_LambErrorThres AINc_V_MAP_Dft AINc_V_MAP_OV AINc_V_MAP_Ofst AINc_V_MAP_UV AINc_V_ManifoldTemp_Max AINc_V_ManifoldTemp_Min AINc_V_TP1_Max AINc_V_TP1_Min AINc_V_TP1_Ofst AINc_V_TP2_Max AINc_V_TP2_Min AINc_V_TP2_Ofst AINc_V_VBatt AINc_V_VBattLow AINc_V_VBattTop AINc_adv_KnockRegionStartAng AINc_b_APP1_Valid AINc_b_APP2_Valid AINc_b_DC_start AINc_b_Eng_running AINc_b_IC_start AINc_b_KnockWinSPT_Ofst AINc_b_RealGear AINc_b_Tank2_Available AINc_b_UEGO1_Valid AINc_b_UEGO2_Valid AINc_b_UseHalfVBatt AINc_b_WU_start AINc_bar_FuelPress AINc_bar_FuelPressOvrd AINc_bar_FuelPress_Dflt AINc_bar_FuelPress_Max AINc_bar_FuelPress_Min AINc_cnt_CylIdxA AINc_cnt_CylIdxB AINc_e_MAP_SampleCylinder AINc_kPa_Baro AINc_kPa_Baro_Dflt AINc_kPa_Baro_Max AINc_kPa_Baro_Min AINc_kPa_Baro_Ofst AINc_kPa_CompOutPress AINc_kPa_CompOutPress_Dflt AINc_kPa_CompOutPress_Max AINc_kPa_CompOutPress_Min AINc_kPa_CompOutPress_Ofst AINc_kPa_FAP AINc_kPa_FAPPress_Dflt AINc_kPa_FAPPress_Max AINc_kPa_FAPPress_Min AINc_kPa_FuelPressDefault AINc_kPa_MAP AINc_kPa_MAPsThershold AINc_kPa_MAPuThershold AINc_kPa_OilPress AINc_lam_UEGO1 AINc_lam_UEGO2 AINc_o_APP1_Raw AINc_o_APP1_Valid AINc_o_APP2_Raw AINc_o_APP2_Valid AINc_o_AmbientTemp AINc_o_Baro AINc_o_CompOutPress AINc_o_CompOutTemp AINc_o_CoolantTemp AINc_o_CylIdxA AINc_o_CylIdxB AINc_o_Cylinder1_Knock AINc_o_Cylinder2_Knock AINc_o_Cylinder3_Knock AINc_o_Cylinder4_Knock AINc_o_DC_start AINc_o_EGO11 AINc_o_EGO12 AINc_o_EGO21 AINc_o_Eng_running AINc_o_ExhaustTemp AINc_o_FAP AINc_o_FuelPress AINc_o_FuelPressOvrd AINc_o_FuelTemp AINc_o_IC_start AINc_o_MAP AINc_o_MIL_Status AINc_o_ManifoldTemp AINc_o_OilPress AINc_o_OilTemp AINc_o_TP1_Raw AINc_o_TP2_Raw AINc_o_UEGO1 AINc_o_UEGO1_Valid AINc_o_UEGO2 AINc_o_UEGO2_Valid AINc_o_VBatt AINc_o_WU_start AINc_pct_Cylinder1_Knock AINc_pct_Cylinder2_Knock AINc_pct_Cylinder3_Knock AINc_pct_Cylinder4_Knock AINc_s_L1DeadTime AINc_s_L1ResetTime AINc_s_L2SBDeadTime AINc_s_L2SBResetTime AINc_s_NoSyncDelay AINc_s_SyncCranktime AINc_s_THRDeadTime AINc_s_THRResetTime AINc_s_TimeFuelLevel AINc_s_cyl_inj_RDT AINc_s_cyl_inj_SDT AINm_NU_FuelPress_x AINm_NU_FuelPress_z AINm_NU_KnockGain_x AINm_NU_KnockGain_z AINm_NU_KnockOfst_x AINm_NU_KnockOfst_z AINm_deg_KnockWinDur_x AINm_deg_KnockWinDur_z AINm_deg_KnockWinStartOfst_x AINm_deg_KnockWinStartOfst_z AINv_C_AmbientTemp_TF AINv_C_CoolantTemp_TF AINv_C_ExTemp_TF AINv_C_FuelTemp_TF AINv_C_ManifoldTemp_TF AINv_NU_KnockFilterGain AINv_V_AmbientTemp_TF AINv_V_CoolantTemp_TF AINv_V_ExTemp_TF AINv_V_FuelPress_TF AINv_V_FuelTemp_TF AINv_V_ManifoldTemp_TF AINv_bar_FuelPress_TF AINv_deg_MAP_SampleAngles AINv_kHz_KnockFilterFrq AINv_us_KnockFilterIntegrator /end REF_CHARACTERISTIC
/end FUNCTION
/begin FUNCTION amb "Group /ByDataDictionaryPrefix/amb" /begin LOC_MEASUREMENT AMB_b_OBDTempOK /end LOC_MEASUREMENT /begin REF_CHARACTERISTIC AMBc_b_OBDTempOK AMBc_o_OBDTempOK /end REF_CHARACTERISTIC /end FUNCTION
/begin FUNCTION ame "Group /ByDataDictionaryPrefix/ame"
 /begin LOC_MEASUREMENT AME_C_ChargeTemp AME_C_ChargeTempDelta AME_b_LearnedBaro AME_b_Transient AME_cc_ChargeVol AME_gps_FreshMassAirFlow AME_gps_IdealAirAtSTP AME_gps_MAF_Corr AME_gps_MAF_FreshMassAirFlow AME_gps_MassAirFlowUncorr AME_gps_MassAirFlowUnfiltd AME_gps_SD_FreshMassAirFlow AME_gps_SD_MassAirFlow AME_kPa_Baro AME_kPa_ChargePress AME_mg_FreshAirMass AME_mg_SD_AirMassPerCyl AME_pct_ChargeTempCF AME_pct_DemandHPF_Peak AME_pct_DmndHPF AME_pct_Load AME_pct_MAF_Ofst AME_pct_UseMAF AME_pct_VolEff /end LOC_MEASUREMENT
 /begin REF_CHARACTERISTIC AMEc_C_ChargeTemp AMEc_Hz_ChargeTempLPF AMEc_Hz_LoadFiltCutoff AMEc_Hz_MassAirFlowLPF AMEc_NU_DmndHPF AMEc_b_EnableMAF AMEc_b_EnableSD AMEc_gps_FreshMassAirFlow AMEc_kPa_Baro AMEc_kPa_BaroMax AMEc_kPa_BaroMin AMEc_mg_FreshAirMass AMEc_o_Baro AMEc_o_ChargeTemp AMEc_o_FreshAirMass AMEc_o_FreshMassAirFlow AMEc_o_Load AMEc_o_VolEff AMEc_pct_DemandHPF_Thrsh AMEc_pct_Load AMEc_pct_VolEff AMEc_s_BaroLearnDbnc AMEm_NU_ChargeTempCF_x AMEm_NU_ChargeTempCF_y AMEm_NU_ChargeTempCF_z AMEm_NU_MAF_Ofst_x AMEm_NU_MAF_Ofst_y AMEm_NU_MAF_Ofst_z AMEm_NU_ResidualPress_x AMEm_NU_ResidualPress_z AMEm_NU_UseDemandTime_x AMEm_NU_UseDemandTime_y AMEm_NU_UseDemandTime_z AMEm_NU_UseMAF_x AMEm_NU_UseMAF_y AMEm_NU_UseMAF_z AMEm_NU_VolEff_x AMEm_NU_VolEff_y AMEm_NU_VolEff_z /end REF_CHARACTERISTIC
/end FUNCTION
/begin FUNCTION app "Group /ByDataDictionaryPrefix/app"
 /begin LOC_MEASUREMENT APP_Nm_DrvrDmndTq APP_Nm_DrvrTqDmndRaw APP_V_APP1_Filtd APP_V_APP2_Filtd APP_V_FullLearnNewAPP1 APP_V_FullLearnNewAPP2 APP_V_ZeroLearnPosAPP1 APP_V_ZeroLearnPosAPP2 APP_b_BrakePedal_actv APP_b_CorrFlt APP_b_EEC1TorqueMode APP_b_Fault APP_b_ZeroLearnEnAPP1 APP_b_ZeroLearnEnAPP2 APP_e_PdlMode APP_kph_VehSpeed APP_pct_APP1 APP_pct_APP2 APP_pct_Dmnd APP_rpm_IN APP_rpm_OUT /end LOC_MEASUREMENT
 /begin REF_CHARACTERISTIC APPc_Hz_APP1_LPF APPc_Hz_APP2_LPF APPc_NU_APP1_ZeroCreepUpRate APPc_NU_APP2_ZeroCreepUpRate APPc_NU_EEC1TorqueMode APPc_NU_RPM2Hz APPc_NU_VehSpeed_Gain APPc_NU_VehSpeed_Ofst APPc_Nm_DrvrDmndTq APPc_Nm_DrvrTqDmndMax APPc_Nm_DrvrTqDmndMin APPc_V_FullLearnDfltValAPP1 APPc_V_FullLearnDfltValAPP2 APPc_V_FullLearnHiLimAPP1 APPc_V_FullLearnHiLimAPP2 APPc_V_FullLearnLoLimAPP1 APPc_V_FullLearnLoLimAPP2 APPc_V_ZeroLearnDfltValAPP1 APPc_V_ZeroLearnDfltValAPP2 APPc_V_ZeroLearnHiLimAPP1 APPc_V_ZeroLearnHiLimAPP2 APPc_V_ZeroLearnLoLimAPP1 APPc_V_ZeroLearnLoLimAPP2 APPc_b_APP1_Inverted APPc_b_APP2_Inverted APPc_b_BrakePedal_actv APPc_b_EEC1TorqueSelector APPc_b_Fault APPc_b_FullLearnEnbl APPc_b_ResetFaultLatch APPc_b_ResetNVM APPc_b_SpeedLimitActv APPc_b_UseTransGear APPc_b_idleRPMVh APPc_b_pedalmode APPc_e_PdlMode APPc_kmh_SpeedLimitSetpoint APPc_kph_VehSpeed APPc_kph_ZeroLearnSpdThrsh APPc_o_BrakePedal_actv APPc_o_Dmnd APPc_o_DrvrDmndTq APPc_o_Fault APPc_o_IN APPc_o_OUT APPc_o_PdlMode APPc_o_VehSpeed APPc_pct_APP1_Wgt APPc_pct_CorrFltLim APPc_pct_Dmnd APPc_pct_PdlModeFull APPc_pct_PdlModeHyst APPc_pct_PdlModeZero APPc_rpm_IN APPc_rpm_OUT APPc_s_CorrFltDelay APPca_V_FullLearnDfltValAPP1 APPca_V_FullLearnDfltValAPP2 APPm_NU_DrvrTqDmndFallRate_x APPm_NU_DrvrTqDmndFallRate_y APPm_NU_DrvrTqDmndFallRate_z APPm_NU_DrvrTqDmndRiseRate_x APPm_NU_DrvrTqDmndRiseRate_y APPm_NU_DrvrTqDmndRiseRate_z APPm_NU_SpeedLimitGain_x APPm_NU_SpeedLimitGain_z APPm_Nm_DrvrTqDmndMapIdle_x APPm_Nm_DrvrTqDmndMapIdle_z APPm_Nm_DrvrTqDmndMap_1_x APPm_Nm_DrvrTqDmndMap_1_y APPm_Nm_DrvrTqDmndMap_1_z APPm_Nm_DrvrTqDmndMap_2_x APPm_Nm_DrvrTqDmndMap_2_y APPm_Nm_DrvrTqDmndMap_2_z APPm_Nm_DrvrTqDmndMap_3_x APPm_Nm_DrvrTqDmndMap_3_y APPm_Nm_DrvrTqDmndMap_3_z APPm_Nm_DrvrTqDmndMap_4_x APPm_Nm_DrvrTqDmndMap_4_y APPm_Nm_DrvrTqDmndMap_4_z APPm_Nm_DrvrTqDmndMap_5_x APPm_Nm_DrvrTqDmndMap_5_y APPm_Nm_DrvrTqDmndMap_5_z APPm_Nm_DrvrTqDmndMap_IDLE_x APPm_Nm_DrvrTqDmndMap_IDLE_y APPm_Nm_DrvrTqDmndMap_IDLE_z /end REF_CHARACTERISTIC
/end FUNCTION
/begin FUNCTION baf "Group /ByDataDictionaryPrefix/baf" /begin LOC_MEASUREMENT BAF_NU_TrgtAFR1 BAF_mg_FuelRqst1 BAF_mg_FuelRqst1Raw /end LOC_MEASUREMENT
 /begin REF_CHARACTERISTIC BAFc_mg_FuelRqst1 BAFc_o_FuelRqst1 BAFm_NU_BaseFuelCI_x BAFm_NU_BaseFuelCI_y BAFm_NU_BaseFuelCI_z BAFm_NU_TransientFuelGain_x BAFm_NU_TransientFuelGain_y BAFm_NU_TransientFuelGain_z /end REF_CHARACTERISTIC
/end FUNCTION
/begin FUNCTION bar "Group /ByDataDictionaryPrefix/bar" /begin LOC_MEASUREMENT BAR_b_OBDPressOK /end LOC_MEASUREMENT /begin REF_CHARACTERISTIC BARc_b_OBDPressOK BARc_o_OBDPressOK /end REF_CHARACTERISTIC /end FUNCTION
/begin FUNCTION bas "Group /ByDataDictionaryPrefix/bas"
 /begin LOC_MEASUREMENT BAS_adv_BaseSpark BAS_adv_CrankingSpark BAS_adv_MBT_Spark BAS_adv_MBT_SparkLowGradeFuel BAS_b_LowGradeFuel BAS_cnt_KnockEvents /end LOC_MEASUREMENT
 /begin REF_CHARACTERISTIC BASc_adv_BaseSpark BASc_cnt_KnockEventCalThrsh BASc_o_BaseSpark BASm_NU_CrankingSpark_x BASm_NU_CrankingSpark_y BASm_NU_CrankingSpark_z BASm_NU_MBT_SparkLowGradeFuel_x BASm_NU_MBT_SparkLowGradeFuel_y BASm_NU_MBT_SparkLowGradeFuel_z BASm_NU_MBT_Spark_x BASm_NU_MBT_Spark_y BASm_NU_MBT_Spark_z /end REF_CHARACTERISTIC
/end FUNCTION
/begin FUNCTION cal "Group /ByDataDictionaryPrefix/cal"
 /begin LOC_MEASUREMENT CAL_V_Uoffset_A CAL_V_Uoffset_B CAL_b_CalibrationModeActv_A CAL_b_CalibrationModeActv_B CAL_b_CalibrationModeRqst_A CAL_b_CalibrationModeRqst_B /end LOC_MEASUREMENT
 /begin REF_CHARACTERISTIC CALc_V_UoffsetDfltValue CALc_b_EnblCalibrationMode_A CALc_b_EnblCalibrationMode_B CALc_b_ResetUoffset_A CALc_b_ResetUoffset_B CALca_V_UoffsetDfltValue /end REF_CHARACTERISTIC
/end FUNCTION
/begin FUNCTION cin "Group /ByDataDictionaryPrefix/cin"
 /begin LOC_MEASUREMENT CIN_NU_EngOvrCtrMd_ESP CIN_NU_EngOvrCtrMd_ESP_B CIN_NU_EngOvrCtrMd_TCM CIN_NU_EngOvrCtrMd_TCM_B CIN_NU_OvrCtrMd_ESP CIN_NU_OvrCtrMd_ESP_B CIN_NU_OvrCtrMd_TCM CIN_NU_OvrCtrMd_TCM_B CIN_Nm_TqCtrRq_ESP CIN_Nm_TqCtrRq_TCM CIN_pct_TqCtrRq_ESP CIN_pct_TqCtrRq_ESP_B CIN_pct_TqCtrRq_TCM CIN_pct_TqCtrRq_TCM_B /end LOC_MEASUREMENT
 /begin REF_CHARACTERISTIC CINc_NU_EngOvrCtrMd_ESP CINc_NU_EngOvrCtrMd_TCM CINc_NU_OvrCtrMd_ESP CINc_NU_OvrCtrMd_TCM CINc_o_EngOvrCtrMd_ESP CINc_o_EngOvrCtrMd_TCM CINc_o_OvrCtrMd_ESP CINc_o_OvrCtrMd_TCM CINc_o_TqCtrRq_ESP CINc_o_TqCtrRq_TCM CINc_pct_TqCtrRq_ESP CINc_pct_TqCtrRq_TCM /end REF_CHARACTERISTIC
/end FUNCTION
/begin FUNCTION clf "Group /ByDataDictionaryPrefix/clf"
 /begin LOC_MEASUREMENT CLF_NU_DGainFast1 CLF_NU_DGainFast2 CLF_NU_DGainSlow1 CLF_NU_DGainSlow2 CLF_NU_FB1_ErrorDot CLF_NU_FB2_ErrorDot CLF_NU_IGainFast1 CLF_NU_IGainFast2 CLF_NU_IGainSlow1 CLF_NU_IGainSlow2 CLF_NU_PGainFast1 CLF_NU_PGainFast2 CLF_NU_PGainSlow1 CLF_NU_PGainSlow2 CLF_RPM_EngSpdHPF CLF_b_Dither1Active CLF_b_Dither1Lean CLF_b_Dither1Rich CLF_b_Dither2Active CLF_b_Dither2Lean CLF_b_Dither2Rich CLF_b_DitherLamErrorActv CLF_b_FB1_Active CLF_b_FB1_Enbld CLF_b_FB2_Active CLF_b_FB2_Enbld CLF_b_FastFB1 CLF_b_FastFB2 CLF_b_InitialFB1_Stable CLF_b_InitialFB2_Stable CLF_b_LTFT1_Active CLF_b_LTFT1_AdaptFlag CLF_b_LTFT2_Active CLF_b_LTFT2_AdaptFlag CLF_b_SlowFB1 CLF_b_SlowFB1_Unstable CLF_b_SlowFB2 CLF_b_SlowFB2_Unstable CLF_cnt_LeanFiringsRqst1 CLF_cnt_LeanFiringsRqst2 CLF_cnt_RichFiringsRqst1 CLF_cnt_RichFiringsRqst2 CLF_lam_DTermLPF1 CLF_lam_DTermLPF2 CLF_lam_Error1ThrshLPF CLF_lam_Error2ThrshLPF CLF_lam_FB1_Ctrl CLF_lam_FB1_Error CLF_lam_FB1_ITerm CLF_lam_FB1_PTerm CLF_lam_FB2_Ctrl CLF_lam_FB2_Error CLF_lam_FB2_ITerm CLF_lam_FB2_PTerm CLF_lam_LTFT1 CLF_lam_LTFT2 CLF_lam_O2_Dither1 CLF_lam_O2_Dither2 CLF_lam_UEGO1_DitherAvg CLF_lam_UEGO2_DitherAvg CLF_pct_LoadHPF /end LOC_MEASUREMENT
 /begin REF_CHARACTERISTIC CLFc_C_LTFT_EngineTempMax CLFc_C_LTFT_EngineTempMin CLFc_Hz_DTermLPF CLFc_Hz_ErrorThrshLPF CLFc_NU_EngSpdHPF_TC CLFc_NU_LoadHPF_TC CLFc_NU_PID_GainScale CLFc_RPM_EngSpdHPF_Thrsh CLFc_b_AllowITermReset CLFc_b_DitherLamErrorActv CLFc_b_EnblDither CLFc_b_EnblFB1 CLFc_b_EnblFB2 CLFc_b_EnblLTFT1 CLFc_b_EnblLTFT2 CLFc_b_FB1_Active CLFc_b_FB2_Active CLFc_b_LTFT1_Reset CLFc_b_LTFT2_Reset CLFc_lam_FB1_Ctrl CLFc_lam_FB2_Ctrl CLFc_lam_FB_IMax CLFc_lam_FB_IMin CLFc_lam_FB_StableThrsh CLFc_lam_ITermResetThrsh CLFc_lam_LTFT1 CLFc_lam_LTFT2 CLFc_lam_LeanStep CLFc_lam_O2_Dither1 CLFc_lam_O2_Dither2 CLFc_lam_RichStep CLFc_lam_StoicThrshMax CLFc_lam_StoicThrshMin CLFc_lam_UEGO1_Max CLFc_lam_UEGO1_Min CLFc_lam_UEGO2_Max CLFc_lam_UEGO2_Min CLFc_o_DitherLamErrorActv CLFc_o_FB1_Active CLFc_o_FB1_Ctrl CLFc_o_FB2_Active CLFc_o_FB2_Ctrl CLFc_o_LTFT1 CLFc_o_LTFT2 CLFc_o_O2_Dither1 CLFc_o_O2_Dither2 CLFc_pct_LoadHPF_Thrsh CLFc_s_DitherActiveDbnc CLFc_s_DitherActiveHold CLFc_s_FB_StableDbnc CLFc_s_FB_UnstableDbnc CLFc_s_LTFT_ActiveDbnc CLFc_s_LTFT_RefreshPeriod CLFc_s_UEGO1_Dbnc CLFc_s_UEGO2_Dbnc CLFm_NU_DGainFast_x CLFm_NU_DGainFast_y CLFm_NU_DGainFast_z CLFm_NU_DGainSlow_x CLFm_NU_DGainSlow_y CLFm_NU_DGainSlow_z CLFm_NU_DitherLeanFirings_x CLFm_NU_DitherLeanFirings_y CLFm_NU_DitherLeanFirings_z CLFm_NU_DitherRichFirings_x CLFm_NU_DitherRichFirings_y CLFm_NU_DitherRichFirings_z CLFm_NU_IGainFast_x CLFm_NU_IGainFast_y CLFm_NU_IGainFast_z CLFm_NU_IGainSlow_x CLFm_NU_IGainSlow_y CLFm_NU_IGainSlow_z CLFm_NU_LTFT_x CLFm_NU_LTFT_y CLFm_NU_LTFT_z CLFm_NU_PGainFast_x CLFm_NU_PGainFast_y CLFm_NU_PGainFast_z CLFm_NU_PGainSlow_x CLFm_NU_PGainSlow_y CLFm_NU_PGainSlow_z CLFma_NU_LTFT_z /end REF_CHARACTERISTIC
/end FUNCTION
/begin FUNCTION cpl "Group /ByDataDictionaryPrefix/cpl" /begin LOC_MEASUREMENT CPL_b_CutSpark CPL_kPa_BoostDelta CPL_ret_SparkRetardRqst /end LOC_MEASUREMENT
 /begin REF_CHARACTERISTIC CPLc_NU_RetardPGain CPLc_b_CutSpark CPLc_kPa_SparkCutOfst CPLc_o_CutSpark CPLc_o_SparkRetardRqst CPLc_ret_RetardMax CPLc_ret_SparkRetardRqst CPLm_NU_BoostLimit_x CPLm_NU_BoostLimit_z /end REF_CHARACTERISTIC
/end FUNCTION
/begin FUNCTION cru "Group /ByDataDictionaryPrefix/cru"
 /begin LOC_MEASUREMENT CRU_NU_CurrSpeed CRU_NU_LimSpeed CRU_NU_TargetSpeed CRU_V_CruiserSET CRU_b_Active CRU_b_BrakeON CRU_b_Cancel CRU_b_ClunchON CRU_b_DownSpeed CRU_b_Enable CRU_b_FootBrake CRU_b_ParkingBrake CRU_b_UpSpeed /end LOC_MEASUREMENT
 /begin REF_CHARACTERISTIC CRUc_NU_Calib CRUc_NU_CurrSpeed CRUc_NU_DGain CRUc_NU_IGain CRUc_NU_LimSpeed CRUc_NU_PGain CRUc_NU_TargetSpeed CRUc_NU_VehSpeed_Gain CRUc_NU_VehSpeed_Ofst CRUc_V_CruiserSET CRUc_b_Active CRUc_b_BrakeON CRUc_b_Cancel CRUc_b_ClunchON CRUc_b_DownSpeed CRUc_b_Enable CRUc_b_FootBrake CRUc_b_ParkingBrake CRUc_b_UpSpeed CRUc_o_Active CRUc_o_BrakeON CRUc_o_Cancel CRUc_o_ClunchON CRUc_o_CruiserSET CRUc_o_CurrSpeed CRUc_o_DownSpeed CRUc_o_Enable CRUc_o_FootBrake CRUc_o_LimSpeed CRUc_o_ParkingBrake CRUc_o_TargetSpeed CRUc_o_UpSpeed CRUm_NU_Effort_Torque_x CRUm_NU_Effort_Torque_z /end REF_CHARACTERISTIC
/end FUNCTION
/begin FUNCTION ctc "Group /ByDataDictionaryPrefix/ctc"
 /begin LOC_MEASUREMENT CTC_lam_FuelEnrichment CTC_lam_FuelOfst CTC_ret_SparkRqst CTC_ret_SparkRqstRaw /end LOC_MEASUREMENT
 /begin REF_CHARACTERISTIC CTCc_b_UseEngineTemp CTCc_b_UseExhaustTemp CTCc_lam_FuelOfst CTCc_lam_FuelOfstMin CTCc_o_FuelOfst CTCc_o_SparkRqst CTCc_ret_SparkRqst CTCc_ret_SparkRqstMax CTCm_NU_FuelEnrichment_x CTCm_NU_FuelEnrichment_y CTCm_NU_FuelEnrichment_z CTCm_NU_SparkRqst_x CTCm_NU_SparkRqst_y CTCm_NU_SparkRqst_z /end REF_CHARACTERISTIC
/end FUNCTION
/begin FUNCTION dfc "Group /ByDataDictionaryPrefix/dfc"
 /begin LOC_MEASUREMENT DFC_RPM_EntryThrsh DFC_RPM_ExitThrsh DFC_b_BurningDFC_Active DFC_b_DTC_Condition DFC_b_FuelCut DFC_e_State DFC_ret_SparkRetard /end LOC_MEASUREMENT
 /begin REF_CHARACTERISTIC DFCc_C_MinEngTemp DFCc_Hz_TqHPF_TC DFCc_Nm_TqEntryThrsh DFCc_Nm_TqExitThrsh DFCc_Nm_TqHPF_Thrsh DFCc_b_DTC_Condition DFCc_b_FuelCut DFCc_deg_MaxSparkRetard DFCc_o_DTC_Condition DFCc_o_FuelCut DFCc_o_SparkRetard DFCc_ret_SparkRetard DFCc_s_BurningDelay DFCc_s_FuelRampOutDelay DFCc_s_StartupDelay DFCm_NU_EntryThrsh_x DFCm_NU_EntryThrsh_z DFCm_NU_ExitThrsh_x DFCm_NU_ExitThrsh_z /end REF_CHARACTERISTIC
/end FUNCTION
/begin FUNCTION dia "Group /ByDataDictionaryPrefix/dia"
 /begin REF_CHARACTERISTIC DIAc_NU_SpiCtrlCntsThresh DIAc_V_HtrNoRspnsURRstThrsh_A DIAc_V_HtrNoRspnsURRstThrsh_B DIAc_V_HtrNoRspnsURThrsh_A DIAc_V_HtrNoRspnsURThrsh_B DIAc_V_UA_OORHi DIAc_V_UA_OORLo DIAc_V_UR_OORHi DIAc_V_UR_OORLo DIAc_pct_HtrNoRspnsPWMThrsh DIAc_pct_SpiCtrl_BucketFallWgt DIAc_pct_SpiCtrl_BucketRiseWgt DIAc_s_HtrNoResponseDbnc DIAc_s_HtrNoResponseRstDbnc DIAc_s_OORHiDbnc DIAc_s_OORLoDbnc /end REF_CHARACTERISTIC
/end FUNCTION
/begin FUNCTION din "Group /ByDataDictionaryPrefix/din"
 /begin LOC_MEASUREMENT DIN_Hz_MAF DIN_NU_Gear DIN_RPM_EngSpd DIN_RPM_Per720 DIN_RPM_PerCyl DIN_RPM_TOSS DIN_b_AC_PressSw DIN_b_AC_ReqSw DIN_b_Belt DIN_b_CamPhaseValid DIN_b_CamTO DIN_b_Door DIN_b_EngSync DIN_b_Ign DIN_b_MAF_To DIN_b_OilPrSw DIN_b_ParkingBrake DIN_b_PedalBrake DIN_b_RearGear DIN_b_Y13_SB_OL DIN_b_Y17_Enabled DIN_b_Y17_Fault DIN_b_Y17_OFF_OL DIN_b_Y17_ON_OL DIN_b_Y17_OV DIN_b_Y17_Reset DIN_b_Y17_SB DIN_b_Y17_SB_Tested DIN_b_Y17_SG DIN_b_Y17_SG_OL DIN_cnt_CamExtraTeeth DIN_cnt_CamMissTeeth DIN_deg_CamTooth1 DIN_deg_CamTooth2 DIN_deg_CamTooth3 DIN_deg_CamTooth4 DIN_deg_CamToothDelta DIN_e_CurrentCyl DIN_gps_MAF DIN_kph_VehSpd DIN_pct_AltLoad DIN_ret_CamPhase /end LOC_MEASUREMENT
 /begin REF_CHARACTERISTIC DINc_Hz_EngSpdLPF DINc_Hz_MAF_To DINc_NU_Gear DINc_NU_MAF_FallRate DINc_NU_MAF_RiseRate DINc_RPM_EngSpd DINc_RPM_TOSS DINc_V_L12SG DINc_b_AC_PressSw DINc_b_AC_ReqSw DINc_b_Belt DINc_b_CamPhaseValid DINc_b_Door DINc_b_EngSync DINc_b_Ign DINc_b_OilPrSw DINc_b_ParkingBrake DINc_b_PedalBrake DINc_b_RearGear DINc_deg_Tooth2AngHi DINc_deg_Tooth2AngLo DINc_deg_Tooth2BaseAng DINc_deg_Tooth3BaseAng DINc_deg_ValidCamDelta DINc_gps_MAF DINc_kph_VehSpd DINc_o_AC_PressSw DINc_o_AC_ReqSw DINc_o_AltLoad DINc_o_Belt DINc_o_CamPhase DINc_o_CamPhaseValid DINc_o_Door DINc_o_EngSpd DINc_o_EngSync DINc_o_Gear DINc_o_Ign DINc_o_MAF DINc_o_OilPrSw DINc_o_ParkingBrake DINc_o_PedalBrake DINc_o_RearGear DINc_o_TOSS DINc_o_VehSpd DINc_pct_AltLoad DINc_ret_CamPhase DINc_ret_CamPhaseMax DINc_s_TimeIgnitionON DINc_s_ValidCamDbnc1 DINc_s_ValidCamDbnc2 DINm_NU_MAF_x DINm_NU_MAF_z /end REF_CHARACTERISTIC
/end FUNCTION
/begin FUNCTION drl "Group /ByDataDictionaryPrefix/drl" /begin LOC_MEASUREMENT DRL_b_Active DRL_gps_DynoAirRqst /end LOC_MEASUREMENT
 /begin REF_CHARACTERISTIC DRLc_b_UseDynoRqst DRLc_gps_DynoAirRqst DRLc_o_DynoAirRqst DRLm_NU_APP_ToADM_x DRLm_NU_APP_ToADM_y DRLm_NU_APP_ToADM_z /end REF_CHARACTERISTIC
/end FUNCTION
/end MODULE
/end PROJECT
