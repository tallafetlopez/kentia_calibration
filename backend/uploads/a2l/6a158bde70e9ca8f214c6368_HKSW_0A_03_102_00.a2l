ASAP2_VERSION 1 31
/begin PROJECT M670_Engine_Control_1.2.0_M670_000 "BeGas B430LG Turbocharged engine"
/begin HEADER "Begas Motor 2017-2022 (c)" VERSION "1_2_0" /end HEADER
/begin MODULE OpenECU_M670_000 ""
/* Scalar measurable for DDE 'AIN_NU_TP2_Raw'. */
/begin MEASUREMENT AIN_NU_TP2_Raw "Displayable" FLOAT32_IEEE CU_AIN_NU_TP2_RAW 1 100 0.0 0.0 ECU_ADDRESS 0x40003898 BYTE_ORDER MSB_FIRST /end MEASUREMENT
/begin COMPU_METHOD CU_AIN_NU_TP2_RAW "Conversion method for AIN_NU_TP2_Raw" RAT_FUNC "%10.1" "NU" COEFFS 0.000000 1.000000 0.000000 0.000000 0.000000 1.000000 /end COMPU_METHOD
/* Scalar measurable for DDE 'AIN_V_AmbientTemp'. */
/begin MEASUREMENT AIN_V_AmbientTemp "Analog input value" FLOAT32_IEEE CU_AIN_V_AMBIENTTEMP 1 100 0.0 0.0 ECU_ADDRESS 0x40003968 BYTE_ORDER MSB_FIRST /end MEASUREMENT
/begin COMPU_METHOD CU_AIN_V_AMBIENTTEMP "Conversion method for AIN_V_AmbientTemp" RAT_FUNC "%10.3" "V" COEFFS 0.000000 1.000000 0.000000 0.000000 0.000000 1.000000 /end COMPU_METHOD
/* Scalar measurable for DDE 'AIN_V_Baro'. */
/begin MEASUREMENT AIN_V_Baro "Analog input value" FLOAT32_IEEE CU_AIN_V_BARO 1 100 0.0 0.0 ECU_ADDRESS 0x40003920 BYTE_ORDER MSB_FIRST /end MEASUREMENT
/begin COMPU_METHOD CU_AIN_V_BARO "Conversion method for AIN_V_Baro" RAT_FUNC "%10.3" "V" COEFFS 0.000000 1.000000 0.000000 0.000000 0.000000 1.000000 /end COMPU_METHOD
/* Scalar measurable for DDE 'AIN_V_CoolantTemp'. */
/begin MEASUREMENT AIN_V_CoolantTemp "Analog input value" FLOAT32_IEEE CU_AIN_V_COOLANTTEMP 1 100 0.0 0.0 ECU_ADDRESS 0x400038f8 BYTE_ORDER MSB_FIRST /end MEASUREMENT
/begin COMPU_METHOD CU_AIN_V_COOLANTTEMP "Conversion method for AIN_V_CoolantTemp" RAT_FUNC "%10.3" "V" COEFFS 0.000000 1.000000 0.000000 0.000000 0.000000 1.000000 /end COMPU_METHOD
/* Scalar measurable for DDE 'AIN_V_EGO11'. */
/begin MEASUREMENT AIN_V_EGO11 "Displayable" FLOAT32_IEEE CU_AIN_V_EGO11 1 100 0.0 5.0 ECU_ADDRESS 0x40003878 BYTE_ORDER MSB_FIRST /end MEASUREMENT
/begin COMPU_METHOD CU_AIN_V_EGO11 "Conversion method for AIN_V_EGO11" RAT_FUNC "%10.1" "V" COEFFS 0.000000 1.000000 0.000000 0.000000 0.000000 1.000000 /end COMPU_METHOD
/* Scalar measurable for DDE 'AIN_V_EGO12'. */
/begin MEASUREMENT AIN_V_EGO12 "Displayable" FLOAT32_IEEE CU_AIN_V_EGO12 1 100 0.0 5.0 ECU_ADDRESS 0x40003900 BYTE_ORDER MSB_FIRST /end MEASUREMENT
/begin COMPU_METHOD CU_AIN_V_EGO12 "Conversion method for AIN_V_EGO12" RAT_FUNC "%10.3" "V" COEFFS 0.000000 1.000000 0.000000 0.000000 0.000000 1.000000 /end COMPU_METHOD
/* Scalar measurable for DDE 'AIN_V_EGO21'. */
/begin MEASUREMENT AIN_V_EGO21 "Displayable" FLOAT32_IEEE CU_AIN_V_EGO21 1 100 0.0 5.0 ECU_ADDRESS 0x400038a0 BYTE_ORDER MSB_FIRST /end MEASUREMENT
/begin COMPU_METHOD CU_AIN_V_EGO21 "Conversion method for AIN_V_EGO21" RAT_FUNC "%10.3" "V" COEFFS 0.000000 1.000000 0.000000 0.000000 0.000000 1.000000 /end COMPU_METHOD
/* Scalar measurable for DDE 'AIN_V_EGT'. */
/begin MEASUREMENT AIN_V_EGT "Analog input value" FLOAT32_IEEE CU_AIN_V_EGT 1 100 0.0 5.0 ECU_ADDRESS 0x400038f4 BYTE_ORDER MSB_FIRST /end MEASUREMENT
/begin COMPU_METHOD CU_AIN_V_EGT "Conversion method for AIN_V_EGT" RAT_FUNC "%10.3" "V" COEFFS 0.000000 1.000000 0.000000 0.000000 0.000000 1.000000 /end COMPU_METHOD
/* Scalar measurable for DDE 'AIN_V_ETC_MonA'. */
/begin MEASUREMENT AIN_V_ETC_MonA "Output monitor" FLOAT32_IEEE CU_AIN_V_ETC_MONA 1 100 0.0 0.0 ECU_ADDRESS 0x400037d0 BYTE_ORDER MSB_FIRST /end MEASUREMENT
/begin COMPU_METHOD CU_AIN_V_ETC_MONA "Conversion method for AIN_V_ETC_MonA" RAT_FUNC "%10.2" "V" COEFFS 0.000000 1.000000 0.000000 0.000000 0.000000 1.000000 /end COMPU_METHOD
/* Scalar measurable for DDE 'AIN_V_ETC_MonB'. */
/begin MEASUREMENT AIN_V_ETC_MonB "Output monitor" FLOAT32_IEEE CU_AIN_V_ETC_MONB 1 100 0.0 0.0 ECU_ADDRESS 0x400037c0 BYTE_ORDER MSB_FIRST /end MEASUREMENT
/begin COMPU_METHOD CU_AIN_V_ETC_MONB "Conversion method for AIN_V_ETC_MonB" RAT_FUNC "%10.2" "V" COEFFS 0.000000 1.000000 0.000000 0.000000 0.000000 1.000000 /end COMPU_METHOD
/* Scalar measurable for DDE 'AIN_V_FAPRaw'. */
/begin MEASUREMENT AIN_V_FAPRaw "Displayable" FLOAT32_IEEE CU_AIN_V_FAPRAW 1 100 0.0 5.0 ECU_ADDRESS 0x400038f0 BYTE_ORDER MSB_FIRST /end MEASUREMENT
/begin COMPU_METHOD CU_AIN_V_FAPRAW "Conversion method for AIN_V_FAPRaw" RAT_FUNC "%10.3" "V" COEFFS 0.000000 1.000000 0.000000 0.000000 0.000000 1.000000 /end COMPU_METHOD
/* Scalar measurable for DDE 'AIN_V_FCV_Mon'. */
/begin MEASUREMENT AIN_V_FCV_Mon "Output monitor" FLOAT32_IEEE CU_AIN_V_FCV_MON 1 100 0.0 0.0 ECU_ADDRESS 0x400037bc BYTE_ORDER MSB_FIRST /end MEASUREMENT
/begin COMPU_METHOD CU_AIN_V_FCV_MON "Conversion method for AIN_V_FCV_Mon" RAT_FUNC "%10.2" "V" COEFFS 0.000000 1.000000 0.000000 0.000000 0.000000 1.000000 /end COMPU_METHOD
/* Scalar measurable for DDE 'AIN_V_FiltUA_A'. */
/begin MEASUREMENT AIN_V_FiltUA_A "lambda AIN filtered" FLOAT32_IEEE CU_AIN_V_FILTUA_A 1 100 0.0 0.0 ECU_ADDRESS 0x40003108 BYTE_ORDER MSB_FIRST /end MEASUREMENT
/begin COMPU_METHOD CU_AIN_V_FILTUA_A "Conversion method for AIN_V_FiltUA_A" RAT_FUNC "%10.3" "V" COEFFS 0.000000 1.000000 0.000000 0.000000 0.000000 1.000000 /end COMPU_METHOD
/* Scalar measurable for DDE 'AIN_V_FiltUA_B'. */
/begin MEASUREMENT AIN_V_FiltUA_B "lambda AIN filtered" FLOAT32_IEEE CU_AIN_V_FILTUA_B 1 100 0.0 0.0 ECU_ADDRESS 0x40003138 BYTE_ORDER MSB_FIRST /end MEASUREMENT
/begin COMPU_METHOD CU_AIN_V_FILTUA_B "Conversion method for AIN_V_FiltUA_B" RAT_FUNC "%10.3" "V" COEFFS 0.000000 1.000000 0.000000 0.000000 0.000000 1.000000 /end COMPU_METHOD
/* Scalar measurable for DDE 'AIN_V_FiltUR_A'. */
/begin MEASUREMENT AIN_V_FiltUR_A "sensor temperature AIN filtered" FLOAT32_IEEE CU_AIN_V_FILTUR_A 1 100 0.0 0.0 ECU_ADDRESS 0x40003100 BYTE_ORDER MSB_FIRST /end MEASUREMENT
/begin COMPU_METHOD CU_AIN_V_FILTUR_A "Conversion method for AIN_V_FiltUR_A" RAT_FUNC "%10.3" "V" COEFFS 0.000000 1.000000 0.000000 0.000000 0.000000 1.000000 /end COMPU_METHOD
/* Scalar measurable for DDE 'AIN_V_FiltUR_B'. */
/begin MEASUREMENT AIN_V_FiltUR_B "sensor temperature AIN filtered" FLOAT32_IEEE CU_AIN_V_FILTUR_B 1 100 0.0 0.0 ECU_ADDRESS 0x40003130 BYTE_ORDER MSB_FIRST /end MEASUREMENT
/begin COMPU_METHOD CU_AIN_V_FILTUR_B "Conversion method for AIN_V_FiltUR_B" RAT_FUNC "%10.3" "V" COEFFS 0.000000 1.000000 0.000000 0.000000 0.000000 1.000000 /end COMPU_METHOD
/* Scalar measurable for DDE 'AIN_V_FuelPressRaw'. */
/begin MEASUREMENT AIN_V_FuelPressRaw "Analog input value" FLOAT32_IEEE CU_AIN_V_FUELPRESSRAW 1 100 0.0 5.0 ECU_ADDRESS 0x400038ec BYTE_ORDER MSB_FIRST /end MEASUREMENT
/begin COMPU_METHOD CU_AIN_V_FUELPRESSRAW "Conversion method for AIN_V_FuelPressRaw" RAT_FUNC "%10.3" "V" COEFFS 0.000000 1.000000 0.000000 0.000000 0.000000 1.000000 /end COMPU_METHOD
/* Scalar measurable for DDE 'AIN_V_FuelTempRaw'. */
/begin MEASUREMENT AIN_V_FuelTempRaw "Analog input value" FLOAT32_IEEE CU_AIN_V_FUELTEMPRAW 1 100 0.0 0.0 ECU_ADDRESS 0x400038e8 BYTE_ORDER MSB_FIRST /end MEASUREMENT
/begin COMPU_METHOD CU_AIN_V_FUELTEMPRAW "Conversion method for AIN_V_FuelTempRaw" RAT_FUNC "%10.3" "V" COEFFS 0.000000 1.000000 0.000000 0.000000 0.000000 1.000000 /end COMPU_METHOD
/* Scalar measurable for DDE 'AIN_V_Highside'. */
/begin MEASUREMENT AIN_V_Highside "Output monitor" FLOAT32_IEEE CU_AIN_V_HIGHSIDE 1 100 0.0 0.0 ECU_ADDRESS 0x400037a4 BYTE_ORDER MSB_FIRST /end MEASUREMENT
/begin COMPU_METHOD CU_AIN_V_HIGHSIDE "Conversion method for AIN_V_Highside" RAT_FUNC "%10.2" "V" COEFFS 0.000000 1.000000 0.000000 0.000000 0.000000 1.000000 /end COMPU_METHOD
/* Scalar measurable for DDE 'AIN_V_KnockSignalCyl1'. */
/begin MEASUREMENT AIN_V_KnockSignalCyl1 "Analog input value" FLOAT32_IEEE CU_AIN_V_KNOCKSIGNALCYL1 1 100 0.0 5.0 ECU_ADDRESS 0x400038c4 BYTE_ORDER MSB_FIRST /end MEASUREMENT
/begin COMPU_METHOD CU_AIN_V_KNOCKSIGNALCYL1 "Conversion method for AIN_V_KnockSignalCyl1" RAT_FUNC "%10.3" "V" COEFFS 0.000000 1.000000 0.000000 0.000000 0.000000 1.000000 /end COMPU_METHOD
/* Scalar measurable for DDE 'AIN_V_MAP_BeforeThro'. */
/begin MEASUREMENT AIN_V_MAP_BeforeThro "Analog input value" FLOAT32_IEEE CU_AIN_V_MAP_BEFORETHRO 1 100 0.0 0.0 ECU_ADDRESS 0x400038a8 BYTE_ORDER MSB_FIRST /end MEASUREMENT
/begin COMPU_METHOD CU_AIN_V_MAP_BEFORETHRO "Conversion method for AIN_V_MAP_BeforeThro" RAT_FUNC "%10.3" "V" COEFFS 0.000000 1.000000 0.000000 0.000000 0.000000 1.000000 /end COMPU_METHOD
/* Scalar measurable for DDE 'AIN_V_MAP_Raw'. */
/begin MEASUREMENT AIN_V_MAP_Raw "Raw value" FLOAT32_IEEE CU_AIN_V_MAP_RAW 1 100 0.0 0.0 ECU_ADDRESS 0x40003924 BYTE_ORDER MSB_FIRST /end MEASUREMENT
/begin COMPU_METHOD CU_AIN_V_MAP_RAW "Conversion method for AIN_V_MAP_Raw" RAT_FUNC "%10.3" "V" COEFFS 0.000000 1.000000 0.000000 0.000000 0.000000 1.000000 /end COMPU_METHOD
/* Scalar measurable for DDE 'AIN_V_MAP_Sample1'. */
/begin MEASUREMENT AIN_V_MAP_Sample1 "Raw value sampled in angular domain" FLOAT32_IEEE CU_AIN_V_MAP_SAMPLE1 1 100 0.0 0.0 ECU_ADDRESS 0x40003964 BYTE_ORDER MSB_FIRST /end MEASUREMENT
/begin COMPU_METHOD CU_AIN_V_MAP_SAMPLE1 "Conversion method for AIN_V_MAP_Sample1" RAT_FUNC "%10.3" "V" COEFFS 0.000000 1.000000 0.000000 0.000000 0.000000 1.000000 /end COMPU_METHOD
/* Scalar measurable for DDE 'AIN_V_MAP_Sample10'. */
/begin MEASUREMENT AIN_V_MAP_Sample10 "Raw value sampled in angular domain" FLOAT32_IEEE CU_AIN_V_MAP_SAMPLE10 1 100 0.0 0.0 ECU_ADDRESS 0x40003928 BYTE_ORDER MSB_FIRST /end MEASUREMENT
/begin COMPU_METHOD CU_AIN_V_MAP_SAMPLE10 "Conversion method for AIN_V_MAP_Sample10" RAT_FUNC "%10.3" "V" COEFFS 0.000000 1.000000 0.000000 0.000000 0.000000 1.000000 /end COMPU_METHOD
/* Scalar measurable for DDE 'AIN_V_MAP_Sample11'. */
/begin MEASUREMENT AIN_V_MAP_Sample11 "Raw value sampled in angular domain" FLOAT32_IEEE CU_AIN_V_MAP_SAMPLE11 1 100 0.0 0.0 ECU_ADDRESS 0x4000395c BYTE_ORDER MSB_FIRST /end MEASUREMENT
/begin COMPU_METHOD CU_AIN_V_MAP_SAMPLE11 "Conversion method for AIN_V_MAP_Sample11" RAT_FUNC "%10.3" "V" COEFFS 0.000000 1.000000 0.000000 0.000000 0.000000 1.000000 /end COMPU_METHOD
/* Scalar measurable for DDE 'AIN_V_MAP_Sample12'. */
/begin MEASUREMENT AIN_V_MAP_Sample12 "Raw value sampled in angular domain" FLOAT32_IEEE CU_AIN_V_MAP_SAMPLE12 1 100 0.0 0.0 ECU_ADDRESS 0x40003958 BYTE_ORDER MSB_FIRST /end MEASUREMENT
/begin COMPU_METHOD CU_AIN_V_MAP_SAMPLE12 "Conversion method for AIN_V_MAP_Sample12" RAT_FUNC "%10.3" "V" COEFFS 0.000000 1.000000 0.000000 0.000000 0.000000 1.000000 /end COMPU_METHOD
/* Scalar measurable for DDE 'AIN_V_MAP_Sample13'. */
/begin MEASUREMENT AIN_V_MAP_Sample13 "Raw value sampled in angular domain" FLOAT32_IEEE CU_AIN_V_MAP_SAMPLE13 1 100 0.0 0.0 ECU_ADDRESS 0x40003954 BYTE_ORDER MSB_FIRST /end MEASUREMENT
/begin COMPU_METHOD CU_AIN_V_MAP_SAMPLE13 "Conversion method for AIN_V_MAP_Sample13" RAT_FUNC "%10.3" "V" COEFFS 0.000000 1.000000 0.000000 0.000000 0.000000 1.000000 /end COMPU_METHOD
/* Scalar measurable for DDE 'AIN_V_MAP_Sample14'. */
/begin MEASUREMENT AIN_V_MAP_Sample14 "Raw value sampled in angular domain" FLOAT32_IEEE CU_AIN_V_MAP_SAMPLE14 1 100 0.0 0.0 ECU_ADDRESS 0x40003950 BYTE_ORDER MSB_FIRST /end MEASUREMENT
/begin COMPU_METHOD CU_AIN_V_MAP_SAMPLE14 "Conversion method for AIN_V_MAP_Sample14" RAT_FUNC "%10.3" "V" COEFFS 0.000000 1.000000 0.000000 0.000000 0.000000 1.000000 /end COMPU_METHOD
/* Scalar measurable for DDE 'AIN_V_MAP_Sample15'. */
/begin MEASUREMENT AIN_V_MAP_Sample15 "Raw value sampled in angular domain" FLOAT32_IEEE CU_AIN_V_MAP_SAMPLE15 1 100 0.0 0.0 ECU_ADDRESS 0x4000394c BYTE_ORDER MSB_FIRST /end MEASUREMENT
/begin COMPU_METHOD CU_AIN_V_MAP_SAMPLE15 "Conversion method for AIN_V_MAP_Sample15" RAT_FUNC "%10.3" "V" COEFFS 0.000000 1.000000 0.000000 0.000000 0.000000 1.000000 /end COMPU_METHOD
/* Scalar measurable for DDE 'AIN_V_MAP_Sample16'. */
/begin MEASUREMENT AIN_V_MAP_Sample16 "Raw value sampled in angular domain" FLOAT32_IEEE CU_AIN_V_MAP_SAMPLE16 1 100 0.0 0.0 ECU_ADDRESS 0x40003948 BYTE_ORDER MSB_FIRST /end MEASUREMENT
/begin COMPU_METHOD CU_AIN_V_MAP_SAMPLE16 "Conversion method for AIN_V_MAP_Sample16" RAT_FUNC "%10.3" "V" COEFFS 0.000000 1.000000 0.000000 0.000000 0.000000 1.000000 /end COMPU_METHOD
/* Scalar measurable for DDE 'AIN_V_MAP_Sample2'. */
/begin MEASUREMENT AIN_V_MAP_Sample2 "Raw value sampled in angular domain" FLOAT32_IEEE CU_AIN_V_MAP_SAMPLE2 1 100 0.0 0.0 ECU_ADDRESS 0x40003960 BYTE_ORDER MSB_FIRST /end MEASUREMENT
/begin COMPU_METHOD CU_AIN_V_MAP_SAMPLE2 "Conversion method for AIN_V_MAP_Sample2" RAT_FUNC "%10.3" "V" COEFFS 0.000000 1.000000 0.000000 0.000000 0.000000 1.000000 /end COMPU_METHOD
/* Scalar measurable for DDE 'AIN_V_MAP_Sample3'. */
/begin MEASUREMENT AIN_V_MAP_Sample3 "Raw value sampled in angular domain" FLOAT32_IEEE CU_AIN_V_MAP_SAMPLE3 1 100 0.0 0.0 ECU_ADDRESS 0x40003944 BYTE_ORDER MSB_FIRST /end MEASUREMENT
/begin COMPU_METHOD CU_AIN_V_MAP_SAMPLE3 "Conversion method for AIN_V_MAP_Sample3" RAT_FUNC "%10.3" "V" COEFFS 0.000000 1.000000 0.000000 0.000000 0.000000 1.000000 /end COMPU_METHOD
/* Scalar measurable for DDE 'AIN_V_MAP_Sample4'. */
/begin MEASUREMENT AIN_V_MAP_Sample4 "Raw value sampled in angular domain" FLOAT32_IEEE CU_AIN_V_MAP_SAMPLE4 1 100 0.0 0.0 ECU_ADDRESS 0x40003940 BYTE_ORDER MSB_FIRST /end MEASUREMENT
/begin COMPU_METHOD CU_AIN_V_MAP_SAMPLE4 "Conversion method for AIN_V_MAP_Sample4" RAT_FUNC "%10.3" "V" COEFFS 0.000000 1.000000 0.000000 0.000000 0.000000 1.000000 /end COMPU_METHOD
/* Scalar measurable for DDE 'AIN_V_MAP_Sample5'. */
/begin MEASUREMENT AIN_V_MAP_Sample5 "Raw value sampled in angular domain" FLOAT32_IEEE CU_AIN_V_MAP_SAMPLE5 1 100 0.0 0.0 ECU_ADDRESS 0x4000393c BYTE_ORDER MSB_FIRST /end MEASUREMENT
/begin COMPU_METHOD CU_AIN_V_MAP_SAMPLE5 "Conversion method for AIN_V_MAP_Sample5" RAT_FUNC "%10.3" "V" COEFFS 0.000000 1.000000 0.000000 0.000000 0.000000 1.000000 /end COMPU_METHOD
/* Scalar measurable for DDE 'AIN_V_MAP_Sample6'. */
/begin MEASUREMENT AIN_V_MAP_Sample6 "Raw value sampled in angular domain" FLOAT32_IEEE CU_AIN_V_MAP_SAMPLE6 1 100 0.0 0.0 ECU_ADDRESS 0x40003938 BYTE_ORDER MSB_FIRST /end MEASUREMENT
/begin COMPU_METHOD CU_AIN_V_MAP_SAMPLE6 "Conversion method for AIN_V_MAP_Sample6" RAT_FUNC "%10.3" "V" COEFFS 0.000000 1.000000 0.000000 0.000000 0.000000 1.000000 /end COMPU_METHOD
/* Scalar measurable for DDE 'AIN_V_MAP_Sample7'. */
/begin MEASUREMENT AIN_V_MAP_Sample7 "Raw value sampled in angular domain" FLOAT32_IEEE CU_AIN_V_MAP_SAMPLE7 1 100 0.0 0.0 ECU_ADDRESS 0x40003934 BYTE_ORDER MSB_FIRST /end MEASUREMENT
/begin COMPU_METHOD CU_AIN_V_MAP_SAMPLE7 "Conversion method for AIN_V_MAP_Sample7" RAT_FUNC "%10.3" "V" COEFFS 0.000000 1.000000 0.000000 0.000000 0.000000 1.000000 /end COMPU_METHOD
/* Scalar measurable for DDE 'AIN_V_MAP_Sample8'. */
/begin MEASUREMENT AIN_V_MAP_Sample8 "Raw value sampled in angular domain" FLOAT32_IEEE CU_AIN_V_MAP_SAMPLE8 1 100 0.0 0.0 ECU_ADDRESS 0x40003930 BYTE_ORDER MSB_FIRST /end MEASUREMENT
/begin COMPU_METHOD CU_AIN_V_MAP_SAMPLE8 "Conversion method for AIN_V_MAP_Sample8" RAT_FUNC "%10.3" "V" COEFFS 0.000000 1.000000 0.000000 0.000000 0.000000 1.000000 /end COMPU_METHOD
/* Scalar measurable for DDE 'AIN_V_MAP_Sample9'. */
/begin MEASUREMENT AIN_V_MAP_Sample9 "Raw value sampled in angular domain" FLOAT32_IEEE CU_AIN_V_MAP_SAMPLE9 1 100 0.0 0.0 ECU_ADDRESS 0x4000392c BYTE_ORDER MSB_FIRST /end MEASUREMENT
/begin COMPU_METHOD CU_AIN_V_MAP_SAMPLE9 "Conversion method for AIN_V_MAP_Sample9" RAT_FUNC "%10.3" "V" COEFFS 0.000000 1.000000 0.000000 0.000000 0.000000 1.000000 /end COMPU_METHOD
/* Scalar measurable for DDE 'AIN_V_ManifoldTemp'. */
/begin MEASUREMENT AIN_V_ManifoldTemp "Analog input value" FLOAT32_IEEE CU_AIN_V_MANIFOLDTEMP 1 100 -40.0 120.0 ECU_ADDRESS 0x400038c8 BYTE_ORDER MSB_FIRST /end MEASUREMENT
/begin COMPU_METHOD CU_AIN_V_MANIFOLDTEMP "Conversion method for AIN_V_ManifoldTemp" RAT_FUNC "%10.3" "V" COEFFS 0.000000 1.000000 0.000000 0.000000 0.000000 1.000000 /end COMPU_METHOD
/* Scalar measurable for DDE 'AIN_V_TP1'. */
/begin MEASUREMENT AIN_V_TP1 "Raw value" FLOAT32_IEEE CU_AIN_V_TP1 1 100 0.0 0.0 ECU_ADDRESS 0x400038b0 BYTE_ORDER MSB_FIRST /end MEASUREMENT
/begin COMPU_METHOD CU_AIN_V_TP1 "Conversion method for AIN_V_TP1" RAT_FUNC "%10.3" "V" COEFFS 0.000000 1.000000 0.000000 0.000000 0.000000 1.000000 /end COMPU_METHOD
/* Scalar measurable for DDE 'AIN_V_TP2'. */
/begin MEASUREMENT AIN_V_TP2 "Raw value" FLOAT32_IEEE CU_AIN_V_TP2 1 100 0.0 0.0 ECU_ADDRESS 0x400038ac BYTE_ORDER MSB_FIRST /end MEASUREMENT
/begin COMPU_METHOD CU_AIN_V_TP2 "Conversion method for AIN_V_TP2" RAT_FUNC "%10.3" "V" COEFFS 0.000000 1.000000 0.000000 0.000000 0.000000 1.000000 /end COMPU_METHOD
/* Scalar measurable for DDE 'AIN_V_UA_A'. */
/begin MEASUREMENT AIN_V_UA_A "lambda AIN unfiltered" FLOAT32_IEEE CU_AIN_V_UA_A 1 100 0.0 0.0 ECU_ADDRESS 0x400030cc BYTE_ORDER MSB_FIRST /end MEASUREMENT
/begin COMPU_METHOD CU_AIN_V_UA_A "Conversion method for AIN_V_UA_A" RAT_FUNC "%10.3" "V" COEFFS 0.000000 1.000000 0.000000 0.000000 0.000000 1.000000 /end COMPU_METHOD
/* Scalar measurable for DDE 'AIN_V_UA_B'. */
/begin MEASUREMENT AIN_V_UA_B "lambda AIN unfiltered" FLOAT32_IEEE CU_AIN_V_UA_B 1 100 0.0 0.0 ECU_ADDRESS 0x400030d8 BYTE_ORDER MSB_FIRST /end MEASUREMENT
/begin COMPU_METHOD CU_AIN_V_UA_B "Conversion method for AIN_V_UA_B" RAT_FUNC "%10.3" "V" COEFFS 0.000000 1.000000 0.000000 0.000000 0.000000 1.000000 /end COMPU_METHOD
/* Scalar measurable for DDE 'AIN_V_UR_A'. */
/begin MEASUREMENT AIN_V_UR_A "sensor temperature AIN unfiltered" FLOAT32_IEEE CU_AIN_V_UR_A 1 100 0.0 0.0 ECU_ADDRESS 0x400030c8 BYTE_ORDER MSB_FIRST /end MEASUREMENT
/begin COMPU_METHOD CU_AIN_V_UR_A "Conversion method for AIN_V_UR_A" RAT_FUNC "%10.3" "V" COEFFS 0.000000 1.000000 0.000000 0.000000 0.000000 1.000000 /end COMPU_METHOD
/* Scalar measurable for DDE 'AIN_V_UR_B'. */
/begin MEASUREMENT AIN_V_UR_B "sensor temperature AIN unfiltered" FLOAT32_IEEE CU_AIN_V_UR_B 1 100 0.0 0.0 ECU_ADDRESS 0x400030d4 BYTE_ORDER MSB_FIRST /end MEASUREMENT
/begin COMPU_METHOD CU_AIN_V_UR_B "Conversion method for AIN_V_UR_B" RAT_FUNC "%10.3" "V" COEFFS 0.000000 1.000000 0.000000 0.000000 0.000000 1.000000 /end COMPU_METHOD
/* Scalar measurable for DDE 'AIN_V_VBatt'. */
/begin MEASUREMENT AIN_V_VBatt "Displayable" FLOAT32_IEEE CU_AIN_V_VBATT 1 100 0.0 0.0 ECU_ADDRESS 0x40003910 BYTE_ORDER MSB_FIRST /end MEASUREMENT
/begin COMPU_METHOD CU_AIN_V_VBATT "Conversion method for AIN_V_VBatt" RAT_FUNC "%10.1" "V" COEFFS 0.000000 1.000000 0.000000 0.000000 0.000000 1.000000 /end COMPU_METHOD
/* Scalar measurable for DDE 'AIN_V_VBattRaw'. */
/begin MEASUREMENT AIN_V_VBattRaw "Displayable" FLOAT32_IEEE CU_AIN_V_VBATTRAW 1 100 0.0 0.0 ECU_ADDRESS 0x40003914 BYTE_ORDER MSB_FIRST /end MEASUREMENT
/begin COMPU_METHOD CU_AIN_V_VBATTRAW "Conversion method for AIN_V_VBattRaw" RAT_FUNC "%10.3" "V" COEFFS 0.000000 1.000000 0.000000 0.000000 0.000000 1.000000 /end COMPU_METHOD
/* Scalar measurable for DDE 'AIN_V_VRefA'. */
/begin MEASUREMENT AIN_V_VRefA "Output monitor" FLOAT32_IEEE CU_AIN_V_VREFA 1 100 0.0 0.0 ECU_ADDRESS 0x400037dc BYTE_ORDER MSB_FIRST /end MEASUREMENT
/begin COMPU_METHOD CU_AIN_V_VREFA "Conversion method for AIN_V_VRefA" RAT_FUNC "%10.2" "V" COEFFS 0.000000 1.000000 0.000000 0.000000 0.000000 1.000000 /end COMPU_METHOD
/* Scalar measurable for DDE 'AIN_V_VRefB'. */
/begin MEASUREMENT AIN_V_VRefB "Output monitor" FLOAT32_IEEE CU_AIN_V_VREFB 1 100 0.0 0.0 ECU_ADDRESS 0x400037e0 BYTE_ORDER MSB_FIRST /end MEASUREMENT
/begin COMPU_METHOD CU_AIN_V_VREFB "Conversion method for AIN_V_VRefB" RAT_FUNC "%10.2" "V" COEFFS 0.000000 1.000000 0.000000 0.000000 0.000000 1.000000 /end COMPU_METHOD
/* Scalar measurable for DDE 'AIN_V_VRefC'. */
/begin MEASUREMENT AIN_V_VRefC "Output monitor" FLOAT32_IEEE CU_AIN_V_VREFC 1 100 0.0 0.0 ECU_ADDRESS 0x400037d8 BYTE_ORDER MSB_FIRST /end MEASUREMENT
/begin COMPU_METHOD CU_AIN_V_VREFC "Conversion method for AIN_V_VRefC" RAT_FUNC "%10.2" "V" COEFFS 0.000000 1.000000 0.000000 0.000000 0.000000 1.000000 /end COMPU_METHOD
/* Scalar measurable for DDE 'AIN_V_VRefD'. */
/begin MEASUREMENT AIN_V_VRefD "Output monitor" FLOAT32_IEEE CU_AIN_V_VREFD 1 100 0.0 0.0 ECU_ADDRESS 0x400037d4 BYTE_ORDER MSB_FIRST /end MEASUREMENT
/begin COMPU_METHOD CU_AIN_V_VREFD "Conversion method for AIN_V_VRefD" RAT_FUNC "%10.2" "V" COEFFS 0.000000 1.000000 0.000000 0.000000 0.000000 1.000000 /end COMPU_METHOD
/* Scalar measurable for DDE 'AIN_V_XL1_Mon'. */
/begin MEASUREMENT AIN_V_XL1_Mon "Output monitor" FLOAT32_IEEE CU_AIN_V_XL1_MON 1 100 0.0 0.0 ECU_ADDRESS 0x400037cc BYTE_ORDER MSB_FIRST /end MEASUREMENT
/begin COMPU_METHOD CU_AIN_V_XL1_MON "Conversion method for AIN_V_XL1_Mon" RAT_FUNC "%10.2" "V" COEFFS 0.000000 1.000000 0.000000 0.000000 0.000000 1.000000 /end COMPU_METHOD
/* Scalar measurable for DDE 'AIN_V_XM1_Mon'. */
/begin MEASUREMENT AIN_V_XM1_Mon "Output monitor" FLOAT32_IEEE CU_AIN_V_XM1_MON 1 100 0.0 0.0 ECU_ADDRESS 0x400037c8 BYTE_ORDER MSB_FIRST /end MEASUREMENT
/begin COMPU_METHOD CU_AIN_V_XM1_MON "Conversion method for AIN_V_XM1_Mon" RAT_FUNC "%10.2" "V" COEFFS 0.000000 1.000000 0.000000 0.000000 0.000000 1.000000 /end COMPU_METHOD
/* Scalar measurable for DDE 'AIN_V_Y29_Mon'. */
/begin MEASUREMENT AIN_V_Y29_Mon "Output monitor" FLOAT32_IEEE CU_AIN_V_Y29_MON 1 100 0.0 0.0 ECU_ADDRESS 0x400037b8 BYTE_ORDER MSB_FIRST /end MEASUREMENT
/begin COMPU_METHOD CU_AIN_V_Y29_MON "Conversion method for AIN_V_Y29_Mon" RAT_FUNC "%10.2" "V" COEFFS 0.000000 1.000000 0.000000 0.000000 0.000000 1.000000 /end COMPU_METHOD
/* Scalar measurable for DDE 'AIN_V_Y41_Mon'. */
/begin MEASUREMENT AIN_V_Y41_Mon "Output monitor" FLOAT32_IEEE CU_AIN_V_Y41_MON 1 100 0.0 0.0 ECU_ADDRESS 0x400037b4 BYTE_ORDER MSB_FIRST /end MEASUREMENT
/begin COMPU_METHOD CU_AIN_V_Y41_MON "Conversion method for AIN_V_Y41_Mon" RAT_FUNC "%10.2" "V" COEFFS 0.000000 1.000000 0.000000 0.000000 0.000000 1.000000 /end COMPU_METHOD
/* Scalar measurable for DDE 'AIN_V_Y42_Mon'. */
/begin MEASUREMENT AIN_V_Y42_Mon "Output monitor" FLOAT32_IEEE CU_AIN_V_Y42_MON 1 100 0.0 0.0 ECU_ADDRESS 0x400037c4 BYTE_ORDER MSB_FIRST /end MEASUREMENT
/begin COMPU_METHOD CU_AIN_V_Y42_MON "Conversion method for AIN_V_Y42_Mon" RAT_FUNC "%10.2" "V" COEFFS 0.000000 1.000000 0.000000 0.000000 0.000000 1.000000 /end COMPU_METHOD
/* Scalar measurable for DDE 'AIN_V_Y6_Mon'. */
/begin MEASUREMENT AIN_V_Y6_Mon "Output monitor" FLOAT32_IEEE CU_AIN_V_Y6_MON 1 100 0.0 0.0 ECU_ADDRESS 0x4000390c BYTE_ORDER MSB_FIRST /end MEASUREMENT
/begin COMPU_METHOD CU_AIN_V_Y6_MON "Conversion method for AIN_V_Y6_Mon" RAT_FUNC "%10.2" "V" COEFFS 0.000000 1.000000 0.000000 0.000000 0.000000 1.000000 /end COMPU_METHOD
/* Scalar measurable for DDE 'AIN_adv_KnockWinStartAngA'. */
/begin MEASUREMENT AIN_adv_KnockWinStartAngA "Cyl1357 displayble" FLOAT32_IEEE CU_AIN_ADV_KNOCKWINSTARTANGA 1 100 0.0 0.0 ECU_ADDRESS 0x400038c0 BYTE_ORDER MSB_FIRST /end MEASUREMENT
/begin COMPU_METHOD CU_AIN_ADV_KNOCKWINSTARTANGA "Conversion method for AIN_adv_KnockWinStartAngA" RAT_FUNC "%10.1" "adv" COEFFS 0.000000 1.000000 0.000000 0.000000 0.000000 1.000000 /end COMPU_METHOD
/* Scalar measurable for DDE 'AIN_adv_KnockWinStopAngA'. */
/begin MEASUREMENT AIN_adv_KnockWinStopAngA "Cyl1357 displayble" FLOAT32_IEEE CU_AIN_ADV_KNOCKWINSTOPANGA 1 100 0.0 0.0 ECU_ADDRESS 0x400038bc BYTE_ORDER MSB_FIRST /end MEASUREMENT
/begin COMPU_METHOD CU_AIN_ADV_KNOCKWINSTOPANGA "Conversion method for AIN_adv_KnockWinStopAngA" RAT_FUNC "%10.1" "adv" COEFFS 0.000000 1.000000 0.000000 0.000000 0.000000 1.000000 /end COMPU_METHOD
/* Scalar measurable for DDE 'AIN_b_APP1_Valid'. */
/begin MEASUREMENT AIN_b_APP1_Valid "Displayable" UBYTE CU_AIN_B_APP1_VALID 1 100 0.0 1.0 ECU_ADDRESS 0x40002f84 BYTE_ORDER MSB_FIRST /end MEASUREMENT
/begin COMPU_METHOD CU_AIN_B_APP1_VALID "Conversion method for AIN_b_APP1_Valid" RAT_FUNC "%10.0" "b" COEFFS 0.000000 1.000000 0.000000 0.000000 0.000000 1.000000 /end COMPU_METHOD
/* Scalar measurable for DDE 'AIN_b_APP2_Valid'. */
/begin MEASUREMENT AIN_b_APP2_Valid "Displayable" UBYTE CU_AIN_B_APP2_VALID 1 100 0.0 1.0 ECU_ADDRESS 0x40002f85 BYTE_ORDER MSB_FIRST /end MEASUREMENT
/begin COMPU_METHOD CU_AIN_B_APP2_VALID "Conversion method for AIN_b_APP2_Valid" RAT_FUNC "%10.0" "b" COEFFS 0.000000 1.000000 0.000000 0.000000 0.000000 1.000000 /end COMPU_METHOD
/* Scalar measurable for DDE 'AIN_b_AmbientTemp_Fault'. */
/begin MEASUREMENT AIN_b_AmbientTemp_Fault "Displayable" UBYTE CU_AIN_B_AMBIENTTEMP_FAULT 1 100 0.0 1.0 ECU_ADDRESS 0x40002fcc BYTE_ORDER MSB_FIRST /end MEASUREMENT
/begin COMPU_METHOD CU_AIN_B_AMBIENTTEMP_FAULT "Conversion method for AIN_b_AmbientTemp_Fault" RAT_FUNC "%10.0" "b" COEFFS 0.000000 1.000000 0.000000 0.000000 0.000000 1.000000 /end COMPU_METHOD
/* Scalar measurable for DDE 'AIN_b_Baro_Fault'. */
/begin MEASUREMENT AIN_b_Baro_Fault "Displayable" UBYTE CU_AIN_B_BARO_FAULT 1 100 0.0 1.0 ECU_ADDRESS 0x40002fc1 BYTE_ORDER MSB_FIRST /end MEASUREMENT
/begin COMPU_METHOD CU_AIN_B_BARO_FAULT "Conversion method for AIN_b_Baro_Fault" RAT_FUNC "%10.0" "b" COEFFS 0.000000 1.000000 0.000000 0.000000 0.000000 1.000000 /end COMPU_METHOD
/* Scalar measurable for DDE 'AIN_b_CompOutPress_Fault'. */
/begin MEASUREMENT AIN_b_CompOutPress_Fault "Displayable" UBYTE CU_AIN_B_COMPOUTPRESS_FAULT 1 100 0.0 1.0 ECU_ADDRESS 0x40002f86 BYTE_ORDER MSB_FIRST /end MEASUREMENT
/begin COMPU_METHOD CU_AIN_B_COMPOUTPRESS_FAULT "Conversion method for AIN_b_CompOutPress_Fault" RAT_FUNC "%10.0" "b" COEFFS 0.000000 1.000000 0.000000 0.000000 0.000000 1.000000 /end COMPU_METHOD
/* Scalar measurable for DDE 'AIN_b_CoolantTemp_Fault'. */
/begin MEASUREMENT AIN_b_CoolantTemp_Fault "Displayable" UBYTE CU_AIN_B_COOLANTTEMP_FAULT 1 100 0.0 1.0 ECU_ADDRESS 0x40002fb1 BYTE_ORDER MSB_FIRST /end MEASUREMENT
/begin COMPU_METHOD CU_AIN_B_COOLANTTEMP_FAULT "Conversion method for AIN_b_CoolantTemp_Fault" RAT_FUNC "%10.0" "b" COEFFS 0.000000 1.000000 0.000000 0.000000 0.000000 1.000000 /end COMPU_METHOD
/* Scalar measurable for DDE 'AIN_b_DC_start'. */
/begin MEASUREMENT AIN_b_DC_start "Displayable" UBYTE CU_AIN_B_DC_START 1 100 0.0 1.0 ECU_ADDRESS 0x40002f33 BYTE_ORDER MSB_FIRST /end MEASUREMENT
/begin COMPU_METHOD CU_AIN_B_DC_START "Conversion method for AIN_b_DC_start" RAT_FUNC "%10.0" "b" COEFFS 0.000000 1.000000 0.000000 0.000000 0.000000 1.000000 /end COMPU_METHOD
/* Scalar measurable for DDE 'AIN_b_EGT_Fault'. */
/begin MEASUREMENT AIN_b_EGT_Fault "Displayable" UBYTE CU_AIN_B_EGT_FAULT 1 100 0.0 1.0 ECU_ADDRESS 0x40002fad BYTE_ORDER MSB_FIRST /end MEASUREMENT
/begin COMPU_METHOD CU_AIN_B_EGT_FAULT "Conversion method for AIN_b_EGT_Fault" RAT_FUNC "%10.0" "b" COEFFS 0.000000 1.000000 0.000000 0.000000 0.000000 1.000000 /end COMPU_METHOD
/* Scalar measurable for DDE 'AIN_b_Eng_running'. */
/begin MEASUREMENT AIN_b_Eng_running "Displayable" UBYTE CU_AIN_B_ENG_RUNNING 1 100 0.0 1.0 ECU_ADDRESS 0x40002f30 BYTE_ORDER MSB_FIRST /end MEASUREMENT
/begin COMPU_METHOD CU_AIN_B_ENG_RUNNING "Conversion method for AIN_b_Eng_running" RAT_FUNC "%10.0" "b" COEFFS 0.000000 1.000000 0.000000 0.000000 0.000000 1.000000 /end COMPU_METHOD
/* Scalar measurable for DDE 'AIN_b_FuelPress_Fault'. */
/begin MEASUREMENT AIN_b_FuelPress_Fault "Displayable" UBYTE CU_AIN_B_FUELPRESS_FAULT 1 100 0.0 1.0 ECU_ADDRESS 0x40002fa6 BYTE_ORDER MSB_FIRST /end MEASUREMENT
/begin COMPU_METHOD CU_AIN_B_FUELPRESS_FAULT "Conversion method for AIN_b_FuelPress_Fault" RAT_FUNC "%10.0" "b" COEFFS 0.000000 1.000000 0.000000 0.000000 0.000000 1.000000 /end COMPU_METHOD
/* Scalar measurable for DDE 'AIN_b_FuelTemp_Fault'. */
/begin MEASUREMENT AIN_b_FuelTemp_Fault "Displayable" UBYTE CU_AIN_B_FUELTEMP_FAULT 1 100 0.0 1.0 ECU_ADDRESS 0x40002fa1 BYTE_ORDER MSB_FIRST /end MEASUREMENT
/begin COMPU_METHOD CU_AIN_B_FUELTEMP_FAULT "Conversion method for AIN_b_FuelTemp_Fault" RAT_FUNC "%10.0" "b" COEFFS 0.000000 1.000000 0.000000 0.000000 0.000000 1.000000 /end COMPU_METHOD
/* Scalar measurable for DDE 'AIN_b_IC_start'. */
/begin MEASUREMENT AIN_b_IC_start "Displayable" UBYTE CU_AIN_B_IC_START 1 100 0.0 1.0 ECU_ADDRESS 0x40002f31 BYTE_ORDER MSB_FIRST /end MEASUREMENT
/begin COMPU_METHOD CU_AIN_B_IC_START "Conversion method for AIN_b_IC_start" RAT_FUNC "%10.0" "b" COEFFS 0.000000 1.000000 0.000000 0.000000 0.000000 1.000000 /end COMPU_METHOD
/* Scalar measurable for DDE 'AIN_b_ManifoldTemp_Fault'. */
/begin MEASUREMENT AIN_b_ManifoldTemp_Fault "Displayable" UBYTE CU_AIN_B_MANIFOLDTEMP_FAULT 1 100 0.0 1.0 ECU_ADDRESS 0x40002f9b BYTE_ORDER MSB_FIRST /end MEASUREMENT
/begin COMPU_METHOD CU_AIN_B_MANIFOLDTEMP_FAULT "Conversion method for AIN_b_ManifoldTemp_Fault" RAT_FUNC "%10.0" "b" COEFFS 0.000000 1.000000 0.000000 0.000000 0.000000 1.000000 /end COMPU_METHOD
/* Scalar measurable for DDE 'AIN_b_TP1_Fault'. */
/begin MEASUREMENT AIN_b_TP1_Fault "Displayable" UBYTE CU_AIN_B_TP1_FAULT 1 100 0.0 1.0 ECU_ADDRESS 0x40002f8f BYTE_ORDER MSB_FIRST /end MEASUREMENT
/begin COMPU_METHOD CU_AIN_B_TP1_FAULT "Conversion method for AIN_b_TP1_Fault" RAT_FUNC "%10.0" "b" COEFFS 0.000000 1.000000 0.000000 0.000000 0.000000 1.000000 /end COMPU_METHOD
/* Scalar measurable for DDE 'AIN_b_TP2_Fault'. */
/begin MEASUREMENT AIN_b_TP2_Fault "Displayable" UBYTE CU_AIN_B_TP2_FAULT 1 100 0.0 1.0 ECU_ADDRESS 0x40002f8c BYTE_ORDER MSB_FIRST /end MEASUREMENT
/begin COMPU_METHOD CU_AIN_B_TP2_FAULT "Conversion method for AIN_b_TP2_Fault" RAT_FUNC "%10.0" "b" COEFFS 0.000000 1.000000 0.000000 0.000000 0.000000 1.000000 /end COMPU_METHOD
/* Scalar measurable for DDE 'AIN_b_UEGO1_Valid'. */
/begin MEASUREMENT AIN_b_UEGO1_Valid "Displayable" UBYTE CU_AIN_B_UEGO1_VALID 1 100 0.0 1.0 ECU_ADDRESS 0x40002f83 BYTE_ORDER MSB_FIRST /end MEASUREMENT
/begin COMPU_METHOD CU_AIN_B_UEGO1_VALID "Conversion method for AIN_b_UEGO1_Valid" RAT_FUNC "%10.0" "b" COEFFS 0.000000 1.000000 0.000000 0.000000 0.000000 1.000000 /end COMPU_METHOD
/* Scalar measurable for DDE 'AIN_b_UEGO2_Valid'. */
/begin MEASUREMENT AIN_b_UEGO2_Valid "Displayable" UBYTE CU_AIN_B_UEGO2_VALID 1 100 0.0 1.0 ECU_ADDRESS 0x40002f82 BYTE_ORDER MSB_FIRST /end MEASUREMENT
/begin COMPU_METHOD CU_AIN_B_UEGO2_VALID "Conversion method for AIN_b_UEGO2_Valid" RAT_FUNC "%10.0" "b" COEFFS 0.000000 1.000000 0.000000 0.000000 0.000000 1.000000 /end COMPU_METHOD
/* Scalar measurable for DDE 'AIN_b_UsingPeriodic'. */
/begin MEASUREMENT AIN_b_UsingPeriodic "Displayable" UBYTE CU_AIN_B_USINGPERIODIC 1 100 0.0 1.0 ECU_ADDRESS 0x40002fc7 BYTE_ORDER MSB_FIRST /end MEASUREMENT
/begin COMPU_METHOD CU_AIN_B_USINGPERIODIC "Conversion method for AIN_b_UsingPeriodic" RAT_FUNC "%10.0" "b" COEFFS 0.000000 1.000000 0.000000 0.000000 0.000000 1.000000 /end COMPU_METHOD
/* Scalar measurable for DDE 'AIN_b_WU_start'. */
/begin MEASUREMENT AIN_b_WU_start "Displayable" UBYTE CU_AIN_B_WU_START 1 100 0.0 1.0 ECU_ADDRESS 0x40002f32 BYTE_ORDER MSB_FIRST /end MEASUREMENT
/begin COMPU_METHOD CU_AIN_B_WU_START "Conversion method for AIN_b_WU_start" RAT_FUNC "%10.0" "b" COEFFS 0.000000 1.000000 0.000000 0.000000 0.000000 1.000000 /end COMPU_METHOD
/* Scalar measurable for DDE 'AIN_bar_FuelPress'. */
/begin MEASUREMENT AIN_bar_FuelPress "AIN output will be bounded by this range" FLOAT32_IEEE CU_AIN_BAR_FUELPRESS 1 100 0.0 1000.0 ECU_ADDRESS 0x40003848 BYTE_ORDER MSB_FIRST /end MEASUREMENT
/begin COMPU_METHOD CU_AIN_BAR_FUELPRESS "Conversion method for AIN_bar_FuelPress" RAT_FUNC "%10.1" "bar" COEFFS 0.000000 1.000000 0.000000 0.000000 0.000000 1.000000 /end COMPU_METHOD
/* Scalar measurable for DDE 'AIN_cnt_CylIdxA'. */
/begin MEASUREMENT AIN_cnt_CylIdxA "Displayable" UBYTE CU_AIN_CNT_CYLIDXA 1 100 0.0 0.0 ECU_ADDRESS 0x40003024 BYTE_ORDER MSB_FIRST /end MEASUREMENT
/begin COMPU_METHOD CU_AIN_CNT_CYLIDXA "Conversion method for AIN_cnt_CylIdxA" RAT_FUNC "%10.0" "cnt" COEFFS 0.000000 1.000000 0.000000 0.000000 0.000000 1.000000 /end COMPU_METHOD
/* Scalar measurable for DDE 'AIN_cnt_CylIdxB'. */
/begin MEASUREMENT AIN_cnt_CylIdxB "Displayable" UBYTE CU_AIN_CNT_CYLIDXB 1 100 0.0 0.0 ECU_ADDRESS 0x40003023 BYTE_ORDER MSB_FIRST /end MEASUREMENT
/begin COMPU_METHOD CU_AIN_CNT_CYLIDXB "Conversion method for AIN_cnt_CylIdxB" RAT_FUNC "%10.0" "cnt" COEFFS 0.000000 1.000000 0.000000 0.000000 0.000000 1.000000 /end COMPU_METHOD
/* Scalar measurable for DDE 'AIN_cnt_HIP_SPI_Flts'. */
/begin MEASUREMENT AIN_cnt_HIP_SPI_Flts "HIP chip SPI fault counter" ULONG CU_AIN_CNT_HIP_SPI_FLTS 1 100 0.0 0.0 ECU_ADDRESS 0x40003070 BYTE_ORDER MSB_FIRST /end MEASUREMENT
/begin COMPU_METHOD CU_AIN_CNT_HIP_SPI_FLTS "Conversion method for AIN_cnt_HIP_SPI_Flts" RAT_FUNC "%10.0" "cnt" COEFFS 0.000000 1.000000 0.000000 0.000000 0.000000 1.000000 /end COMPU_METHOD
/* Scalar measurable for DDE 'AIN_kPa_Baro'. */
/begin MEASUREMENT AIN_kPa_Baro "Displayable" FLOAT32_IEEE CU_AIN_KPA_BARO 1 100 0.0 0.0 ECU_ADDRESS 0x4000387c BYTE_ORDER MSB_FIRST /end MEASUREMENT
/begin COMPU_METHOD CU_AIN_KPA_BARO "Conversion method for AIN_kPa_Baro" RAT_FUNC "%10.3" "kPa" COEFFS 0.000000 1.000000 0.000000 0.000000 0.000000 1.000000 /end COMPU_METHOD
/* Scalar measurable for DDE 'AIN_kPa_CompOutPress'. */
/begin MEASUREMENT AIN_kPa_CompOutPress "Displayable" FLOAT32_IEEE CU_AIN_KPA_COMPOUTPRESS 1 100 0.0 0.0 ECU_ADDRESS 0x40003854 BYTE_ORDER MSB_FIRST /end MEASUREMENT
/begin COMPU_METHOD CU_AIN_KPA_COMPOUTPRESS "Conversion method for AIN_kPa_CompOutPress" RAT_FUNC "%10.3" "kPa" COEFFS 0.000000 1.000000 0.000000 0.000000 0.000000 1.000000 /end COMPU_METHOD
/* Scalar measurable for DDE 'AIN_kPa_FAP'. */
/begin MEASUREMENT AIN_kPa_FAP "Displayable" FLOAT32_IEEE CU_AIN_KPA_FAP 1 100 0.0 0.0 ECU_ADDRESS 0x400038a4 BYTE_ORDER MSB_FIRST /end MEASUREMENT
/begin COMPU_METHOD CU_AIN_KPA_FAP "Conversion method for AIN_kPa_FAP" RAT_FUNC "%10.1" "kPa" COEFFS 0.000000 1.000000 0.000000 0.000000 0.000000 1.000000 /end COMPU_METHOD
/* Scalar measurable for DDE 'AIN_kPa_MAP'. */
/begin MEASUREMENT AIN_kPa_MAP "Displayable" FLOAT32_IEEE CU_AIN_KPA_MAP 1 100 0.0 0.0 ECU_ADDRESS 0x4000384c BYTE_ORDER MSB_FIRST /end MEASUREMENT
/begin COMPU_METHOD CU_AIN_KPA_MAP "Conversion method for AIN_kPa_MAP" RAT_FUNC "%10.0" "kPa" COEFFS 0.000000 1.000000 0.000000 0.000000 0.000000 1.000000 /end COMPU_METHOD
/* Scalar measurable for DDE 'AIN_kPa_OilPress'. */
/begin MEASUREMENT AIN_kPa_OilPress "Displayable" FLOAT32_IEEE CU_AIN_KPA_OILPRESS 1 100 0.0 1000.0 ECU_ADDRESS 0x40003884 BYTE_ORDER MSB_FIRST /end MEASUREMENT
/begin COMPU_METHOD CU_AIN_KPA_OILPRESS "Conversion method for AIN_kPa_OilPress" RAT_FUNC "%10.3" "kPa" COEFFS 0.000000 1.000000 0.000000 0.000000 0.000000 1.000000 /end COMPU_METHOD
/* Scalar measurable for DDE 'AIN_lam_UEGO1'. */
/begin MEASUREMENT AIN_lam_UEGO1 "Displayable" FLOAT32_IEEE CU_AIN_LAM_UEGO1 1 100 0.0 10.0 ECU_ADDRESS 0x40003868 BYTE_ORDER MSB_FIRST /end MEASUREMENT
/begin COMPU_METHOD CU_AIN_LAM_UEGO1 "Conversion method for AIN_lam_UEGO1" RAT_FUNC "%10.3" "lam" COEFFS 0.000000 1.000000 0.000000 0.000000 0.000000 1.000000 /end COMPU_METHOD
/* Scalar measurable for DDE 'AIN_lam_UEGO2'. */
/begin MEASUREMENT AIN_lam_UEGO2 "Displayable" FLOAT32_IEEE CU_AIN_LAM_UEGO2 1 100 0.0 10.0 ECU_ADDRESS 0x40003864 BYTE_ORDER MSB_FIRST /end MEASUREMENT
/begin COMPU_METHOD CU_AIN_LAM_UEGO2 "Conversion method for AIN_lam_UEGO2" RAT_FUNC "%10.1" "lam" COEFFS 0.000000 1.000000 0.000000 0.000000 0.000000 1.000000 /end COMPU_METHOD
/* Scalar measurable for DDE 'AIN_pct_Cylinder1_Knock'. */
/begin MEASUREMENT AIN_pct_Cylinder1_Knock "Displayable" FLOAT32_IEEE CU_AIN_PCT_CYLINDER1_KNOCK 1 100 0.0 0.0 ECU_ADDRESS 0x4000388c BYTE_ORDER MSB_FIRST /end MEASUREMENT
/begin COMPU_METHOD CU_AIN_PCT_CYLINDER1_KNOCK "Conversion method for AIN_pct_Cylinder1_Knock" RAT_FUNC "%10.2" "pct" COEFFS 0.000000 1.000000 0.000000 0.000000 0.000000 1.000000 /end COMPU_METHOD
/* Scalar measurable for DDE 'AIN_pct_Cylinder2_Knock'. */
/begin MEASUREMENT AIN_pct_Cylinder2_Knock "Displayable" FLOAT32_IEEE CU_AIN_PCT_CYLINDER2_KNOCK 1 100 0.0 0.0 ECU_ADDRESS 0x40003888 BYTE_ORDER MSB_FIRST /end MEASUREMENT
/begin COMPU_METHOD CU_AIN_PCT_CYLINDER2_KNOCK "Conversion method for AIN_pct_Cylinder2_Knock" RAT_FUNC "%10.2" "pct" COEFFS 0.000000 1.000000 0.000000 0.000000 0.000000 1.000000 /end COMPU_METHOD
/* Scalar measurable for DDE 'AIN_pct_Cylinder3_Knock'. */
/begin MEASUREMENT AIN_pct_Cylinder3_Knock "Displayable" FLOAT32_IEEE CU_AIN_PCT_CYLINDER3_KNOCK 1 100 0.0 0.0 ECU_ADDRESS 0x40003894 BYTE_ORDER MSB_FIRST /end MEASUREMENT
/begin COMPU_METHOD CU_AIN_PCT_CYLINDER3_KNOCK "Conversion method for AIN_pct_Cylinder3_Knock" RAT_FUNC "%10.2" "pct" COEFFS 0.000000 1.000000 0.000000 0.000000 0.000000 1.000000 /end COMPU_METHOD
/* Scalar measurable for DDE 'AIN_pct_Cylinder4_Knock'. */
/begin MEASUREMENT AIN_pct_Cylinder4_Knock "Displayable" FLOAT32_IEEE CU_AIN_PCT_CYLINDER4_KNOCK 1 100 0.0 0.0 ECU_ADDRESS 0x40003890 BYTE_ORDER MSB_FIRST /end MEASUREMENT
/begin COMPU_METHOD CU_AIN_PCT_CYLINDER4_KNOCK "Conversion method for AIN_pct_Cylinder4_Knock" RAT_FUNC "%10.2" "pct" COEFFS 0.000000 1.000000 0.000000 0.000000 0.000000 1.000000 /end COMPU_METHOD
/* Scalar measurable for DDE 'AIN_s_DelayLambdas'. */
/begin MEASUREMENT AIN_s_DelayLambdas "Analog input value" FLOAT32_IEEE CU_AIN_S_DELAYLAMBDAS 1 100 0.0 5000.0 ECU_ADDRESS 0x400038fc BYTE_ORDER MSB_FIRST /end MEASUREMENT
/begin COMPU_METHOD CU_AIN_S_DELAYLAMBDAS "Conversion method for AIN_s_DelayLambdas" RAT_FUNC "%10.3" "s" COEFFS 0.000000 1.000000 0.000000 0.000000 0.000000 1.000000 /end COMPU_METHOD
/* Scalar measurable for DDE 'AMB_b_OBDTempOK'. */
/begin MEASUREMENT AMB_b_OBDTempOK "Displayable" UBYTE CU_AMB_B_OBDTEMPOK 1 100 0.0 1.0 ECU_ADDRESS 0x40002f37 BYTE_ORDER MSB_FIRST /end MEASUREMENT
/begin COMPU_METHOD CU_AMB_B_OBDTEMPOK "Conversion method for AMB_b_OBDTempOK" RAT_FUNC "%10.0" "b" COEFFS 0.000000 1.000000 0.000000 0.000000 0.000000 1.000000 /end COMPU_METHOD
/* Scalar measurable for DDE 'AME_C_ChargeTemp'. */
/begin MEASUREMENT AME_C_ChargeTemp "Charge temperature" FLOAT32_IEEE CU_AME_C_CHARGETEMP 1 100 0.0 0.0 ECU_ADDRESS 0x40003648 BYTE_ORDER MSB_FIRST /end MEASUREMENT
/begin COMPU_METHOD CU_AME_C_CHARGETEMP "Conversion method for AME_C_ChargeTemp" RAT_FUNC "%10.0" "C" COEFFS 0.000000 1.000000 0.000000 0.000000 0.000000 1.000000 /end COMPU_METHOD
/* Scalar measurable for DDE 'AME_C_ChargeTempDelta'. */
/begin MEASUREMENT AME_C_ChargeTempDelta "Difference between engine temp and intake manifold air temp (positive when engine is hotter than air)" FLOAT32_IEEE CU_AME_C_CHARGETEMPDELTA 1 100 0.0 0.0 ECU_ADDRESS 0x4000364c BYTE_ORDER MSB_FIRST /end MEASUREMENT
/begin COMPU_METHOD CU_AME_C_CHARGETEMPDELTA "Conversion method for AME_C_ChargeTempDelta" RAT_FUNC "%10.1" "C" COEFFS 0.000000 1.000000 0.000000 0.000000 0.000000 1.000000 /end COMPU_METHOD
/* Scalar measurable for DDE 'AME_b_LearnedBaro'. */
/begin MEASUREMENT AME_b_LearnedBaro "Status flag" UBYTE CU_AME_B_LEARNEDBARO 1 100 0.0 1.0 ECU_ADDRESS 0x40002eb9 BYTE_ORDER MSB_FIRST /end MEASUREMENT
/begin COMPU_METHOD CU_AME_B_LEARNEDBARO "Conversion method for AME_b_LearnedBaro" RAT_FUNC "%10.0" "b" COEFFS 0.000000 1.000000 0.000000 0.000000 0.000000 1.000000 /end COMPU_METHOD
/* Scalar measurable for DDE 'AME_b_Transient'. */
/begin MEASUREMENT AME_b_Transient "AME transient detected" UBYTE CU_AME_B_TRANSIENT 1 100 0.0 1.0 ECU_ADDRESS 0x40002ee5 BYTE_ORDER MSB_FIRST /end MEASUREMENT
/begin COMPU_METHOD CU_AME_B_TRANSIENT "Conversion method for AME_b_Transient" RAT_FUNC "%10.0" "b" COEFFS 0.000000 1.000000 0.000000 0.000000 0.000000 1.000000 /end COMPU_METHOD
/* Scalar measurable for DDE 'AME_cc_ChargeVol'. */
/begin MEASUREMENT AME_cc_ChargeVol "Volume of air charge" FLOAT32_IEEE CU_AME_CC_CHARGEVOL 1 100 0.0 2000.0 ECU_ADDRESS 0x40003654 BYTE_ORDER MSB_FIRST /end MEASUREMENT
/begin COMPU_METHOD CU_AME_CC_CHARGEVOL "Conversion method for AME_cc_ChargeVol" RAT_FUNC "%10.2" "cc" COEFFS 0.000000 1.000000 0.000000 0.000000 0.000000 1.000000 /end COMPU_METHOD
/* Scalar measurable for DDE 'AME_gps_FreshMassAirFlow'. */
/begin MEASUREMENT AME_gps_FreshMassAirFlow "Final estimate of fresh air quantity that enters the cylinder" FLOAT32_IEEE CU_AME_GPS_FRESHMASSAIRFLOW 1 100 0.0 0.0 ECU_ADDRESS 0x40003618 BYTE_ORDER MSB_FIRST /end MEASUREMENT
/begin COMPU_METHOD CU_AME_GPS_FRESHMASSAIRFLOW "Conversion method for AME_gps_FreshMassAirFlow" RAT_FUNC "%10.1" "gps" COEFFS 0.000000 1.000000 0.000000 0.000000 0.000000 1.000000 /end COMPU_METHOD
/* Scalar measurable for DDE 'AME_gps_IdealAirAtSTP'. */
/begin MEASUREMENT AME_gps_IdealAirAtSTP "Ideal airflow at STP for the current engine speed and displacement" FLOAT32_IEEE CU_AME_GPS_IDEALAIRATSTP 1 100 0.0 0.0 ECU_ADDRESS 0x40003614 BYTE_ORDER MSB_FIRST /end MEASUREMENT
/begin COMPU_METHOD CU_AME_GPS_IDEALAIRATSTP "Conversion method for AME_gps_IdealAirAtSTP" RAT_FUNC "%10.1" "gps" COEFFS 0.000000 1.000000 0.000000 0.000000 0.000000 1.000000 /end COMPU_METHOD
/* Scalar measurable for DDE 'AME_gps_MAF_Corr'. */
/begin MEASUREMENT AME_gps_MAF_Corr "MAF sensor after speed/load correction" FLOAT32_IEEE CU_AME_GPS_MAF_CORR 1 100 0.0 0.0 ECU_ADDRESS 0x40003630 BYTE_ORDER MSB_FIRST /end MEASUREMENT
/begin COMPU_METHOD CU_AME_GPS_MAF_CORR "Conversion method for AME_gps_MAF_Corr" RAT_FUNC "%10.1" "gps" COEFFS 0.000000 1.000000 0.000000 0.000000 0.000000 1.000000 /end COMPU_METHOD
/* Scalar measurable for DDE 'AME_gps_MAF_FreshMassAirFlow'. */
/begin MEASUREMENT AME_gps_MAF_FreshMassAirFlow "Mass air flow excluding EGR reported by MAF sensor" FLOAT32_IEEE CU_AME_GPS_MAF_FRESHMASSAIRFLOW 1 100 0.0 500.0 ECU_ADDRESS 0x4000362c BYTE_ORDER MSB_FIRST /end MEASUREMENT
/begin COMPU_METHOD CU_AME_GPS_MAF_FRESHMASSAIRFLOW "Conversion method for AME_gps_MAF_FreshMassAirFlow" RAT_FUNC "%10.1" "gps" COEFFS 0.000000 1.000000 0.000000 0.000000 0.000000 1.000000 /end COMPU_METHOD
/* Scalar measurable for DDE 'AME_gps_MassAirFlowUncorr'. */
/begin MEASUREMENT AME_gps_MassAirFlowUncorr "Airflow estimate before transient correction" FLOAT32_IEEE CU_AME_GPS_MASSAIRFLOWUNCORR 1 100 0.0 0.0 ECU_ADDRESS 0x40003628 BYTE_ORDER MSB_FIRST /end MEASUREMENT
/begin COMPU_METHOD CU_AME_GPS_MASSAIRFLOWUNCORR "Conversion method for AME_gps_MassAirFlowUncorr" RAT_FUNC "%10.2" "gps" COEFFS 0.000000 1.000000 0.000000 0.000000 0.000000 1.000000 /end COMPU_METHOD
/* Scalar measurable for DDE 'AME_gps_MassAirFlowUnfiltd'. */
/begin MEASUREMENT AME_gps_MassAirFlowUnfiltd "mass flow estimate before LPF" FLOAT32_IEEE CU_AME_GPS_MASSAIRFLOWUNFILTD 1 100 0.0 0.0 ECU_ADDRESS 0x4000361c BYTE_ORDER MSB_FIRST /end MEASUREMENT
/begin COMPU_METHOD CU_AME_GPS_MASSAIRFLOWUNFILTD "Conversion method for AME_gps_MassAirFlowUnfiltd" RAT_FUNC "%10.2" "gps" COEFFS 0.000000 1.000000 0.000000 0.000000 0.000000 1.000000 /end COMPU_METHOD
/* Scalar measurable for DDE 'AME_gps_SD_FreshMassAirFlow'. */
/begin MEASUREMENT AME_gps_SD_FreshMassAirFlow "Mass air flow excluding EGR calculated using speed density" FLOAT32_IEEE CU_AME_GPS_SD_FRESHMASSAIRFLOW 1 100 0.0 500.0 ECU_ADDRESS 0x4000363c BYTE_ORDER MSB_FIRST /end MEASUREMENT
/begin COMPU_METHOD CU_AME_GPS_SD_FRESHMASSAIRFLOW "Conversion method for AME_gps_SD_FreshMassAirFlow" RAT_FUNC "%10.1" "gps" COEFFS 0.000000 1.000000 0.000000 0.000000 0.000000 1.000000 /end COMPU_METHOD
/* Scalar measurable for DDE 'AME_gps_SD_MassAirFlow'. */
/begin MEASUREMENT AME_gps_SD_MassAirFlow "Mass air flow estimate from speed density calculation" FLOAT32_IEEE CU_AME_GPS_SD_MASSAIRFLOW 1 100 0.0 500.0 ECU_ADDRESS 0x40003640 BYTE_ORDER MSB_FIRST /end MEASUREMENT
/begin COMPU_METHOD CU_AME_GPS_SD_MASSAIRFLOW "Conversion method for AME_gps_SD_MassAirFlow" RAT_FUNC "%10.1" "gps" COEFFS 0.000000 1.000000 0.000000 0.000000 0.000000 1.000000 /end COMPU_METHOD
/* Scalar measurable for DDE 'AME_kPa_Baro'. */
/begin MEASUREMENT AME_kPa_Baro "Displayable" FLOAT32_IEEE CU_AME_KPA_BARO 1 100 0.0 0.0 ECU_ADDRESS 0x400031f4 BYTE_ORDER MSB_FIRST /end MEASUREMENT
/begin COMPU_METHOD CU_AME_KPA_BARO "Conversion method for AME_kPa_Baro" RAT_FUNC "%10.1" "kPa" COEFFS 0.000000 1.000000 0.000000 0.000000 0.000000 1.000000 /end COMPU_METHOD
/* Scalar measurable for DDE 'AME_kPa_ChargePress'. */
/begin MEASUREMENT AME_kPa_ChargePress "Pressure of air charge" FLOAT32_IEEE CU_AME_KPA_CHARGEPRESS 1 100 0.0 200.0 ECU_ADDRESS 0x4000365c BYTE_ORDER MSB_FIRST /end MEASUREMENT
/begin COMPU_METHOD CU_AME_KPA_CHARGEPRESS "Conversion method for AME_kPa_ChargePress" RAT_FUNC "%10.2" "kPa" COEFFS 0.000000 1.000000 0.000000 0.000000 0.000000 1.000000 /end COMPU_METHOD
/* Scalar measurable for DDE 'AME_mg_FreshAirMass'. */
/begin MEASUREMENT AME_mg_FreshAirMass "Fresh air mass" FLOAT32_IEEE CU_AME_MG_FRESHAIRMASS 1 100 0.0 0.0 ECU_ADDRESS 0x40003544 BYTE_ORDER MSB_FIRST /end MEASUREMENT
/begin COMPU_METHOD CU_AME_MG_FRESHAIRMASS "Conversion method for AME_mg_FreshAirMass" RAT_FUNC "%10.1" "mg" COEFFS 0.000000 1.000000 0.000000 0.000000 0.000000 1.000000 /end COMPU_METHOD
/* Scalar measurable for DDE 'AME_mg_SD_AirMassPerCyl'. */
/begin MEASUREMENT AME_mg_SD_AirMassPerCyl "Speed density calculated air mass per cylinder per firing" FLOAT32_IEEE CU_AME_MG_SD_AIRMASSPERCYL 1 100 0.0 500.0 ECU_ADDRESS 0x40003644 BYTE_ORDER MSB_FIRST /end MEASUREMENT
/begin COMPU_METHOD CU_AME_MG_SD_AIRMASSPERCYL "Conversion method for AME_mg_SD_AirMassPerCyl" RAT_FUNC "%10.0" "mg" COEFFS 0.000000 1.000000 0.000000 0.000000 0.000000 1.000000 /end COMPU_METHOD
/* Scalar measurable for DDE 'AME_pct_ChargeTempCF'. */
/begin MEASUREMENT AME_pct_ChargeTempCF "Charge temperature compensation factor" FLOAT32_IEEE CU_AME_PCT_CHARGETEMPCF 1 100 0.0 0.0 ECU_ADDRESS 0x40003650 BYTE_ORDER MSB_FIRST /end MEASUREMENT
/begin COMPU_METHOD CU_AME_PCT_CHARGETEMPCF "Conversion method for AME_pct_ChargeTempCF" RAT_FUNC "%10.2" "pct" COEFFS 0.000000 1.000000 0.000000 0.000000 0.000000 1.000000 /end COMPU_METHOD
/* Scalar measurable for DDE 'AME_pct_DemandHPF_Peak'. */
/begin MEASUREMENT AME_pct_DemandHPF_Peak "Peak value of demand HPF" FLOAT32_IEEE CU_AME_PCT_DEMANDHPF_PEAK 1 100 0.0 0.0 ECU_ADDRESS 0x40003620 BYTE_ORDER MSB_FIRST /end MEASUREMENT
/begin COMPU_METHOD CU_AME_PCT_DEMANDHPF_PEAK "Conversion method for AME_pct_DemandHPF_Peak" RAT_FUNC "%10.3" "pct" COEFFS 0.000000 1.000000 0.000000 0.000000 0.000000 1.000000 /end COMPU_METHOD
/* Scalar measurable for DDE 'AME_pct_DmndHPF'. */
/begin MEASUREMENT AME_pct_DmndHPF "Filtered air demand" FLOAT32_IEEE CU_AME_PCT_DMNDHPF 1 100 0.0 0.0 ECU_ADDRESS 0x40003624 BYTE_ORDER MSB_FIRST /end MEASUREMENT
/begin COMPU_METHOD CU_AME_PCT_DMNDHPF "Conversion method for AME_pct_DmndHPF" RAT_FUNC "%10.2" "pct" COEFFS 0.000000 1.000000 0.000000 0.000000 0.000000 1.000000 /end COMPU_METHOD
/* Scalar measurable for DDE 'AME_pct_Load'. */
/begin MEASUREMENT AME_pct_Load "Airflow-based load: will be > 1.0 for boost conditions" FLOAT32_IEEE CU_AME_PCT_LOAD 1 100 0.0 0.0 ECU_ADDRESS 0x40003610 BYTE_ORDER MSB_FIRST /end MEASUREMENT
/begin COMPU_METHOD CU_AME_PCT_LOAD "Conversion method for AME_pct_Load" RAT_FUNC "%10.2" "pct" COEFFS 0.000000 1.000000 0.000000 0.000000 0.000000 1.000000 /end COMPU_METHOD
/* Scalar measurable for DDE 'AME_pct_MAF_Ofst'. */
/begin MEASUREMENT AME_pct_MAF_Ofst "Table output displayable" FLOAT32_IEEE CU_AME_PCT_MAF_OFST 1 100 0.0 0.0 ECU_ADDRESS 0x40003634 BYTE_ORDER MSB_FIRST /end MEASUREMENT
/begin COMPU_METHOD CU_AME_PCT_MAF_OFST "Conversion method for AME_pct_MAF_Ofst" RAT_FUNC "%10.2" "pct" COEFFS 0.000000 1.000000 0.000000 0.000000 0.000000 1.000000 /end COMPU_METHOD
/* Scalar measurable for DDE 'AME_pct_UseMAF'. */
/begin MEASUREMENT AME_pct_UseMAF "Airmass estimate selection displayable" FLOAT32_IEEE CU_AME_PCT_USEMAF 1 100 0.0 0.0 ECU_ADDRESS 0x40003638 BYTE_ORDER MSB_FIRST /end MEASUREMENT
/begin COMPU_METHOD CU_AME_PCT_USEMAF "Conversion method for AME_pct_UseMAF" RAT_FUNC "%10.2" "pct" COEFFS 0.000000 1.000000 0.000000 0.000000 0.000000 1.000000 /end COMPU_METHOD
/* Scalar measurable for DDE 'AME_pct_VolEff'. */
/begin MEASUREMENT AME_pct_VolEff "volumetric efficiency at current operating point" FLOAT32_IEEE CU_AME_PCT_VOLEFF 1 100 0.0 0.0 ECU_ADDRESS 0x40003658 BYTE_ORDER MSB_FIRST /end MEASUREMENT
/begin COMPU_METHOD CU_AME_PCT_VOLEFF "Conversion method for AME_pct_VolEff" RAT_FUNC "%10.2" "pct" COEFFS 0.000000 1.000000 0.000000 0.000000 0.000000 1.000000 /end COMPU_METHOD
/* Scalar measurable for DDE 'APP_Nm_DrvrDmndTq'. */
/begin MEASUREMENT APP_Nm_DrvrDmndTq "Final driver demanded torque" FLOAT32_IEEE CU_APP_NM_DRVRDMNDTQ 1 100 0.0 0.0 ECU_ADDRESS 0x4000358c BYTE_ORDER MSB_FIRST /end MEASUREMENT
/begin COMPU_METHOD CU_APP_NM_DRVRDMNDTQ "Conversion method for APP_Nm_DrvrDmndTq" RAT_FUNC "%10.2" "Nm" COEFFS 0.000000 1.000000 0.000000 0.000000 0.000000 1.000000 /end COMPU_METHOD
/* Scalar measurable for DDE 'APP_Nm_DrvrTqDmndRaw'. */
/begin MEASUREMENT APP_Nm_DrvrTqDmndRaw "Raw driver torque demand" FLOAT32_IEEE CU_APP_NM_DRVRTQDMNDRAW 1 100 0.0 0.0 ECU_ADDRESS 0x40003590 BYTE_ORDER MSB_FIRST /end MEASUREMENT
/begin COMPU_METHOD CU_APP_NM_DRVRTQDMNDRAW "Conversion method for APP_Nm_DrvrTqDmndRaw" RAT_FUNC "%10.2" "Nm" COEFFS 0.000000 1.000000 0.000000 0.000000 0.000000 1.000000 /end COMPU_METHOD
/* Scalar measurable for DDE 'APP_V_APP1_Filtd'. */
/begin MEASUREMENT APP_V_APP1_Filtd "Filtered accelerator pedal position sensor signal 1" FLOAT32_IEEE CU_APP_V_APP1_FILTD 1 100 0.0 0.0 ECU_ADDRESS 0x400035d0 BYTE_ORDER MSB_FIRST /end MEASUREMENT
/begin COMPU_METHOD CU_APP_V_APP1_FILTD "Conversion method for APP_V_APP1_Filtd" RAT_FUNC "%10.3" "V" COEFFS 0.000000 1.000000 0.000000 0.000000 0.000000 1.000000 /end COMPU_METHOD
/* Scalar measurable for DDE 'APP_V_APP2_Filtd'. */
/begin MEASUREMENT APP_V_APP2_Filtd "Filtered accelerator pedal position sensor signal 2" FLOAT32_IEEE CU_APP_V_APP2_FILTD 1 100 0.0 0.0 ECU_ADDRESS 0x400035e4 BYTE_ORDER MSB_FIRST /end MEASUREMENT
/begin COMPU_METHOD CU_APP_V_APP2_FILTD "Conversion method for APP_V_APP2_Filtd" RAT_FUNC "%10.3" "V" COEFFS 0.000000 1.000000 0.000000 0.000000 0.000000 1.000000 /end COMPU_METHOD
/* Scalar measurable for DDE 'APP_V_FullLearnNewAPP1'. */
/begin MEASUREMENT APP_V_FullLearnNewAPP1 "Accelerator pedal position 1 new full pedal learn position" FLOAT32_IEEE CU_APP_V_FULLLEARNNEWAPP1 1 100 0.0 0.0 ECU_ADDRESS 0x400035c8 BYTE_ORDER MSB_FIRST /end MEASUREMENT
/begin COMPU_METHOD CU_APP_V_FULLLEARNNEWAPP1 "Conversion method for APP_V_FullLearnNewAPP1" RAT_FUNC "%10.3" "V" COEFFS 0.000000 1.000000 0.000000 0.000000 0.000000 1.000000 /end COMPU_METHOD
/* Scalar measurable for DDE 'APP_V_FullLearnNewAPP2'. */
/begin MEASUREMENT APP_V_FullLearnNewAPP2 "Accelerator pedal position 2 new full pedal learn position" FLOAT32_IEEE CU_APP_V_FULLLEARNNEWAPP2 1 100 0.0 0.0 ECU_ADDRESS 0x400035dc BYTE_ORDER MSB_FIRST /end MEASUREMENT
/begin COMPU_METHOD CU_APP_V_FULLLEARNNEWAPP2 "Conversion method for APP_V_FullLearnNewAPP2" RAT_FUNC "%10.3" "V" COEFFS 0.000000 1.000000 0.000000 0.000000 0.000000 1.000000 /end COMPU_METHOD
/* Scalar measurable for DDE 'APP_V_ZeroLearnPosAPP1'. */
/begin MEASUREMENT APP_V_ZeroLearnPosAPP1 "Zero pedal learned value for accelerator pedal position sensor 1" FLOAT32_IEEE CU_APP_V_ZEROLEARNPOSAPP1 1 100 0.0 0.0 ECU_ADDRESS 0x400035cc BYTE_ORDER MSB_FIRST /end MEASUREMENT
/begin COMPU_METHOD CU_APP_V_ZEROLEARNPOSAPP1 "Conversion method for APP_V_ZeroLearnPosAPP1" RAT_FUNC "%10.3" "V" COEFFS 0.000000 1.000000 0.000000 0.000000 0.000000 1.000000 /end COMPU_METHOD
/* Scalar measurable for DDE 'APP_V_ZeroLearnPosAPP2'. */
/begin MEASUREMENT APP_V_ZeroLearnPosAPP2 "Zero pedal learned value for accelerator pedal position sensor 2" FLOAT32_IEEE CU_APP_V_ZEROLEARNPOSAPP2 1 100 0.0 0.0 ECU_ADDRESS 0x400035e0 BYTE_ORDER MSB_FIRST /end MEASUREMENT
/begin COMPU_METHOD CU_APP_V_ZEROLEARNPOSAPP2 "Conversion method for APP_V_ZeroLearnPosAPP2" RAT_FUNC "%10.3" "V" COEFFS 0.000000 1.000000 0.000000 0.000000 0.000000 1.000000 /end COMPU_METHOD
/* Scalar measurable for DDE 'APP_b_BrakePedal_actv'. */
/begin MEASUREMENT APP_b_BrakePedal_actv "(not defined)" UBYTE CU_APP_B_BRAKEPEDAL_ACTV 1 100 0.0 1.0 ECU_ADDRESS 0x40002ed5 BYTE_ORDER MSB_FIRST /end MEASUREMENT
/begin COMPU_METHOD CU_APP_B_BRAKEPEDAL_ACTV "Conversion method for APP_b_BrakePedal_actv" RAT_FUNC "%10.0" "b" COEFFS 0.000000 1.000000 0.000000 0.000000 0.000000 1.000000 /end COMPU_METHOD
/* Scalar measurable for DDE 'APP_b_CorrFlt'. */
/begin MEASUREMENT APP_b_CorrFlt "Corr fault active flag" UBYTE CU_APP_B_CORRFLT 1 100 0.0 1.0 ECU_ADDRESS 0x40002ed6 BYTE_ORDER MSB_FIRST /end MEASUREMENT
/begin COMPU_METHOD CU_APP_B_CORRFLT "Conversion method for APP_b_CorrFlt" RAT_FUNC "%10.0" "b" COEFFS 0.000000 1.000000 0.000000 0.000000 0.000000 1.000000 /end COMPU_METHOD
/* Scalar measurable for DDE 'APP_b_EEC1TorqueMode'. */
/begin MEASUREMENT APP_b_EEC1TorqueMode "Lectura modo de par EEC1 activación IDL o APP" UBYTE CU_APP_B_EEC1TORQUEMODE 1 100 0.0 1.0 ECU_ADDRESS 0x40003168 BYTE_ORDER MSB_FIRST /end MEASUREMENT
/begin COMPU_METHOD CU_APP_B_EEC1TORQUEMODE "Conversion method for APP_b_EEC1TorqueMode" RAT_FUNC "%10.0" "b" COEFFS 0.000000 1.000000 0.000000 0.000000 0.000000 1.000000 /end COMPU_METHOD
/* Scalar measurable for DDE 'APP_b_Fault'. */
/begin MEASUREMENT APP_b_Fault "APP faulted override value" UBYTE CU_APP_B_FAULT 1 100 0.0 1.0 ECU_ADDRESS 0x40002e80 BYTE_ORDER MSB_FIRST /end MEASUREMENT
/begin COMPU_METHOD CU_APP_B_FAULT "Conversion method for APP_b_Fault" RAT_FUNC "%10.0" "b" COEFFS 0.000000 1.000000 0.000000 0.000000 0.000000 1.000000 /end COMPU_METHOD
/* Scalar measurable for DDE 'APP_b_ZeroLearnEnAPP1'. */
/begin MEASUREMENT APP_b_ZeroLearnEnAPP1 "Zero pedal learn enabled" UBYTE CU_APP_B_ZEROLEARNENAPP1 1 100 0.0 1.0 ECU_ADDRESS 0x40002ed8 BYTE_ORDER MSB_FIRST /end MEASUREMENT
/begin COMPU_METHOD CU_APP_B_ZEROLEARNENAPP1 "Conversion method for APP_b_ZeroLearnEnAPP1" RAT_FUNC "%10.0" "b" COEFFS 0.000000 1.000000 0.000000 0.000000 0.000000 1.000000 /end COMPU_METHOD
/* Scalar measurable for DDE 'APP_b_ZeroLearnEnAPP2'. */
/begin MEASUREMENT APP_b_ZeroLearnEnAPP2 "Zero pedal learn enabled" UBYTE CU_APP_B_ZEROLEARNENAPP2 1 100 0.0 1.0 ECU_ADDRESS 0x40002eda BYTE_ORDER MSB_FIRST /end MEASUREMENT
/begin COMPU_METHOD CU_APP_B_ZEROLEARNENAPP2 "Conversion method for APP_b_ZeroLearnEnAPP2" RAT_FUNC "%10.0" "b" COEFFS 0.000000 1.000000 0.000000 0.000000 0.000000 1.000000 /end COMPU_METHOD
/* Scalar measurable for DDE 'APP_e_PdlMode'. */
/begin MEASUREMENT APP_e_PdlMode "Pdl Mode" UBYTE CU_APP_E_PDLMODE 1 100 0.0 0.0 ECU_ADDRESS 0x40002fe7 BYTE_ORDER MSB_FIRST /end MEASUREMENT
/begin COMPU_METHOD CU_APP_E_PDLMODE "Conversion method for APP_e_PdlMode" TAB_VERB "%12.0" "e" COMPU_TAB_REF CT_APP_E_PDLMODE /end COMPU_METHOD
/begin COMPU_VTAB CT_APP_E_PDLMODE "Conversion method for APP_e_PdlMode" TAB_VERB 3 0 "APPk_e_Zero" 1 "APPk_e_Partial" 2 "APPk_e_Full" /end COMPU_VTAB
/* Scalar measurable for DDE 'APP_kph_VehSpeed'. */
/begin MEASUREMENT APP_kph_VehSpeed "Condición 80KM/h speed limit" FLOAT32_IEEE CU_APP_KPH_VEHSPEED 1 100 0.0 0.0 ECU_ADDRESS 0x4000370c BYTE_ORDER MSB_FIRST /end MEASUREMENT
/begin COMPU_METHOD CU_APP_KPH_VEHSPEED "Conversion method for APP_kph_VehSpeed" RAT_FUNC "%10.2" "pct" COEFFS 0.000000 1.000000 0.000000 0.000000 0.000000 1.000000 /end COMPU_METHOD
/* Scalar measurable for DDE 'APP_pct_APP1'. */
/begin MEASUREMENT APP_pct_APP1 "Accelerator pedal position 1 percent" FLOAT32_IEEE CU_APP_PCT_APP1 1 100 0.0 0.0 ECU_ADDRESS 0x400035c0 BYTE_ORDER MSB_FIRST /end MEASUREMENT
/begin COMPU_METHOD CU_APP_PCT_APP1 "Conversion method for APP_pct_APP1" RAT_FUNC "%10.3" "pct" COEFFS 0.000000 1.000000 0.000000 0.000000 0.000000 1.000000 /end COMPU_METHOD
/* Scalar measurable for DDE 'APP_pct_APP2'. */
/begin MEASUREMENT APP_pct_APP2 "Accelerator pedal position 1 percent" FLOAT32_IEEE CU_APP_PCT_APP2 1 100 0.0 0.0 ECU_ADDRESS 0x400035d4 BYTE_ORDER MSB_FIRST /end MEASUREMENT
/begin COMPU_METHOD CU_APP_PCT_APP2 "Conversion method for APP_pct_APP2" RAT_FUNC "%10.3" "pct" COEFFS 0.000000 1.000000 0.000000 0.000000 0.000000 1.000000 /end COMPU_METHOD
/* Scalar measurable for DDE 'APP_pct_Dmnd'. */
/begin MEASUREMENT APP_pct_Dmnd "Arbitrated pedal position override value" FLOAT32_IEEE CU_APP_PCT_DMND 1 100 0.0 0.0 ECU_ADDRESS 0x40003340 BYTE_ORDER MSB_FIRST /end MEASUREMENT
/begin COMPU_METHOD CU_APP_PCT_DMND "Conversion method for APP_pct_Dmnd" RAT_FUNC "%10.2" "pct" COEFFS 0.000000 1.000000 0.000000 0.000000 0.000000 1.000000 /end COMPU_METHOD
/* Scalar measurable for DDE 'APP_rpm_IN'. */
/begin MEASUREMENT APP_rpm_IN "Displayable" FLOAT32_IEEE CU_APP_RPM_IN 1 100 0.0 0.0 ECU_ADDRESS 0x4000378c BYTE_ORDER MSB_FIRST /end MEASUREMENT
/begin COMPU_METHOD CU_APP_RPM_IN "Conversion method for APP_rpm_IN" RAT_FUNC "%10.0" "NU" COEFFS 0.000000 1.000000 0.000000 0.000000 0.000000 1.000000 /end COMPU_METHOD
/* Scalar measurable for DDE 'APP_rpm_OUT'. */
/begin MEASUREMENT APP_rpm_OUT "Displayable" FLOAT32_IEEE CU_APP_RPM_OUT 1 100 0.0 0.0 ECU_ADDRESS 0x40003790 BYTE_ORDER MSB_FIRST /end MEASUREMENT
/begin COMPU_METHOD CU_APP_RPM_OUT "Conversion method for APP_rpm_OUT" RAT_FUNC "%10.0" "NU" COEFFS 0.000000 1.000000 0.000000 0.000000 0.000000 1.000000 /end COMPU_METHOD
/* Scalar measurable for DDE 'BAF_NU_TrgtAFR1'. */
/begin MEASUREMENT BAF_NU_TrgtAFR1 "Target air fuel ratio" FLOAT32_IEEE CU_BAF_NU_TRGTAFR1 1 100 0.0 20.0 ECU_ADDRESS 0x400034a8 BYTE_ORDER MSB_FIRST /end MEASUREMENT
/begin COMPU_METHOD CU_BAF_NU_TRGTAFR1 "Conversion method for BAF_NU_TrgtAFR1" RAT_FUNC "%10.2" "NU" COEFFS 0.000000 1.000000 0.000000 0.000000 0.000000 1.000000 /end COMPU_METHOD
/* Scalar measurable for DDE 'BAF_mg_FuelRqst1'. */
/begin MEASUREMENT BAF_mg_FuelRqst1 "(mg/cyl/firing) Torque-making fuel mass request for Bank 1" FLOAT32_IEEE CU_BAF_MG_FUELRQST1 1 100 0.0 0.0 ECU_ADDRESS 0x400034a0 BYTE_ORDER MSB_FIRST /end MEASUREMENT
/begin COMPU_METHOD CU_BAF_MG_FUELRQST1 "Conversion method for BAF_mg_FuelRqst1" RAT_FUNC "%10.2" "mg" COEFFS 0.000000 1.000000 0.000000 0.000000 0.000000 1.000000 /end COMPU_METHOD
/* Scalar measurable for DDE 'BAF_mg_FuelRqst1Raw'. */
/begin MEASUREMENT BAF_mg_FuelRqst1Raw "(mg/cyl/firing) Raw torque-making fuel mass request" FLOAT32_IEEE CU_BAF_MG_FUELRQST1RAW 1 100 0.0 0.0 ECU_ADDRESS 0x400034a4 BYTE_ORDER MSB_FIRST /end MEASUREMENT
/begin COMPU_METHOD CU_BAF_MG_FUELRQST1RAW "Conversion method for BAF_mg_FuelRqst1Raw" RAT_FUNC "%10.2" "mg" COEFFS 0.000000 1.000000 0.000000 0.000000 0.000000 1.000000 /end COMPU_METHOD
/* Scalar measurable for DDE 'BAR_b_OBDPressOK'. */
/begin MEASUREMENT BAR_b_OBDPressOK "Displayable" UBYTE CU_BAR_B_OBDPRESSOK 1 100 0.0 1.0 ECU_ADDRESS 0x40002f35 BYTE_ORDER MSB_FIRST /end MEASUREMENT
/begin COMPU_METHOD CU_BAR_B_OBDPRESSOK "Conversion method for BAR_b_OBDPressOK" RAT_FUNC "%10.0" "b" COEFFS 0.000000 1.000000 0.000000 0.000000 0.000000 1.000000 /end COMPU_METHOD
/* Scalar measurable for DDE 'BAS_adv_BaseSpark'. */
/begin MEASUREMENT BAS_adv_BaseSpark "Final Ignition Advance Angle from BAS feature" FLOAT32_IEEE CU_BAS_ADV_BASESPARK 1 100 0.0 0.0 ECU_ADDRESS 0x40003604 BYTE_ORDER MSB_FIRST /end MEASUREMENT
/begin COMPU_METHOD CU_BAS_ADV_BASESPARK "Conversion method for BAS_adv_BaseSpark" RAT_FUNC "%10.1" "adv" COEFFS 0.000000 1.000000 0.000000 0.000000 0.000000 1.000000 /end COMPU_METHOD
/* Scalar measurable for DDE 'BAS_adv_CrankingSpark'. */
/begin MEASUREMENT BAS_adv_CrankingSpark "Cranking spark advance" FLOAT32_IEEE CU_BAS_ADV_CRANKINGSPARK 1 100 -40.0 0.0 ECU_ADDRESS 0x40003660 BYTE_ORDER MSB_FIRST /end MEASUREMENT
/begin COMPU_METHOD CU_BAS_ADV_CRANKINGSPARK "Conversion method for BAS_adv_CrankingSpark" RAT_FUNC "%10.1" "adv" COEFFS 0.000000 1.000000 0.000000 0.000000 0.000000 1.000000 /end COMPU_METHOD
/* Scalar measurable for DDE 'BAS_adv_MBT_Spark'. */
/begin MEASUREMENT BAS_adv_MBT_Spark "Running point displayable" FLOAT32_IEEE CU_BAS_ADV_MBT_SPARK 1 100 0.0 0.0 ECU_ADDRESS 0x40003608 BYTE_ORDER MSB_FIRST /end MEASUREMENT
/begin COMPU_METHOD CU_BAS_ADV_MBT_SPARK "Conversion method for BAS_adv_MBT_Spark" RAT_FUNC "%10.1" "adv" COEFFS 0.000000 1.000000 0.000000 0.000000 0.000000 1.000000 /end COMPU_METHOD
/* Scalar measurable for DDE 'BAS_adv_MBT_SparkLowGradeFuel'. */
/begin MEASUREMENT BAS_adv_MBT_SparkLowGradeFuel "Running point displayable" FLOAT32_IEEE CU_BAS_ADV_MBT_SPARKLOWGRADEFU0 1 100 0.0 0.0 ECU_ADDRESS 0x4000360c BYTE_ORDER MSB_FIRST /end MEASUREMENT
/begin COMPU_METHOD CU_BAS_ADV_MBT_SPARKLOWGRADEFU0 "Conversion method for BAS_adv_MBT_SparkLowGradeFuel" RAT_FUNC "%10.1" "adv" COEFFS 0.000000 1.000000 0.000000 0.000000 0.000000 1.000000 /end COMPU_METHOD
/* Scalar measurable for DDE 'BAS_b_LowGradeFuel'. */
/begin MEASUREMENT BAS_b_LowGradeFuel "Displayable" UBYTE CU_BAS_B_LOWGRADEFUEL 1 100 0.0 1.0 ECU_ADDRESS 0x40002ee3 BYTE_ORDER MSB_FIRST /end MEASUREMENT
/begin COMPU_METHOD CU_BAS_B_LOWGRADEFUEL "Conversion method for BAS_b_LowGradeFuel" RAT_FUNC "%10.0" "b" COEFFS 0.000000 1.000000 0.000000 0.000000 0.000000 1.000000 /end COMPU_METHOD
/* Scalar measurable for DDE 'BAS_cnt_KnockEvents'. */
/begin MEASUREMENT BAS_cnt_KnockEvents "Calibratable number of times Eng has knocked during one Eng duration" UWORD CU_BAS_CNT_KNOCKEVENTS 1 100 0.0 0.0 ECU_ADDRESS 0x4000302a BYTE_ORDER MSB_FIRST /end MEASUREMENT
/begin COMPU_METHOD CU_BAS_CNT_KNOCKEVENTS "Conversion method for BAS_cnt_KnockEvents" RAT_FUNC "%10.0" "cnt" COEFFS 0.000000 1.000000 0.000000 0.000000 0.000000 1.000000 /end COMPU_METHOD
/* Scalar measurable for DDE 'CAL_V_Uoffset_A'. */
/begin MEASUREMENT CAL_V_Uoffset_A "NVM offset value used for Lambda calculation" FLOAT32_IEEE CU_CAL_V_UOFFSET_A 1 100 0.0 0.0 ECU_ADDRESS 0x40003104 BYTE_ORDER MSB_FIRST /end MEASUREMENT
/begin COMPU_METHOD CU_CAL_V_UOFFSET_A "Conversion method for CAL_V_Uoffset_A" RAT_FUNC "%10.3" "V" COEFFS 0.000000 1.000000 0.000000 0.000000 0.000000 1.000000 /end COMPU_METHOD
/* Scalar measurable for DDE 'CAL_V_Uoffset_B'. */
/begin MEASUREMENT CAL_V_Uoffset_B "NVM offset value used for Lambda calculation" FLOAT32_IEEE CU_CAL_V_UOFFSET_B 1 100 0.0 0.0 ECU_ADDRESS 0x40003134 BYTE_ORDER MSB_FIRST /end MEASUREMENT
/begin COMPU_METHOD CU_CAL_V_UOFFSET_B "Conversion method for CAL_V_Uoffset_B" RAT_FUNC "%10.3" "V" COEFFS 0.000000 1.000000 0.000000 0.000000 0.000000 1.000000 /end COMPU_METHOD
/* Scalar measurable for DDE 'CAL_b_CalibrationModeActv_A'. */
/begin MEASUREMENT CAL_b_CalibrationModeActv_A "Calibration mode active flag" UBYTE CU_CAL_B_CALIBRATIONMODEACTV_A 1 100 0.0 1.0 ECU_ADDRESS 0x40002e4b BYTE_ORDER MSB_FIRST /end MEASUREMENT
/begin COMPU_METHOD CU_CAL_B_CALIBRATIONMODEACTV_A "Conversion method for CAL_b_CalibrationModeActv_A" RAT_FUNC "%10.0" "b" COEFFS 0.000000 1.000000 0.000000 0.000000 0.000000 1.000000 /end COMPU_METHOD
/* Scalar measurable for DDE 'CAL_b_CalibrationModeActv_B'. */
/begin MEASUREMENT CAL_b_CalibrationModeActv_B "Calibration mode active flag" UBYTE CU_CAL_B_CALIBRATIONMODEACTV_B 1 100 0.0 1.0 ECU_ADDRESS 0x40002e5c BYTE_ORDER MSB_FIRST /end MEASUREMENT
/begin COMPU_METHOD CU_CAL_B_CALIBRATIONMODEACTV_B "Conversion method for CAL_b_CalibrationModeActv_B" RAT_FUNC "%10.0" "b" COEFFS 0.000000 1.000000 0.000000 0.000000 0.000000 1.000000 /end COMPU_METHOD
/* Scalar measurable for DDE 'CAL_b_CalibrationModeRqst_A'. */
/begin MEASUREMENT CAL_b_CalibrationModeRqst_A "Calibration mode request flag" UBYTE CU_CAL_B_CALIBRATIONMODERQST_A 1 100 0.0 1.0 ECU_ADDRESS 0x40002e4c BYTE_ORDER MSB_FIRST /end MEASUREMENT
/begin COMPU_METHOD CU_CAL_B_CALIBRATIONMODERQST_A "Conversion method for CAL_b_CalibrationModeRqst_A" RAT_FUNC "%10.0" "b" COEFFS 0.000000 1.000000 0.000000 0.000000 0.000000 1.000000 /end COMPU_METHOD
/* Scalar measurable for DDE 'CAL_b_CalibrationModeRqst_B'. */
/begin MEASUREMENT CAL_b_CalibrationModeRqst_B "Calibration mode request flag" UBYTE CU_CAL_B_CALIBRATIONMODERQST_B 1 100 0.0 1.0 ECU_ADDRESS 0x40002e5d BYTE_ORDER MSB_FIRST /end MEASUREMENT
/begin COMPU_METHOD CU_CAL_B_CALIBRATIONMODERQST_B "Conversion method for CAL_b_CalibrationModeRqst_B" RAT_FUNC "%10.0" "b" COEFFS 0.000000 1.000000 0.000000 0.000000 0.000000 1.000000 /end COMPU_METHOD
/* Scalar measurable for DDE 'CIN_NU_EngOvrCtrMd_ESP'. */
/begin MEASUREMENT CIN_NU_EngOvrCtrMd_ESP "Displayable" FLOAT32_IEEE CU_CIN_NU_ENGOVRCTRMD_ESP 1 100 0.0 0.0 ECU_ADDRESS 0x4000383c BYTE_ORDER MSB_FIRST /end MEASUREMENT
/begin COMPU_METHOD CU_CIN_NU_ENGOVRCTRMD_ESP "Conversion method for CIN_NU_EngOvrCtrMd_ESP" RAT_FUNC "%10.0" "NU" COEFFS 0.000000 1.000000 0.000000 0.000000 0.000000 1.000000 /end COMPU_METHOD
/* Scalar measurable for DDE 'CIN_NU_EngOvrCtrMd_ESP_B'. */
/begin MEASUREMENT CIN_NU_EngOvrCtrMd_ESP_B "Displayable" FLOAT32_IEEE CU_CIN_NU_ENGOVRCTRMD_ESP_B 1 100 0.0 0.0 ECU_ADDRESS 0x40003708 BYTE_ORDER MSB_FIRST /end MEASUREMENT
/begin COMPU_METHOD CU_CIN_NU_ENGOVRCTRMD_ESP_B "Conversion method for CIN_NU_EngOvrCtrMd_ESP_B" RAT_FUNC "%10.0" "NU" COEFFS 0.000000 1.000000 0.000000 0.000000 0.000000 1.000000 /end COMPU_METHOD
/* Scalar measurable for DDE 'CIN_NU_EngOvrCtrMd_TCM'. */
/begin MEASUREMENT CIN_NU_EngOvrCtrMd_TCM "Displayable" FLOAT32_IEEE CU_CIN_NU_ENGOVRCTRMD_TCM 1 100 0.0 0.0 ECU_ADDRESS 0x40003830 BYTE_ORDER MSB_FIRST /end MEASUREMENT
/begin COMPU_METHOD CU_CIN_NU_ENGOVRCTRMD_TCM "Conversion method for CIN_NU_EngOvrCtrMd_TCM" RAT_FUNC "%10.0" "NU" COEFFS 0.000000 1.000000 0.000000 0.000000 0.000000 1.000000 /end COMPU_METHOD
/* Scalar measurable for DDE 'CIN_NU_EngOvrCtrMd_TCM_B'. */
/begin MEASUREMENT CIN_NU_EngOvrCtrMd_TCM_B "Displayable" FLOAT32_IEEE CU_CIN_NU_ENGOVRCTRMD_TCM_B 1 100 0.0 0.0 ECU_ADDRESS 0x40003704 BYTE_ORDER MSB_FIRST /end MEASUREMENT
/begin COMPU_METHOD CU_CIN_NU_ENGOVRCTRMD_TCM_B "Conversion method for CIN_NU_EngOvrCtrMd_TCM_B" RAT_FUNC "%10.0" "NU" COEFFS 0.000000 1.000000 0.000000 0.000000 0.000000 1.000000 /end COMPU_METHOD
/* Scalar measurable for DDE 'CIN_NU_OvrCtrMd_ESP'. */
/begin MEASUREMENT CIN_NU_OvrCtrMd_ESP "Displayable" FLOAT32_IEEE CU_CIN_NU_OVRCTRMD_ESP 1 100 0.0 0.0 ECU_ADDRESS 0x40003844 BYTE_ORDER MSB_FIRST /end MEASUREMENT
/begin COMPU_METHOD CU_CIN_NU_OVRCTRMD_ESP "Conversion method for CIN_NU_OvrCtrMd_ESP" RAT_FUNC "%10.0" "NU" COEFFS 0.000000 1.000000 0.000000 0.000000 0.000000 1.000000 /end COMPU_METHOD
/* Scalar measurable for DDE 'CIN_NU_OvrCtrMd_ESP_B'. */
/begin MEASUREMENT CIN_NU_OvrCtrMd_ESP_B "Displayable" FLOAT32_IEEE CU_CIN_NU_OVRCTRMD_ESP_B 1 100 0.0 0.0 ECU_ADDRESS 0x400036f4 BYTE_ORDER MSB_FIRST /end MEASUREMENT
/begin COMPU_METHOD CU_CIN_NU_OVRCTRMD_ESP_B "Conversion method for CIN_NU_OvrCtrMd_ESP_B" RAT_FUNC "%10.0" "NU" COEFFS 0.000000 1.000000 0.000000 0.000000 0.000000 1.000000 /end COMPU_METHOD
/* Scalar measurable for DDE 'CIN_NU_OvrCtrMd_TCM'. */
/begin MEASUREMENT CIN_NU_OvrCtrMd_TCM "Displayable" FLOAT32_IEEE CU_CIN_NU_OVRCTRMD_TCM 1 100 0.0 0.0 ECU_ADDRESS 0x40003838 BYTE_ORDER MSB_FIRST /end MEASUREMENT
/begin COMPU_METHOD CU_CIN_NU_OVRCTRMD_TCM "Conversion method for CIN_NU_OvrCtrMd_TCM" RAT_FUNC "%10.0" "NU" COEFFS 0.000000 1.000000 0.000000 0.000000 0.000000 1.000000 /end COMPU_METHOD
/* Scalar measurable for DDE 'CIN_NU_OvrCtrMd_TCM_B'. */
/begin MEASUREMENT CIN_NU_OvrCtrMd_TCM_B "Displayable" FLOAT32_IEEE CU_CIN_NU_OVRCTRMD_TCM_B 1 100 0.0 0.0 ECU_ADDRESS 0x400036fc BYTE_ORDER MSB_FIRST /end MEASUREMENT
/begin COMPU_METHOD CU_CIN_NU_OVRCTRMD_TCM_B "Conversion method for CIN_NU_OvrCtrMd_TCM_B" RAT_FUNC "%10.0" "NU" COEFFS 0.000000 1.000000 0.000000 0.000000 0.000000 1.000000 /end COMPU_METHOD
/* Scalar measurable for DDE 'CIN_Nm_TqCtrRq_ESP'. */
/begin MEASUREMENT CIN_Nm_TqCtrRq_ESP "(not defined)" FLOAT32_IEEE CU_CIN_NM_TQCTRRQ_ESP 1 100 0.0 0.0 ECU_ADDRESS 0x40003558 BYTE_ORDER MSB_FIRST /end MEASUREMENT
/begin COMPU_METHOD CU_CIN_NM_TQCTRRQ_ESP "Conversion method for CIN_Nm_TqCtrRq_ESP" RAT_FUNC "%10.0" "Nm" COEFFS 0.000000 1.000000 0.000000 0.000000 0.000000 1.000000 /end COMPU_METHOD
/* Scalar measurable for DDE 'CIN_Nm_TqCtrRq_TCM'. */
/begin MEASUREMENT CIN_Nm_TqCtrRq_TCM "(not defined)" FLOAT32_IEEE CU_CIN_NM_TQCTRRQ_TCM 1 100 0.0 0.0 ECU_ADDRESS 0x40003554 BYTE_ORDER MSB_FIRST /end MEASUREMENT
/begin COMPU_METHOD CU_CIN_NM_TQCTRRQ_TCM "Conversion method for CIN_Nm_TqCtrRq_TCM" RAT_FUNC "%10.0" "Nm" COEFFS 0.000000 1.000000 0.000000 0.000000 0.000000 1.000000 /end COMPU_METHOD
/* Scalar measurable for DDE 'CIN_pct_TqCtrRq_ESP'. */
/begin MEASUREMENT CIN_pct_TqCtrRq_ESP "Displayable" FLOAT32_IEEE CU_CIN_PCT_TQCTRRQ_ESP 1 100 0.0 0.0 ECU_ADDRESS 0x40003840 BYTE_ORDER MSB_FIRST /end MEASUREMENT
/begin COMPU_METHOD CU_CIN_PCT_TQCTRRQ_ESP "Conversion method for CIN_pct_TqCtrRq_ESP" RAT_FUNC "%10.0" "pct" COEFFS 0.000000 1.000000 0.000000 0.000000 0.000000 1.000000 /end COMPU_METHOD
/* Scalar measurable for DDE 'CIN_pct_TqCtrRq_ESP_B'. */
/begin MEASUREMENT CIN_pct_TqCtrRq_ESP_B "Displayable" FLOAT32_IEEE CU_CIN_PCT_TQCTRRQ_ESP_B 1 100 0.0 0.0 ECU_ADDRESS 0x400036f8 BYTE_ORDER MSB_FIRST /end MEASUREMENT
/begin COMPU_METHOD CU_CIN_PCT_TQCTRRQ_ESP_B "Conversion method for CIN_pct_TqCtrRq_ESP_B" RAT_FUNC "%10.0" "pct" COEFFS 0.000000 1.000000 0.000000 0.000000 0.000000 1.000000 /end COMPU_METHOD
/* Scalar measurable for DDE 'CIN_pct_TqCtrRq_TCM'. */
/begin MEASUREMENT CIN_pct_TqCtrRq_TCM "Displayable" FLOAT32_IEEE CU_CIN_PCT_TQCTRRQ_TCM 1 100 0.0 0.0 ECU_ADDRESS 0x40003834 BYTE_ORDER MSB_FIRST /end MEASUREMENT
/begin COMPU_METHOD CU_CIN_PCT_TQCTRRQ_TCM "Conversion method for CIN_pct_TqCtrRq_TCM" RAT_FUNC "%10.0" "pct" COEFFS 0.000000 1.000000 0.000000 0.000000 0.000000 1.000000 /end COMPU_METHOD
/* Scalar measurable for DDE 'CIN_pct_TqCtrRq_TCM_B'. */
/begin MEASUREMENT CIN_pct_TqCtrRq_TCM_B "Displayable" FLOAT32_IEEE CU_CIN_PCT_TQCTRRQ_TCM_B 1 100 0.0 0.0 ECU_ADDRESS 0x40003700 BYTE_ORDER MSB_FIRST /end MEASUREMENT
/begin COMPU_METHOD CU_CIN_PCT_TQCTRRQ_TCM_B "Conversion method for CIN_pct_TqCtrRq_TCM_B" RAT_FUNC "%10.0" "pct" COEFFS 0.000000 1.000000 0.000000 0.000000 0.000000 1.000000 /end COMPU_METHOD
/* Scalar measurable for DDE 'CLF_NU_DGainFast1'. */
/begin MEASUREMENT CLF_NU_DGainFast1 "Convenience displayable" FLOAT32_IEEE CU_CLF_NU_DGAINFAST1 1 100 0.0 0.0 ECU_ADDRESS 0x40003520 BYTE_ORDER MSB_FIRST /end MEASUREMENT
/begin COMPU_METHOD CU_CLF_NU_DGAINFAST1 "Conversion method for CLF_NU_DGainFast1" RAT_FUNC "%10.4" "NU" COEFFS 0.000000 1.000000 0.000000 0.000000 0.000000 1.000000 /end COMPU_METHOD
/* Scalar measurable for DDE 'CLF_NU_DGainFast2'. */
/begin MEASUREMENT CLF_NU_DGainFast2 "Convenience displayable" FLOAT32_IEEE CU_CLF_NU_DGAINFAST2 1 100 0.0 0.0 ECU_ADDRESS 0x400034f8 BYTE_ORDER MSB_FIRST /end MEASUREMENT
/begin COMPU_METHOD CU_CLF_NU_DGAINFAST2 "Conversion method for CLF_NU_DGainFast2" RAT_FUNC "%10.4" "NU" COEFFS 0.000000 1.000000 0.000000 0.000000 0.000000 1.000000 /end COMPU_METHOD
/* Scalar measurable for DDE 'CLF_NU_DGainSlow1'. */
/begin MEASUREMENT CLF_NU_DGainSlow1 "Convenience displayable" FLOAT32_IEEE CU_CLF_NU_DGAINSLOW1 1 100 0.0 0.0 ECU_ADDRESS 0x40003514 BYTE_ORDER MSB_FIRST /end MEASUREMENT
/begin COMPU_METHOD CU_CLF_NU_DGAINSLOW1 "Conversion method for CLF_NU_DGainSlow1" RAT_FUNC "%10.4" "NU" COEFFS 0.000000 1.000000 0.000000 0.000000 0.000000 1.000000 /end COMPU_METHOD
/* Scalar measurable for DDE 'CLF_NU_DGainSlow2'. */
/begin MEASUREMENT CLF_NU_DGainSlow2 "Convenience displayable" FLOAT32_IEEE CU_CLF_NU_DGAINSLOW2 1 100 0.0 0.0 ECU_ADDRESS 0x400034e8 BYTE_ORDER MSB_FIRST /end MEASUREMENT
/begin COMPU_METHOD CU_CLF_NU_DGAINSLOW2 "Conversion method for CLF_NU_DGainSlow2" RAT_FUNC "%10.4" "NU" COEFFS 0.000000 1.000000 0.000000 0.000000 0.000000 1.000000 /end COMPU_METHOD
/* Scalar measurable for DDE 'CLF_NU_FB1_ErrorDot'. */
/begin MEASUREMENT CLF_NU_FB1_ErrorDot "Error derivative" FLOAT32_IEEE CU_CLF_NU_FB1_ERRORDOT 1 100 0.0 0.0 ECU_ADDRESS 0x40003508 BYTE_ORDER MSB_FIRST /end MEASUREMENT
/begin COMPU_METHOD CU_CLF_NU_FB1_ERRORDOT "Conversion method for CLF_NU_FB1_ErrorDot" RAT_FUNC "%10.3" "NU" COEFFS 0.000000 1.000000 0.000000 0.000000 0.000000 1.000000 /end COMPU_METHOD
/* Scalar measurable for DDE 'CLF_NU_FB2_ErrorDot'. */
/begin MEASUREMENT CLF_NU_FB2_ErrorDot "Error derivative" FLOAT32_IEEE CU_CLF_NU_FB2_ERRORDOT 1 100 0.0 0.0 ECU_ADDRESS 0x400034d8 BYTE_ORDER MSB_FIRST /end MEASUREMENT
/begin COMPU_METHOD CU_CLF_NU_FB2_ERRORDOT "Conversion method for CLF_NU_FB2_ErrorDot" RAT_FUNC "%10.3" "NU" COEFFS 0.000000 1.000000 0.000000 0.000000 0.000000 1.000000 /end COMPU_METHOD
/* Scalar measurable for DDE 'CLF_NU_IGainFast1'. */
/begin MEASUREMENT CLF_NU_IGainFast1 "Convenience displayable" FLOAT32_IEEE CU_CLF_NU_IGAINFAST1 1 100 0.0 0.0 ECU_ADDRESS 0x40003524 BYTE_ORDER MSB_FIRST /end MEASUREMENT
/begin COMPU_METHOD CU_CLF_NU_IGAINFAST1 "Conversion method for CLF_NU_IGainFast1" RAT_FUNC "%10.4" "NU" COEFFS 0.000000 1.000000 0.000000 0.000000 0.000000 1.000000 /end COMPU_METHOD
/* Scalar measurable for DDE 'CLF_NU_IGainFast2'. */
/begin MEASUREMENT CLF_NU_IGainFast2 "Convenience displayable" FLOAT32_IEEE CU_CLF_NU_IGAINFAST2 1 100 0.0 0.0 ECU_ADDRESS 0x400034fc BYTE_ORDER MSB_FIRST /end MEASUREMENT
/begin COMPU_METHOD CU_CLF_NU_IGAINFAST2 "Conversion method for CLF_NU_IGainFast2" RAT_FUNC "%10.4" "NU" COEFFS 0.000000 1.000000 0.000000 0.000000 0.000000 1.000000 /end COMPU_METHOD
/* Scalar measurable for DDE 'CLF_NU_IGainSlow1'. */
/begin MEASUREMENT CLF_NU_IGainSlow1 "Convenience displayable" FLOAT32_IEEE CU_CLF_NU_IGAINSLOW1 1 100 0.0 0.0 ECU_ADDRESS 0x40003518 BYTE_ORDER MSB_FIRST /end MEASUREMENT
/begin COMPU_METHOD CU_CLF_NU_IGAINSLOW1 "Conversion method for CLF_NU_IGainSlow1" RAT_FUNC "%10.4" "NU" COEFFS 0.000000 1.000000 0.000000 0.000000 0.000000 1.000000 /end COMPU_METHOD
/* Scalar measurable for DDE 'CLF_NU_IGainSlow2'. */
/begin MEASUREMENT CLF_NU_IGainSlow2 "Convenience displayable" FLOAT32_IEEE CU_CLF_NU_IGAINSLOW2 1 100 0.0 0.0 ECU_ADDRESS 0x400034ec BYTE_ORDER MSB_FIRST /end MEASUREMENT
/begin COMPU_METHOD CU_CLF_NU_IGAINSLOW2 "Conversion method for CLF_NU_IGainSlow2" RAT_FUNC "%10.4" "NU" COEFFS 0.000000 1.000000 0.000000 0.000000 0.000000 1.000000 /end COMPU_METHOD
/* Scalar measurable for DDE 'CLF_NU_PGainFast1'. */
/begin MEASUREMENT CLF_NU_PGainFast1 "Convenience displayable" FLOAT32_IEEE CU_CLF_NU_PGAINFAST1 1 100 0.0 0.0 ECU_ADDRESS 0x40003528 BYTE_ORDER MSB_FIRST /end MEASUREMENT
/begin COMPU_METHOD CU_CLF_NU_PGAINFAST1 "Conversion method for CLF_NU_PGainFast1" RAT_FUNC "%10.4" "NU" COEFFS 0.000000 1.000000 0.000000 0.000000 0.000000 1.000000 /end COMPU_METHOD
/* Scalar measurable for DDE 'CLF_NU_PGainFast2'. */
/begin MEASUREMENT CLF_NU_PGainFast2 "Convenience displayable" FLOAT32_IEEE CU_CLF_NU_PGAINFAST2 1 100 0.0 0.0 ECU_ADDRESS 0x40003500 BYTE_ORDER MSB_FIRST /end MEASUREMENT
/begin COMPU_METHOD CU_CLF_NU_PGAINFAST2 "Conversion method for CLF_NU_PGainFast2" RAT_FUNC "%10.4" "NU" COEFFS 0.000000 1.000000 0.000000 0.000000 0.000000 1.000000 /end COMPU_METHOD
/* Scalar measurable for DDE 'CLF_NU_PGainSlow1'. */
/begin MEASUREMENT CLF_NU_PGainSlow1 "Convenience displayable" FLOAT32_IEEE CU_CLF_NU_PGAINSLOW1 1 100 0.0 0.0 ECU_ADDRESS 0x4000351c BYTE_ORDER MSB_FIRST /end MEASUREMENT
/begin COMPU_METHOD CU_CLF_NU_PGAINSLOW1 "Conversion method for CLF_NU_PGainSlow1" RAT_FUNC "%10.4" "NU" COEFFS 0.000000 1.000000 0.000000 0.000000 0.000000 1.000000 /end COMPU_METHOD
/* Scalar measurable for DDE 'CLF_NU_PGainSlow2'. */
/begin MEASUREMENT CLF_NU_PGainSlow2 "Convenience displayable" FLOAT32_IEEE CU_CLF_NU_PGAINSLOW2 1 100 0.0 0.0 ECU_ADDRESS 0x400034f0 BYTE_ORDER MSB_FIRST /end MEASUREMENT
/begin COMPU_METHOD CU_CLF_NU_PGAINSLOW2 "Conversion method for CLF_NU_PGainSlow2" RAT_FUNC "%10.4" "NU" COEFFS 0.000000 1.000000 0.000000 0.000000 0.000000 1.000000 /end COMPU_METHOD
/* Scalar measurable for DDE 'CLF_RPM_EngSpdHPF'. */
/begin MEASUREMENT CLF_RPM_EngSpdHPF "HPF result displayable" FLOAT32_IEEE CU_CLF_RPM_ENGSPDHPF 1 100 0.0 0.0 ECU_ADDRESS 0x40003538 BYTE_ORDER MSB_FIRST /end MEASUREMENT
/begin COMPU_METHOD CU_CLF_RPM_ENGSPDHPF "Conversion method for CLF_RPM_EngSpdHPF" RAT_FUNC "%10.1" "RPM" COEFFS 0.000000 1.000000 0.000000 0.000000 0.000000 1.000000 /end COMPU_METHOD
/* Scalar measurable for DDE 'CLF_b_Dither1Active'. */
/begin MEASUREMENT CLF_b_Dither1Active "Displayable" UBYTE CU_CLF_B_DITHER1ACTIVE 1 100 0.0 1.0 ECU_ADDRESS 0x40002eb7 BYTE_ORDER MSB_FIRST /end MEASUREMENT
/begin COMPU_METHOD CU_CLF_B_DITHER1ACTIVE "Conversion method for CLF_b_Dither1Active" RAT_FUNC "%10.0" "b" COEFFS 0.000000 1.000000 0.000000 0.000000 0.000000 1.000000 /end COMPU_METHOD
/* Scalar measurable for DDE 'CLF_b_Dither1Lean'. */
/begin MEASUREMENT CLF_b_Dither1Lean "Displayable" UBYTE CU_CLF_B_DITHER1LEAN 1 100 0.0 1.0 ECU_ADDRESS 0x40002e6b BYTE_ORDER MSB_FIRST /end MEASUREMENT
/begin COMPU_METHOD CU_CLF_B_DITHER1LEAN "Conversion method for CLF_b_Dither1Lean" RAT_FUNC "%10.0" "b" COEFFS 0.000000 1.000000 0.000000 0.000000 0.000000 1.000000 /end COMPU_METHOD
/* Scalar measurable for DDE 'CLF_b_Dither1Rich'. */
/begin MEASUREMENT CLF_b_Dither1Rich "Displayable" UBYTE CU_CLF_B_DITHER1RICH 1 100 0.0 1.0 ECU_ADDRESS 0x40002e6a BYTE_ORDER MSB_FIRST /end MEASUREMENT
/begin COMPU_METHOD CU_CLF_B_DITHER1RICH "Conversion method for CLF_b_Dither1Rich" RAT_FUNC "%10.0" "b" COEFFS 0.000000 1.000000 0.000000 0.000000 0.000000 1.000000 /end COMPU_METHOD
/* Scalar measurable for DDE 'CLF_b_Dither2Active'. */
/begin MEASUREMENT CLF_b_Dither2Active "Displayable" UBYTE CU_CLF_B_DITHER2ACTIVE 1 100 0.0 1.0 ECU_ADDRESS 0x40002eb6 BYTE_ORDER MSB_FIRST /end MEASUREMENT
/begin COMPU_METHOD CU_CLF_B_DITHER2ACTIVE "Conversion method for CLF_b_Dither2Active" RAT_FUNC "%10.0" "b" COEFFS 0.000000 1.000000 0.000000 0.000000 0.000000 1.000000 /end COMPU_METHOD
/* Scalar measurable for DDE 'CLF_b_Dither2Lean'. */
/begin MEASUREMENT CLF_b_Dither2Lean "Displayable" UBYTE CU_CLF_B_DITHER2LEAN 1 100 0.0 1.0 ECU_ADDRESS 0x40002e6d BYTE_ORDER MSB_FIRST /end MEASUREMENT
/begin COMPU_METHOD CU_CLF_B_DITHER2LEAN "Conversion method for CLF_b_Dither2Lean" RAT_FUNC "%10.0" "b" COEFFS 0.000000 1.000000 0.000000 0.000000 0.000000 1.000000 /end COMPU_METHOD
/* Scalar measurable for DDE 'CLF_b_Dither2Rich'. */
/begin MEASUREMENT CLF_b_Dither2Rich "Displayable" UBYTE CU_CLF_B_DITHER2RICH 1 100 0.0 1.0 ECU_ADDRESS 0x40002e6c BYTE_ORDER MSB_FIRST /end MEASUREMENT
/begin COMPU_METHOD CU_CLF_B_DITHER2RICH "Conversion method for CLF_b_Dither2Rich" RAT_FUNC "%10.0" "b" COEFFS 0.000000 1.000000 0.000000 0.000000 0.000000 1.000000 /end COMPU_METHOD
/* Scalar measurable for DDE 'CLF_b_DitherLamErrorActv'. */
/begin MEASUREMENT CLF_b_DitherLamErrorActv "Displayable" UBYTE CU_CLF_B_DITHERLAMERRORACTV 1 100 0.0 1.0 ECU_ADDRESS 0x40002ecd BYTE_ORDER MSB_FIRST /end MEASUREMENT
/begin COMPU_METHOD CU_CLF_B_DITHERLAMERRORACTV "Conversion method for CLF_b_DitherLamErrorActv" RAT_FUNC "%10.0" "b" COEFFS 0.000000 1.000000 0.000000 0.000000 0.000000 1.000000 /end COMPU_METHOD
/* Scalar measurable for DDE 'CLF_b_FB1_Active'. */
/begin MEASUREMENT CLF_b_FB1_Active "Displayable" UBYTE CU_CLF_B_FB1_ACTIVE 1 100 0.0 1.0 ECU_ADDRESS 0x40002e7e BYTE_ORDER MSB_FIRST /end MEASUREMENT
/begin COMPU_METHOD CU_CLF_B_FB1_ACTIVE "Conversion method for CLF_b_FB1_Active" RAT_FUNC "%10.0" "b" COEFFS 0.000000 1.000000 0.000000 0.000000 0.000000 1.000000 /end COMPU_METHOD
/* Scalar measurable for DDE 'CLF_b_FB1_Enbld'. */
/begin MEASUREMENT CLF_b_FB1_Enbld "FB status" UBYTE CU_CLF_B_FB1_ENBLD 1 100 0.0 1.0 ECU_ADDRESS 0x40002ecb BYTE_ORDER MSB_FIRST /end MEASUREMENT
/begin COMPU_METHOD CU_CLF_B_FB1_ENBLD "Conversion method for CLF_b_FB1_Enbld" RAT_FUNC "%10.0" "b" COEFFS 0.000000 1.000000 0.000000 0.000000 0.000000 1.000000 /end COMPU_METHOD
/* Scalar measurable for DDE 'CLF_b_FB2_Active'. */
/begin MEASUREMENT CLF_b_FB2_Active "Displayable" UBYTE CU_CLF_B_FB2_ACTIVE 1 100 0.0 1.0 ECU_ADDRESS 0x40002e7d BYTE_ORDER MSB_FIRST /end MEASUREMENT
/begin COMPU_METHOD CU_CLF_B_FB2_ACTIVE "Conversion method for CLF_b_FB2_Active" RAT_FUNC "%10.0" "b" COEFFS 0.000000 1.000000 0.000000 0.000000 0.000000 1.000000 /end COMPU_METHOD
/* Scalar measurable for DDE 'CLF_b_FB2_Enbld'. */
/begin MEASUREMENT CLF_b_FB2_Enbld "FB status" UBYTE CU_CLF_B_FB2_ENBLD 1 100 0.0 1.0 ECU_ADDRESS 0x40002ec6 BYTE_ORDER MSB_FIRST /end MEASUREMENT
/begin COMPU_METHOD CU_CLF_B_FB2_ENBLD "Conversion method for CLF_b_FB2_Enbld" RAT_FUNC "%10.0" "b" COEFFS 0.000000 1.000000 0.000000 0.000000 0.000000 1.000000 /end COMPU_METHOD
/* Scalar measurable for DDE 'CLF_b_FastFB1'. */
/begin MEASUREMENT CLF_b_FastFB1 "State displayable" UBYTE CU_CLF_B_FASTFB1 1 100 0.0 1.0 ECU_ADDRESS 0x40002e67 BYTE_ORDER MSB_FIRST /end MEASUREMENT
/begin COMPU_METHOD CU_CLF_B_FASTFB1 "Conversion method for CLF_b_FastFB1" RAT_FUNC "%10.0" "b" COEFFS 0.000000 1.000000 0.000000 0.000000 0.000000 1.000000 /end COMPU_METHOD
/* Scalar measurable for DDE 'CLF_b_FastFB2'. */
/begin MEASUREMENT CLF_b_FastFB2 "State displayable" UBYTE CU_CLF_B_FASTFB2 1 100 0.0 1.0 ECU_ADDRESS 0x40002e69 BYTE_ORDER MSB_FIRST /end MEASUREMENT
/begin COMPU_METHOD CU_CLF_B_FASTFB2 "Conversion method for CLF_b_FastFB2" RAT_FUNC "%10.0" "b" COEFFS 0.000000 1.000000 0.000000 0.000000 0.000000 1.000000 /end COMPU_METHOD
/* Scalar measurable for DDE 'CLF_b_InitialFB1_Stable'. */
/begin MEASUREMENT CLF_b_InitialFB1_Stable "Displayable" UBYTE CU_CLF_B_INITIALFB1_STABLE 1 100 0.0 1.0 ECU_ADDRESS 0x40002eca BYTE_ORDER MSB_FIRST /end MEASUREMENT
/begin COMPU_METHOD CU_CLF_B_INITIALFB1_STABLE "Conversion method for CLF_b_InitialFB1_Stable" RAT_FUNC "%10.0" "b" COEFFS 0.000000 1.000000 0.000000 0.000000 0.000000 1.000000 /end COMPU_METHOD
/* Scalar measurable for DDE 'CLF_b_InitialFB2_Stable'. */
/begin MEASUREMENT CLF_b_InitialFB2_Stable "Displayable" UBYTE CU_CLF_B_INITIALFB2_STABLE 1 100 0.0 1.0 ECU_ADDRESS 0x40002ec5 BYTE_ORDER MSB_FIRST /end MEASUREMENT
/begin COMPU_METHOD CU_CLF_B_INITIALFB2_STABLE "Conversion method for CLF_b_InitialFB2_Stable" RAT_FUNC "%10.0" "b" COEFFS 0.000000 1.000000 0.000000 0.000000 0.000000 1.000000 /end COMPU_METHOD
/* Scalar measurable for DDE 'CLF_b_LTFT1_Active'. */
/begin MEASUREMENT CLF_b_LTFT1_Active "LTFT criteria met" UBYTE CU_CLF_B_LTFT1_ACTIVE 1 100 0.0 1.0 ECU_ADDRESS 0x40002ec8 BYTE_ORDER MSB_FIRST /end MEASUREMENT
/begin COMPU_METHOD CU_CLF_B_LTFT1_ACTIVE "Conversion method for CLF_b_LTFT1_Active" RAT_FUNC "%10.0" "b" COEFFS 0.000000 1.000000 0.000000 0.000000 0.000000 1.000000 /end COMPU_METHOD
/* Scalar measurable for DDE 'CLF_b_LTFT1_AdaptFlag'. */
/begin MEASUREMENT CLF_b_LTFT1_AdaptFlag "Adapt status displayable" UBYTE CU_CLF_B_LTFT1_ADAPTFLAG 1 100 0.0 1.0 ECU_ADDRESS 0x40002ec7 BYTE_ORDER MSB_FIRST /end MEASUREMENT
/begin COMPU_METHOD CU_CLF_B_LTFT1_ADAPTFLAG "Conversion method for CLF_b_LTFT1_AdaptFlag" RAT_FUNC "%10.0" "b" COEFFS 0.000000 1.000000 0.000000 0.000000 0.000000 1.000000 /end COMPU_METHOD
/* Scalar measurable for DDE 'CLF_b_LTFT2_Active'. */
/begin MEASUREMENT CLF_b_LTFT2_Active "LTFT criteria met" UBYTE CU_CLF_B_LTFT2_ACTIVE 1 100 0.0 1.0 ECU_ADDRESS 0x40002ec3 BYTE_ORDER MSB_FIRST /end MEASUREMENT
/begin COMPU_METHOD CU_CLF_B_LTFT2_ACTIVE "Conversion method for CLF_b_LTFT2_Active" RAT_FUNC "%10.0" "b" COEFFS 0.000000 1.000000 0.000000 0.000000 0.000000 1.000000 /end COMPU_METHOD
/* Scalar measurable for DDE 'CLF_b_LTFT2_AdaptFlag'. */
/begin MEASUREMENT CLF_b_LTFT2_AdaptFlag "Adapt status displayable" UBYTE CU_CLF_B_LTFT2_ADAPTFLAG 1 100 0.0 1.0 ECU_ADDRESS 0x40002ec2 BYTE_ORDER MSB_FIRST /end MEASUREMENT
/begin COMPU_METHOD CU_CLF_B_LTFT2_ADAPTFLAG "Conversion method for CLF_b_LTFT2_AdaptFlag" RAT_FUNC "%10.0" "b" COEFFS 0.000000 1.000000 0.000000 0.000000 0.000000 1.000000 /end COMPU_METHOD
/* Scalar measurable for DDE 'CLF_b_SlowFB1'. */
/begin MEASUREMENT CLF_b_SlowFB1 "State displayable" UBYTE CU_CLF_B_SLOWFB1 1 100 0.0 1.0 ECU_ADDRESS 0x40002e66 BYTE_ORDER MSB_FIRST /end MEASUREMENT
/begin COMPU_METHOD CU_CLF_B_SLOWFB1 "Conversion method for CLF_b_SlowFB1" RAT_FUNC "%10.0" "b" COEFFS 0.000000 1.000000 0.000000 0.000000 0.000000 1.000000 /end COMPU_METHOD
/* Scalar measurable for DDE 'CLF_b_SlowFB1_Unstable'. */
/begin MEASUREMENT CLF_b_SlowFB1_Unstable "Displayable" UBYTE CU_CLF_B_SLOWFB1_UNSTABLE 1 100 0.0 1.0 ECU_ADDRESS 0x40002ec9 BYTE_ORDER MSB_FIRST /end MEASUREMENT
/begin COMPU_METHOD CU_CLF_B_SLOWFB1_UNSTABLE "Conversion method for CLF_b_SlowFB1_Unstable" RAT_FUNC "%10.0" "b" COEFFS 0.000000 1.000000 0.000000 0.000000 0.000000 1.000000 /end COMPU_METHOD
/* Scalar measurable for DDE 'CLF_b_SlowFB2'. */
/begin MEASUREMENT CLF_b_SlowFB2 "State displayable" UBYTE CU_CLF_B_SLOWFB2 1 100 0.0 1.0 ECU_ADDRESS 0x40002e68 BYTE_ORDER MSB_FIRST /end MEASUREMENT
/begin COMPU_METHOD CU_CLF_B_SLOWFB2 "Conversion method for CLF_b_SlowFB2" RAT_FUNC "%10.0" "b" COEFFS 0.000000 1.000000 0.000000 0.000000 0.000000 1.000000 /end COMPU_METHOD
/* Scalar measurable for DDE 'CLF_b_SlowFB2_Unstable'. */
/begin MEASUREMENT CLF_b_SlowFB2_Unstable "Displayable" UBYTE CU_CLF_B_SLOWFB2_UNSTABLE 1 100 0.0 1.0 ECU_ADDRESS 0x40002ec4 BYTE_ORDER MSB_FIRST /end MEASUREMENT
/begin COMPU_METHOD CU_CLF_B_SLOWFB2_UNSTABLE "Conversion method for CLF_b_SlowFB2_Unstable" RAT_FUNC "%10.0" "b" COEFFS 0.000000 1.000000 0.000000 0.000000 0.000000 1.000000 /end COMPU_METHOD
/* Scalar measurable for DDE 'CLF_cnt_LeanFiringsRqst1'. */
/begin MEASUREMENT CLF_cnt_LeanFiringsRqst1 "Map output displayable" UBYTE CU_CLF_CNT_LEANFIRINGSRQST1 1 100 0.0 0.0 ECU_ADDRESS 0x40002fe5 BYTE_ORDER MSB_FIRST /end MEASUREMENT
/begin COMPU_METHOD CU_CLF_CNT_LEANFIRINGSRQST1 "Conversion method for CLF_cnt_LeanFiringsRqst1" RAT_FUNC "%10.0" "cnt" COEFFS 0.000000 1.000000 0.000000 0.000000 0.000000 1.000000 /end COMPU_METHOD
/* Scalar measurable for DDE 'CLF_cnt_LeanFiringsRqst2'. */
/begin MEASUREMENT CLF_cnt_LeanFiringsRqst2 "Map output displayable" UBYTE CU_CLF_CNT_LEANFIRINGSRQST2 1 100 0.0 0.0 ECU_ADDRESS 0x40002fe3 BYTE_ORDER MSB_FIRST /end MEASUREMENT
/begin COMPU_METHOD CU_CLF_CNT_LEANFIRINGSRQST2 "Conversion method for CLF_cnt_LeanFiringsRqst2" RAT_FUNC "%10.0" "cnt" COEFFS 0.000000 1.000000 0.000000 0.000000 0.000000 1.000000 /end COMPU_METHOD
/* Scalar measurable for DDE 'CLF_cnt_RichFiringsRqst1'. */
/begin MEASUREMENT CLF_cnt_RichFiringsRqst1 "Map output displayable" UBYTE CU_CLF_CNT_RICHFIRINGSRQST1 1 100 0.0 0.0 ECU_ADDRESS 0x40002fe6 BYTE_ORDER MSB_FIRST /end MEASUREMENT
/begin COMPU_METHOD CU_CLF_CNT_RICHFIRINGSRQST1 "Conversion method for CLF_cnt_RichFiringsRqst1" RAT_FUNC "%10.0" "cnt" COEFFS 0.000000 1.000000 0.000000 0.000000 0.000000 1.000000 /end COMPU_METHOD
/* Scalar measurable for DDE 'CLF_cnt_RichFiringsRqst2'. */
/begin MEASUREMENT CLF_cnt_RichFiringsRqst2 "Map output displayable" UBYTE CU_CLF_CNT_RICHFIRINGSRQST2 1 100 0.0 0.0 ECU_ADDRESS 0x40002fe4 BYTE_ORDER MSB_FIRST /end MEASUREMENT
/begin COMPU_METHOD CU_CLF_CNT_RICHFIRINGSRQST2 "Conversion method for CLF_cnt_RichFiringsRqst2" RAT_FUNC "%10.0" "cnt" COEFFS 0.000000 1.000000 0.000000 0.000000 0.000000 1.000000 /end COMPU_METHOD
/* Scalar measurable for DDE 'CLF_lam_DTermLPF1'. */
/begin MEASUREMENT CLF_lam_DTermLPF1 "LPF result displayable" FLOAT32_IEEE CU_CLF_LAM_DTERMLPF1 1 100 0.0 0.0 ECU_ADDRESS 0x4000350c BYTE_ORDER MSB_FIRST /end MEASUREMENT
/begin COMPU_METHOD CU_CLF_LAM_DTERMLPF1 "Conversion method for CLF_lam_DTermLPF1" RAT_FUNC "%10.3" "lam" COEFFS 0.000000 1.000000 0.000000 0.000000 0.000000 1.000000 /end COMPU_METHOD
/* Scalar measurable for DDE 'CLF_lam_DTermLPF2'. */
/begin MEASUREMENT CLF_lam_DTermLPF2 "LPF result displayable" FLOAT32_IEEE CU_CLF_LAM_DTERMLPF2 1 100 0.0 0.0 ECU_ADDRESS 0x400034dc BYTE_ORDER MSB_FIRST /end MEASUREMENT
/begin COMPU_METHOD CU_CLF_LAM_DTERMLPF2 "Conversion method for CLF_lam_DTermLPF2" RAT_FUNC "%10.3" "lam" COEFFS 0.000000 1.000000 0.000000 0.000000 0.000000 1.000000 /end COMPU_METHOD
/* Scalar measurable for DDE 'CLF_lam_Error1ThrshLPF'. */
/begin MEASUREMENT CLF_lam_Error1ThrshLPF "LPF result displayable" FLOAT32_IEEE CU_CLF_LAM_ERROR1THRSHLPF 1 100 0.0 0.0 ECU_ADDRESS 0x40003530 BYTE_ORDER MSB_FIRST /end MEASUREMENT
/begin COMPU_METHOD CU_CLF_LAM_ERROR1THRSHLPF "Conversion method for CLF_lam_Error1ThrshLPF" RAT_FUNC "%10.3" "lam" COEFFS 0.000000 1.000000 0.000000 0.000000 0.000000 1.000000 /end COMPU_METHOD
/* Scalar measurable for DDE 'CLF_lam_Error2ThrshLPF'. */
/begin MEASUREMENT CLF_lam_Error2ThrshLPF "LPF result displayable" FLOAT32_IEEE CU_CLF_LAM_ERROR2THRSHLPF 1 100 0.0 0.0 ECU_ADDRESS 0x400034f4 BYTE_ORDER MSB_FIRST /end MEASUREMENT
/begin COMPU_METHOD CU_CLF_LAM_ERROR2THRSHLPF "Conversion method for CLF_lam_Error2ThrshLPF" RAT_FUNC "%10.3" "lam" COEFFS 0.000000 1.000000 0.000000 0.000000 0.000000 1.000000 /end COMPU_METHOD
/* Scalar measurable for DDE 'CLF_lam_FB1_Ctrl'. */
/begin MEASUREMENT CLF_lam_FB1_Ctrl "Delta-lambda displayable" FLOAT32_IEEE CU_CLF_LAM_FB1_CTRL 1 100 0.0 0.0 ECU_ADDRESS 0x400034d4 BYTE_ORDER MSB_FIRST /end MEASUREMENT
/begin COMPU_METHOD CU_CLF_LAM_FB1_CTRL "Conversion method for CLF_lam_FB1_Ctrl" RAT_FUNC "%10.3" "lam" COEFFS 0.000000 1.000000 0.000000 0.000000 0.000000 1.000000 /end COMPU_METHOD
/* Scalar measurable for DDE 'CLF_lam_FB1_Error'. */
/begin MEASUREMENT CLF_lam_FB1_Error "Displayable" FLOAT32_IEEE CU_CLF_LAM_FB1_ERROR 1 100 0.0 0.0 ECU_ADDRESS 0x4000353c BYTE_ORDER MSB_FIRST /end MEASUREMENT
/begin COMPU_METHOD CU_CLF_LAM_FB1_ERROR "Conversion method for CLF_lam_FB1_Error" RAT_FUNC "%10.3" "lam" COEFFS 0.000000 1.000000 0.000000 0.000000 0.000000 1.000000 /end COMPU_METHOD
/* Scalar measurable for DDE 'CLF_lam_FB1_ITerm'. */
/begin MEASUREMENT CLF_lam_FB1_ITerm "PID effort displayable" FLOAT32_IEEE CU_CLF_LAM_FB1_ITERM 1 100 0.0 0.0 ECU_ADDRESS 0x4000352c BYTE_ORDER MSB_FIRST /end MEASUREMENT
/begin COMPU_METHOD CU_CLF_LAM_FB1_ITERM "Conversion method for CLF_lam_FB1_ITerm" RAT_FUNC "%10.3" "lam" COEFFS 0.000000 1.000000 0.000000 0.000000 0.000000 1.000000 /end COMPU_METHOD
/* Scalar measurable for DDE 'CLF_lam_FB1_PTerm'. */
/begin MEASUREMENT CLF_lam_FB1_PTerm "PID effort displayable" FLOAT32_IEEE CU_CLF_LAM_FB1_PTERM 1 100 0.0 0.0 ECU_ADDRESS 0x40003510 BYTE_ORDER MSB_FIRST /end MEASUREMENT
/begin COMPU_METHOD CU_CLF_LAM_FB1_PTERM "Conversion method for CLF_lam_FB1_PTerm" RAT_FUNC "%10.3" "lam" COEFFS 0.000000 1.000000 0.000000 0.000000 0.000000 1.000000 /end COMPU_METHOD
/* Scalar measurable for DDE 'CLF_lam_FB2_Ctrl'. */
/begin MEASUREMENT CLF_lam_FB2_Ctrl "Delta-lambda displayable" FLOAT32_IEEE CU_CLF_LAM_FB2_CTRL 1 100 0.0 0.0 ECU_ADDRESS 0x40003384 BYTE_ORDER MSB_FIRST /end MEASUREMENT
/begin COMPU_METHOD CU_CLF_LAM_FB2_CTRL "Conversion method for CLF_lam_FB2_Ctrl" RAT_FUNC "%10.3" "lam" COEFFS 0.000000 1.000000 0.000000 0.000000 0.000000 1.000000 /end COMPU_METHOD
/* Scalar measurable for DDE 'CLF_lam_FB2_Error'. */
/begin MEASUREMENT CLF_lam_FB2_Error "Displayable" FLOAT32_IEEE CU_CLF_LAM_FB2_ERROR 1 100 0.0 0.0 ECU_ADDRESS 0x40003504 BYTE_ORDER MSB_FIRST /end MEASUREMENT
/begin COMPU_METHOD CU_CLF_LAM_FB2_ERROR "Conversion method for CLF_lam_FB2_Error" RAT_FUNC "%10.3" "lam" COEFFS 0.000000 1.000000 0.000000 0.000000 0.000000 1.000000 /end COMPU_METHOD
/* Scalar measurable for DDE 'CLF_lam_FB2_ITerm'. */
/begin MEASUREMENT CLF_lam_FB2_ITerm "PID effort displayable" FLOAT32_IEEE CU_CLF_LAM_FB2_ITERM 1 100 0.0 0.0 ECU_ADDRESS 0x400034e0 BYTE_ORDER MSB_FIRST /end MEASUREMENT
/begin COMPU_METHOD CU_CLF_LAM_FB2_ITERM "Conversion method for CLF_lam_FB2_ITerm" RAT_FUNC "%10.3" "lam" COEFFS 0.000000 1.000000 0.000000 0.000000 0.000000 1.000000 /end COMPU_METHOD
/* Scalar measurable for DDE 'CLF_lam_FB2_PTerm'. */
/begin MEASUREMENT CLF_lam_FB2_PTerm "PID effort displayable" FLOAT32_IEEE CU_CLF_LAM_FB2_PTERM 1 100 0.0 0.0 ECU_ADDRESS 0x400034e4 BYTE_ORDER MSB_FIRST /end MEASUREMENT
/begin COMPU_METHOD CU_CLF_LAM_FB2_PTERM "Conversion method for CLF_lam_FB2_PTerm" RAT_FUNC "%10.3" "lam" COEFFS 0.000000 1.000000 0.000000 0.000000 0.000000 1.000000 /end COMPU_METHOD
/* Scalar measurable for DDE 'CLF_lam_LTFT1'. */
/begin MEASUREMENT CLF_lam_LTFT1 "Longterm trim delta-lambda displayable" FLOAT32_IEEE CU_CLF_LAM_LTFT1 1 100 0.0 0.0 ECU_ADDRESS 0x400034d0 BYTE_ORDER MSB_FIRST /end MEASUREMENT
/begin COMPU_METHOD CU_CLF_LAM_LTFT1 "Conversion method for CLF_lam_LTFT1" RAT_FUNC "%10.3" "lam" COEFFS 0.000000 1.000000 0.000000 0.000000 0.000000 1.000000 /end COMPU_METHOD
/* Scalar measurable for DDE 'CLF_lam_LTFT2'. */
/begin MEASUREMENT CLF_lam_LTFT2 "Longterm trim delta-lambda displayable" FLOAT32_IEEE CU_CLF_LAM_LTFT2 1 100 0.0 0.0 ECU_ADDRESS 0x40003380 BYTE_ORDER MSB_FIRST /end MEASUREMENT
/begin COMPU_METHOD CU_CLF_LAM_LTFT2 "Conversion method for CLF_lam_LTFT2" RAT_FUNC "%10.3" "lam" COEFFS 0.000000 1.000000 0.000000 0.000000 0.000000 1.000000 /end COMPU_METHOD
/* Scalar measurable for DDE 'CLF_lam_O2_Dither1'. */
/begin MEASUREMENT CLF_lam_O2_Dither1 "Delta-lambda displayable" FLOAT32_IEEE CU_CLF_LAM_O2_DITHER1 1 100 0.0 0.0 ECU_ADDRESS 0x400031ec BYTE_ORDER MSB_FIRST /end MEASUREMENT
/begin COMPU_METHOD CU_CLF_LAM_O2_DITHER1 "Conversion method for CLF_lam_O2_Dither1" RAT_FUNC "%10.3" "lam" COEFFS 0.000000 1.000000 0.000000 0.000000 0.000000 1.000000 /end COMPU_METHOD
/* Scalar measurable for DDE 'CLF_lam_O2_Dither2'. */
/begin MEASUREMENT CLF_lam_O2_Dither2 "Delta-lambda displayable" FLOAT32_IEEE CU_CLF_LAM_O2_DITHER2 1 100 0.0 0.0 ECU_ADDRESS 0x400031e4 BYTE_ORDER MSB_FIRST /end MEASUREMENT
/begin COMPU_METHOD CU_CLF_LAM_O2_DITHER2 "Conversion method for CLF_lam_O2_Dither2" RAT_FUNC "%10.3" "lam" COEFFS 0.000000 1.000000 0.000000 0.000000 0.000000 1.000000 /end COMPU_METHOD
/* Scalar measurable for DDE 'CLF_lam_UEGO1_DitherAvg'. */
/begin MEASUREMENT CLF_lam_UEGO1_DitherAvg "Sensor value averaged across the most recent dither period" FLOAT32_IEEE CU_CLF_LAM_UEGO1_DITHERAVG 1 100 0.0 0.0 ECU_ADDRESS 0x4000337c BYTE_ORDER MSB_FIRST /end MEASUREMENT
/begin COMPU_METHOD CU_CLF_LAM_UEGO1_DITHERAVG "Conversion method for CLF_lam_UEGO1_DitherAvg" RAT_FUNC "%10.3" "lam" COEFFS 0.000000 1.000000 0.000000 0.000000 0.000000 1.000000 /end COMPU_METHOD
/* Scalar measurable for DDE 'CLF_lam_UEGO2_DitherAvg'. */
/begin MEASUREMENT CLF_lam_UEGO2_DitherAvg "Sensor value averaged across the most recent dither period" FLOAT32_IEEE CU_CLF_LAM_UEGO2_DITHERAVG 1 100 0.0 0.0 ECU_ADDRESS 0x40003378 BYTE_ORDER MSB_FIRST /end MEASUREMENT
/begin COMPU_METHOD CU_CLF_LAM_UEGO2_DITHERAVG "Conversion method for CLF_lam_UEGO2_DitherAvg" RAT_FUNC "%10.3" "lam" COEFFS 0.000000 1.000000 0.000000 0.000000 0.000000 1.000000 /end COMPU_METHOD
/* Scalar measurable for DDE 'CLF_pct_LoadHPF'. */
/begin MEASUREMENT CLF_pct_LoadHPF "HPF result displayable" FLOAT32_IEEE CU_CLF_PCT_LOADHPF 1 100 0.0 0.0 ECU_ADDRESS 0x40003534 BYTE_ORDER MSB_FIRST /end MEASUREMENT
/begin COMPU_METHOD CU_CLF_PCT_LOADHPF "Conversion method for CLF_pct_LoadHPF" RAT_FUNC "%10.3" "pct" COEFFS 0.000000 1.000000 0.000000 0.000000 0.000000 1.000000 /end COMPU_METHOD
/* Scalar measurable for DDE 'CPL_b_CutSpark'. */
/begin MEASUREMENT CPL_b_CutSpark "Displayable" UBYTE CU_CPL_B_CUTSPARK 1 100 0.0 1.0 ECU_ADDRESS 0x40002e91 BYTE_ORDER MSB_FIRST /end MEASUREMENT
/begin COMPU_METHOD CU_CPL_B_CUTSPARK "Conversion method for CPL_b_CutSpark" RAT_FUNC "%10.0" "b" COEFFS 0.000000 1.000000 0.000000 0.000000 0.000000 1.000000 /end COMPU_METHOD
/* Scalar measurable for DDE 'CPL_kPa_BoostDelta'. */
/begin MEASUREMENT CPL_kPa_BoostDelta "Difference between MAP and current boost limit (positive implies overboost)" FLOAT32_IEEE CU_CPL_KPA_BOOSTDELTA 1 100 0.0 0.0 ECU_ADDRESS 0x4000345c BYTE_ORDER MSB_FIRST /end MEASUREMENT
/begin COMPU_METHOD CU_CPL_KPA_BOOSTDELTA "Conversion method for CPL_kPa_BoostDelta" RAT_FUNC "%10.0" "kPa" COEFFS 0.000000 1.000000 0.000000 0.000000 0.000000 1.000000 /end COMPU_METHOD
/* Scalar measurable for DDE 'CPL_ret_SparkRetardRqst'. */
/begin MEASUREMENT CPL_ret_SparkRetardRqst "Displayable" FLOAT32_IEEE CU_CPL_RET_SPARKRETARDRQST 1 100 0.0 0.0 ECU_ADDRESS 0x40003458 BYTE_ORDER MSB_FIRST /end MEASUREMENT
/begin COMPU_METHOD CU_CPL_RET_SPARKRETARDRQST "Conversion method for CPL_ret_SparkRetardRqst" RAT_FUNC "%10.1" "ret" COEFFS 0.000000 1.000000 0.000000 0.000000 0.000000 1.000000 /end COMPU_METHOD
/* Scalar measurable for DDE 'CRU_NU_CurrSpeed'. */
/begin MEASUREMENT CRU_NU_CurrSpeed "(not defined)" FLOAT32_IEEE CU_CRU_NU_CURRSPEED 1 100 0.0 250.0 ECU_ADDRESS 0x400035fc BYTE_ORDER MSB_FIRST /end MEASUREMENT
/begin COMPU_METHOD CU_CRU_NU_CURRSPEED "Conversion method for CRU_NU_CurrSpeed" RAT_FUNC "%10.0" "NU" COEFFS 0.000000 1.000000 0.000000 0.000000 0.000000 1.000000 /end COMPU_METHOD
/* Scalar measurable for DDE 'CRU_NU_LimSpeed'. */
/begin MEASUREMENT CRU_NU_LimSpeed "(not defined)" FLOAT32_IEEE CU_CRU_NU_LIMSPEED 1 100 0.0 250.0 ECU_ADDRESS 0x400035f0 BYTE_ORDER MSB_FIRST /end MEASUREMENT
/begin COMPU_METHOD CU_CRU_NU_LIMSPEED "Conversion method for CRU_NU_LimSpeed" RAT_FUNC "%10.0" "NU" COEFFS 0.000000 1.000000 0.000000 0.000000 0.000000 1.000000 /end COMPU_METHOD
/* Scalar measurable for DDE 'CRU_NU_TargetSpeed'. */
/begin MEASUREMENT CRU_NU_TargetSpeed "(not defined)" FLOAT32_IEEE CU_CRU_NU_TARGETSPEED 1 100 0.0 250.0 ECU_ADDRESS 0x400035ec BYTE_ORDER MSB_FIRST /end MEASUREMENT
/begin COMPU_METHOD CU_CRU_NU_TARGETSPEED "Conversion method for CRU_NU_TargetSpeed" RAT_FUNC "%10.0" "NU" COEFFS 0.000000 1.000000 0.000000 0.000000 0.000000 1.000000 /end COMPU_METHOD
/* Scalar measurable for DDE 'CRU_V_CruiserSET'. */
/begin MEASUREMENT CRU_V_CruiserSET "(not defined)" FLOAT32_IEEE CU_CRU_V_CRUISERSET 1 100 0.0 0.0 ECU_ADDRESS 0x400035f4 BYTE_ORDER MSB_FIRST /end MEASUREMENT
/begin COMPU_METHOD CU_CRU_V_CRUISERSET "Conversion method for CRU_V_CruiserSET" RAT_FUNC "%10.2" "V" COEFFS 0.000000 1.000000 0.000000 0.000000 0.000000 1.000000 /end COMPU_METHOD
/* Scalar measurable for DDE 'CRU_b_Active'. */
/begin MEASUREMENT CRU_b_Active "(not defined)" UBYTE CU_CRU_B_ACTIVE 1 100 0.0 1.0 ECU_ADDRESS 0x400035f8 BYTE_ORDER MSB_FIRST /end MEASUREMENT
/begin COMPU_METHOD CU_CRU_B_ACTIVE "Conversion method for CRU_b_Active" RAT_FUNC "%10.0" "NU" COEFFS 0.000000 1.000000 0.000000 0.000000 0.000000 1.000000 /end COMPU_METHOD
/* Scalar measurable for DDE 'CRU_b_BrakeON'. */
/begin MEASUREMENT CRU_b_BrakeON "(not defined)" UBYTE CU_CRU_B_BRAKEON 1 100 0.0 1.0 ECU_ADDRESS 0x40002ee0 BYTE_ORDER MSB_FIRST /end MEASUREMENT
/begin COMPU_METHOD CU_CRU_B_BRAKEON "Conversion method for CRU_b_BrakeON" RAT_FUNC "%10.0" "NU" COEFFS 0.000000 1.000000 0.000000 0.000000 0.000000 1.000000 /end COMPU_METHOD
/* Scalar measurable for DDE 'CRU_b_Cancel'. */
/begin MEASUREMENT CRU_b_Cancel "(not defined)" UBYTE CU_CRU_B_CANCEL 1 100 0.0 1.0 ECU_ADDRESS 0x40002ede BYTE_ORDER MSB_FIRST /end MEASUREMENT
/begin COMPU_METHOD CU_CRU_B_CANCEL "Conversion method for CRU_b_Cancel" RAT_FUNC "%10.0" "NU" COEFFS 0.000000 1.000000 0.000000 0.000000 0.000000 1.000000 /end COMPU_METHOD
/* Scalar measurable for DDE 'CRU_b_ClunchON'. */
/begin MEASUREMENT CRU_b_ClunchON "(not defined)" UBYTE CU_CRU_B_CLUNCHON 1 100 0.0 1.0 ECU_ADDRESS 0x40002edf BYTE_ORDER MSB_FIRST /end MEASUREMENT
/begin COMPU_METHOD CU_CRU_B_CLUNCHON "Conversion method for CRU_b_ClunchON" RAT_FUNC "%10.0" "NU" COEFFS 0.000000 1.000000 0.000000 0.000000 0.000000 1.000000 /end COMPU_METHOD
/* Scalar measurable for DDE 'CRU_b_DownSpeed'. */
/begin MEASUREMENT CRU_b_DownSpeed "(not defined)" UBYTE CU_CRU_B_DOWNSPEED 1 100 0.0 1.0 ECU_ADDRESS 0x40002edc BYTE_ORDER MSB_FIRST /end MEASUREMENT
/begin COMPU_METHOD CU_CRU_B_DOWNSPEED "Conversion method for CRU_b_DownSpeed" RAT_FUNC "%10.0" "NU" COEFFS 0.000000 1.000000 0.000000 0.000000 0.000000 1.000000 /end COMPU_METHOD
/* Scalar measurable for DDE 'CRU_b_Enable'. */
/begin MEASUREMENT CRU_b_Enable "(not defined)" UBYTE CU_CRU_B_ENABLE 1 100 0.0 1.0 ECU_ADDRESS 0x40002edb BYTE_ORDER MSB_FIRST /end MEASUREMENT
/begin COMPU_METHOD CU_CRU_B_ENABLE "Conversion method for CRU_b_Enable" RAT_FUNC "%10.0" "NU" COEFFS 0.000000 1.000000 0.000000 0.000000 0.000000 1.000000 /end COMPU_METHOD
/* Scalar measurable for DDE 'CRU_b_FootBrake'. */
/begin MEASUREMENT CRU_b_FootBrake "(not defined)" UBYTE CU_CRU_B_FOOTBRAKE 1 100 0.0 1.0 ECU_ADDRESS 0x40002eb4 BYTE_ORDER MSB_FIRST /end MEASUREMENT
/begin COMPU_METHOD CU_CRU_B_FOOTBRAKE "Conversion method for CRU_b_FootBrake" RAT_FUNC "%10.0" "NU" COEFFS 0.000000 1.000000 0.000000 0.000000 0.000000 1.000000 /end COMPU_METHOD
/* Scalar measurable for DDE 'CRU_b_ParkingBrake'. */
/begin MEASUREMENT CRU_b_ParkingBrake "(not defined)" UBYTE CU_CRU_B_PARKINGBRAKE 1 100 0.0 1.0 ECU_ADDRESS 0x40002eb5 BYTE_ORDER MSB_FIRST /end MEASUREMENT
/begin COMPU_METHOD CU_CRU_B_PARKINGBRAKE "Conversion method for CRU_b_ParkingBrake" RAT_FUNC "%10.0" "NU" COEFFS 0.000000 1.000000 0.000000 0.000000 0.000000 1.000000 /end COMPU_METHOD
/* Scalar measurable for DDE 'CRU_b_UpSpeed'. */
/begin MEASUREMENT CRU_b_UpSpeed "(not defined)" UBYTE CU_CRU_B_UPSPEED 1 100 0.0 1.0 ECU_ADDRESS 0x40002edd BYTE_ORDER MSB_FIRST /end MEASUREMENT
/begin COMPU_METHOD CU_CRU_B_UPSPEED "Conversion method for CRU_b_UpSpeed" RAT_FUNC "%10.0" "NU" COEFFS 0.000000 1.000000 0.000000 0.000000 0.000000 1.000000 /end COMPU_METHOD
/* Scalar measurable for DDE 'CTC_lam_FuelEnrichment'. */
/begin MEASUREMENT CTC_lam_FuelEnrichment "Raw charge temp fuel modifier angle" FLOAT32_IEEE CU_CTC_LAM_FUELENRICHMENT 1 100 0.0 0.0 ECU_ADDRESS 0x400034c0 BYTE_ORDER MSB_FIRST /end MEASUREMENT
/begin COMPU_METHOD CU_CTC_LAM_FUELENRICHMENT "Conversion method for CTC_lam_FuelEnrichment" RAT_FUNC "%10.3" "lam" COEFFS 0.000000 1.000000 0.000000 0.000000 0.000000 1.000000 /end COMPU_METHOD
/* Scalar measurable for DDE 'CTC_lam_FuelOfst'. */
/begin MEASUREMENT CTC_lam_FuelOfst "Final charge temp fuel modifier angle" FLOAT32_IEEE CU_CTC_LAM_FUELOFST 1 100 0.0 0.0 ECU_ADDRESS 0x400034bc BYTE_ORDER MSB_FIRST /end MEASUREMENT
/begin COMPU_METHOD CU_CTC_LAM_FUELOFST "Conversion method for CTC_lam_FuelOfst" RAT_FUNC "%10.3" "lam" COEFFS 0.000000 1.000000 0.000000 0.000000 0.000000 1.000000 /end COMPU_METHOD
/* Scalar measurable for DDE 'CTC_ret_SparkRqst'. */
/begin MEASUREMENT CTC_ret_SparkRqst "Final charge temp spark modifier angle" FLOAT32_IEEE CU_CTC_RET_SPARKRQST 1 100 0.0 0.0 ECU_ADDRESS 0x4000348c BYTE_ORDER MSB_FIRST /end MEASUREMENT
/begin COMPU_METHOD CU_CTC_RET_SPARKRQST "Conversion method for CTC_ret_SparkRqst" RAT_FUNC "%10.2" "ret" COEFFS 0.000000 1.000000 0.000000 0.000000 0.000000 1.000000 /end COMPU_METHOD
/* Scalar measurable for DDE 'CTC_ret_SparkRqstRaw'. */
/begin MEASUREMENT CTC_ret_SparkRqstRaw "Raw charge temp spark modifier angle" FLOAT32_IEEE CU_CTC_RET_SPARKRQSTRAW 1 100 0.0 0.0 ECU_ADDRESS 0x40003490 BYTE_ORDER MSB_FIRST /end MEASUREMENT
/begin COMPU_METHOD CU_CTC_RET_SPARKRQSTRAW "Conversion method for CTC_ret_SparkRqstRaw" RAT_FUNC "%10.2" "ret" COEFFS 0.000000 1.000000 0.000000 0.000000 0.000000 1.000000 /end COMPU_METHOD
/* Scalar measurable for DDE 'CruiseTorqueRequestRaw_Nm'. */
/begin MEASUREMENT CruiseTorqueRequestRaw_Nm "(not defined)" FLOAT32_IEEE CU_CRUISETORQUEREQUESTRAW_NM 1 100 -10000.0 10000.0 ECU_ADDRESS 0x400035e8 BYTE_ORDER MSB_FIRST /end MEASUREMENT
/begin COMPU_METHOD CU_CRUISETORQUEREQUESTRAW_NM "Conversion method for CruiseTorqueRequestRaw_Nm" RAT_FUNC "%10.2" "NU" COEFFS 0.000000 1.000000 0.000000 0.000000 0.000000 1.000000 /end COMPU_METHOD
/* Scalar measurable for DDE 'Cruiser_State'. */
/begin MEASUREMENT Cruiser_State "CRUISE STATES" FLOAT32_IEEE CU_CRUISER_STATE 1 100 -10.0 10.0 ECU_ADDRESS 0x40003158 BYTE_ORDER MSB_FIRST /end MEASUREMENT
/begin COMPU_METHOD CU_CRUISER_STATE "Conversion method for Cruiser_State" RAT_FUNC "%10.0" "NU" COEFFS 0.000000 1.000000 0.000000 0.000000 0.000000 1.000000 /end COMPU_METHOD
/* Scalar measurable for DDE 'DFC_RPM_EntryThrsh'. */
/begin MEASUREMENT DFC_RPM_EntryThrsh "DFC enable engine speed threshold value" FLOAT32_IEEE CU_DFC_RPM_ENTRYTHRSH 1 100 0.0 0.0 ECU_ADDRESS 0x4000354c BYTE_ORDER MSB_FIRST /end MEASUREMENT
/begin COMPU_METHOD CU_DFC_RPM_ENTRYTHRSH "Conversion method for DFC_RPM_EntryThrsh" RAT_FUNC "%10.0" "RPM" COEFFS 0.000000 1.000000 0.000000 0.000000 0.000000 1.000000 /end COMPU_METHOD
/* Scalar measurable for DDE 'DFC_RPM_ExitThrsh'. */
/begin MEASUREMENT DFC_RPM_ExitThrsh "DFC disable engine speed threshold value" FLOAT32_IEEE CU_DFC_RPM_EXITTHRSH 1 100 0.0 0.0 ECU_ADDRESS 0x40003548 BYTE_ORDER MSB_FIRST /end MEASUREMENT
/begin COMPU_METHOD CU_DFC_RPM_EXITTHRSH "Conversion method for DFC_RPM_ExitThrsh" RAT_FUNC "%10.0" "RPM" COEFFS 0.000000 1.000000 0.000000 0.000000 0.000000 1.000000 /end COMPU_METHOD
/* Scalar measurable for DDE 'DFC_b_BurningDFC_Active'. */
/begin MEASUREMENT DFC_b_BurningDFC_Active "DFC fuel cut flag" UBYTE CU_DFC_B_BURNINGDFC_ACTIVE 1 100 0.0 1.0 ECU_ADDRESS 0x40002e6e BYTE_ORDER MSB_FIRST /end MEASUREMENT
/begin COMPU_METHOD CU_DFC_B_BURNINGDFC_ACTIVE "Conversion method for DFC_b_BurningDFC_Active" RAT_FUNC "%10.0" "b" COEFFS 0.000000 1.000000 0.000000 0.000000 0.000000 1.000000 /end COMPU_METHOD
/* Scalar measurable for DDE 'DFC_b_DTC_Condition'. */
/begin MEASUREMENT DFC_b_DTC_Condition "Displayable" UBYTE CU_DFC_B_DTC_CONDITION 1 100 0.0 1.0 ECU_ADDRESS 0x40002ed0 BYTE_ORDER MSB_FIRST /end MEASUREMENT
/begin COMPU_METHOD CU_DFC_B_DTC_CONDITION "Conversion method for DFC_b_DTC_Condition" RAT_FUNC "%10.0" "b" COEFFS 0.000000 1.000000 0.000000 0.000000 0.000000 1.000000 /end COMPU_METHOD
/* Scalar measurable for DDE 'DFC_b_FuelCut'. */
/begin MEASUREMENT DFC_b_FuelCut "DFC fuel cut flag" UBYTE CU_DFC_B_FUELCUT 1 100 0.0 1.0 ECU_ADDRESS 0x40002ecf BYTE_ORDER MSB_FIRST /end MEASUREMENT
/begin COMPU_METHOD CU_DFC_B_FUELCUT "Conversion method for DFC_b_FuelCut" RAT_FUNC "%10.0" "b" COEFFS 0.000000 1.000000 0.000000 0.000000 0.000000 1.000000 /end COMPU_METHOD
/* Scalar measurable for DDE 'DFC_e_State'. */
/begin MEASUREMENT DFC_e_State "DFC state" UBYTE CU_DFC_E_STATE 1 100 0.0 0.0 ECU_ADDRESS 0x40002fe2 BYTE_ORDER MSB_FIRST /end MEASUREMENT
/begin COMPU_METHOD CU_DFC_E_STATE "Conversion method for DFC_e_State" TAB_VERB "%12.0" "e" COMPU_TAB_REF CT_DFC_E_STATE /end COMPU_METHOD
/begin COMPU_VTAB CT_DFC_E_STATE "Conversion method for DFC_e_State" TAB_VERB 3 0 "DFCk_e_Inactive" 1 "DFCk_e_RetardSpark" 3 "DFCk_e_CutFuel" /end COMPU_VTAB
/* Scalar measurable for DDE 'DFC_ret_SparkRetard'. */
/begin MEASUREMENT DFC_ret_SparkRetard "Spark retard before fuel is cut when DFC is active" FLOAT32_IEEE CU_DFC_RET_SPARKRETARD 1 100 0.0 0.0 ECU_ADDRESS 0x40003450 BYTE_ORDER MSB_FIRST /end MEASUREMENT
/begin COMPU_METHOD CU_DFC_RET_SPARKRETARD "Conversion method for DFC_ret_SparkRetard" RAT_FUNC "%10.1" "ret" COEFFS 0.000000 1.000000 0.000000 0.000000 0.000000 1.000000 /end COMPU_METHOD
/* Scalar measurable for DDE 'DIN_Hz_MAF'. */
/begin MEASUREMENT DIN_Hz_MAF "Raw value" FLOAT32_IEEE CU_DIN_HZ_MAF 1 100 0.0 0.0 ECU_ADDRESS 0x4000303c BYTE_ORDER MSB_FIRST /end MEASUREMENT
/begin COMPU_METHOD CU_DIN_HZ_MAF "Conversion method for DIN_Hz_MAF" RAT_FUNC "%10.3" "Hz" COEFFS 0.000000 1.000000 0.000000 0.000000 0.000000 1.000000 /end COMPU_METHOD
/* Scalar measurable for DDE 'DIN_NU_Gear'. */
/begin MEASUREMENT DIN_NU_Gear "Displayable" FLOAT32_IEEE CU_DIN_NU_GEAR 1 100 0.0 0.0 ECU_ADDRESS 0x40003800 BYTE_ORDER MSB_FIRST /end MEASUREMENT
/begin COMPU_METHOD CU_DIN_NU_GEAR "Conversion method for DIN_NU_Gear" RAT_FUNC "%10.0" "NU" COEFFS 0.000000 1.000000 0.000000 0.000000 0.000000 1.000000 /end COMPU_METHOD
/* Scalar measurable for DDE 'DIN_RPM_EngSpd'. */
/begin MEASUREMENT DIN_RPM_EngSpd "Displayable" FLOAT32_IEEE CU_DIN_RPM_ENGSPD 1 100 0.0 0.0 ECU_ADDRESS 0x40003804 BYTE_ORDER MSB_FIRST /end MEASUREMENT
/begin COMPU_METHOD CU_DIN_RPM_ENGSPD "Conversion method for DIN_RPM_EngSpd" RAT_FUNC "%10.0" "RPM" COEFFS 0.000000 1.000000 0.000000 0.000000 0.000000 1.000000 /end COMPU_METHOD
/* Scalar measurable for DDE 'DIN_RPM_Per720'. */
/begin MEASUREMENT DIN_RPM_Per720 "Displayable" FLOAT32_IEEE CU_DIN_RPM_PER720 1 100 0.0 0.0 ECU_ADDRESS 0x400037fc BYTE_ORDER MSB_FIRST /end MEASUREMENT
/begin COMPU_METHOD CU_DIN_RPM_PER720 "Conversion method for DIN_RPM_Per720" RAT_FUNC "%10.0" "RPM" COEFFS 0.000000 1.000000 0.000000 0.000000 0.000000 1.000000 /end COMPU_METHOD
/* Scalar measurable for DDE 'DIN_RPM_PerCyl'. */
/begin MEASUREMENT DIN_RPM_PerCyl "Displayable" FLOAT32_IEEE CU_DIN_RPM_PERCYL 1 100 0.0 0.0 ECU_ADDRESS 0x400037f8 BYTE_ORDER MSB_FIRST /end MEASUREMENT
/begin COMPU_METHOD CU_DIN_RPM_PERCYL "Conversion method for DIN_RPM_PerCyl" RAT_FUNC "%10.0" "RPM" COEFFS 0.000000 1.000000 0.000000 0.000000 0.000000 1.000000 /end COMPU_METHOD
/* Scalar measurable for DDE 'DIN_RPM_TOSS'. */
/begin MEASUREMENT DIN_RPM_TOSS "Displayable" FLOAT32_IEEE CU_DIN_RPM_TOSS 1 100 0.0 0.0 ECU_ADDRESS 0x400037f0 BYTE_ORDER MSB_FIRST /end MEASUREMENT
/begin COMPU_METHOD CU_DIN_RPM_TOSS "Conversion method for DIN_RPM_TOSS" RAT_FUNC "%10.0" "RPM" COEFFS 0.000000 1.000000 0.000000 0.000000 0.000000 1.000000 /end COMPU_METHOD
/* Scalar measurable for DDE 'DIN_b_AC_PressSw'. */
/begin MEASUREMENT DIN_b_AC_PressSw "Displayable" UBYTE CU_DIN_B_AC_PRESSSW 1 100 0.0 1.0 ECU_ADDRESS 0x40002f6c BYTE_ORDER MSB_FIRST /end MEASUREMENT
/begin COMPU_METHOD CU_DIN_B_AC_PRESSSW "Conversion method for DIN_b_AC_PressSw" RAT_FUNC "%10.0" "b" COEFFS 0.000000 1.000000 0.000000 0.000000 0.000000 1.000000 /end COMPU_METHOD
/* Scalar measurable for DDE 'DIN_b_AC_ReqSw'. */
/begin MEASUREMENT DIN_b_AC_ReqSw "Displayable" UBYTE CU_DIN_B_AC_REQSW 1 100 0.0 1.0 ECU_ADDRESS 0x40002f6b BYTE_ORDER MSB_FIRST /end MEASUREMENT
/begin COMPU_METHOD CU_DIN_B_AC_REQSW "Conversion method for DIN_b_AC_ReqSw" RAT_FUNC "%10.0" "b" COEFFS 0.000000 1.000000 0.000000 0.000000 0.000000 1.000000 /end COMPU_METHOD
/* Scalar measurable for DDE 'DIN_b_Belt'. */
/begin MEASUREMENT DIN_b_Belt "(not defined)" UBYTE CU_DIN_B_BELT 1 100 0.0 1.0 ECU_ADDRESS 0x40002f69 BYTE_ORDER MSB_FIRST /end MEASUREMENT
/begin COMPU_METHOD CU_DIN_B_BELT "Conversion method for DIN_b_Belt" RAT_FUNC "%10.0" "b" COEFFS 0.000000 1.000000 0.000000 0.000000 0.000000 1.000000 /end COMPU_METHOD
/* Scalar measurable for DDE 'DIN_b_CamPhaseValid'. */
/begin MEASUREMENT DIN_b_CamPhaseValid "Displayable" UBYTE CU_DIN_B_CAMPHASEVALID 1 100 0.0 1.0 ECU_ADDRESS 0x40002f77 BYTE_ORDER MSB_FIRST /end MEASUREMENT
/begin COMPU_METHOD CU_DIN_B_CAMPHASEVALID "Conversion method for DIN_b_CamPhaseValid" RAT_FUNC "%10.0" "b" COEFFS 0.000000 1.000000 0.000000 0.000000 0.000000 1.000000 /end COMPU_METHOD
/* Scalar measurable for DDE 'DIN_b_CamTO'. */
/begin MEASUREMENT DIN_b_CamTO "Intake cam timeout flag" UBYTE CU_DIN_B_CAMTO 1 100 0.0 1.0 ECU_ADDRESS 0x40002f78 BYTE_ORDER MSB_FIRST /end MEASUREMENT
/begin COMPU_METHOD CU_DIN_B_CAMTO "Conversion method for DIN_b_CamTO" RAT_FUNC "%10.0" "b" COEFFS 0.000000 1.000000 0.000000 0.000000 0.000000 1.000000 /end COMPU_METHOD
/* Scalar measurable for DDE 'DIN_b_Door'. */
/begin MEASUREMENT DIN_b_Door "(not defined)" UBYTE CU_DIN_B_DOOR 1 100 0.0 1.0 ECU_ADDRESS 0x40002f68 BYTE_ORDER MSB_FIRST /end MEASUREMENT
/begin COMPU_METHOD CU_DIN_B_DOOR "Conversion method for DIN_b_Door" RAT_FUNC "%10.0" "b" COEFFS 0.000000 1.000000 0.000000 0.000000 0.000000 1.000000 /end COMPU_METHOD
/* Scalar measurable for DDE 'DIN_b_EngSync'. */
/begin MEASUREMENT DIN_b_EngSync "Displayable" UBYTE CU_DIN_B_ENGSYNC 1 100 0.0 1.0 ECU_ADDRESS 0x40002f66 BYTE_ORDER MSB_FIRST /end MEASUREMENT
/begin COMPU_METHOD CU_DIN_B_ENGSYNC "Conversion method for DIN_b_EngSync" RAT_FUNC "%10.0" "b" COEFFS 0.000000 1.000000 0.000000 0.000000 0.000000 1.000000 /end COMPU_METHOD
/* Scalar measurable for DDE 'DIN_b_Ign'. */
/begin MEASUREMENT DIN_b_Ign "Displayable" UBYTE CU_DIN_B_IGN 1 100 0.0 1.0 ECU_ADDRESS 0x40002f79 BYTE_ORDER MSB_FIRST /end MEASUREMENT
/begin COMPU_METHOD CU_DIN_B_IGN "Conversion method for DIN_b_Ign" RAT_FUNC "%10.0" "b" COEFFS 0.000000 1.000000 0.000000 0.000000 0.000000 1.000000 /end COMPU_METHOD
/* Scalar measurable for DDE 'DIN_b_MAF_To'. */
/begin MEASUREMENT DIN_b_MAF_To "Timeout flag" UBYTE CU_DIN_B_MAF_TO 1 100 0.0 1.0 ECU_ADDRESS 0x40002f71 BYTE_ORDER MSB_FIRST /end MEASUREMENT
/begin COMPU_METHOD CU_DIN_B_MAF_TO "Conversion method for DIN_b_MAF_To" RAT_FUNC "%10.0" "b" COEFFS 0.000000 1.000000 0.000000 0.000000 0.000000 1.000000 /end COMPU_METHOD
/* Scalar measurable for DDE 'DIN_b_OilPrSw'. */
/begin MEASUREMENT DIN_b_OilPrSw "(not defined)" UBYTE CU_DIN_B_OILPRSW 1 100 0.0 1.0 ECU_ADDRESS 0x40002f6d BYTE_ORDER MSB_FIRST /end MEASUREMENT
/begin COMPU_METHOD CU_DIN_B_OILPRSW "Conversion method for DIN_b_OilPrSw" RAT_FUNC "%10.0" "b" COEFFS 0.000000 1.000000 0.000000 0.000000 0.000000 1.000000 /end COMPU_METHOD
/* Scalar measurable for DDE 'DIN_b_ParkingBrake'. */
/begin MEASUREMENT DIN_b_ParkingBrake "(not defined)" UBYTE CU_DIN_B_PARKINGBRAKE 1 100 0.0 1.0 ECU_ADDRESS 0x40002f67 BYTE_ORDER MSB_FIRST /end MEASUREMENT
/begin COMPU_METHOD CU_DIN_B_PARKINGBRAKE "Conversion method for DIN_b_ParkingBrake" RAT_FUNC "%10.0" "b" COEFFS 0.000000 1.000000 0.000000 0.000000 0.000000 1.000000 /end COMPU_METHOD
/* Scalar measurable for DDE 'DIN_b_PedalBrake'. */
/begin MEASUREMENT DIN_b_PedalBrake "(not defined)" UBYTE CU_DIN_B_PEDALBRAKE 1 100 0.0 1.0 ECU_ADDRESS 0x40002f6a BYTE_ORDER MSB_FIRST /end MEASUREMENT
/begin COMPU_METHOD CU_DIN_B_PEDALBRAKE "Conversion method for DIN_b_PedalBrake" RAT_FUNC "%10.0" "b" COEFFS 0.000000 1.000000 0.000000 0.000000 0.000000 1.000000 /end COMPU_METHOD
/* Scalar measurable for DDE 'DIN_b_RearGear'. */
/begin MEASUREMENT DIN_b_RearGear "Displayable" UBYTE CU_DIN_B_REARGEAR 1 100 0.0 1.0 ECU_ADDRESS 0x40002f75 BYTE_ORDER MSB_FIRST /end MEASUREMENT
/begin COMPU_METHOD CU_DIN_B_REARGEAR "Conversion method for DIN_b_RearGear" RAT_FUNC "%10.0" "b" COEFFS 0.000000 1.000000 0.000000 0.000000 0.000000 1.000000 /end COMPU_METHOD
/* Scalar measurable for DDE 'DIN_b_Y13_SB_OL'. */
/begin MEASUREMENT DIN_b_Y13_SB_OL "(not defined)" UBYTE CU_DIN_B_Y13_SB_OL 1 100 0.0 1.0 ECU_ADDRESS 0x40002f3f BYTE_ORDER MSB_FIRST /end MEASUREMENT
/begin COMPU_METHOD CU_DIN_B_Y13_SB_OL "Conversion method for DIN_b_Y13_SB_OL" RAT_FUNC "%10.0" "b" COEFFS 0.000000 1.000000 0.000000 0.000000 0.000000 1.000000 /end COMPU_METHOD
/* Scalar measurable for DDE 'DIN_b_Y17_Enabled'. */
/begin MEASUREMENT DIN_b_Y17_Enabled "(not defined)" UBYTE CU_DIN_B_Y17_ENABLED 1 100 0.0 1.0 ECU_ADDRESS 0x40002f4a BYTE_ORDER MSB_FIRST /end MEASUREMENT
/begin COMPU_METHOD CU_DIN_B_Y17_ENABLED "Conversion method for DIN_b_Y17_Enabled" RAT_FUNC "%10.0" "b" COEFFS 0.000000 1.000000 0.000000 0.000000 0.000000 1.000000 /end COMPU_METHOD
/* Scalar measurable for DDE 'DIN_b_Y17_Fault'. */
/begin MEASUREMENT DIN_b_Y17_Fault "(not defined)" UBYTE CU_DIN_B_Y17_FAULT 1 100 0.0 1.0 ECU_ADDRESS 0x40002f49 BYTE_ORDER MSB_FIRST /end MEASUREMENT
/begin COMPU_METHOD CU_DIN_B_Y17_FAULT "Conversion method for DIN_b_Y17_Fault" RAT_FUNC "%10.0" "b" COEFFS 0.000000 1.000000 0.000000 0.000000 0.000000 1.000000 /end COMPU_METHOD
/* Scalar measurable for DDE 'DIN_b_Y17_OFF_OL'. */
/begin MEASUREMENT DIN_b_Y17_OFF_OL "(not defined)" UBYTE CU_DIN_B_Y17_OFF_OL 1 100 0.0 1.0 ECU_ADDRESS 0x40002f48 BYTE_ORDER MSB_FIRST /end MEASUREMENT
/begin COMPU_METHOD CU_DIN_B_Y17_OFF_OL "Conversion method for DIN_b_Y17_OFF_OL" RAT_FUNC "%10.0" "b" COEFFS 0.000000 1.000000 0.000000 0.000000 0.000000 1.000000 /end COMPU_METHOD
/* Scalar measurable for DDE 'DIN_b_Y17_ON_OL'. */
/begin MEASUREMENT DIN_b_Y17_ON_OL "(not defined)" UBYTE CU_DIN_B_Y17_ON_OL 1 100 0.0 1.0 ECU_ADDRESS 0x40002f47 BYTE_ORDER MSB_FIRST /end MEASUREMENT
/begin COMPU_METHOD CU_DIN_B_Y17_ON_OL "Conversion method for DIN_b_Y17_ON_OL" RAT_FUNC "%10.0" "b" COEFFS 0.000000 1.000000 0.000000 0.000000 0.000000 1.000000 /end COMPU_METHOD
/* Scalar measurable for DDE 'DIN_b_Y17_OV'. */
/begin MEASUREMENT DIN_b_Y17_OV "(not defined)" UBYTE CU_DIN_B_Y17_OV 1 100 0.0 1.0 ECU_ADDRESS 0x40002f46 BYTE_ORDER MSB_FIRST /end MEASUREMENT
/begin COMPU_METHOD CU_DIN_B_Y17_OV "Conversion method for DIN_b_Y17_OV" RAT_FUNC "%10.0" "b" COEFFS 0.000000 1.000000 0.000000 0.000000 0.000000 1.000000 /end COMPU_METHOD
/* Scalar measurable for DDE 'DIN_b_Y17_Reset'. */
/begin MEASUREMENT DIN_b_Y17_Reset "(not defined)" UBYTE CU_DIN_B_Y17_RESET 1 100 0.0 1.0 ECU_ADDRESS 0x40002f45 BYTE_ORDER MSB_FIRST /end MEASUREMENT
/begin COMPU_METHOD CU_DIN_B_Y17_RESET "Conversion method for DIN_b_Y17_Reset" RAT_FUNC "%10.0" "b" COEFFS 0.000000 1.000000 0.000000 0.000000 0.000000 1.000000 /end COMPU_METHOD
/* Scalar measurable for DDE 'DIN_b_Y17_SB'. */
/begin MEASUREMENT DIN_b_Y17_SB "(not defined)" UBYTE CU_DIN_B_Y17_SB 1 100 0.0 1.0 ECU_ADDRESS 0x40002f43 BYTE_ORDER MSB_FIRST /end MEASUREMENT
/begin COMPU_METHOD CU_DIN_B_Y17_SB "Conversion method for DIN_b_Y17_SB" RAT_FUNC "%10.0" "b" COEFFS 0.000000 1.000000 0.000000 0.000000 0.000000 1.000000 /end COMPU_METHOD
/* Scalar measurable for DDE 'DIN_b_Y17_SB_Tested'. */
/begin MEASUREMENT DIN_b_Y17_SB_Tested "(not defined)" UBYTE CU_DIN_B_Y17_SB_TESTED 1 100 0.0 1.0 ECU_ADDRESS 0x40002f44 BYTE_ORDER MSB_FIRST /end MEASUREMENT
/begin COMPU_METHOD CU_DIN_B_Y17_SB_TESTED "Conversion method for DIN_b_Y17_SB_Tested" RAT_FUNC "%10.0" "b" COEFFS 0.000000 1.000000 0.000000 0.000000 0.000000 1.000000 /end COMPU_METHOD
/* Scalar measurable for DDE 'DIN_b_Y17_SG'. */
/begin MEASUREMENT DIN_b_Y17_SG "(not defined)" UBYTE CU_DIN_B_Y17_SG 1 100 0.0 1.0 ECU_ADDRESS 0x40002f42 BYTE_ORDER MSB_FIRST /end MEASUREMENT
/begin COMPU_METHOD CU_DIN_B_Y17_SG "Conversion method for DIN_b_Y17_SG" RAT_FUNC "%10.0" "b" COEFFS 0.000000 1.000000 0.000000 0.000000 0.000000 1.000000 /end COMPU_METHOD
/* Scalar measurable for DDE 'DIN_b_Y17_SG_OL'. */
/begin MEASUREMENT DIN_b_Y17_SG_OL "(not defined)" UBYTE CU_DIN_B_Y17_SG_OL 1 100 0.0 1.0 ECU_ADDRESS 0x40002f41 BYTE_ORDER MSB_FIRST /end MEASUREMENT
/begin COMPU_METHOD CU_DIN_B_Y17_SG_OL "Conversion method for DIN_b_Y17_SG_OL" RAT_FUNC "%10.0" "b" COEFFS 0.000000 1.000000 0.000000 0.000000 0.000000 1.000000 /end COMPU_METHOD
/* Scalar measurable for DDE 'DIN_cnt_CamExtraTeeth'. */
/begin MEASUREMENT DIN_cnt_CamExtraTeeth "Number of extra cam teeth counted" FLOAT32_IEEE CU_DIN_CNT_CAMEXTRATEETH 1 100 0.0 0.0 ECU_ADDRESS 0x40003820 BYTE_ORDER MSB_FIRST /end MEASUREMENT
/begin COMPU_METHOD CU_DIN_CNT_CAMEXTRATEETH "Conversion method for DIN_cnt_CamExtraTeeth" RAT_FUNC "%10.0" "cnt" COEFFS 0.000000 1.000000 0.000000 0.000000 0.000000 1.000000 /end COMPU_METHOD
/* Scalar measurable for DDE 'DIN_cnt_CamMissTeeth'. */
/begin MEASUREMENT DIN_cnt_CamMissTeeth "Number of cam teeth missed" FLOAT32_IEEE CU_DIN_CNT_CAMMISSTEETH 1 100 0.0 0.0 ECU_ADDRESS 0x40003824 BYTE_ORDER MSB_FIRST /end MEASUREMENT
/begin COMPU_METHOD CU_DIN_CNT_CAMMISSTEETH "Conversion method for DIN_cnt_CamMissTeeth" RAT_FUNC "%10.0" "cnt" COEFFS 0.000000 1.000000 0.000000 0.000000 0.000000 1.000000 /end COMPU_METHOD
/* Scalar measurable for DDE 'DIN_deg_CamTooth1'. */
/begin MEASUREMENT DIN_deg_CamTooth1 "Tooth angle for Tooth 1 of intake cam" FLOAT32_IEEE CU_DIN_DEG_CAMTOOTH1 1 100 0.0 0.0 ECU_ADDRESS 0x40003810 BYTE_ORDER MSB_FIRST /end MEASUREMENT
/begin COMPU_METHOD CU_DIN_DEG_CAMTOOTH1 "Conversion method for DIN_deg_CamTooth1" RAT_FUNC "%10.2" "deg" COEFFS 0.000000 1.000000 0.000000 0.000000 0.000000 1.000000 /end COMPU_METHOD
/* Scalar measurable for DDE 'DIN_deg_CamTooth2'. */
/begin MEASUREMENT DIN_deg_CamTooth2 "Tooth angle for Tooth 2 of intake cam" FLOAT32_IEEE CU_DIN_DEG_CAMTOOTH2 1 100 0.0 0.0 ECU_ADDRESS 0x4000381c BYTE_ORDER MSB_FIRST /end MEASUREMENT
/begin COMPU_METHOD CU_DIN_DEG_CAMTOOTH2 "Conversion method for DIN_deg_CamTooth2" RAT_FUNC "%10.2" "deg" COEFFS 0.000000 1.000000 0.000000 0.000000 0.000000 1.000000 /end COMPU_METHOD
/* Scalar measurable for DDE 'DIN_deg_CamTooth3'. */
/begin MEASUREMENT DIN_deg_CamTooth3 "Tooth angle for Tooth 3 of intake cam" FLOAT32_IEEE CU_DIN_DEG_CAMTOOTH3 1 100 0.0 0.0 ECU_ADDRESS 0x40003818 BYTE_ORDER MSB_FIRST /end MEASUREMENT
/begin COMPU_METHOD CU_DIN_DEG_CAMTOOTH3 "Conversion method for DIN_deg_CamTooth3" RAT_FUNC "%10.2" "deg" COEFFS 0.000000 1.000000 0.000000 0.000000 0.000000 1.000000 /end COMPU_METHOD
/* Scalar measurable for DDE 'DIN_deg_CamTooth4'. */
/begin MEASUREMENT DIN_deg_CamTooth4 "Tooth angle for Tooth 4 of intake cam" FLOAT32_IEEE CU_DIN_DEG_CAMTOOTH4 1 100 0.0 0.0 ECU_ADDRESS 0x4000380c BYTE_ORDER MSB_FIRST /end MEASUREMENT
/begin COMPU_METHOD CU_DIN_DEG_CAMTOOTH4 "Conversion method for DIN_deg_CamTooth4" RAT_FUNC "%10.2" "deg" COEFFS 0.000000 1.000000 0.000000 0.000000 0.000000 1.000000 /end COMPU_METHOD
/* Scalar measurable for DDE 'DIN_deg_CamToothDelta'. */
/begin MEASUREMENT DIN_deg_CamToothDelta "Displayable" FLOAT32_IEEE CU_DIN_DEG_CAMTOOTHDELTA 1 100 0.0 0.0 ECU_ADDRESS 0x40003814 BYTE_ORDER MSB_FIRST /end MEASUREMENT
/begin COMPU_METHOD CU_DIN_DEG_CAMTOOTHDELTA "Conversion method for DIN_deg_CamToothDelta" RAT_FUNC "%10.0" "deg" COEFFS 0.000000 1.000000 0.000000 0.000000 0.000000 1.000000 /end COMPU_METHOD
/* Scalar measurable for DDE 'DIN_e_CurrentCyl'. */
/begin MEASUREMENT DIN_e_CurrentCyl "Angular cylinder number" UBYTE CU_DIN_E_CURRENTCYL 1 100 0.0 0.0 ECU_ADDRESS 0x4000301e BYTE_ORDER MSB_FIRST /end MEASUREMENT
/begin COMPU_METHOD CU_DIN_E_CURRENTCYL "Conversion method for DIN_e_CurrentCyl" RAT_FUNC "%10.0" "e" COEFFS 0.000000 1.000000 0.000000 0.000000 0.000000 1.000000 /end COMPU_METHOD
/* Scalar measurable for DDE 'DIN_gps_MAF'. */
/begin MEASUREMENT DIN_gps_MAF "Displayable" FLOAT32_IEEE CU_DIN_GPS_MAF 1 100 0.0 0.0 ECU_ADDRESS 0x400037e8 BYTE_ORDER MSB_FIRST /end MEASUREMENT
/begin COMPU_METHOD CU_DIN_GPS_MAF "Conversion method for DIN_gps_MAF" RAT_FUNC "%10.0" "gps" COEFFS 0.000000 1.000000 0.000000 0.000000 0.000000 1.000000 /end COMPU_METHOD
/* Scalar measurable for DDE 'DIN_kph_VehSpd'. */
/begin MEASUREMENT DIN_kph_VehSpd "Displayable" FLOAT32_IEEE CU_DIN_KPH_VEHSPD 1 100 0.0 0.0 ECU_ADDRESS 0x400037f4 BYTE_ORDER MSB_FIRST /end MEASUREMENT
/begin COMPU_METHOD CU_DIN_KPH_VEHSPD "Conversion method for DIN_kph_VehSpd" RAT_FUNC "%10.0" "kph" COEFFS 0.000000 1.000000 0.000000 0.000000 0.000000 1.000000 /end COMPU_METHOD
/* Scalar measurable for DDE 'DIN_pct_AltLoad'. */
/begin MEASUREMENT DIN_pct_AltLoad "Displayable" FLOAT32_IEEE CU_DIN_PCT_ALTLOAD 1 100 0.0 0.0 ECU_ADDRESS 0x400037e4 BYTE_ORDER MSB_FIRST /end MEASUREMENT
/begin COMPU_METHOD CU_DIN_PCT_ALTLOAD "Conversion method for DIN_pct_AltLoad" RAT_FUNC "%10.0" "pct" COEFFS 0.000000 1.000000 0.000000 0.000000 0.000000 1.000000 /end COMPU_METHOD
/* Scalar measurable for DDE 'DIN_ret_CamPhase'. */
/begin MEASUREMENT DIN_ret_CamPhase "Intake cam phase angle" FLOAT32_IEEE CU_DIN_RET_CAMPHASE 1 100 0.0 0.0 ECU_ADDRESS 0x400037ec BYTE_ORDER MSB_FIRST /end MEASUREMENT
/begin COMPU_METHOD CU_DIN_RET_CAMPHASE "Conversion method for DIN_ret_CamPhase" RAT_FUNC "%10.2" "ret" COEFFS 0.000000 1.000000 0.000000 0.000000 0.000000 1.000000 /end COMPU_METHOD
/* Scalar measurable for DDE 'DRL_b_Active'. */
/begin MEASUREMENT DRL_b_Active "Displayable" UBYTE CU_DRL_B_ACTIVE 1 100 0.0 1.0 ECU_ADDRESS 0x40002ebc BYTE_ORDER MSB_FIRST /end MEASUREMENT
/begin COMPU_METHOD CU_DRL_B_ACTIVE "Conversion method for DRL_b_Active" RAT_FUNC "%10.0" "b" COEFFS 0.000000 1.000000 0.000000 0.000000 0.000000 1.000000 /end COMPU_METHOD
/* Scalar measurable for DDE 'DRL_gps_DynoAirRqst'. */
/begin MEASUREMENT DRL_gps_DynoAirRqst "Displayable" FLOAT32_IEEE CU_DRL_GPS_DYNOAIRRQST 1 100 0.0 0.0 ECU_ADDRESS 0x4000340c BYTE_ORDER MSB_FIRST /end MEASUREMENT
/begin COMPU_METHOD CU_DRL_GPS_DYNOAIRRQST "Conversion method for DRL_gps_DynoAirRqst" RAT_FUNC "%10.1" "gps" COEFFS 0.000000 1.000000 0.000000 0.000000 0.000000 1.000000 /end COMPU_METHOD
/* Scalar measurable for DDE 'DTC_NU_KNKButaneThr'. */
/begin MEASUREMENT DTC_NU_KNKButaneThr "(not defined)" FLOAT32_IEEE CU_DTC_NU_KNKBUTANETHR 1 100 0.0 0.0 ECU_ADDRESS 0x400032c8 BYTE_ORDER MSB_FIRST /end MEASUREMENT
/begin COMPU_METHOD CU_DTC_NU_KNKBUTANETHR "Conversion method for DTC_NU_KNKButaneThr" RAT_FUNC "%10.2" "ret" COEFFS 0.000000 1.000000 0.000000 0.000000 0.000000 1.000000 /end COMPU_METHOD
/* Scalar measurable for DDE 'DTC_NU_TestTime'. */
/begin MEASUREMENT DTC_NU_TestTime "(not defined)" FLOAT32_IEEE CU_DTC_NU_TESTTIME 1 100 0.0 1000000.0 ECU_ADDRESS 0x40003904 BYTE_ORDER MSB_FIRST /end MEASUREMENT
/begin COMPU_METHOD CU_DTC_NU_TESTTIME "Conversion method for DTC_NU_TestTime" RAT_FUNC "%10.0" "s" COEFFS 0.000000 1.000000 0.000000 0.000000 0.000000 1.000000 /end COMPU_METHOD
/* Scalar measurable for DDE 'DTC_b_1_boostOC'. */
/begin MEASUREMENT DTC_b_1_boostOC "DTC62" UBYTE CU_DTC_B_1_BOOSTOC 1 100 0.0 1.0 ECU_ADDRESS 0x40002f5f BYTE_ORDER MSB_FIRST /end MEASUREMENT
/begin COMPU_METHOD CU_DTC_B_1_BOOSTOC "Conversion method for DTC_b_1_boostOC" RAT_FUNC "%10.0" "b" COEFFS 0.000000 1.000000 0.000000 0.000000 0.000000 1.000000 /end COMPU_METHOD
/* Scalar measurable for DDE 'DTC_b_1_lsol'. */
/begin MEASUREMENT DTC_b_1_lsol "DTC44" UBYTE CU_DTC_B_1_LSOL 1 100 0.0 1.0 ECU_ADDRESS 0x40002f61 BYTE_ORDER MSB_FIRST /end MEASUREMENT
/begin COMPU_METHOD CU_DTC_B_1_LSOL "Conversion method for DTC_b_1_lsol" RAT_FUNC "%10.0" "b" COEFFS 0.000000 1.000000 0.000000 0.000000 0.000000 1.000000 /end COMPU_METHOD
/* Scalar measurable for DDE 'DTC_b_1_sb'. */
/begin MEASUREMENT DTC_b_1_sb "DTC60" UBYTE CU_DTC_B_1_SB 1 100 0.0 1.0 ECU_ADDRESS 0x40002f60 BYTE_ORDER MSB_FIRST /end MEASUREMENT
/begin COMPU_METHOD CU_DTC_B_1_SB "Conversion method for DTC_b_1_sb" RAT_FUNC "%10.0" "b" COEFFS 0.000000 1.000000 0.000000 0.000000 0.000000 1.000000 /end COMPU_METHOD
/* Scalar measurable for DDE 'DTC_b_1_sg'. */
/begin MEASUREMENT DTC_b_1_sg "DTC68" UBYTE CU_DTC_B_1_SG 1 100 0.0 1.0 ECU_ADDRESS 0x40002f5e BYTE_ORDER MSB_FIRST /end MEASUREMENT
/begin COMPU_METHOD CU_DTC_B_1_SG "Conversion method for DTC_b_1_sg" RAT_FUNC "%10.0" "b" COEFFS 0.000000 1.000000 0.000000 0.000000 0.000000 1.000000 /end COMPU_METHOD
/* Scalar measurable for DDE 'DTC_b_2_boostOC'. */
/begin MEASUREMENT DTC_b_2_boostOC "DTC62" UBYTE CU_DTC_B_2_BOOSTOC 1 100 0.0 1.0 ECU_ADDRESS 0x40002f5b BYTE_ORDER MSB_FIRST /end MEASUREMENT
/begin COMPU_METHOD CU_DTC_B_2_BOOSTOC "Conversion method for DTC_b_2_boostOC" RAT_FUNC "%10.0" "b" COEFFS 0.000000 1.000000 0.000000 0.000000 0.000000 1.000000 /end COMPU_METHOD
/* Scalar measurable for DDE 'DTC_b_2_lsol'. */
/begin MEASUREMENT DTC_b_2_lsol "DTC43" UBYTE CU_DTC_B_2_LSOL 1 100 0.0 1.0 ECU_ADDRESS 0x40002f5d BYTE_ORDER MSB_FIRST /end MEASUREMENT
/begin COMPU_METHOD CU_DTC_B_2_LSOL "Conversion method for DTC_b_2_lsol" RAT_FUNC "%10.0" "b" COEFFS 0.000000 1.000000 0.000000 0.000000 0.000000 1.000000 /end COMPU_METHOD
/* Scalar measurable for DDE 'DTC_b_2_sb'. */
/begin MEASUREMENT DTC_b_2_sb "DTC59" UBYTE CU_DTC_B_2_SB 1 100 0.0 1.0 ECU_ADDRESS 0x40002f5c BYTE_ORDER MSB_FIRST /end MEASUREMENT
/begin COMPU_METHOD CU_DTC_B_2_SB "Conversion method for DTC_b_2_sb" RAT_FUNC "%10.0" "b" COEFFS 0.000000 1.000000 0.000000 0.000000 0.000000 1.000000 /end COMPU_METHOD
/* Scalar measurable for DDE 'DTC_b_2_sg'. */
/begin MEASUREMENT DTC_b_2_sg "DTC67" UBYTE CU_DTC_B_2_SG 1 100 0.0 1.0 ECU_ADDRESS 0x40002f5a BYTE_ORDER MSB_FIRST /end MEASUREMENT
/begin COMPU_METHOD CU_DTC_B_2_SG "Conversion method for DTC_b_2_sg" RAT_FUNC "%10.0" "b" COEFFS 0.000000 1.000000 0.000000 0.000000 0.000000 1.000000 /end COMPU_METHOD
/* Scalar measurable for DDE 'DTC_b_3_boostOC'. */
/begin MEASUREMENT DTC_b_3_boostOC "DTC62" UBYTE CU_DTC_B_3_BOOSTOC 1 100 0.0 1.0 ECU_ADDRESS 0x40002f53 BYTE_ORDER MSB_FIRST /end MEASUREMENT
/begin COMPU_METHOD CU_DTC_B_3_BOOSTOC "Conversion method for DTC_b_3_boostOC" RAT_FUNC "%10.0" "b" COEFFS 0.000000 1.000000 0.000000 0.000000 0.000000 1.000000 /end COMPU_METHOD
/* Scalar measurable for DDE 'DTC_b_3_lsol'. */
/begin MEASUREMENT DTC_b_3_lsol "DTC45" UBYTE CU_DTC_B_3_LSOL 1 100 0.0 1.0 ECU_ADDRESS 0x40002f55 BYTE_ORDER MSB_FIRST /end MEASUREMENT
/begin COMPU_METHOD CU_DTC_B_3_LSOL "Conversion method for DTC_b_3_lsol" RAT_FUNC "%10.0" "b" COEFFS 0.000000 1.000000 0.000000 0.000000 0.000000 1.000000 /end COMPU_METHOD
/* Scalar measurable for DDE 'DTC_b_3_sb'. */
/begin MEASUREMENT DTC_b_3_sb "DTC61" UBYTE CU_DTC_B_3_SB 1 100 0.0 1.0 ECU_ADDRESS 0x40002f54 BYTE_ORDER MSB_FIRST /end MEASUREMENT
/begin COMPU_METHOD CU_DTC_B_3_SB "Conversion method for DTC_b_3_sb" RAT_FUNC "%10.0" "b" COEFFS 0.000000 1.000000 0.000000 0.000000 0.000000 1.000000 /end COMPU_METHOD
/* Scalar measurable for DDE 'DTC_b_3_sg'. */
/begin MEASUREMENT DTC_b_3_sg "DTC69" UBYTE CU_DTC_B_3_SG 1 100 0.0 1.0 ECU_ADDRESS 0x40002f52 BYTE_ORDER MSB_FIRST /end MEASUREMENT
/begin COMPU_METHOD CU_DTC_B_3_SG "Conversion method for DTC_b_3_sg" RAT_FUNC "%10.0" "b" COEFFS 0.000000 1.000000 0.000000 0.000000 0.000000 1.000000 /end COMPU_METHOD
/* Scalar measurable for DDE 'DTC_b_4_boostOC'. */
/begin MEASUREMENT DTC_b_4_boostOC "DTC62" UBYTE CU_DTC_B_4_BOOSTOC 1 100 0.0 1.0 ECU_ADDRESS 0x40002f58 BYTE_ORDER MSB_FIRST /end MEASUREMENT
/begin COMPU_METHOD CU_DTC_B_4_BOOSTOC "Conversion method for DTC_b_4_boostOC" RAT_FUNC "%10.0" "b" COEFFS 0.000000 1.000000 0.000000 0.000000 0.000000 1.000000 /end COMPU_METHOD
/* Scalar measurable for DDE 'DTC_b_4_lsol'. */
/begin MEASUREMENT DTC_b_4_lsol "DTC46" UBYTE CU_DTC_B_4_LSOL 1 100 0.0 1.0 ECU_ADDRESS 0x40002f59 BYTE_ORDER MSB_FIRST /end MEASUREMENT
/begin COMPU_METHOD CU_DTC_B_4_LSOL "Conversion method for DTC_b_4_lsol" RAT_FUNC "%10.0" "b" COEFFS 0.000000 1.000000 0.000000 0.000000 0.000000 1.000000 /end COMPU_METHOD
/* Scalar measurable for DDE 'DTC_b_4_sb'. */
/begin MEASUREMENT DTC_b_4_sb "DTC62" UBYTE CU_DTC_B_4_SB 1 100 0.0 1.0 ECU_ADDRESS 0x40002f57 BYTE_ORDER MSB_FIRST /end MEASUREMENT
/begin COMPU_METHOD CU_DTC_B_4_SB "Conversion method for DTC_b_4_sb" RAT_FUNC "%10.0" "b" COEFFS 0.000000 1.000000 0.000000 0.000000 0.000000 1.000000 /end COMPU_METHOD
/* Scalar measurable for DDE 'DTC_b_4_sg'. */
/begin MEASUREMENT DTC_b_4_sg "DTC70" UBYTE CU_DTC_B_4_SG 1 100 0.0 1.0 ECU_ADDRESS 0x40002f56 BYTE_ORDER MSB_FIRST /end MEASUREMENT
/begin COMPU_METHOD CU_DTC_B_4_SG "Conversion method for DTC_b_4_sg" RAT_FUNC "%10.0" "b" COEFFS 0.000000 1.000000 0.000000 0.000000 0.000000 1.000000 /end COMPU_METHOD
/* Scalar measurable for DDE 'DTC_b_APP1_NonValidVoltage'. */
/begin MEASUREMENT DTC_b_APP1_NonValidVoltage "DTC150" UBYTE CU_DTC_B_APP1_NONVALIDVOLTAGE 1 100 0.0 1.0 ECU_ADDRESS 0x40002fcb BYTE_ORDER MSB_FIRST /end MEASUREMENT
/begin COMPU_METHOD CU_DTC_B_APP1_NONVALIDVOLTAGE "Conversion method for DTC_b_APP1_NonValidVoltage" RAT_FUNC "%10.0" "b" COEFFS 0.000000 1.000000 0.000000 0.000000 0.000000 1.000000 /end COMPU_METHOD
/* Scalar measurable for DDE 'DTC_b_APP2_NonValidVoltage'. */
/begin MEASUREMENT DTC_b_APP2_NonValidVoltage "DTC151" UBYTE CU_DTC_B_APP2_NONVALIDVOLTAGE 1 100 0.0 1.0 ECU_ADDRESS 0x40002fca BYTE_ORDER MSB_FIRST /end MEASUREMENT
/begin COMPU_METHOD CU_DTC_B_APP2_NONVALIDVOLTAGE "Conversion method for DTC_b_APP2_NonValidVoltage" RAT_FUNC "%10.0" "b" COEFFS 0.000000 1.000000 0.000000 0.000000 0.000000 1.000000 /end COMPU_METHOD
/* Scalar measurable for DDE 'DTC_b_APP_CorrFLT'. */
/begin MEASUREMENT DTC_b_APP_CorrFLT "DTC133" UBYTE CU_DTC_B_APP_CORRFLT 1 100 0.0 1.0 ECU_ADDRESS 0x40002eb8 BYTE_ORDER MSB_FIRST /end MEASUREMENT
/begin COMPU_METHOD CU_DTC_B_APP_CORRFLT "Conversion method for DTC_b_APP_CorrFLT" RAT_FUNC "%10.0" "b" COEFFS 0.000000 1.000000 0.000000 0.000000 0.000000 1.000000 /end COMPU_METHOD
/* Scalar measurable for DDE 'DTC_b_Air_HTemp'. */
/begin MEASUREMENT DTC_b_Air_HTemp "DTC118" UBYTE CU_DTC_B_AIR_HTEMP 1 100 0.0 1.0 ECU_ADDRESS 0x40002fcd BYTE_ORDER MSB_FIRST /end MEASUREMENT
/begin COMPU_METHOD CU_DTC_B_AIR_HTEMP "Conversion method for DTC_b_Air_HTemp" RAT_FUNC "%10.0" "b" COEFFS 0.000000 1.000000 0.000000 0.000000 0.000000 1.000000 /end COMPU_METHOD
/* Scalar measurable for DDE 'DTC_b_Air_TempHV'. */
/begin MEASUREMENT DTC_b_Air_TempHV "DTC117" UBYTE CU_DTC_B_AIR_TEMPHV 1 100 0.0 1.0 ECU_ADDRESS 0x40002fce BYTE_ORDER MSB_FIRST /end MEASUREMENT
/begin COMPU_METHOD CU_DTC_B_AIR_TEMPHV "Conversion method for DTC_b_Air_TempHV" RAT_FUNC "%10.0" "b" COEFFS 0.000000 1.000000 0.000000 0.000000 0.000000 1.000000 /end COMPU_METHOD
/* Scalar measurable for DDE 'DTC_b_Air_TempLV'. */
/begin MEASUREMENT DTC_b_Air_TempLV "DTC116" UBYTE CU_DTC_B_AIR_TEMPLV 1 100 0.0 1.0 ECU_ADDRESS 0x40002fcf BYTE_ORDER MSB_FIRST /end MEASUREMENT
/begin COMPU_METHOD CU_DTC_B_AIR_TEMPLV "Conversion method for DTC_b_Air_TempLV" RAT_FUNC "%10.0" "b" COEFFS 0.000000 1.000000 0.000000 0.000000 0.000000 1.000000 /end COMPU_METHOD
/* Scalar measurable for DDE 'DTC_b_BARO_ErraticValue'. */
/begin MEASUREMENT DTC_b_BARO_ErraticValue "DTC203" UBYTE CU_DTC_B_BARO_ERRATICVALUE 1 100 0.0 1.0 ECU_ADDRESS 0x40002fc2 BYTE_ORDER MSB_FIRST /end MEASUREMENT
/begin COMPU_METHOD CU_DTC_B_BARO_ERRATICVALUE "Conversion method for DTC_b_BARO_ErraticValue" RAT_FUNC "%10.0" "b" COEFFS 0.000000 1.000000 0.000000 0.000000 0.000000 1.000000 /end COMPU_METHOD
/* Scalar measurable for DDE 'DTC_b_BARO_PressHVoltage'. */
/begin MEASUREMENT DTC_b_BARO_PressHVoltage "DTC123" UBYTE CU_DTC_B_BARO_PRESSHVOLTAGE 1 100 0.0 1.0 ECU_ADDRESS 0x40002fc3 BYTE_ORDER MSB_FIRST /end MEASUREMENT
/begin COMPU_METHOD CU_DTC_B_BARO_PRESSHVOLTAGE "Conversion method for DTC_b_BARO_PressHVoltage" RAT_FUNC "%10.0" "b" COEFFS 0.000000 1.000000 0.000000 0.000000 0.000000 1.000000 /end COMPU_METHOD
/* Scalar measurable for DDE 'DTC_b_BARO_PressLVoltage'. */
/begin MEASUREMENT DTC_b_BARO_PressLVoltage "DTC122" UBYTE CU_DTC_B_BARO_PRESSLVOLTAGE 1 100 0.0 1.0 ECU_ADDRESS 0x40002fc4 BYTE_ORDER MSB_FIRST /end MEASUREMENT
/begin COMPU_METHOD CU_DTC_B_BARO_PRESSLVOLTAGE "Conversion method for DTC_b_BARO_PressLVoltage" RAT_FUNC "%10.0" "b" COEFFS 0.000000 1.000000 0.000000 0.000000 0.000000 1.000000 /end COMPU_METHOD
/* Scalar measurable for DDE 'DTC_b_BAT_VoltageOutofRange'. */
/begin MEASUREMENT DTC_b_BAT_VoltageOutofRange "DTC176" UBYTE CU_DTC_B_BAT_VOLTAGEOUTOFRANGE 1 100 0.0 1.0 ECU_ADDRESS 0x40002f8b BYTE_ORDER MSB_FIRST /end MEASUREMENT
/begin COMPU_METHOD CU_DTC_B_BAT_VOLTAGEOUTOFRANGE "Conversion method for DTC_b_BAT_VoltageOutofRange" RAT_FUNC "%10.0" "b" COEFFS 0.000000 1.000000 0.000000 0.000000 0.000000 1.000000 /end COMPU_METHOD
/* Scalar measurable for DDE 'DTC_b_CataCounting'. */
/begin MEASUREMENT DTC_b_CataCounting "DTC" UBYTE CU_DTC_B_CATACOUNTING 1 100 0.0 1.0 ECU_ADDRESS 0x40002fb7 BYTE_ORDER MSB_FIRST /end MEASUREMENT
/begin COMPU_METHOD CU_DTC_B_CATACOUNTING "Conversion method for DTC_b_CataCounting" RAT_FUNC "%10.0" "b" COEFFS 0.000000 1.000000 0.000000 0.000000 0.000000 1.000000 /end COMPU_METHOD
/* Scalar measurable for DDE 'DTC_b_Catalyst_A'. */
/begin MEASUREMENT DTC_b_Catalyst_A "DTC40" UBYTE CU_DTC_B_CATALYST_A 1 100 0.0 1.0 ECU_ADDRESS 0x40002fb6 BYTE_ORDER MSB_FIRST /end MEASUREMENT
/begin COMPU_METHOD CU_DTC_B_CATALYST_A "Conversion method for DTC_b_Catalyst_A" RAT_FUNC "%10.0" "b" COEFFS 0.000000 1.000000 0.000000 0.000000 0.000000 1.000000 /end COMPU_METHOD
/* Scalar measurable for DDE 'DTC_b_CompIAT_HTemp'. */
/begin MEASUREMENT DTC_b_CompIAT_HTemp "DTC172" UBYTE CU_DTC_B_COMPIAT_HTEMP 1 100 0.0 1.0 ECU_ADDRESS 0x40002f9c BYTE_ORDER MSB_FIRST /end MEASUREMENT
/begin COMPU_METHOD CU_DTC_B_COMPIAT_HTEMP "Conversion method for DTC_b_CompIAT_HTemp" RAT_FUNC "%10.0" "b" COEFFS 0.000000 1.000000 0.000000 0.000000 0.000000 1.000000 /end COMPU_METHOD
/* Scalar measurable for DDE 'DTC_b_CompIAT_TempHV'. */
/begin MEASUREMENT DTC_b_CompIAT_TempHV "DTC171" UBYTE CU_DTC_B_COMPIAT_TEMPHV 1 100 0.0 1.0 ECU_ADDRESS 0x40002f9d BYTE_ORDER MSB_FIRST /end MEASUREMENT
/begin COMPU_METHOD CU_DTC_B_COMPIAT_TEMPHV "Conversion method for DTC_b_CompIAT_TempHV" RAT_FUNC "%10.0" "b" COEFFS 0.000000 1.000000 0.000000 0.000000 0.000000 1.000000 /end COMPU_METHOD
/* Scalar measurable for DDE 'DTC_b_CompIAT_TempLV'. */
/begin MEASUREMENT DTC_b_CompIAT_TempLV "DTC170" UBYTE CU_DTC_B_COMPIAT_TEMPLV 1 100 0.0 1.0 ECU_ADDRESS 0x40002f9e BYTE_ORDER MSB_FIRST /end MEASUREMENT
/begin COMPU_METHOD CU_DTC_B_COMPIAT_TEMPLV "Conversion method for DTC_b_CompIAT_TempLV" RAT_FUNC "%10.0" "b" COEFFS 0.000000 1.000000 0.000000 0.000000 0.000000 1.000000 /end COMPU_METHOD
/* Scalar measurable for DDE 'DTC_b_DM11Force'. */
/begin MEASUREMENT DTC_b_DM11Force "DTC168" UBYTE CU_DTC_B_DM11FORCE 1 100 0.0 1.0 ECU_ADDRESS 0x40002f2e BYTE_ORDER MSB_FIRST /end MEASUREMENT
/begin COMPU_METHOD CU_DTC_B_DM11FORCE "Conversion method for DTC_b_DM11Force" RAT_FUNC "%10.0" "b" COEFFS 0.000000 1.000000 0.000000 0.000000 0.000000 1.000000 /end COMPU_METHOD
/* Scalar measurable for DDE 'DTC_b_DM37request'. */
/begin MEASUREMENT DTC_b_DM37request "DTC168" UBYTE CU_DTC_B_DM37REQUEST 1 100 0.0 1.0 ECU_ADDRESS 0x40002efb BYTE_ORDER MSB_FIRST /end MEASUREMENT
/begin COMPU_METHOD CU_DTC_B_DM37REQUEST "Conversion method for DTC_b_DM37request" RAT_FUNC "%10.0" "b" COEFFS 0.000000 1.000000 0.000000 0.000000 0.000000 1.000000 /end COMPU_METHOD
/* Scalar measurable for DDE 'DTC_b_DiagCataTemp_ena'. */
/begin MEASUREMENT DTC_b_DiagCataTemp_ena "DiagCataTemp_ena" UBYTE CU_DTC_B_DIAGCATATEMP_ENA 1 100 0.0 1.0 ECU_ADDRESS 0x40002fba BYTE_ORDER MSB_FIRST /end MEASUREMENT
/begin COMPU_METHOD CU_DTC_B_DIAGCATATEMP_ENA "Conversion method for DTC_b_DiagCataTemp_ena" RAT_FUNC "%10.0" "b" COEFFS 0.000000 1.000000 0.000000 0.000000 0.000000 1.000000 /end COMPU_METHOD
/* Scalar measurable for DDE 'DTC_b_DiagCata_Condition'. */
/begin MEASUREMENT DTC_b_DiagCata_Condition "DiagCata_Condition" UBYTE CU_DTC_B_DIAGCATA_CONDITION 1 100 0.0 1.0 ECU_ADDRESS 0x40002fb9 BYTE_ORDER MSB_FIRST /end MEASUREMENT
/begin COMPU_METHOD CU_DTC_B_DIAGCATA_CONDITION "Conversion method for DTC_b_DiagCata_Condition" RAT_FUNC "%10.0" "b" COEFFS 0.000000 1.000000 0.000000 0.000000 0.000000 1.000000 /end COMPU_METHOD
/* Scalar measurable for DDE 'DTC_b_DiagCata_Reset'. */
/begin MEASUREMENT DTC_b_DiagCata_Reset "DiagCata_Reset" UBYTE CU_DTC_B_DIAGCATA_RESET 1 100 0.0 1.0 ECU_ADDRESS 0x40002fb8 BYTE_ORDER MSB_FIRST /end MEASUREMENT
/begin COMPU_METHOD CU_DTC_B_DIAGCATA_RESET "Conversion method for DTC_b_DiagCata_Reset" RAT_FUNC "%10.0" "b" COEFFS 0.000000 1.000000 0.000000 0.000000 0.000000 1.000000 /end COMPU_METHOD
/* Scalar measurable for DDE 'DTC_b_DiagCata_Set'. */
/begin MEASUREMENT DTC_b_DiagCata_Set "DiagCata_Set" UBYTE CU_DTC_B_DIAGCATA_SET 1 100 0.0 1.0 ECU_ADDRESS 0x40002fc0 BYTE_ORDER MSB_FIRST /end MEASUREMENT
/begin COMPU_METHOD CU_DTC_B_DIAGCATA_SET "Conversion method for DTC_b_DiagCata_Set" RAT_FUNC "%10.0" "b" COEFFS 0.000000 1.000000 0.000000 0.000000 0.000000 1.000000 /end COMPU_METHOD
/* Scalar measurable for DDE 'DTC_b_DiagCata_TestEnd'. */
/begin MEASUREMENT DTC_b_DiagCata_TestEnd "DiagCata_TestEnd" UBYTE CU_DTC_B_DIAGCATA_TESTEND 1 100 0.0 1.0 ECU_ADDRESS 0x40002f81 BYTE_ORDER MSB_FIRST /end MEASUREMENT
/begin COMPU_METHOD CU_DTC_B_DIAGCATA_TESTEND "Conversion method for DTC_b_DiagCata_TestEnd" RAT_FUNC "%10.0" "b" COEFFS 0.000000 1.000000 0.000000 0.000000 0.000000 1.000000 /end COMPU_METHOD
/* Scalar measurable for DDE 'DTC_b_ECT_HTemp'. */
/begin MEASUREMENT DTC_b_ECT_HTemp "DTC91" UBYTE CU_DTC_B_ECT_HTEMP 1 100 0.0 1.0 ECU_ADDRESS 0x40002fb3 BYTE_ORDER MSB_FIRST /end MEASUREMENT
/begin COMPU_METHOD CU_DTC_B_ECT_HTEMP "Conversion method for DTC_b_ECT_HTemp" RAT_FUNC "%10.0" "b" COEFFS 0.000000 1.000000 0.000000 0.000000 0.000000 1.000000 /end COMPU_METHOD
/* Scalar measurable for DDE 'DTC_b_ECT_LTemp'. */
/begin MEASUREMENT DTC_b_ECT_LTemp "DTC92" UBYTE CU_DTC_B_ECT_LTEMP 1 100 0.0 1.0 ECU_ADDRESS 0x40002fb2 BYTE_ORDER MSB_FIRST /end MEASUREMENT
/begin COMPU_METHOD CU_DTC_B_ECT_LTEMP "Conversion method for DTC_b_ECT_LTemp" RAT_FUNC "%10.0" "b" COEFFS 0.000000 1.000000 0.000000 0.000000 0.000000 1.000000 /end COMPU_METHOD
/* Scalar measurable for DDE 'DTC_b_ECT_TempHVoltage'. */
/begin MEASUREMENT DTC_b_ECT_TempHVoltage "DTC89" UBYTE CU_DTC_B_ECT_TEMPHVOLTAGE 1 100 0.0 1.0 ECU_ADDRESS 0x40002fb5 BYTE_ORDER MSB_FIRST /end MEASUREMENT
/begin COMPU_METHOD CU_DTC_B_ECT_TEMPHVOLTAGE "Conversion method for DTC_b_ECT_TempHVoltage" RAT_FUNC "%10.0" "b" COEFFS 0.000000 1.000000 0.000000 0.000000 0.000000 1.000000 /end COMPU_METHOD
/* Scalar measurable for DDE 'DTC_b_ECT_TempLVoltage'. */
/begin MEASUREMENT DTC_b_ECT_TempLVoltage "DTC90" UBYTE CU_DTC_B_ECT_TEMPLVOLTAGE 1 100 0.0 1.0 ECU_ADDRESS 0x40002fb4 BYTE_ORDER MSB_FIRST /end MEASUREMENT
/begin COMPU_METHOD CU_DTC_B_ECT_TEMPLVOLTAGE "Conversion method for DTC_b_ECT_TempLVoltage" RAT_FUNC "%10.0" "b" COEFFS 0.000000 1.000000 0.000000 0.000000 0.000000 1.000000 /end COMPU_METHOD
/* Scalar measurable for DDE 'DTC_b_EGT_TempHV'. */
/begin MEASUREMENT DTC_b_EGT_TempHV "DTC171" UBYTE CU_DTC_B_EGT_TEMPHV 1 100 0.0 1.0 ECU_ADDRESS 0x40002fb0 BYTE_ORDER MSB_FIRST /end MEASUREMENT
/begin COMPU_METHOD CU_DTC_B_EGT_TEMPHV "Conversion method for DTC_b_EGT_TempHV" RAT_FUNC "%10.0" "b" COEFFS 0.000000 1.000000 0.000000 0.000000 0.000000 1.000000 /end COMPU_METHOD
/* Scalar measurable for DDE 'DTC_b_EGT_TempLV'. */
/begin MEASUREMENT DTC_b_EGT_TempLV "DTC171" UBYTE CU_DTC_B_EGT_TEMPLV 1 100 0.0 1.0 ECU_ADDRESS 0x40002faf BYTE_ORDER MSB_FIRST /end MEASUREMENT
/begin COMPU_METHOD CU_DTC_B_EGT_TEMPLV "Conversion method for DTC_b_EGT_TempLV" RAT_FUNC "%10.0" "b" COEFFS 0.000000 1.000000 0.000000 0.000000 0.000000 1.000000 /end COMPU_METHOD
/* Scalar measurable for DDE 'DTC_b_ETC_MotorFLT'. */
/begin MEASUREMENT DTC_b_ETC_MotorFLT "DTC134" UBYTE CU_DTC_B_ETC_MOTORFLT 1 100 0.0 1.0 ECU_ADDRESS 0x40002ea4 BYTE_ORDER MSB_FIRST /end MEASUREMENT
/begin COMPU_METHOD CU_DTC_B_ETC_MOTORFLT "Conversion method for DTC_b_ETC_MotorFLT" RAT_FUNC "%10.0" "b" COEFFS 0.000000 1.000000 0.000000 0.000000 0.000000 1.000000 /end COMPU_METHOD
/* Scalar measurable for DDE 'DTC_b_EcuMemFault'. */
/begin MEASUREMENT DTC_b_EcuMemFault "DTC141" UBYTE CU_DTC_B_ECUMEMFAULT 1 100 0.0 1.0 ECU_ADDRESS 0x40002fd7 BYTE_ORDER MSB_FIRST /end MEASUREMENT
/begin COMPU_METHOD CU_DTC_B_ECUMEMFAULT "Conversion method for DTC_b_EcuMemFault" RAT_FUNC "%10.0" "b" COEFFS 0.000000 1.000000 0.000000 0.000000 0.000000 1.000000 /end COMPU_METHOD
/* Scalar measurable for DDE 'DTC_b_EnableMIsfire'. */
/begin MEASUREMENT DTC_b_EnableMIsfire "DTC" UBYTE CU_DTC_B_ENABLEMISFIRE 1 100 0.0 1.0 ECU_ADDRESS 0x40002f80 BYTE_ORDER MSB_FIRST /end MEASUREMENT
/begin COMPU_METHOD CU_DTC_B_ENABLEMISFIRE "Conversion method for DTC_b_EnableMIsfire" RAT_FUNC "%10.0" "b" COEFFS 0.000000 1.000000 0.000000 0.000000 0.000000 1.000000 /end COMPU_METHOD
/* Scalar measurable for DDE 'DTC_b_Exhaust_HTemp'. */
/begin MEASUREMENT DTC_b_Exhaust_HTemp "Turbo_HTemp" UBYTE CU_DTC_B_EXHAUST_HTEMP 1 100 0.0 1.0 ECU_ADDRESS 0x40002fae BYTE_ORDER MSB_FIRST /end MEASUREMENT
/begin COMPU_METHOD CU_DTC_B_EXHAUST_HTEMP "Conversion method for DTC_b_Exhaust_HTemp" RAT_FUNC "%10.0" "b" COEFFS 0.000000 1.000000 0.000000 0.000000 0.000000 1.000000 /end COMPU_METHOD
/* Scalar measurable for DDE 'DTC_b_FAP_Disconected'. */
/begin MEASUREMENT DTC_b_FAP_Disconected "Displayable" UBYTE CU_DTC_B_FAP_DISCONECTED 1 100 0.0 1.0 ECU_ADDRESS 0x40002fab BYTE_ORDER MSB_FIRST /end MEASUREMENT
/begin COMPU_METHOD CU_DTC_B_FAP_DISCONECTED "Conversion method for DTC_b_FAP_Disconected" RAT_FUNC "%10.0" "b" COEFFS 0.000000 1.000000 0.000000 0.000000 0.000000 1.000000 /end COMPU_METHOD
/* Scalar measurable for DDE 'DTC_b_FAP_HPress'. */
/begin MEASUREMENT DTC_b_FAP_HPress "Displayable" UBYTE CU_DTC_B_FAP_HPRESS 1 100 0.0 1.0 ECU_ADDRESS 0x40002fac BYTE_ORDER MSB_FIRST /end MEASUREMENT
/begin COMPU_METHOD CU_DTC_B_FAP_HPRESS "Conversion method for DTC_b_FAP_HPress" RAT_FUNC "%10.0" "b" COEFFS 0.000000 1.000000 0.000000 0.000000 0.000000 1.000000 /end COMPU_METHOD
/* Scalar measurable for DDE 'DTC_b_FalloCamShaft'. */
/begin MEASUREMENT DTC_b_FalloCamShaft "DTC141" UBYTE CU_DTC_B_FALLOCAMSHAFT 1 100 0.0 1.0 ECU_ADDRESS 0x40002f76 BYTE_ORDER MSB_FIRST /end MEASUREMENT
/begin COMPU_METHOD CU_DTC_B_FALLOCAMSHAFT "Conversion method for DTC_b_FalloCamShaft" RAT_FUNC "%10.0" "b" COEFFS 0.000000 1.000000 0.000000 0.000000 0.000000 1.000000 /end COMPU_METHOD
/* Scalar measurable for DDE 'DTC_b_FalloCramShaft'. */
/begin MEASUREMENT DTC_b_FalloCramShaft "DTC141" UBYTE CU_DTC_B_FALLOCRAMSHAFT 1 100 0.0 1.0 ECU_ADDRESS 0x40002f7a BYTE_ORDER MSB_FIRST /end MEASUREMENT
/begin COMPU_METHOD CU_DTC_B_FALLOCRAMSHAFT "Conversion method for DTC_b_FalloCramShaft" RAT_FUNC "%10.0" "b" COEFFS 0.000000 1.000000 0.000000 0.000000 0.000000 1.000000 /end COMPU_METHOD
/* Scalar measurable for DDE 'DTC_b_GLP1_HVoltage'. */
/begin MEASUREMENT DTC_b_GLP1_HVoltage "DTC147" UBYTE CU_DTC_B_GLP1_HVOLTAGE 1 100 0.0 1.0 ECU_ADDRESS 0x40002fa0 BYTE_ORDER MSB_FIRST /end MEASUREMENT
/begin COMPU_METHOD CU_DTC_B_GLP1_HVOLTAGE "Conversion method for DTC_b_GLP1_HVoltage" RAT_FUNC "%10.0" "b" COEFFS 0.000000 1.000000 0.000000 0.000000 0.000000 1.000000 /end COMPU_METHOD
/* Scalar measurable for DDE 'DTC_b_GLP2_HVoltage'. */
/begin MEASUREMENT DTC_b_GLP2_HVoltage "DTC147" UBYTE CU_DTC_B_GLP2_HVOLTAGE 1 100 0.0 1.0 ECU_ADDRESS 0x40002f9f BYTE_ORDER MSB_FIRST /end MEASUREMENT
/begin COMPU_METHOD CU_DTC_B_GLP2_HVOLTAGE "Conversion method for DTC_b_GLP2_HVoltage" RAT_FUNC "%10.0" "b" COEFFS 0.000000 1.000000 0.000000 0.000000 0.000000 1.000000 /end COMPU_METHOD
/* Scalar measurable for DDE 'DTC_b_GLP_HPress'. */
/begin MEASUREMENT DTC_b_GLP_HPress "DTC144" UBYTE CU_DTC_B_GLP_HPRESS 1 100 0.0 1.0 ECU_ADDRESS 0x40002fa9 BYTE_ORDER MSB_FIRST /end MEASUREMENT
/begin COMPU_METHOD CU_DTC_B_GLP_HPRESS "Conversion method for DTC_b_GLP_HPress" RAT_FUNC "%10.0" "b" COEFFS 0.000000 1.000000 0.000000 0.000000 0.000000 1.000000 /end COMPU_METHOD
/* Scalar measurable for DDE 'DTC_b_GLP_HTemp'. */
/begin MEASUREMENT DTC_b_GLP_HTemp "DTC178" UBYTE CU_DTC_B_GLP_HTEMP 1 100 0.0 1.0 ECU_ADDRESS 0x40002fa3 BYTE_ORDER MSB_FIRST /end MEASUREMENT
/begin COMPU_METHOD CU_DTC_B_GLP_HTEMP "Conversion method for DTC_b_GLP_HTemp" RAT_FUNC "%10.0" "b" COEFFS 0.000000 1.000000 0.000000 0.000000 0.000000 1.000000 /end COMPU_METHOD
/* Scalar measurable for DDE 'DTC_b_GLP_LPress'. */
/begin MEASUREMENT DTC_b_GLP_LPress "DTC145" UBYTE CU_DTC_B_GLP_LPRESS 1 100 0.0 1.0 ECU_ADDRESS 0x40002fa7 BYTE_ORDER MSB_FIRST /end MEASUREMENT
/begin COMPU_METHOD CU_DTC_B_GLP_LPRESS "Conversion method for DTC_b_GLP_LPress" RAT_FUNC "%10.0" "b" COEFFS 0.000000 1.000000 0.000000 0.000000 0.000000 1.000000 /end COMPU_METHOD
/* Scalar measurable for DDE 'DTC_b_GLP_LTemp'. */
/begin MEASUREMENT DTC_b_GLP_LTemp "DTC179" UBYTE CU_DTC_B_GLP_LTEMP 1 100 0.0 1.0 ECU_ADDRESS 0x40002fa2 BYTE_ORDER MSB_FIRST /end MEASUREMENT
/begin COMPU_METHOD CU_DTC_B_GLP_LTEMP "Conversion method for DTC_b_GLP_LTemp" RAT_FUNC "%10.0" "b" COEFFS 0.000000 1.000000 0.000000 0.000000 0.000000 1.000000 /end COMPU_METHOD
/* Scalar measurable for DDE 'DTC_b_GLP_OL'. */
/begin MEASUREMENT DTC_b_GLP_OL "DTCxxx" UBYTE CU_DTC_B_GLP_OL 1 100 0.0 1.0 ECU_ADDRESS 0x40002fa8 BYTE_ORDER MSB_FIRST /end MEASUREMENT
/begin COMPU_METHOD CU_DTC_B_GLP_OL "Conversion method for DTC_b_GLP_OL" RAT_FUNC "%10.0" "b" COEFFS 0.000000 1.000000 0.000000 0.000000 0.000000 1.000000 /end COMPU_METHOD
/* Scalar measurable for DDE 'DTC_b_GLP_TempHVoltage'. */
/begin MEASUREMENT DTC_b_GLP_TempHVoltage "DTC177" UBYTE CU_DTC_B_GLP_TEMPHVOLTAGE 1 100 0.0 1.0 ECU_ADDRESS 0x40002fa5 BYTE_ORDER MSB_FIRST /end MEASUREMENT
/begin COMPU_METHOD CU_DTC_B_GLP_TEMPHVOLTAGE "Conversion method for DTC_b_GLP_TempHVoltage" RAT_FUNC "%10.0" "b" COEFFS 0.000000 1.000000 0.000000 0.000000 0.000000 1.000000 /end COMPU_METHOD
/* Scalar measurable for DDE 'DTC_b_GLP_TempLVoltage'. */
/begin MEASUREMENT DTC_b_GLP_TempLVoltage "DTCxxx" UBYTE CU_DTC_B_GLP_TEMPLVOLTAGE 1 100 0.0 1.0 ECU_ADDRESS 0x40002fa4 BYTE_ORDER MSB_FIRST /end MEASUREMENT
/begin COMPU_METHOD CU_DTC_B_GLP_TEMPLVOLTAGE "Conversion method for DTC_b_GLP_TempLVoltage" RAT_FUNC "%10.0" "b" COEFFS 0.000000 1.000000 0.000000 0.000000 0.000000 1.000000 /end COMPU_METHOD
/* Scalar measurable for DDE 'DTC_b_HeatersA_OL'. */
/begin MEASUREMENT DTC_b_HeatersA_OL "DTC13" UBYTE CU_DTC_B_HEATERSA_OL 1 100 0.0 1.0 ECU_ADDRESS 0x40002f98 BYTE_ORDER MSB_FIRST /end MEASUREMENT
/begin COMPU_METHOD CU_DTC_B_HEATERSA_OL "Conversion method for DTC_b_HeatersA_OL" RAT_FUNC "%10.0" "b" COEFFS 0.000000 1.000000 0.000000 0.000000 0.000000 1.000000 /end COMPU_METHOD
/* Scalar measurable for DDE 'DTC_b_HeatersA_SB'. */
/begin MEASUREMENT DTC_b_HeatersA_SB "DTC19" UBYTE CU_DTC_B_HEATERSA_SB 1 100 0.0 1.0 ECU_ADDRESS 0x40002f95 BYTE_ORDER MSB_FIRST /end MEASUREMENT
/begin COMPU_METHOD CU_DTC_B_HEATERSA_SB "Conversion method for DTC_b_HeatersA_SB" RAT_FUNC "%10.0" "b" COEFFS 0.000000 1.000000 0.000000 0.000000 0.000000 1.000000 /end COMPU_METHOD
/* Scalar measurable for DDE 'DTC_b_HeatersA_SG'. */
/begin MEASUREMENT DTC_b_HeatersA_SG "DTC17" UBYTE CU_DTC_B_HEATERSA_SG 1 100 0.0 1.0 ECU_ADDRESS 0x40002f96 BYTE_ORDER MSB_FIRST /end MEASUREMENT
/begin COMPU_METHOD CU_DTC_B_HEATERSA_SG "Conversion method for DTC_b_HeatersA_SG" RAT_FUNC "%10.0" "b" COEFFS 0.000000 1.000000 0.000000 0.000000 0.000000 1.000000 /end COMPU_METHOD
/* Scalar measurable for DDE 'DTC_b_KNOCK_Cyl1'. */
/begin MEASUREMENT DTC_b_KNOCK_Cyl1 "DTC152" UBYTE CU_DTC_B_KNOCK_CYL1 1 100 0.0 1.0 ECU_ADDRESS 0x40002e97 BYTE_ORDER MSB_FIRST /end MEASUREMENT
/begin COMPU_METHOD CU_DTC_B_KNOCK_CYL1 "Conversion method for DTC_b_KNOCK_Cyl1" RAT_FUNC "%10.0" "b" COEFFS 0.000000 1.000000 0.000000 0.000000 0.000000 1.000000 /end COMPU_METHOD
/* Scalar measurable for DDE 'DTC_b_KNOCK_Cyl2'. */
/begin MEASUREMENT DTC_b_KNOCK_Cyl2 "DTC153" UBYTE CU_DTC_B_KNOCK_CYL2 1 100 0.0 1.0 ECU_ADDRESS 0x40002e96 BYTE_ORDER MSB_FIRST /end MEASUREMENT
/begin COMPU_METHOD CU_DTC_B_KNOCK_CYL2 "Conversion method for DTC_b_KNOCK_Cyl2" RAT_FUNC "%10.0" "b" COEFFS 0.000000 1.000000 0.000000 0.000000 0.000000 1.000000 /end COMPU_METHOD
/* Scalar measurable for DDE 'DTC_b_KNOCK_Cyl3'. */
/begin MEASUREMENT DTC_b_KNOCK_Cyl3 "DTC154" UBYTE CU_DTC_B_KNOCK_CYL3 1 100 0.0 1.0 ECU_ADDRESS 0x40002e95 BYTE_ORDER MSB_FIRST /end MEASUREMENT
/begin COMPU_METHOD CU_DTC_B_KNOCK_CYL3 "Conversion method for DTC_b_KNOCK_Cyl3" RAT_FUNC "%10.0" "b" COEFFS 0.000000 1.000000 0.000000 0.000000 0.000000 1.000000 /end COMPU_METHOD
/* Scalar measurable for DDE 'DTC_b_KNOCK_Cyl4'. */
/begin MEASUREMENT DTC_b_KNOCK_Cyl4 "DTC155" UBYTE CU_DTC_B_KNOCK_CYL4 1 100 0.0 1.0 ECU_ADDRESS 0x40002e94 BYTE_ORDER MSB_FIRST /end MEASUREMENT
/begin COMPU_METHOD CU_DTC_B_KNOCK_CYL4 "Conversion method for DTC_b_KNOCK_Cyl4" RAT_FUNC "%10.0" "b" COEFFS 0.000000 1.000000 0.000000 0.000000 0.000000 1.000000 /end COMPU_METHOD
/* Scalar measurable for DDE 'DTC_b_LB11CTFail'. */
/begin MEASUREMENT DTC_b_LB11CTFail "DTC15" UBYTE CU_DTC_B_LB11CTFAIL 1 100 0.0 1.0 ECU_ADDRESS 0x40002f97 BYTE_ORDER MSB_FIRST /end MEASUREMENT
/begin COMPU_METHOD CU_DTC_B_LB11CTFAIL "Conversion method for DTC_b_LB11CTFail" RAT_FUNC "%10.0" "b" COEFFS 0.000000 1.000000 0.000000 0.000000 0.000000 1.000000 /end COMPU_METHOD
/* Scalar measurable for DDE 'DTC_b_LB12OL'. */
/begin MEASUREMENT DTC_b_LB12OL "DTC31" UBYTE CU_DTC_B_LB12OL 1 100 0.0 1.0 ECU_ADDRESS 0x40002fbe BYTE_ORDER MSB_FIRST /end MEASUREMENT
/begin COMPU_METHOD CU_DTC_B_LB12OL "Conversion method for DTC_b_LB12OL" RAT_FUNC "%10.0" "b" COEFFS 0.000000 1.000000 0.000000 0.000000 0.000000 1.000000 /end COMPU_METHOD
/* Scalar measurable for DDE 'DTC_b_LB12SB'. */
/begin MEASUREMENT DTC_b_LB12SB "DTC33" UBYTE CU_DTC_B_LB12SB 1 100 0.0 1.0 ECU_ADDRESS 0x40002fbc BYTE_ORDER MSB_FIRST /end MEASUREMENT
/begin COMPU_METHOD CU_DTC_B_LB12SB "Conversion method for DTC_b_LB12SB" RAT_FUNC "%10.0" "b" COEFFS 0.000000 1.000000 0.000000 0.000000 0.000000 1.000000 /end COMPU_METHOD
/* Scalar measurable for DDE 'DTC_b_LambdaA_SB'. */
/begin MEASUREMENT DTC_b_LambdaA_SB "DTC11" UBYTE CU_DTC_B_LAMBDAA_SB 1 100 0.0 1.0 ECU_ADDRESS 0x40002f99 BYTE_ORDER MSB_FIRST /end MEASUREMENT
/begin COMPU_METHOD CU_DTC_B_LAMBDAA_SB "Conversion method for DTC_b_LambdaA_SB" RAT_FUNC "%10.0" "b" COEFFS 0.000000 1.000000 0.000000 0.000000 0.000000 1.000000 /end COMPU_METHOD
/* Scalar measurable for DDE 'DTC_b_LambdaA_SG'. */
/begin MEASUREMENT DTC_b_LambdaA_SG "DTC9" UBYTE CU_DTC_B_LAMBDAA_SG 1 100 0.0 1.0 ECU_ADDRESS 0x40002f94 BYTE_ORDER MSB_FIRST /end MEASUREMENT
/begin COMPU_METHOD CU_DTC_B_LAMBDAA_SG "Conversion method for DTC_b_LambdaA_SG" RAT_FUNC "%10.0" "b" COEFFS 0.000000 1.000000 0.000000 0.000000 0.000000 1.000000 /end COMPU_METHOD
/* Scalar measurable for DDE 'DTC_b_LambdaB11NOTValid'. */
/begin MEASUREMENT DTC_b_LambdaB11NOTValid "DTC160" UBYTE CU_DTC_B_LAMBDAB11NOTVALID 1 100 0.0 1.0 ECU_ADDRESS 0x40002f93 BYTE_ORDER MSB_FIRST /end MEASUREMENT
/begin COMPU_METHOD CU_DTC_B_LAMBDAB11NOTVALID "Conversion method for DTC_b_LambdaB11NOTValid" RAT_FUNC "%10.0" "b" COEFFS 0.000000 1.000000 0.000000 0.000000 0.000000 1.000000 /end COMPU_METHOD
/* Scalar measurable for DDE 'DTC_b_MAPAfterThInfraPress'. */
/begin MEASUREMENT DTC_b_MAPAfterThInfraPress "DTC166" UBYTE CU_DTC_B_MAPAFTERTHINFRAPRESS 1 100 0.0 1.0 ECU_ADDRESS 0x40002fc5 BYTE_ORDER MSB_FIRST /end MEASUREMENT
/begin COMPU_METHOD CU_DTC_B_MAPAFTERTHINFRAPRESS "Conversion method for DTC_b_MAPAfterThInfraPress" RAT_FUNC "%10.0" "b" COEFFS 0.000000 1.000000 0.000000 0.000000 0.000000 1.000000 /end COMPU_METHOD
/* Scalar measurable for DDE 'DTC_b_MAPAfterThOverPress'. */
/begin MEASUREMENT DTC_b_MAPAfterThOverPress "DTC16" UBYTE CU_DTC_B_MAPAFTERTHOVERPRESS 1 100 0.0 1.0 ECU_ADDRESS 0x40002fc6 BYTE_ORDER MSB_FIRST /end MEASUREMENT
/begin COMPU_METHOD CU_DTC_B_MAPAFTERTHOVERPRESS "Conversion method for DTC_b_MAPAfterThOverPress" RAT_FUNC "%10.0" "b" COEFFS 0.000000 1.000000 0.000000 0.000000 0.000000 1.000000 /end COMPU_METHOD
/* Scalar measurable for DDE 'DTC_b_MAPAfterThr_LV'. */
/begin MEASUREMENT DTC_b_MAPAfterThr_LV "DTC168" UBYTE CU_DTC_B_MAPAFTERTHR_LV 1 100 0.0 1.0 ECU_ADDRESS 0x40002fc8 BYTE_ORDER MSB_FIRST /end MEASUREMENT
/begin COMPU_METHOD CU_DTC_B_MAPAFTERTHR_LV "Conversion method for DTC_b_MAPAfterThr_LV" RAT_FUNC "%10.0" "b" COEFFS 0.000000 1.000000 0.000000 0.000000 0.000000 1.000000 /end COMPU_METHOD
/* Scalar measurable for DDE 'DTC_b_MAPAftrThr_HV'. */
/begin MEASUREMENT DTC_b_MAPAftrThr_HV "DTC167" UBYTE CU_DTC_B_MAPAFTRTHR_HV 1 100 0.0 1.0 ECU_ADDRESS 0x40002fc9 BYTE_ORDER MSB_FIRST /end MEASUREMENT
/begin COMPU_METHOD CU_DTC_B_MAPAFTRTHR_HV "Conversion method for DTC_b_MAPAftrThr_HV" RAT_FUNC "%10.0" "b" COEFFS 0.000000 1.000000 0.000000 0.000000 0.000000 1.000000 /end COMPU_METHOD
/* Scalar measurable for DDE 'DTC_b_MAPBefThroHV'. */
/begin MEASUREMENT DTC_b_MAPBefThroHV "DTC167" UBYTE CU_DTC_B_MAPBEFTHROHV 1 100 0.0 1.0 ECU_ADDRESS 0x40002f89 BYTE_ORDER MSB_FIRST /end MEASUREMENT
/begin COMPU_METHOD CU_DTC_B_MAPBEFTHROHV "Conversion method for DTC_b_MAPBefThroHV" RAT_FUNC "%10.0" "b" COEFFS 0.000000 1.000000 0.000000 0.000000 0.000000 1.000000 /end COMPU_METHOD
/* Scalar measurable for DDE 'DTC_b_MAPBefThroOL'. */
/begin MEASUREMENT DTC_b_MAPBefThroOL "DTC168" UBYTE CU_DTC_B_MAPBEFTHROOL 1 100 0.0 1.0 ECU_ADDRESS 0x40002f8a BYTE_ORDER MSB_FIRST /end MEASUREMENT
/begin COMPU_METHOD CU_DTC_B_MAPBEFTHROOL "Conversion method for DTC_b_MAPBefThroOL" RAT_FUNC "%10.0" "b" COEFFS 0.000000 1.000000 0.000000 0.000000 0.000000 1.000000 /end COMPU_METHOD
/* Scalar measurable for DDE 'DTC_b_MAPBeforeThroHPress'. */
/begin MEASUREMENT DTC_b_MAPBeforeThroHPress "DTC16" UBYTE CU_DTC_B_MAPBEFORETHROHPRESS 1 100 0.0 1.0 ECU_ADDRESS 0x40002f87 BYTE_ORDER MSB_FIRST /end MEASUREMENT
/begin COMPU_METHOD CU_DTC_B_MAPBEFORETHROHPRESS "Conversion method for DTC_b_MAPBeforeThroHPress" RAT_FUNC "%10.0" "b" COEFFS 0.000000 1.000000 0.000000 0.000000 0.000000 1.000000 /end COMPU_METHOD
/* Scalar measurable for DDE 'DTC_b_MAPBeforeThroLPress'. */
/begin MEASUREMENT DTC_b_MAPBeforeThroLPress "DTC166" UBYTE CU_DTC_B_MAPBEFORETHROLPRESS 1 100 0.0 1.0 ECU_ADDRESS 0x40002f88 BYTE_ORDER MSB_FIRST /end MEASUREMENT
/begin COMPU_METHOD CU_DTC_B_MAPBEFORETHROLPRESS "Conversion method for DTC_b_MAPBeforeThroLPress" RAT_FUNC "%10.0" "b" COEFFS 0.000000 1.000000 0.000000 0.000000 0.000000 1.000000 /end COMPU_METHOD
/* Scalar measurable for DDE 'DTC_b_Misfire_Bancada'. */
/begin MEASUREMENT DTC_b_Misfire_Bancada "DTC" UBYTE CU_DTC_B_MISFIRE_BANCADA 1 100 0.0 1.0 ECU_ADDRESS 0x40002f7b BYTE_ORDER MSB_FIRST /end MEASUREMENT
/begin COMPU_METHOD CU_DTC_B_MISFIRE_BANCADA "Conversion method for DTC_b_Misfire_Bancada" RAT_FUNC "%10.0" "b" COEFFS 0.000000 1.000000 0.000000 0.000000 0.000000 1.000000 /end COMPU_METHOD
/* Scalar measurable for DDE 'DTC_b_Misfire_Cylinder_1'. */
/begin MEASUREMENT DTC_b_Misfire_Cylinder_1 "DTC" UBYTE CU_DTC_B_MISFIRE_CYLINDER_1 1 100 0.0 1.0 ECU_ADDRESS 0x40002f7f BYTE_ORDER MSB_FIRST /end MEASUREMENT
/begin COMPU_METHOD CU_DTC_B_MISFIRE_CYLINDER_1 "Conversion method for DTC_b_Misfire_Cylinder_1" RAT_FUNC "%10.0" "b" COEFFS 0.000000 1.000000 0.000000 0.000000 0.000000 1.000000 /end COMPU_METHOD
/* Scalar measurable for DDE 'DTC_b_Misfire_Cylinder_2'. */
/begin MEASUREMENT DTC_b_Misfire_Cylinder_2 "DTC" UBYTE CU_DTC_B_MISFIRE_CYLINDER_2 1 100 0.0 1.0 ECU_ADDRESS 0x40002f7e BYTE_ORDER MSB_FIRST /end MEASUREMENT
/begin COMPU_METHOD CU_DTC_B_MISFIRE_CYLINDER_2 "Conversion method for DTC_b_Misfire_Cylinder_2" RAT_FUNC "%10.0" "b" COEFFS 0.000000 1.000000 0.000000 0.000000 0.000000 1.000000 /end COMPU_METHOD
/* Scalar measurable for DDE 'DTC_b_Misfire_Cylinder_3'. */
/begin MEASUREMENT DTC_b_Misfire_Cylinder_3 "DTC" UBYTE CU_DTC_B_MISFIRE_CYLINDER_3 1 100 0.0 1.0 ECU_ADDRESS 0x40002f7d BYTE_ORDER MSB_FIRST /end MEASUREMENT
/begin COMPU_METHOD CU_DTC_B_MISFIRE_CYLINDER_3 "Conversion method for DTC_b_Misfire_Cylinder_3" RAT_FUNC "%10.0" "b" COEFFS 0.000000 1.000000 0.000000 0.000000 0.000000 1.000000 /end COMPU_METHOD
/* Scalar measurable for DDE 'DTC_b_Misfire_Cylinder_4'. */
/begin MEASUREMENT DTC_b_Misfire_Cylinder_4 "DTC" UBYTE CU_DTC_B_MISFIRE_CYLINDER_4 1 100 0.0 1.0 ECU_ADDRESS 0x40002f7c BYTE_ORDER MSB_FIRST /end MEASUREMENT
/begin COMPU_METHOD CU_DTC_B_MISFIRE_CYLINDER_4 "Conversion method for DTC_b_Misfire_Cylinder_4" RAT_FUNC "%10.0" "b" COEFFS 0.000000 1.000000 0.000000 0.000000 0.000000 1.000000 /end COMPU_METHOD
/* Scalar measurable for DDE 'DTC_b_NBValid'. */
/begin MEASUREMENT DTC_b_NBValid "NBValid" UBYTE CU_DTC_B_NBVALID 1 100 0.0 1.0 ECU_ADDRESS 0x40002fbb BYTE_ORDER MSB_FIRST /end MEASUREMENT
/begin COMPU_METHOD CU_DTC_B_NBVALID "Conversion method for DTC_b_NBValid" RAT_FUNC "%10.0" "b" COEFFS 0.000000 1.000000 0.000000 0.000000 0.000000 1.000000 /end COMPU_METHOD
/* Scalar measurable for DDE 'DTC_b_OIL_LPress'. */
/begin MEASUREMENT DTC_b_OIL_LPress "DTC108" UBYTE CU_DTC_B_OIL_LPRESS 1 100 0.0 1.0 ECU_ADDRESS 0x40002f6e BYTE_ORDER MSB_FIRST /end MEASUREMENT
/begin COMPU_METHOD CU_DTC_B_OIL_LPRESS "Conversion method for DTC_b_OIL_LPress" RAT_FUNC "%10.0" "b" COEFFS 0.000000 1.000000 0.000000 0.000000 0.000000 1.000000 /end COMPU_METHOD
/* Scalar measurable for DDE 'DTC_b_OIL_Sensor'. */
/begin MEASUREMENT DTC_b_OIL_Sensor "DTC107" UBYTE CU_DTC_B_OIL_SENSOR 1 100 0.0 1.0 ECU_ADDRESS 0x40002f70 BYTE_ORDER MSB_FIRST /end MEASUREMENT
/begin COMPU_METHOD CU_DTC_B_OIL_SENSOR "Conversion method for DTC_b_OIL_Sensor" RAT_FUNC "%10.0" "b" COEFFS 0.000000 1.000000 0.000000 0.000000 0.000000 1.000000 /end COMPU_METHOD
/* Scalar measurable for DDE 'DTC_b_OIL_SensorOL'. */
/begin MEASUREMENT DTC_b_OIL_SensorOL "DTC111" UBYTE CU_DTC_B_OIL_SENSOROL 1 100 0.0 1.0 ECU_ADDRESS 0x40002f6f BYTE_ORDER MSB_FIRST /end MEASUREMENT
/begin COMPU_METHOD CU_DTC_B_OIL_SENSOROL "Conversion method for DTC_b_OIL_SensorOL" RAT_FUNC "%10.0" "b" COEFFS 0.000000 1.000000 0.000000 0.000000 0.000000 1.000000 /end COMPU_METHOD
/* Scalar measurable for DDE 'DTC_b_Readiness'. */
/begin MEASUREMENT DTC_b_Readiness "(not defined)" UBYTE CU_DTC_B_READINESS 1 100 0.0 1.0 ECU_ADDRESS 0x40002f2f BYTE_ORDER MSB_FIRST /end MEASUREMENT
/begin COMPU_METHOD CU_DTC_B_READINESS "Conversion method for DTC_b_Readiness" RAT_FUNC "%10.0" "b" COEFFS 0.000000 1.000000 0.000000 0.000000 0.000000 1.000000 /end COMPU_METHOD
/* Scalar measurable for DDE 'DTC_b_ShutOffValveEngine_OL'. */
/begin MEASUREMENT DTC_b_ShutOffValveEngine_OL "DTC119" UBYTE CU_DTC_B_SHUTOFFVALVEENGINE_OL 1 100 0.0 1.0 ECU_ADDRESS 0x40002f1e BYTE_ORDER MSB_FIRST /end MEASUREMENT
/begin COMPU_METHOD CU_DTC_B_SHUTOFFVALVEENGINE_OL "Conversion method for DTC_b_ShutOffValveEngine_OL" RAT_FUNC "%10.0" "b" COEFFS 0.000000 1.000000 0.000000 0.000000 0.000000 1.000000 /end COMPU_METHOD
/* Scalar measurable for DDE 'DTC_b_ShutOffValveEngine_SG'. */
/begin MEASUREMENT DTC_b_ShutOffValveEngine_SG "SG" UBYTE CU_DTC_B_SHUTOFFVALVEENGINE_SG 1 100 0.0 1.0 ECU_ADDRESS 0x40002fbf BYTE_ORDER MSB_FIRST /end MEASUREMENT
/begin COMPU_METHOD CU_DTC_B_SHUTOFFVALVEENGINE_SG "Conversion method for DTC_b_ShutOffValveEngine_SG" RAT_FUNC "%10.0" "b" COEFFS 0.000000 1.000000 0.000000 0.000000 0.000000 1.000000 /end COMPU_METHOD
/* Scalar measurable for DDE 'DTC_b_Supply_VRefA'. */
/begin MEASUREMENT DTC_b_Supply_VRefA "DTC162" UBYTE CU_DTC_B_SUPPLY_VREFA 1 100 0.0 1.0 ECU_ADDRESS 0x40002f64 BYTE_ORDER MSB_FIRST /end MEASUREMENT
/begin COMPU_METHOD CU_DTC_B_SUPPLY_VREFA "Conversion method for DTC_b_Supply_VRefA" RAT_FUNC "%10.0" "b" COEFFS 0.000000 1.000000 0.000000 0.000000 0.000000 1.000000 /end COMPU_METHOD
/* Scalar measurable for DDE 'DTC_b_Supply_VRefB'. */
/begin MEASUREMENT DTC_b_Supply_VRefB "DTC161" UBYTE CU_DTC_B_SUPPLY_VREFB 1 100 0.0 1.0 ECU_ADDRESS 0x40002f65 BYTE_ORDER MSB_FIRST /end MEASUREMENT
/begin COMPU_METHOD CU_DTC_B_SUPPLY_VREFB "Conversion method for DTC_b_Supply_VRefB" RAT_FUNC "%10.0" "b" COEFFS 0.000000 1.000000 0.000000 0.000000 0.000000 1.000000 /end COMPU_METHOD
/* Scalar measurable for DDE 'DTC_b_Supply_VRefC'. */
/begin MEASUREMENT DTC_b_Supply_VRefC "DTC163" UBYTE CU_DTC_B_SUPPLY_VREFC 1 100 0.0 1.0 ECU_ADDRESS 0x40002f63 BYTE_ORDER MSB_FIRST /end MEASUREMENT
/begin COMPU_METHOD CU_DTC_B_SUPPLY_VREFC "Conversion method for DTC_b_Supply_VRefC" RAT_FUNC "%10.0" "b" COEFFS 0.000000 1.000000 0.000000 0.000000 0.000000 1.000000 /end COMPU_METHOD
/* Scalar measurable for DDE 'DTC_b_Supply_VRefD'. */
/begin MEASUREMENT DTC_b_Supply_VRefD "DTC175" UBYTE CU_DTC_B_SUPPLY_VREFD 1 100 0.0 1.0 ECU_ADDRESS 0x40002f62 BYTE_ORDER MSB_FIRST /end MEASUREMENT
/begin COMPU_METHOD CU_DTC_B_SUPPLY_VREFD "Conversion method for DTC_b_Supply_VRefD" RAT_FUNC "%10.0" "b" COEFFS 0.000000 1.000000 0.000000 0.000000 0.000000 1.000000 /end COMPU_METHOD
/* Scalar measurable for DDE 'DTC_b_THR_Motor_Fail'. */
/begin MEASUREMENT DTC_b_THR_Motor_Fail "DTC136" UBYTE CU_DTC_B_THR_MOTOR_FAIL 1 100 0.0 1.0 ECU_ADDRESS 0x40002f90 BYTE_ORDER MSB_FIRST /end MEASUREMENT
/begin COMPU_METHOD CU_DTC_B_THR_MOTOR_FAIL "Conversion method for DTC_b_THR_Motor_Fail" RAT_FUNC "%10.0" "b" COEFFS 0.000000 1.000000 0.000000 0.000000 0.000000 1.000000 /end COMPU_METHOD
/* Scalar measurable for DDE 'DTC_b_TP1_SensorHV'. */
/begin MEASUREMENT DTC_b_TP1_SensorHV "DTC126" UBYTE CU_DTC_B_TP1_SENSORHV 1 100 0.0 1.0 ECU_ADDRESS 0x40002f91 BYTE_ORDER MSB_FIRST /end MEASUREMENT
/begin COMPU_METHOD CU_DTC_B_TP1_SENSORHV "Conversion method for DTC_b_TP1_SensorHV" RAT_FUNC "%10.0" "b" COEFFS 0.000000 1.000000 0.000000 0.000000 0.000000 1.000000 /end COMPU_METHOD
/* Scalar measurable for DDE 'DTC_b_TP1_SensorLV'. */
/begin MEASUREMENT DTC_b_TP1_SensorLV "DTC124" UBYTE CU_DTC_B_TP1_SENSORLV 1 100 0.0 1.0 ECU_ADDRESS 0x40002f92 BYTE_ORDER MSB_FIRST /end MEASUREMENT
/begin COMPU_METHOD CU_DTC_B_TP1_SENSORLV "Conversion method for DTC_b_TP1_SensorLV" RAT_FUNC "%10.0" "b" COEFFS 0.000000 1.000000 0.000000 0.000000 0.000000 1.000000 /end COMPU_METHOD
/* Scalar measurable for DDE 'DTC_b_TP2_SensorHV'. */
/begin MEASUREMENT DTC_b_TP2_SensorHV "DTC127" UBYTE CU_DTC_B_TP2_SENSORHV 1 100 0.0 1.0 ECU_ADDRESS 0x40002f8d BYTE_ORDER MSB_FIRST /end MEASUREMENT
/begin COMPU_METHOD CU_DTC_B_TP2_SENSORHV "Conversion method for DTC_b_TP2_SensorHV" RAT_FUNC "%10.0" "b" COEFFS 0.000000 1.000000 0.000000 0.000000 0.000000 1.000000 /end COMPU_METHOD
/* Scalar measurable for DDE 'DTC_b_TP2_SensorLV'. */
/begin MEASUREMENT DTC_b_TP2_SensorLV "DTC125" UBYTE CU_DTC_B_TP2_SENSORLV 1 100 0.0 1.0 ECU_ADDRESS 0x40002f8e BYTE_ORDER MSB_FIRST /end MEASUREMENT
/begin COMPU_METHOD CU_DTC_B_TP2_SENSORLV "Conversion method for DTC_b_TP2_SensorLV" RAT_FUNC "%10.0" "b" COEFFS 0.000000 1.000000 0.000000 0.000000 0.000000 1.000000 /end COMPU_METHOD
/* Scalar measurable for DDE 'DTC_b_TP_CorrFLT'. */
/begin MEASUREMENT DTC_b_TP_CorrFLT "DTC128" UBYTE CU_DTC_B_TP_CORRFLT 1 100 0.0 1.0 ECU_ADDRESS 0x40002ea1 BYTE_ORDER MSB_FIRST /end MEASUREMENT
/begin COMPU_METHOD CU_DTC_B_TP_CORRFLT "Conversion method for DTC_b_TP_CorrFLT" RAT_FUNC "%10.0" "b" COEFFS 0.000000 1.000000 0.000000 0.000000 0.000000 1.000000 /end COMPU_METHOD
/* Scalar measurable for DDE 'DTC_b_TurboError'. */
/begin MEASUREMENT DTC_b_TurboError "DTC" UBYTE CU_DTC_B_TURBOERROR 1 100 0.0 1.0 ECU_ADDRESS 0x40002e8f BYTE_ORDER MSB_FIRST /end MEASUREMENT
/begin COMPU_METHOD CU_DTC_B_TURBOERROR "Conversion method for DTC_b_TurboError" RAT_FUNC "%10.0" "b" COEFFS 0.000000 1.000000 0.000000 0.000000 0.000000 1.000000 /end COMPU_METHOD
/* Scalar measurable for DDE 'DTC_s_BegasTime'. */
/begin MEASUREMENT DTC_s_BegasTime "(not defined)" FLOAT32_IEEE CU_DTC_S_BEGASTIME 1 100 0.0 100000.0 ECU_ADDRESS 0x4000396c BYTE_ORDER MSB_FIRST /end MEASUREMENT
/begin COMPU_METHOD CU_DTC_S_BEGASTIME "Conversion method for DTC_s_BegasTime" RAT_FUNC "%10.0" "s" COEFFS 0.000000 1.000000 0.000000 0.000000 0.000000 1.000000 /end COMPU_METHOD
/* Scalar measurable for DDE 'DTC_s_TimerOut_1'. */
/begin MEASUREMENT DTC_s_TimerOut_1 "timer salida" FLOAT32_IEEE CU_DTC_S_TIMEROUT_1 1 100 0.0 10000000.0 ECU_ADDRESS 0x40003918 BYTE_ORDER MSB_FIRST /end MEASUREMENT
/begin COMPU_METHOD CU_DTC_S_TIMEROUT_1 "Conversion method for DTC_s_TimerOut_1" RAT_FUNC "%10.2" "s" COEFFS 0.000000 1.000000 0.000000 0.000000 0.000000 1.000000 /end COMPU_METHOD
/* Scalar measurable for DDE 'DTC_s_TimerOut_2'. */
/begin MEASUREMENT DTC_s_TimerOut_2 "timer salida" FLOAT32_IEEE CU_DTC_S_TIMEROUT_2 1 100 0.0 10000000.0 ECU_ADDRESS 0x4000391c BYTE_ORDER MSB_FIRST /end MEASUREMENT
/begin COMPU_METHOD CU_DTC_S_TIMEROUT_2 "Conversion method for DTC_s_TimerOut_2" RAT_FUNC "%10.2" "s" COEFFS 0.000000 1.000000 0.000000 0.000000 0.000000 1.000000 /end COMPU_METHOD
/* Scalar measurable for DDE 'EFP_NU_FuelPumpErrROC'. */
/begin MEASUREMENT EFP_NU_FuelPumpErrROC "(bar/s) Time derivative of position error" FLOAT32_IEEE CU_EFP_NU_FUELPUMPERRROC 1 100 -100.0 100.0 ECU_ADDRESS 0x400036d8 BYTE_ORDER MSB_FIRST /end MEASUREMENT
/begin COMPU_METHOD CU_EFP_NU_FUELPUMPERRROC "Conversion method for EFP_NU_FuelPumpErrROC" RAT_FUNC "%10.3" "NU" COEFFS 0.000000 1.000000 0.000000 0.000000 0.000000 1.000000 /end COMPU_METHOD
/* Scalar measurable for DDE 'EFP_b_FuelPumpDC'. */
/begin MEASUREMENT EFP_b_FuelPumpDC "PWM Signal percentage for Monitoring" FLOAT32_IEEE CU_EFP_B_FUELPUMPDC 1 100 0.0 1.0 ECU_ADDRESS 0x400036c8 BYTE_ORDER MSB_FIRST /end MEASUREMENT
/begin COMPU_METHOD CU_EFP_B_FUELPUMPDC "Conversion method for EFP_b_FuelPumpDC" RAT_FUNC "%10.2" "pct" COEFFS 0.000000 1.000000 0.000000 0.000000 0.000000 1.000000 /end COMPU_METHOD
/* Scalar measurable for DDE 'EFP_b_NotStalled'. */
/begin MEASUREMENT EFP_b_NotStalled "Displayable" UBYTE CU_EFP_B_NOTSTALLED 1 100 0.0 1.0 ECU_ADDRESS 0x40002f28 BYTE_ORDER MSB_FIRST /end MEASUREMENT
/begin COMPU_METHOD CU_EFP_B_NOTSTALLED "Conversion method for EFP_b_NotStalled" RAT_FUNC "%10.0" "b" COEFFS 0.000000 1.000000 0.000000 0.000000 0.000000 1.000000 /end COMPU_METHOD
/* Scalar measurable for DDE 'EFP_b_RunFuelPump'. */
/begin MEASUREMENT EFP_b_RunFuelPump "Displayable" UBYTE CU_EFP_B_RUNFUELPUMP 1 100 0.0 1.0 ECU_ADDRESS 0x40002f27 BYTE_ORDER MSB_FIRST /end MEASUREMENT
/begin COMPU_METHOD CU_EFP_B_RUNFUELPUMP "Conversion method for EFP_b_RunFuelPump" RAT_FUNC "%10.0" "b" COEFFS 0.000000 1.000000 0.000000 0.000000 0.000000 1.000000 /end COMPU_METHOD
/* Scalar measurable for DDE 'EFP_bar_PressErr'. */
/begin MEASUREMENT EFP_bar_PressErr "Fuel pressure error" FLOAT32_IEEE CU_EFP_BAR_PRESSERR 1 100 -100.0 100.0 ECU_ADDRESS 0x400036e4 BYTE_ORDER MSB_FIRST /end MEASUREMENT
/begin COMPU_METHOD CU_EFP_BAR_PRESSERR "Conversion method for EFP_bar_PressErr" RAT_FUNC "%10.3" "NU" COEFFS 0.000000 1.000000 0.000000 0.000000 0.000000 1.000000 /end COMPU_METHOD
/* Scalar measurable for DDE 'EFP_pct_FuelPumpDC_PID'. */
/begin MEASUREMENT EFP_pct_FuelPumpDC_PID "Feedback control effort for  FuelPump" FLOAT32_IEEE CU_EFP_PCT_FUELPUMPDC_PID 1 100 0.0 1.0 ECU_ADDRESS 0x400036cc BYTE_ORDER MSB_FIRST /end MEASUREMENT
/begin COMPU_METHOD CU_EFP_PCT_FUELPUMPDC_PID "Conversion method for EFP_pct_FuelPumpDC_PID" RAT_FUNC "%10.3" "NU" COEFFS 0.000000 1.000000 0.000000 0.000000 0.000000 1.000000 /end COMPU_METHOD
/* Scalar measurable for DDE 'EFP_pct_FuelPumpDTerm'. */
/begin MEASUREMENT EFP_pct_FuelPumpDTerm "Derivative effort for  FuelPump" FLOAT32_IEEE CU_EFP_PCT_FUELPUMPDTERM 1 100 -1.0 1.0 ECU_ADDRESS 0x400036d4 BYTE_ORDER MSB_FIRST /end MEASUREMENT
/begin COMPU_METHOD CU_EFP_PCT_FUELPUMPDTERM "Conversion method for EFP_pct_FuelPumpDTerm" RAT_FUNC "%10.3" "NU" COEFFS 0.000000 1.000000 0.000000 0.000000 0.000000 1.000000 /end COMPU_METHOD
/* Scalar measurable for DDE 'EFP_pct_FuelPumpITerm'. */
/begin MEASUREMENT EFP_pct_FuelPumpITerm "Integral effort for  FuelPump" FLOAT32_IEEE CU_EFP_PCT_FUELPUMPITERM 1 100 -1.0 1.0 ECU_ADDRESS 0x400036dc BYTE_ORDER MSB_FIRST /end MEASUREMENT
/begin COMPU_METHOD CU_EFP_PCT_FUELPUMPITERM "Conversion method for EFP_pct_FuelPumpITerm" RAT_FUNC "%10.3" "NU" COEFFS 0.000000 1.000000 0.000000 0.000000 0.000000 1.000000 /end COMPU_METHOD
/* Scalar measurable for DDE 'EFP_pct_FuelPumpPIDRaw'. */
/begin MEASUREMENT EFP_pct_FuelPumpPIDRaw "FuelPump PID effort raw" FLOAT32_IEEE CU_EFP_PCT_FUELPUMPPIDRAW 1 100 -1.0 1.0 ECU_ADDRESS 0x400036d0 BYTE_ORDER MSB_FIRST /end MEASUREMENT
/begin COMPU_METHOD CU_EFP_PCT_FUELPUMPPIDRAW "Conversion method for EFP_pct_FuelPumpPIDRaw" RAT_FUNC "%10.3" "NU" COEFFS 0.000000 1.000000 0.000000 0.000000 0.000000 1.000000 /end COMPU_METHOD
/* Scalar measurable for DDE 'EFP_pct_FuelPumpPTerm'. */
/begin MEASUREMENT EFP_pct_FuelPumpPTerm "Proportional effort" FLOAT32_IEEE CU_EFP_PCT_FUELPUMPPTERM 1 100 0.0 1.0 ECU_ADDRESS 0x400036e0 BYTE_ORDER MSB_FIRST /end MEASUREMENT
/begin COMPU_METHOD CU_EFP_PCT_FUELPUMPPTERM "Conversion method for EFP_pct_FuelPumpPTerm" RAT_FUNC "%10.3" "NU" COEFFS 0.000000 1.000000 0.000000 0.000000 0.000000 1.000000 /end COMPU_METHOD
/* Scalar measurable for DDE 'ELM_Nm_AlternatorTq'. */
/begin MEASUREMENT ELM_Nm_AlternatorTq "Alternator load torque value" FLOAT32_IEEE CU_ELM_NM_ALTERNATORTQ 1 100 0.0 0.0 ECU_ADDRESS 0x400035b4 BYTE_ORDER MSB_FIRST /end MEASUREMENT
/begin COMPU_METHOD CU_ELM_NM_ALTERNATORTQ "Conversion method for ELM_Nm_AlternatorTq" RAT_FUNC "%10.2" "Nm" COEFFS 0.000000 1.000000 0.000000 0.000000 0.000000 1.000000 /end COMPU_METHOD
/* Scalar measurable for DDE 'ELM_Nm_FrictionTq'. */
/begin MEASUREMENT ELM_Nm_FrictionTq "Friction torque value" FLOAT32_IEEE CU_ELM_NM_FRICTIONTQ 1 100 0.0 0.0 ECU_ADDRESS 0x40003580 BYTE_ORDER MSB_FIRST /end MEASUREMENT
/begin COMPU_METHOD CU_ELM_NM_FRICTIONTQ "Conversion method for ELM_Nm_FrictionTq" RAT_FUNC "%10.2" "Nm" COEFFS 0.000000 1.000000 0.000000 0.000000 0.000000 1.000000 /end COMPU_METHOD
/* Scalar measurable for DDE 'ELM_Nm_HVAC_Tq'. */
/begin MEASUREMENT ELM_Nm_HVAC_Tq "HVAC load torque value" FLOAT32_IEEE CU_ELM_NM_HVAC_TQ 1 100 0.0 0.0 ECU_ADDRESS 0x40003588 BYTE_ORDER MSB_FIRST /end MEASUREMENT
/begin COMPU_METHOD CU_ELM_NM_HVAC_TQ "Conversion method for ELM_Nm_HVAC_Tq" RAT_FUNC "%10.2" "Nm" COEFFS 0.000000 1.000000 0.000000 0.000000 0.000000 1.000000 /end COMPU_METHOD
/* Scalar measurable for DDE 'ELM_Nm_PwrStrTq'. */
/begin MEASUREMENT ELM_Nm_PwrStrTq "Power steering load torque value" FLOAT32_IEEE CU_ELM_NM_PWRSTRTQ 1 100 0.0 0.0 ECU_ADDRESS 0x40003584 BYTE_ORDER MSB_FIRST /end MEASUREMENT
/begin COMPU_METHOD CU_ELM_NM_PWRSTRTQ "Conversion method for ELM_Nm_PwrStrTq" RAT_FUNC "%10.2" "Nm" COEFFS 0.000000 1.000000 0.000000 0.000000 0.000000 1.000000 /end COMPU_METHOD
/* Scalar measurable for DDE 'ELM_Nm_Tq'. */
/begin MEASUREMENT ELM_Nm_Tq "Total engine load torque" FLOAT32_IEEE CU_ELM_NM_TQ 1 100 0.0 0.0 ECU_ADDRESS 0x40003574 BYTE_ORDER MSB_FIRST /end MEASUREMENT
/begin COMPU_METHOD CU_ELM_NM_TQ "Conversion method for ELM_Nm_Tq" RAT_FUNC "%10.2" "Nm" COEFFS 0.000000 1.000000 0.000000 0.000000 0.000000 1.000000 /end COMPU_METHOD
/* Scalar measurable for DDE 'ELM_Nm_ZFFAN_Tq'. */
/begin MEASUREMENT ELM_Nm_ZFFAN_Tq "Fuel pump load torque value" FLOAT32_IEEE CU_ELM_NM_ZFFAN_TQ 1 100 0.0 0.0 ECU_ADDRESS 0x4000357c BYTE_ORDER MSB_FIRST /end MEASUREMENT
/begin COMPU_METHOD CU_ELM_NM_ZFFAN_TQ "Conversion method for ELM_Nm_ZFFAN_Tq" RAT_FUNC "%10.2" "Nm" COEFFS 0.000000 1.000000 0.000000 0.000000 0.000000 1.000000 /end COMPU_METHOD
/* Scalar measurable for DDE 'ERL_RPM_HardLim'. */
/begin MEASUREMENT ERL_RPM_HardLim "Hard engine speed limit" FLOAT32_IEEE CU_ERL_RPM_HARDLIM 1 100 0.0 0.0 ECU_ADDRESS 0x4000356c BYTE_ORDER MSB_FIRST /end MEASUREMENT
/begin COMPU_METHOD CU_ERL_RPM_HARDLIM "Conversion method for ERL_RPM_HardLim" RAT_FUNC "%10.0" "RPM" COEFFS 0.000000 1.000000 0.000000 0.000000 0.000000 1.000000 /end COMPU_METHOD
/* Scalar measurable for DDE 'ERL_RPM_Overspd'. */
/begin MEASUREMENT ERL_RPM_Overspd "Engine over speed" FLOAT32_IEEE CU_ERL_RPM_OVERSPD 1 100 0.0 0.0 ECU_ADDRESS 0x40003568 BYTE_ORDER MSB_FIRST /end MEASUREMENT
/begin COMPU_METHOD CU_ERL_RPM_OVERSPD "Conversion method for ERL_RPM_Overspd" RAT_FUNC "%10.0" "RPM" COEFFS 0.000000 1.000000 0.000000 0.000000 0.000000 1.000000 /end COMPU_METHOD
/* Scalar measurable for DDE 'ERL_b_Active'. */
/begin MEASUREMENT ERL_b_Active "Engine speed limiting active flag" UBYTE CU_ERL_B_ACTIVE 1 100 0.0 1.0 ECU_ADDRESS 0x40002ecc BYTE_ORDER MSB_FIRST /end MEASUREMENT
/begin COMPU_METHOD CU_ERL_B_ACTIVE "Conversion method for ERL_b_Active" RAT_FUNC "%10.0" "b" COEFFS 0.000000 1.000000 0.000000 0.000000 0.000000 1.000000 /end COMPU_METHOD
/* Scalar measurable for DDE 'ERL_b_CutFuel'. */
/begin MEASUREMENT ERL_b_CutFuel "Engine speed limited fuel cut command" UBYTE CU_ERL_B_CUTFUEL 1 100 0.0 1.0 ECU_ADDRESS 0x40002ece BYTE_ORDER MSB_FIRST /end MEASUREMENT
/begin COMPU_METHOD CU_ERL_B_CUTFUEL "Conversion method for ERL_b_CutFuel" RAT_FUNC "%10.0" "b" COEFFS 0.000000 1.000000 0.000000 0.000000 0.000000 1.000000 /end COMPU_METHOD
/* Scalar measurable for DDE 'ERL_b_CutSpark'. */
/begin MEASUREMENT ERL_b_CutSpark "Engine speed limited spark cut command" UBYTE CU_ERL_B_CUTSPARK 1 100 0.0 1.0 ECU_ADDRESS 0x40002e92 BYTE_ORDER MSB_FIRST /end MEASUREMENT
/begin COMPU_METHOD CU_ERL_B_CUTSPARK "Conversion method for ERL_b_CutSpark" RAT_FUNC "%10.0" "b" COEFFS 0.000000 1.000000 0.000000 0.000000 0.000000 1.000000 /end COMPU_METHOD
/* Scalar measurable for DDE 'ERL_b_HardLimReached'. */
/begin MEASUREMENT ERL_b_HardLimReached "Hard engine speed limit reached" UBYTE CU_ERL_B_HARDLIMREACHED 1 100 0.0 1.0 ECU_ADDRESS 0x40002ed2 BYTE_ORDER MSB_FIRST /end MEASUREMENT
/begin COMPU_METHOD CU_ERL_B_HARDLIMREACHED "Conversion method for ERL_b_HardLimReached" RAT_FUNC "%10.0" "b" COEFFS 0.000000 1.000000 0.000000 0.000000 0.000000 1.000000 /end COMPU_METHOD
/* Scalar measurable for DDE 'ERL_pct_PTerm'. */
/begin MEASUREMENT ERL_pct_PTerm "Torque demand multiplier for proportional speed limiting" FLOAT32_IEEE CU_ERL_PCT_PTERM 1 100 0.0 0.0 ECU_ADDRESS 0x40003564 BYTE_ORDER MSB_FIRST /end MEASUREMENT
/begin COMPU_METHOD CU_ERL_PCT_PTERM "Conversion method for ERL_pct_PTerm" RAT_FUNC "%10.2" "pct" COEFFS 0.000000 1.000000 0.000000 0.000000 0.000000 1.000000 /end COMPU_METHOD
/* Scalar measurable for DDE 'ERL_pct_TqMult'. */
/begin MEASUREMENT ERL_pct_TqMult "Final torque demand multiplier" FLOAT32_IEEE CU_ERL_PCT_TQMULT 1 100 0.0 0.0 ECU_ADDRESS 0x40003560 BYTE_ORDER MSB_FIRST /end MEASUREMENT
/begin COMPU_METHOD CU_ERL_PCT_TQMULT "Conversion method for ERL_pct_TqMult" RAT_FUNC "%10.2" "pct" COEFFS 0.000000 1.000000 0.000000 0.000000 0.000000 1.000000 /end COMPU_METHOD
/* Scalar measurable for DDE 'ERL_ret_SparkRetard'. */
/begin MEASUREMENT ERL_ret_SparkRetard "Engine speed limiting spark retard angle" FLOAT32_IEEE CU_ERL_RET_SPARKRETARD 1 100 0.0 0.0 ECU_ADDRESS 0x40003454 BYTE_ORDER MSB_FIRST /end MEASUREMENT
/begin COMPU_METHOD CU_ERL_RET_SPARKRETARD "Conversion method for ERL_ret_SparkRetard" RAT_FUNC "%10.0" "ret" COEFFS 0.000000 1.000000 0.000000 0.000000 0.000000 1.000000 /end COMPU_METHOD
/* Scalar measurable for DDE 'ERM_e_RunningMode'. */
/begin MEASUREMENT ERM_e_RunningMode "Displayable" UBYTE CU_ERM_E_RUNNINGMODE 1 100 0.0 0.0 ECU_ADDRESS 0x40002fe8 BYTE_ORDER MSB_FIRST /end MEASUREMENT
/begin COMPU_METHOD CU_ERM_E_RUNNINGMODE "Conversion method for ERM_e_RunningMode" TAB_VERB "%12.0" "e" COMPU_TAB_REF CT_ERM_E_RUNNINGMODE /end COMPU_METHOD
/begin COMPU_VTAB CT_ERM_E_RUNNINGMODE "Conversion method for ERM_e_RunningMode" TAB_VERB 5 0 "ERMk_e_Stopped" 1 "ERMk_e_Stalled" 2 "ERMk_e_Cranking" 3 "ERMk_e_360_Mode" 4 "ERMk_e_Running" /end COMPU_VTAB
/* Scalar measurable for DDE 'ERM_s_TimeSinceStart'. */
/begin MEASUREMENT ERM_s_TimeSinceStart "Displayable" FLOAT32_IEEE CU_ERM_S_TIMESINCESTART 1 100 0.0 0.0 ECU_ADDRESS 0x400035bc BYTE_ORDER MSB_FIRST /end MEASUREMENT
/begin COMPU_METHOD CU_ERM_S_TIMESINCESTART "Conversion method for ERM_s_TimeSinceStart" RAT_FUNC "%10.0" "s" COEFFS 0.000000 1.000000 0.000000 0.000000 0.000000 1.000000 /end COMPU_METHOD
/* Scalar measurable for DDE 'ETC_NU_DTerm'. */
/begin MEASUREMENT ETC_NU_DTerm "Displayable" FLOAT32_IEEE CU_ETC_NU_DTERM 1 100 0.0 0.0 ECU_ADDRESS 0x40003188 BYTE_ORDER MSB_FIRST /end MEASUREMENT
/begin COMPU_METHOD CU_ETC_NU_DTERM "Conversion method for ETC_NU_DTerm" RAT_FUNC "%10.3" "NU" COEFFS 0.000000 1.000000 0.000000 0.000000 0.000000 1.000000 /end COMPU_METHOD
/* Scalar measurable for DDE 'ETC_NU_Error_Int'. */
/begin MEASUREMENT ETC_NU_Error_Int "(not defined)" FLOAT32_IEEE CU_ETC_NU_ERROR_INT 1 100 -1000.0 1000.0 ECU_ADDRESS 0x40003170 BYTE_ORDER MSB_FIRST /end MEASUREMENT
/begin COMPU_METHOD CU_ETC_NU_ERROR_INT "Conversion method for ETC_NU_Error_Int" RAT_FUNC "%10.2" "NU" COEFFS 0.000000 1.000000 0.000000 0.000000 0.000000 1.000000 /end COMPU_METHOD
/* Scalar measurable for DDE 'ETC_NU_ITerm'. */
/begin MEASUREMENT ETC_NU_ITerm "Displayable" FLOAT32_IEEE CU_ETC_NU_ITERM 1 100 0.0 0.0 ECU_ADDRESS 0x40003178 BYTE_ORDER MSB_FIRST /end MEASUREMENT
/begin COMPU_METHOD CU_ETC_NU_ITERM "Conversion method for ETC_NU_ITerm" RAT_FUNC "%10.3" "NU" COEFFS 0.000000 1.000000 0.000000 0.000000 0.000000 1.000000 /end COMPU_METHOD
/* Scalar measurable for DDE 'ETC_NU_PTerm'. */
/begin MEASUREMENT ETC_NU_PTerm "Displayable" FLOAT32_IEEE CU_ETC_NU_PTERM 1 100 0.0 0.0 ECU_ADDRESS 0x40003194 BYTE_ORDER MSB_FIRST /end MEASUREMENT
/begin COMPU_METHOD CU_ETC_NU_PTERM "Conversion method for ETC_NU_PTerm" RAT_FUNC "%10.3" "NU" COEFFS 0.000000 1.000000 0.000000 0.000000 0.000000 1.000000 /end COMPU_METHOD
/* Scalar measurable for DDE 'ETC_NU_TP1_FullPos'. */
/begin MEASUREMENT ETC_NU_TP1_FullPos "Displayable" FLOAT32_IEEE CU_ETC_NU_TP1_FULLPOS 1 100 0.0 0.0 ECU_ADDRESS 0x40003360 BYTE_ORDER MSB_FIRST /end MEASUREMENT
/begin COMPU_METHOD CU_ETC_NU_TP1_FULLPOS "Conversion method for ETC_NU_TP1_FullPos" RAT_FUNC "%10.3" "NU" COEFFS 0.000000 1.000000 0.000000 0.000000 0.000000 1.000000 /end COMPU_METHOD
/* Scalar measurable for DDE 'ETC_NU_TP1_Slow'. */
/begin MEASUREMENT ETC_NU_TP1_Slow "Result of lowspeed filter for TP endstop learning" FLOAT32_IEEE CU_ETC_NU_TP1_SLOW 1 100 0.0 0.0 ECU_ADDRESS 0x40003368 BYTE_ORDER MSB_FIRST /end MEASUREMENT
/begin COMPU_METHOD CU_ETC_NU_TP1_SLOW "Conversion method for ETC_NU_TP1_Slow" RAT_FUNC "%10.3" "NU" COEFFS 0.000000 1.000000 0.000000 0.000000 0.000000 1.000000 /end COMPU_METHOD
/* Scalar measurable for DDE 'ETC_NU_TP1_ZeroPos'. */
/begin MEASUREMENT ETC_NU_TP1_ZeroPos "Displayable" FLOAT32_IEEE CU_ETC_NU_TP1_ZEROPOS 1 100 0.0 0.0 ECU_ADDRESS 0x40003364 BYTE_ORDER MSB_FIRST /end MEASUREMENT
/begin COMPU_METHOD CU_ETC_NU_TP1_ZEROPOS "Conversion method for ETC_NU_TP1_ZeroPos" RAT_FUNC "%10.3" "NU" COEFFS 0.000000 1.000000 0.000000 0.000000 0.000000 1.000000 /end COMPU_METHOD
/* Scalar measurable for DDE 'ETC_NU_TP2_FullPos'. */
/begin MEASUREMENT ETC_NU_TP2_FullPos "Displayable" FLOAT32_IEEE CU_ETC_NU_TP2_FULLPOS 1 100 0.0 0.0 ECU_ADDRESS 0x40003354 BYTE_ORDER MSB_FIRST /end MEASUREMENT
/begin COMPU_METHOD CU_ETC_NU_TP2_FULLPOS "Conversion method for ETC_NU_TP2_FullPos" RAT_FUNC "%10.3" "NU" COEFFS 0.000000 1.000000 0.000000 0.000000 0.000000 1.000000 /end COMPU_METHOD
/* Scalar measurable for DDE 'ETC_NU_TP2_Slow'. */
/begin MEASUREMENT ETC_NU_TP2_Slow "Result of lowspeed filter for TP endstop learning" FLOAT32_IEEE CU_ETC_NU_TP2_SLOW 1 100 0.0 0.0 ECU_ADDRESS 0x40003374 BYTE_ORDER MSB_FIRST /end MEASUREMENT
/begin COMPU_METHOD CU_ETC_NU_TP2_SLOW "Conversion method for ETC_NU_TP2_Slow" RAT_FUNC "%10.3" "NU" COEFFS 0.000000 1.000000 0.000000 0.000000 0.000000 1.000000 /end COMPU_METHOD
/* Scalar measurable for DDE 'ETC_NU_TP2_ZeroPos'. */
/begin MEASUREMENT ETC_NU_TP2_ZeroPos "Displayable" FLOAT32_IEEE CU_ETC_NU_TP2_ZEROPOS 1 100 0.0 0.0 ECU_ADDRESS 0x40003358 BYTE_ORDER MSB_FIRST /end MEASUREMENT
/begin COMPU_METHOD CU_ETC_NU_TP2_ZEROPOS "Conversion method for ETC_NU_TP2_ZeroPos" RAT_FUNC "%10.3" "NU" COEFFS 0.000000 1.000000 0.000000 0.000000 0.000000 1.000000 /end COMPU_METHOD
/* Scalar measurable for DDE 'ETC_NU_TPRate'. */
/begin MEASUREMENT ETC_NU_TPRate "Displayable" FLOAT32_IEEE CU_ETC_NU_TPRATE 1 100 0.0 0.0 ECU_ADDRESS 0x4000336c BYTE_ORDER MSB_FIRST /end MEASUREMENT
/begin COMPU_METHOD CU_ETC_NU_TPRATE "Conversion method for ETC_NU_TPRate" RAT_FUNC "%10.3" "NU" COEFFS 0.000000 1.000000 0.000000 0.000000 0.000000 1.000000 /end COMPU_METHOD
/* Scalar measurable for DDE 'ETC_NU_TP_Dot'. */
/begin MEASUREMENT ETC_NU_TP_Dot "(V/s) Raw TPS rate of change" FLOAT32_IEEE CU_ETC_NU_TP_DOT 1 100 0.0 0.0 ECU_ADDRESS 0x40003038 BYTE_ORDER MSB_FIRST /end MEASUREMENT
/begin COMPU_METHOD CU_ETC_NU_TP_DOT "Conversion method for ETC_NU_TP_Dot" RAT_FUNC "%10.2" "NU" COEFFS 0.000000 1.000000 0.000000 0.000000 0.000000 1.000000 /end COMPU_METHOD
/* Scalar measurable for DDE 'ETC_b_AuthorityReduced'. */
/begin MEASUREMENT ETC_b_AuthorityReduced "Flag to indicate to other features that ETC cannot currently provide high-precision position control" UBYTE CU_ETC_B_AUTHORITYREDUCED 1 100 0.0 1.0 ECU_ADDRESS 0x40002e81 BYTE_ORDER MSB_FIRST /end MEASUREMENT
/begin COMPU_METHOD CU_ETC_B_AUTHORITYREDUCED "Conversion method for ETC_b_AuthorityReduced" RAT_FUNC "%10.0" "b" COEFFS 0.000000 1.000000 0.000000 0.000000 0.000000 1.000000 /end COMPU_METHOD
/* Scalar measurable for DDE 'ETC_b_CloseComplete'. */
/begin MEASUREMENT ETC_b_CloseComplete "Displayable" UBYTE CU_ETC_B_CLOSECOMPLETE 1 100 0.0 1.0 ECU_ADDRESS 0x40002fe1 BYTE_ORDER MSB_FIRST /end MEASUREMENT
/begin COMPU_METHOD CU_ETC_B_CLOSECOMPLETE "Conversion method for ETC_b_CloseComplete" RAT_FUNC "%10.0" "b" COEFFS 0.000000 1.000000 0.000000 0.000000 0.000000 1.000000 /end COMPU_METHOD
/* Scalar measurable for DDE 'ETC_b_Expired'. */
/begin MEASUREMENT ETC_b_Expired "Displayable" UBYTE CU_ETC_B_EXPIRED 1 100 0.0 1.0 ECU_ADDRESS 0x40002ea6 BYTE_ORDER MSB_FIRST /end MEASUREMENT
/begin COMPU_METHOD CU_ETC_B_EXPIRED "Conversion method for ETC_b_Expired" RAT_FUNC "%10.0" "b" COEFFS 0.000000 1.000000 0.000000 0.000000 0.000000 1.000000 /end COMPU_METHOD
/* Scalar measurable for DDE 'ETC_b_ForceClosed'. */
/begin MEASUREMENT ETC_b_ForceClosed "Displayable" UBYTE CU_ETC_B_FORCECLOSED 1 100 0.0 1.0 ECU_ADDRESS 0x40002e71 BYTE_ORDER MSB_FIRST /end MEASUREMENT
/begin COMPU_METHOD CU_ETC_B_FORCECLOSED "Conversion method for ETC_b_ForceClosed" RAT_FUNC "%10.0" "b" COEFFS 0.000000 1.000000 0.000000 0.000000 0.000000 1.000000 /end COMPU_METHOD
/* Scalar measurable for DDE 'ETC_b_ForceOpen'. */
/begin MEASUREMENT ETC_b_ForceOpen "Displayable" UBYTE CU_ETC_B_FORCEOPEN 1 100 0.0 1.0 ECU_ADDRESS 0x40002e72 BYTE_ORDER MSB_FIRST /end MEASUREMENT
/begin COMPU_METHOD CU_ETC_B_FORCEOPEN "Conversion method for ETC_b_ForceOpen" RAT_FUNC "%10.0" "b" COEFFS 0.000000 1.000000 0.000000 0.000000 0.000000 1.000000 /end COMPU_METHOD
/* Scalar measurable for DDE 'ETC_b_LearnReady'. */
/begin MEASUREMENT ETC_b_LearnReady "Displayable" UBYTE CU_ETC_B_LEARNREADY 1 100 0.0 1.0 ECU_ADDRESS 0x40002eaa BYTE_ORDER MSB_FIRST /end MEASUREMENT
/begin COMPU_METHOD CU_ETC_B_LEARNREADY "Conversion method for ETC_b_LearnReady" RAT_FUNC "%10.0" "b" COEFFS 0.000000 1.000000 0.000000 0.000000 0.000000 1.000000 /end COMPU_METHOD
/* Scalar measurable for DDE 'ETC_b_LearnRest'. */
/begin MEASUREMENT ETC_b_LearnRest "Displayable" UBYTE CU_ETC_B_LEARNREST 1 100 0.0 1.0 ECU_ADDRESS 0x40002ea7 BYTE_ORDER MSB_FIRST /end MEASUREMENT
/begin COMPU_METHOD CU_ETC_B_LEARNREST "Conversion method for ETC_b_LearnRest" RAT_FUNC "%10.0" "b" COEFFS 0.000000 1.000000 0.000000 0.000000 0.000000 1.000000 /end COMPU_METHOD
/* Scalar measurable for DDE 'ETC_b_LearnSequenceFailed'. */
/begin MEASUREMENT ETC_b_LearnSequenceFailed "Displayable" UBYTE CU_ETC_B_LEARNSEQUENCEFAILED 1 100 0.0 1.0 ECU_ADDRESS 0x40002e6f BYTE_ORDER MSB_FIRST /end MEASUREMENT
/begin COMPU_METHOD CU_ETC_B_LEARNSEQUENCEFAILED "Conversion method for ETC_b_LearnSequenceFailed" RAT_FUNC "%10.0" "b" COEFFS 0.000000 1.000000 0.000000 0.000000 0.000000 1.000000 /end COMPU_METHOD
/* Scalar measurable for DDE 'ETC_b_LearnSequenceSuccess'. */
/begin MEASUREMENT ETC_b_LearnSequenceSuccess "Displayable" UBYTE CU_ETC_B_LEARNSEQUENCESUCCESS 1 100 0.0 1.0 ECU_ADDRESS 0x40002e70 BYTE_ORDER MSB_FIRST /end MEASUREMENT
/begin COMPU_METHOD CU_ETC_B_LEARNSEQUENCESUCCESS "Conversion method for ETC_b_LearnSequenceSuccess" RAT_FUNC "%10.0" "b" COEFFS 0.000000 1.000000 0.000000 0.000000 0.000000 1.000000 /end COMPU_METHOD
/* Scalar measurable for DDE 'ETC_b_OpenComplete'. */
/begin MEASUREMENT ETC_b_OpenComplete "Displayable" UBYTE CU_ETC_B_OPENCOMPLETE 1 100 0.0 1.0 ECU_ADDRESS 0x40002fe0 BYTE_ORDER MSB_FIRST /end MEASUREMENT
/begin COMPU_METHOD CU_ETC_B_OPENCOMPLETE "Conversion method for ETC_b_OpenComplete" RAT_FUNC "%10.0" "b" COEFFS 0.000000 1.000000 0.000000 0.000000 0.000000 1.000000 /end COMPU_METHOD
/* Scalar measurable for DDE 'ETC_b_RangeCheckFailed'. */
/begin MEASUREMENT ETC_b_RangeCheckFailed "Displayable" UBYTE CU_ETC_B_RANGECHECKFAILED 1 100 0.0 1.0 ECU_ADDRESS 0x40002ea5 BYTE_ORDER MSB_FIRST /end MEASUREMENT
/begin COMPU_METHOD CU_ETC_B_RANGECHECKFAILED "Conversion method for ETC_b_RangeCheckFailed" RAT_FUNC "%10.0" "b" COEFFS 0.000000 1.000000 0.000000 0.000000 0.000000 1.000000 /end COMPU_METHOD
/* Scalar measurable for DDE 'ETC_b_RestPosOOR'. */
/begin MEASUREMENT ETC_b_RestPosOOR "Displayable" UBYTE CU_ETC_B_RESTPOSOOR 1 100 0.0 1.0 ECU_ADDRESS 0x40002ea2 BYTE_ORDER MSB_FIRST /end MEASUREMENT
/begin COMPU_METHOD CU_ETC_B_RESTPOSOOR "Conversion method for ETC_b_RestPosOOR" RAT_FUNC "%10.0" "b" COEFFS 0.000000 1.000000 0.000000 0.000000 0.000000 1.000000 /end COMPU_METHOD
/* Scalar measurable for DDE 'ETC_b_Stable'. */
/begin MEASUREMENT ETC_b_Stable "Displayable" UBYTE CU_ETC_B_STABLE 1 100 0.0 1.0 ECU_ADDRESS 0x40002eb3 BYTE_ORDER MSB_FIRST /end MEASUREMENT
/begin COMPU_METHOD CU_ETC_B_STABLE "Conversion method for ETC_b_Stable" RAT_FUNC "%10.0" "b" COEFFS 0.000000 1.000000 0.000000 0.000000 0.000000 1.000000 /end COMPU_METHOD
/* Scalar measurable for DDE 'ETC_b_StoppedClosing'. */
/begin MEASUREMENT ETC_b_StoppedClosing "Displayable" UBYTE CU_ETC_B_STOPPEDCLOSING 1 100 0.0 1.0 ECU_ADDRESS 0x40002ea8 BYTE_ORDER MSB_FIRST /end MEASUREMENT
/begin COMPU_METHOD CU_ETC_B_STOPPEDCLOSING "Conversion method for ETC_b_StoppedClosing" RAT_FUNC "%10.0" "b" COEFFS 0.000000 1.000000 0.000000 0.000000 0.000000 1.000000 /end COMPU_METHOD
/* Scalar measurable for DDE 'ETC_b_StoppedOpening'. */
/begin MEASUREMENT ETC_b_StoppedOpening "Displayable" UBYTE CU_ETC_B_STOPPEDOPENING 1 100 0.0 1.0 ECU_ADDRESS 0x40002ea9 BYTE_ORDER MSB_FIRST /end MEASUREMENT
/begin COMPU_METHOD CU_ETC_B_STOPPEDOPENING "Conversion method for ETC_b_StoppedOpening" RAT_FUNC "%10.0" "b" COEFFS 0.000000 1.000000 0.000000 0.000000 0.000000 1.000000 /end COMPU_METHOD
/* Scalar measurable for DDE 'ETC_b_TP1_FullPosOOR'. */
/begin MEASUREMENT ETC_b_TP1_FullPosOOR "Displayable" UBYTE CU_ETC_B_TP1_FULLPOSOOR 1 100 0.0 1.0 ECU_ADDRESS 0x40002eab BYTE_ORDER MSB_FIRST /end MEASUREMENT
/begin COMPU_METHOD CU_ETC_B_TP1_FULLPOSOOR "Conversion method for ETC_b_TP1_FullPosOOR" RAT_FUNC "%10.0" "b" COEFFS 0.000000 1.000000 0.000000 0.000000 0.000000 1.000000 /end COMPU_METHOD
/* Scalar measurable for DDE 'ETC_b_TP1_LearnFull'. */
/begin MEASUREMENT ETC_b_TP1_LearnFull "Displayable" UBYTE CU_ETC_B_TP1_LEARNFULL 1 100 0.0 1.0 ECU_ADDRESS 0x40002eac BYTE_ORDER MSB_FIRST /end MEASUREMENT
/begin COMPU_METHOD CU_ETC_B_TP1_LEARNFULL "Conversion method for ETC_b_TP1_LearnFull" RAT_FUNC "%10.0" "b" COEFFS 0.000000 1.000000 0.000000 0.000000 0.000000 1.000000 /end COMPU_METHOD
/* Scalar measurable for DDE 'ETC_b_TP1_LearnZero'. */
/begin MEASUREMENT ETC_b_TP1_LearnZero "Displayable" UBYTE CU_ETC_B_TP1_LEARNZERO 1 100 0.0 1.0 ECU_ADDRESS 0x40002eb0 BYTE_ORDER MSB_FIRST /end MEASUREMENT
/begin COMPU_METHOD CU_ETC_B_TP1_LEARNZERO "Conversion method for ETC_b_TP1_LearnZero" RAT_FUNC "%10.0" "b" COEFFS 0.000000 1.000000 0.000000 0.000000 0.000000 1.000000 /end COMPU_METHOD
/* Scalar measurable for DDE 'ETC_b_TP1_ZeroPosOOR'. */
/begin MEASUREMENT ETC_b_TP1_ZeroPosOOR "Displayable" UBYTE CU_ETC_B_TP1_ZEROPOSOOR 1 100 0.0 1.0 ECU_ADDRESS 0x40002eaf BYTE_ORDER MSB_FIRST /end MEASUREMENT
/begin COMPU_METHOD CU_ETC_B_TP1_ZEROPOSOOR "Conversion method for ETC_b_TP1_ZeroPosOOR" RAT_FUNC "%10.0" "b" COEFFS 0.000000 1.000000 0.000000 0.000000 0.000000 1.000000 /end COMPU_METHOD
/* Scalar measurable for DDE 'ETC_b_TP2_FullPosOOR'. */
/begin MEASUREMENT ETC_b_TP2_FullPosOOR "Displayable" UBYTE CU_ETC_B_TP2_FULLPOSOOR 1 100 0.0 1.0 ECU_ADDRESS 0x40002ead BYTE_ORDER MSB_FIRST /end MEASUREMENT
/begin COMPU_METHOD CU_ETC_B_TP2_FULLPOSOOR "Conversion method for ETC_b_TP2_FullPosOOR" RAT_FUNC "%10.0" "b" COEFFS 0.000000 1.000000 0.000000 0.000000 0.000000 1.000000 /end COMPU_METHOD
/begin FUNCTION Signals "Group /ByType/Signals"
 /begin LOC_MEASUREMENT AIN_NU_TP2_Raw AIN_V_AmbientTemp AIN_V_Baro AIN_V_CoolantTemp AIN_V_EGO11 AIN_V_EGO12 AIN_V_EGO21 AIN_V_EGT AIN_V_ETC_MonA AIN_V_ETC_MonB AIN_V_FAPRaw AIN_V_FCV_Mon AIN_V_FiltUA_A AIN_V_FiltUA_B AIN_V_FiltUR_A AIN_V_FiltUR_B AIN_V_FuelPressRaw AIN_V_FuelTempRaw AIN_V_Highside AIN_V_KnockSignalCyl1 AIN_V_MAP_BeforeThro AIN_V_MAP_Raw AIN_V_MAP_Sample1 AIN_V_MAP_Sample10 AIN_V_MAP_Sample11 AIN_V_MAP_Sample12 AIN_V_MAP_Sample13 AIN_V_MAP_Sample14 AIN_V_MAP_Sample15 AIN_V_MAP_Sample16 AIN_V_MAP_Sample2 AIN_V_MAP_Sample3 AIN_V_MAP_Sample4 AIN_V_MAP_Sample5 AIN_V_MAP_Sample6 AIN_V_MAP_Sample7 AIN_V_MAP_Sample8 AIN_V_MAP_Sample9 AIN_V_ManifoldTemp AIN_V_TP1 AIN_V_TP2 AIN_V_UA_A AIN_V_UA_B AIN_V_UR_A AIN_V_UR_B AIN_V_VBatt AIN_V_VBattRaw AIN_V_VRefA AIN_V_VRefB AIN_V_VRefC AIN_V_VRefD AIN_V_XL1_Mon AIN_V_XM1_Mon AIN_V_Y29_Mon AIN_V_Y41_Mon AIN_V_Y42_Mon AIN_V_Y6_Mon AIN_adv_KnockWinStartAngA AIN_adv_KnockWinStopAngA AIN_b_APP1_Valid AIN_b_APP2_Valid AIN_b_AmbientTemp_Fault AIN_b_Baro_Fault AIN_b_CompOutPress_Fault AIN_b_CoolantTemp_Fault AIN_b_DC_start AIN_b_EGT_Fault AIN_b_Eng_running AIN_b_FuelPress_Fault AIN_b_FuelTemp_Fault AIN_b_IC_start AIN_b_ManifoldTemp_Fault AIN_b_TP1_Fault AIN_b_TP2_Fault AIN_b_UEGO1_Valid AIN_b_UEGO2_Valid AIN_b_UsingPeriodic AIN_b_WU_start AIN_bar_FuelPress AIN_cnt_CylIdxA AIN_cnt_CylIdxB AIN_cnt_HIP_SPI_Flts AIN_kPa_Baro AIN_kPa_CompOutPress AIN_kPa_FAP AIN_kPa_MAP AIN_kPa_OilPress AIN_lam_UEGO1 AIN_lam_UEGO2 AIN_pct_Cylinder1_Knock AIN_pct_Cylinder2_Knock AIN_pct_Cylinder3_Knock AIN_pct_Cylinder4_Knock AIN_s_DelayLambdas AMB_b_OBDTempOK AME_C_ChargeTemp AME_C_ChargeTempDelta AME_b_LearnedBaro AME_b_Transient AME_cc_ChargeVol AME_gps_FreshMassAirFlow AME_gps_IdealAirAtSTP AME_gps_MAF_Corr AME_gps_MAF_FreshMassAirFlow AME_gps_MassAirFlowUncorr AME_gps_MassAirFlowUnfiltd AME_gps_SD_FreshMassAirFlow AME_gps_SD_MassAirFlow AME_kPa_Baro AME_kPa_ChargePress AME_mg_FreshAirMass AME_mg_SD_AirMassPerCyl AME_pct_ChargeTempCF AME_pct_DemandHPF_Peak AME_pct_DmndHPF AME_pct_Load AME_pct_MAF_Ofst AME_pct_UseMAF AME_pct_VolEff APP_Nm_DrvrDmndTq APP_Nm_DrvrTqDmndRaw APP_V_APP1_Filtd APP_V_APP2_Filtd APP_V_FullLearnNewAPP1 APP_V_FullLearnNewAPP2 APP_V_ZeroLearnPosAPP1 APP_V_ZeroLearnPosAPP2 APP_b_BrakePedal_actv APP_b_CorrFlt APP_b_EEC1TorqueMode APP_b_Fault APP_b_ZeroLearnEnAPP1 APP_b_ZeroLearnEnAPP2 APP_e_PdlMode APP_kph_VehSpeed APP_pct_APP1 APP_pct_APP2 APP_pct_Dmnd APP_rpm_IN APP_rpm_OUT BAF_NU_TrgtAFR1 BAF_mg_FuelRqst1 BAF_mg_FuelRqst1Raw BAR_b_OBDPressOK BAS_adv_BaseSpark BAS_adv_CrankingSpark BAS_adv_MBT_Spark BAS_adv_MBT_SparkLowGradeFuel BAS_b_LowGradeFuel BAS_cnt_KnockEvents CAL_V_Uoffset_A CAL_V_Uoffset_B CAL_b_CalibrationModeActv_A CAL_b_CalibrationModeActv_B CAL_b_CalibrationModeRqst_A CAL_b_CalibrationModeRqst_B CIN_NU_EngOvrCtrMd_ESP CIN_NU_EngOvrCtrMd_ESP_B CIN_NU_EngOvrCtrMd_TCM CIN_NU_EngOvrCtrMd_TCM_B CIN_NU_OvrCtrMd_ESP CIN_NU_OvrCtrMd_ESP_B CIN_NU_OvrCtrMd_TCM CIN_NU_OvrCtrMd_TCM_B CIN_Nm_TqCtrRq_ESP CIN_Nm_TqCtrRq_TCM CIN_pct_TqCtrRq_ESP CIN_pct_TqCtrRq_ESP_B CIN_pct_TqCtrRq_TCM CIN_pct_TqCtrRq_TCM_B CLF_NU_DGainFast1 CLF_NU_DGainFast2 CLF_NU_DGainSlow1 CLF_NU_DGainSlow2 CLF_NU_FB1_ErrorDot CLF_NU_FB2_ErrorDot CLF_NU_IGainFast1 CLF_NU_IGainFast2 CLF_NU_IGainSlow1 CLF_NU_IGainSlow2 CLF_NU_PGainFast1 CLF_NU_PGainFast2 CLF_NU_PGainSlow1 CLF_NU_PGainSlow2 CLF_RPM_EngSpdHPF CLF_b_Dither1Active CLF_b_Dither1Lean CLF_b_Dither1Rich CLF_b_Dither2Active CLF_b_Dither2Lean CLF_b_Dither2Rich CLF_b_DitherLamErrorActv CLF_b_FB1_Active CLF_b_FB1_Enbld CLF_b_FB2_Active CLF_b_FB2_Enbld CLF_b_FastFB1 CLF_b_FastFB2 CLF_b_InitialFB1_Stable CLF_b_InitialFB2_Stable CLF_b_LTFT1_Active CLF_b_LTFT1_AdaptFlag CLF_b_LTFT2_Active CLF_b_LTFT2_AdaptFlag CLF_b_SlowFB1 CLF_b_SlowFB1_Unstable CLF_b_SlowFB2 CLF_b_SlowFB2_Unstable CLF_cnt_LeanFiringsRqst1 CLF_cnt_LeanFiringsRqst2 CLF_cnt_RichFiringsRqst1 CLF_cnt_RichFiringsRqst2 CLF_lam_DTermLPF1 CLF_lam_DTermLPF2 CLF_lam_Error1ThrshLPF CLF_lam_Error2ThrshLPF CLF_lam_FB1_Ctrl CLF_lam_FB1_Error CLF_lam_FB1_ITerm CLF_lam_FB1_PTerm CLF_lam_FB2_Ctrl CLF_lam_FB2_Error CLF_lam_FB2_ITerm CLF_lam_FB2_PTerm CLF_lam_LTFT1 CLF_lam_LTFT2 CLF_lam_O2_Dither1 CLF_lam_O2_Dither2 CLF_lam_UEGO1_DitherAvg CLF_lam_UEGO2_DitherAvg CLF_pct_LoadHPF CPL_b_CutSpark CPL_kPa_BoostDelta CPL_ret_SparkRetardRqst CRU_NU_CurrSpeed CRU_NU_LimSpeed CRU_NU_TargetSpeed CRU_V_CruiserSET CRU_b_Active CRU_b_BrakeON CRU_b_Cancel CRU_b_ClunchON CRU_b_DownSpeed CRU_b_Enable CRU_b_FootBrake CRU_b_ParkingBrake CRU_b_UpSpeed CTC_lam_FuelEnrichment CTC_lam_FuelOfst CTC_ret_SparkRqst CTC_ret_SparkRqstRaw CruiseTorqueRequestRaw_Nm Cruiser_State DFC_RPM_EntryThrsh DFC_RPM_ExitThrsh DFC_b_BurningDFC_Active DFC_b_DTC_Condition DFC_b_FuelCut DFC_e_State DFC_ret_SparkRetard DIN_Hz_MAF DIN_NU_Gear DIN_RPM_EngSpd DIN_RPM_Per720 DIN_RPM_PerCyl DIN_RPM_TOSS DIN_b_AC_PressSw DIN_b_AC_ReqSw DIN_b_Belt DIN_b_CamPhaseValid DIN_b_CamTO DIN_b_Door DIN_b_EngSync DIN_b_Ign DIN_b_MAF_To DIN_b_OilPrSw DIN_b_ParkingBrake DIN_b_PedalBrake DIN_b_RearGear DIN_b_Y13_SB_OL DIN_b_Y17_Enabled DIN_b_Y17_Fault DIN_b_Y17_OFF_OL DIN_b_Y17_ON_OL DIN_b_Y17_OV DIN_b_Y17_Reset DIN_b_Y17_SB DIN_b_Y17_SB_Tested DIN_b_Y17_SG DIN_b_Y17_SG_OL DIN_cnt_CamExtraTeeth DIN_cnt_CamMissTeeth DIN_deg_CamTooth1 DIN_deg_CamTooth2 DIN_deg_CamTooth3 DIN_deg_CamTooth4 DIN_deg_CamToothDelta DIN_e_CurrentCyl DIN_gps_MAF DIN_kph_VehSpd DIN_pct_AltLoad DIN_ret_CamPhase DRL_b_Active DRL_gps_DynoAirRqst DTC_NU_KNKButaneThr DTC_NU_TestTime DTC_b_1_boostOC DTC_b_1_lsol DTC_b_1_sb DTC_b_1_sg DTC_b_2_boostOC DTC_b_2_lsol DTC_b_2_sb DTC_b_2_sg DTC_b_3_boostOC DTC_b_3_lsol DTC_b_3_sb DTC_b_3_sg DTC_b_4_boostOC DTC_b_4_lsol DTC_b_4_sb DTC_b_4_sg DTC_b_APP1_NonValidVoltage DTC_b_APP2_NonValidVoltage DTC_b_APP_CorrFLT DTC_b_Air_HTemp DTC_b_Air_TempHV DTC_b_Air_TempLV DTC_b_BARO_ErraticValue DTC_b_BARO_PressHVoltage DTC_b_BARO_PressLVoltage DTC_b_BAT_VoltageOutofRange DTC_b_CataCounting DTC_b_Catalyst_A DTC_b_CompIAT_HTemp DTC_b_CompIAT_TempHV DTC_b_CompIAT_TempLV DTC_b_DM11Force DTC_b_DM37request DTC_b_DiagCataTemp_ena DTC_b_DiagCata_Condition DTC_b_DiagCata_Reset DTC_b_DiagCata_Set DTC_b_DiagCata_TestEnd DTC_b_ECT_HTemp DTC_b_ECT_LTemp DTC_b_ECT_TempHVoltage DTC_b_ECT_TempLVoltage DTC_b_EGT_TempHV DTC_b_EGT_TempLV DTC_b_ETC_MotorFLT DTC_b_EcuMemFault DTC_b_EnableMIsfire DTC_b_Exhaust_HTemp DTC_b_FAP_Disconected DTC_b_FAP_HPress DTC_b_FalloCamShaft DTC_b_FalloCramShaft DTC_b_GLP1_HVoltage DTC_b_GLP2_HVoltage DTC_b_GLP_HPress DTC_b_GLP_HTemp DTC_b_GLP_LPress DTC_b_GLP_LTemp DTC_b_GLP_OL DTC_b_GLP_TempHVoltage DTC_b_GLP_TempLVoltage DTC_b_HeatersA_OL DTC_b_HeatersA_SB DTC_b_HeatersA_SG DTC_b_KNOCK_Cyl1 DTC_b_KNOCK_Cyl2 DTC_b_KNOCK_Cyl3 DTC_b_KNOCK_Cyl4 DTC_b_LB11CTFail DTC_b_LB12OL DTC_b_LB12SB DTC_b_LambdaA_SB DTC_b_LambdaA_SG DTC_b_LambdaB11NOTValid DTC_b_MAPAfterThInfraPress DTC_b_MAPAfterThOverPress DTC_b_MAPAfterThr_LV DTC_b_MAPAftrThr_HV DTC_b_MAPBefThroHV DTC_b_MAPBefThroOL DTC_b_MAPBeforeThroHPress DTC_b_MAPBeforeThroLPress DTC_b_Misfire_Bancada DTC_b_Misfire_Cylinder_1 DTC_b_Misfire_Cylinder_2 DTC_b_Misfire_Cylinder_3 DTC_b_Misfire_Cylinder_4 DTC_b_NBValid DTC_b_OIL_LPress DTC_b_OIL_Sensor DTC_b_OIL_SensorOL DTC_b_Readiness DTC_b_ShutOffValveEngine_OL DTC_b_ShutOffValveEngine_SG DTC_b_Supply_VRefA DTC_b_Supply_VRefB DTC_b_Supply_VRefC DTC_b_Supply_VRefD DTC_b_THR_Motor_Fail DTC_b_TP1_SensorHV DTC_b_TP1_SensorLV DTC_b_TP2_SensorHV DTC_b_TP2_SensorLV DTC_b_TP_CorrFLT DTC_b_TurboError DTC_s_BegasTime DTC_s_TimerOut_1 DTC_s_TimerOut_2 EFP_NU_FuelPumpErrROC EFP_b_FuelPumpDC EFP_b_NotStalled EFP_b_RunFuelPump EFP_bar_PressErr EFP_pct_FuelPumpDC_PID EFP_pct_FuelPumpDTerm EFP_pct_FuelPumpITerm EFP_pct_FuelPumpPIDRaw EFP_pct_FuelPumpPTerm ELM_Nm_AlternatorTq ELM_Nm_FrictionTq ELM_Nm_HVAC_Tq ELM_Nm_PwrStrTq ELM_Nm_Tq ELM_Nm_ZFFAN_Tq ERL_RPM_HardLim ERL_RPM_Overspd ERL_b_Active ERL_b_CutFuel ERL_b_CutSpark ERL_b_HardLimReached ERL_pct_PTerm ERL_pct_TqMult ERL_ret_SparkRetard ERM_e_RunningMode ERM_s_TimeSinceStart ETC_NU_DTerm ETC_NU_Error_Int ETC_NU_ITerm ETC_NU_PTerm ETC_NU_TP1_FullPos ETC_NU_TP1_Slow ETC_NU_TP1_ZeroPos ETC_NU_TP2_FullPos ETC_NU_TP2_Slow ETC_NU_TP2_ZeroPos ETC_NU_TPRate ETC_NU_TP_Dot ETC_b_AuthorityReduced ETC_b_CloseComplete ETC_b_Expired ETC_b_ForceClosed ETC_b_ForceOpen ETC_b_LearnReady ETC_b_LearnRest ETC_b_LearnSequenceFailed ETC_b_LearnSequenceSuccess ETC_b_OpenComplete ETC_b_RangeCheckFailed ETC_b_RestPosOOR ETC_b_Stable ETC_b_StoppedClosing ETC_b_StoppedOpening ETC_b_TP1_FullPosOOR ETC_b_TP1_LearnFull ETC_b_TP1_LearnZero ETC_b_TP1_ZeroPosOOR ETC_b_TP2_FullPosOOR /end LOC_MEASUREMENT
/end FUNCTION
/end MODULE
/end PROJECT
