ASAP2_VERSION 1 31
/begin PROJECT M670_Engine_Control_1.2.0_M670_000 "BeGas B430LG Turbocharged engine"
/begin HEADER "Begas Motor 2017-2022 (c)" VERSION "1_2_0" /end HEADER
/begin MODULE OpenECU_M670_000 ""
/* Scalar measurable for DDE 'AIN_C_AmbientTemp'. */
/begin MEASUREMENT AIN_C_AmbientTemp "Displayable" FLOAT32_IEEE CU_AIN_C_AMBIENTTEMP 1 100 0.0 0.0 ECU_ADDRESS 0x40003880 BYTE_ORDER MSB_FIRST /end MEASUREMENT
/begin COMPU_METHOD CU_AIN_C_AMBIENTTEMP "Conversion method for AIN_C_AmbientTemp" RAT_FUNC "%10.3" "C" COEFFS 0.000000 1.000000 0.000000 0.000000 0.000000 1.000000 /end COMPU_METHOD
/* Scalar measurable for DDE 'AIN_C_CompOutTemp'. */
/begin MEASUREMENT AIN_C_CompOutTemp "Displayable" FLOAT32_IEEE CU_AIN_C_COMPOUTTEMP 1 100 -40.0 120.0 ECU_ADDRESS 0x40003860 BYTE_ORDER MSB_FIRST /end MEASUREMENT
/begin COMPU_METHOD CU_AIN_C_COMPOUTTEMP "Conversion method for AIN_C_CompOutTemp" RAT_FUNC "%10.3" "C" COEFFS 0.000000 1.000000 0.000000 0.000000 0.000000 1.000000 /end COMPU_METHOD
/* Scalar measurable for DDE 'AIN_C_CoolantTemp'. */
/begin MEASUREMENT AIN_C_CoolantTemp "Displayable" FLOAT32_IEEE CU_AIN_C_COOLANTTEMP 1 100 -40.0 120.0 ECU_ADDRESS 0x40003850 BYTE_ORDER MSB_FIRST /end MEASUREMENT
/begin COMPU_METHOD CU_AIN_C_COOLANTTEMP "Conversion method for AIN_C_CoolantTemp" RAT_FUNC "%10.0" "C" COEFFS 0.000000 1.000000 0.000000 0.000000 0.000000 1.000000 /end COMPU_METHOD
/* Scalar measurable for DDE 'AIN_C_ExhaustTemp'. */
/begin MEASUREMENT AIN_C_ExhaustTemp "Displayable" FLOAT32_IEEE CU_AIN_C_EXHAUSTTEMP 1 100 0.0 0.0 ECU_ADDRESS 0x40003908 BYTE_ORDER MSB_FIRST /end MEASUREMENT
/begin COMPU_METHOD CU_AIN_C_EXHAUSTTEMP "Conversion method for AIN_C_ExhaustTemp" RAT_FUNC "%10.3" "C" COEFFS 0.000000 1.000000 0.000000 0.000000 0.000000 1.000000 /end COMPU_METHOD
/* Scalar measurable for DDE 'AIN_C_FuelTemp'. */
/begin MEASUREMENT AIN_C_FuelTemp "Displayable" FLOAT32_IEEE CU_AIN_C_FUELTEMP 1 100 0.0 0.0 ECU_ADDRESS 0x4000385c BYTE_ORDER MSB_FIRST /end MEASUREMENT
/begin COMPU_METHOD CU_AIN_C_FUELTEMP "Conversion method for AIN_C_FuelTemp" RAT_FUNC "%10.3" "C" COEFFS 0.000000 1.000000 0.000000 0.000000 0.000000 1.000000 /end COMPU_METHOD
/* Scalar measurable for DDE 'AIN_C_ManifoldTemp'. */
/begin MEASUREMENT AIN_C_ManifoldTemp "Displayable" FLOAT32_IEEE CU_AIN_C_MANIFOLDTEMP 1 100 -40.0 120.0 ECU_ADDRESS 0x40003858 BYTE_ORDER MSB_FIRST /end MEASUREMENT
/begin COMPU_METHOD CU_AIN_C_MANIFOLDTEMP "Conversion method for AIN_C_ManifoldTemp" RAT_FUNC "%10.1" "C" COEFFS 0.000000 1.000000 0.000000 0.000000 0.000000 1.000000 /end COMPU_METHOD
/* Scalar measurable for DDE 'AIN_C_OilTemp'. */
/begin MEASUREMENT AIN_C_OilTemp "Displayable" FLOAT32_IEEE CU_AIN_C_OILTEMP 1 100 -40.0 120.0 ECU_ADDRESS 0x40003874 BYTE_ORDER MSB_FIRST /end MEASUREMENT
/begin COMPU_METHOD CU_AIN_C_OILTEMP "Conversion method for AIN_C_OilTemp" RAT_FUNC "%10.3" "C" COEFFS 0.000000 1.000000 0.000000 0.000000 0.000000 1.000000 /end COMPU_METHOD
/* Scalar measurable for DDE 'AIN_NU_APP1_Raw'. */
/begin MEASUREMENT AIN_NU_APP1_Raw "Displayable" FLOAT32_IEEE CU_AIN_NU_APP1_RAW 1 100 0.0 0.0 ECU_ADDRESS 0x40003870 BYTE_ORDER MSB_FIRST /end MEASUREMENT
/begin COMPU_METHOD CU_AIN_NU_APP1_RAW "Conversion method for AIN_NU_APP1_Raw" RAT_FUNC "%10.3" "NU" COEFFS 0.000000 1.000000 0.000000 0.000000 0.000000 1.000000 /end COMPU_METHOD
/* Scalar measurable for DDE 'AIN_NU_APP2_Raw'. */
/begin MEASUREMENT AIN_NU_APP2_Raw "Displayable" FLOAT32_IEEE CU_AIN_NU_APP2_RAW 1 100 0.0 0.0 ECU_ADDRESS 0x4000386c BYTE_ORDER MSB_FIRST /end MEASUREMENT
/begin COMPU_METHOD CU_AIN_NU_APP2_RAW "Conversion method for AIN_NU_APP2_Raw" RAT_FUNC "%10.3" "NU" COEFFS 0.000000 1.000000 0.000000 0.000000 0.000000 1.000000 /end COMPU_METHOD
/* Scalar measurable for DDE 'AIN_NU_TP1_Raw'. */
/begin MEASUREMENT AIN_NU_TP1_Raw "Displayable" FLOAT32_IEEE CU_AIN_NU_TP1_RAW 1 100 0.0 0.0 ECU_ADDRESS 0x4000389c BYTE_ORDER MSB_FIRST /end MEASUREMENT
/begin COMPU_METHOD CU_AIN_NU_TP1_RAW "Conversion method for AIN_NU_TP1_Raw" RAT_FUNC "%10.1" "NU" COEFFS 0.000000 1.000000 0.000000 0.000000 0.000000 1.000000 /end COMPU_METHOD
/* Scalar measurable for DDE 'AIN_NU_TP2_Raw'. */
/begin MEASUREMENT AIN_NU_TP2_Raw "Displayable" FLOAT32_IEEE CU_AIN_NU_TP2_RAW 1 100 0.0 0.0 ECU_ADDRESS 0x40003898 BYTE_ORDER MSB_FIRST /end MEASUREMENT
/begin COMPU_METHOD CU_AIN_NU_TP2_RAW "Conversion method for AIN_NU_TP2_Raw" RAT_FUNC "%10.1" "NU" COEFFS 0.000000 1.000000 0.000000 0.000000 0.000000 1.000000 /end COMPU_METHOD
/* Scalar measurable for DDE 'AIN_V_EGO11'. */
/begin MEASUREMENT AIN_V_EGO11 "Displayable" FLOAT32_IEEE CU_AIN_V_EGO11 1 100 0.0 5.0 ECU_ADDRESS 0x40003878 BYTE_ORDER MSB_FIRST /end MEASUREMENT
/begin COMPU_METHOD CU_AIN_V_EGO11 "Conversion method for AIN_V_EGO11" RAT_FUNC "%10.1" "V" COEFFS 0.000000 1.000000 0.000000 0.000000 0.000000 1.000000 /end COMPU_METHOD
/* Scalar measurable for DDE 'AIN_V_EGO12'. */
/begin MEASUREMENT AIN_V_EGO12 "Displayable" FLOAT32_IEEE CU_AIN_V_EGO12 1 100 0.0 5.0 ECU_ADDRESS 0x40003900 BYTE_ORDER MSB_FIRST /end MEASUREMENT
/begin COMPU_METHOD CU_AIN_V_EGO12 "Conversion method for AIN_V_EGO12" RAT_FUNC "%10.3" "V" COEFFS 0.000000 1.000000 0.000000 0.000000 0.000000 1.000000 /end COMPU_METHOD
/* Scalar measurable for DDE 'AIN_V_EGO21'. */
/begin MEASUREMENT AIN_V_EGO21 "Displayable" FLOAT32_IEEE CU_AIN_V_EGO21 1 100 0.0 5.0 ECU_ADDRESS 0x400038a0 BYTE_ORDER MSB_FIRST /end MEASUREMENT
/begin COMPU_METHOD CU_AIN_V_EGO21 "Conversion method for AIN_V_EGO21" RAT_FUNC "%10.3" "V" COEFFS 0.000000 1.000000 0.000000 0.000000 0.000000 1.000000 /end COMPU_METHOD
/* Scalar measurable for DDE 'AIN_V_FiltUA_A'. */
/begin MEASUREMENT AIN_V_FiltUA_A "lambda AIN filtered" FLOAT32_IEEE CU_AIN_V_FILTUA_A 1 100 0.0 0.0 ECU_ADDRESS 0x40003108 BYTE_ORDER MSB_FIRST /end MEASUREMENT
/begin COMPU_METHOD CU_AIN_V_FILTUA_A "Conversion method for AIN_V_FiltUA_A" RAT_FUNC "%10.3" "V" COEFFS 0.000000 1.000000 0.000000 0.000000 0.000000 1.000000 /end COMPU_METHOD
/* Scalar measurable for DDE 'AIN_V_FiltUA_B'. */
/begin MEASUREMENT AIN_V_FiltUA_B "lambda AIN filtered" FLOAT32_IEEE CU_AIN_V_FILTUA_B 1 100 0.0 0.0 ECU_ADDRESS 0x40003138 BYTE_ORDER MSB_FIRST /end MEASUREMENT
/begin COMPU_METHOD CU_AIN_V_FILTUA_B "Conversion method for AIN_V_FiltUA_B" RAT_FUNC "%10.3" "V" COEFFS 0.000000 1.000000 0.000000 0.000000 0.000000 1.000000 /end COMPU_METHOD
/* Scalar measurable for DDE 'AIN_V_FiltUR_A'. */
/begin MEASUREMENT AIN_V_FiltUR_A "sensor temperature AIN filtered" FLOAT32_IEEE CU_AIN_V_FILTUR_A 1 100 0.0 0.0 ECU_ADDRESS 0x40003100 BYTE_ORDER MSB_FIRST /end MEASUREMENT
/begin COMPU_METHOD CU_AIN_V_FILTUR_A "Conversion method for AIN_V_FiltUR_A" RAT_FUNC "%10.3" "V" COEFFS 0.000000 1.000000 0.000000 0.000000 0.000000 1.000000 /end COMPU_METHOD
/* Scalar measurable for DDE 'AIN_V_FiltUR_B'. */
/begin MEASUREMENT AIN_V_FiltUR_B "sensor temperature AIN filtered" FLOAT32_IEEE CU_AIN_V_FILTUR_B 1 100 0.0 0.0 ECU_ADDRESS 0x40003130 BYTE_ORDER MSB_FIRST /end MEASUREMENT
/begin COMPU_METHOD CU_AIN_V_FILTUR_B "Conversion method for AIN_V_FiltUR_B" RAT_FUNC "%10.3" "V" COEFFS 0.000000 1.000000 0.000000 0.000000 0.000000 1.000000 /end COMPU_METHOD
/* Scalar measurable for DDE 'AIN_V_KnockSignalCyl1'. */
/begin MEASUREMENT AIN_V_KnockSignalCyl1 "Analog input value" FLOAT32_IEEE CU_AIN_V_KNOCKSIGNALCYL1 1 100 0.0 5.0 ECU_ADDRESS 0x400038c4 BYTE_ORDER MSB_FIRST /end MEASUREMENT
/begin COMPU_METHOD CU_AIN_V_KNOCKSIGNALCYL1 "Conversion method for AIN_V_KnockSignalCyl1" RAT_FUNC "%10.3" "V" COEFFS 0.000000 1.000000 0.000000 0.000000 0.000000 1.000000 /end COMPU_METHOD
/* Scalar measurable for DDE 'AIN_V_MAP_BeforeThro'. */
/begin MEASUREMENT AIN_V_MAP_BeforeThro "Analog input value" FLOAT32_IEEE CU_AIN_V_MAP_BEFORETHRO 1 100 0.0 0.0 ECU_ADDRESS 0x400038a8 BYTE_ORDER MSB_FIRST /end MEASUREMENT
/begin COMPU_METHOD CU_AIN_V_MAP_BEFORETHRO "Conversion method for AIN_V_MAP_BeforeThro" RAT_FUNC "%10.3" "V" COEFFS 0.000000 1.000000 0.000000 0.000000 0.000000 1.000000 /end COMPU_METHOD
/* Scalar measurable for DDE 'AIN_V_TP1'. */
/begin MEASUREMENT AIN_V_TP1 "Raw value" FLOAT32_IEEE CU_AIN_V_TP1 1 100 0.0 0.0 ECU_ADDRESS 0x400038b0 BYTE_ORDER MSB_FIRST /end MEASUREMENT
/begin COMPU_METHOD CU_AIN_V_TP1 "Conversion method for AIN_V_TP1" RAT_FUNC "%10.3" "V" COEFFS 0.000000 1.000000 0.000000 0.000000 0.000000 1.000000 /end COMPU_METHOD
/* Scalar measurable for DDE 'AIN_V_TP2'. */
/begin MEASUREMENT AIN_V_TP2 "Raw value" FLOAT32_IEEE CU_AIN_V_TP2 1 100 0.0 0.0 ECU_ADDRESS 0x400038ac BYTE_ORDER MSB_FIRST /end MEASUREMENT
/begin COMPU_METHOD CU_AIN_V_TP2 "Conversion method for AIN_V_TP2" RAT_FUNC "%10.3" "V" COEFFS 0.000000 1.000000 0.000000 0.000000 0.000000 1.000000 /end COMPU_METHOD
/* Scalar measurable for DDE 'AIN_V_UA_A'. */
/begin MEASUREMENT AIN_V_UA_A "lambda AIN unfiltered" FLOAT32_IEEE CU_AIN_V_UA_A 1 100 0.0 0.0 ECU_ADDRESS 0x400030cc BYTE_ORDER MSB_FIRST /end MEASUREMENT
/begin COMPU_METHOD CU_AIN_V_UA_A "Conversion method for AIN_V_UA_A" RAT_FUNC "%10.3" "V" COEFFS 0.000000 1.000000 0.000000 0.000000 0.000000 1.000000 /end COMPU_METHOD
/* Scalar measurable for DDE 'AIN_V_UA_B'. */
/begin MEASUREMENT AIN_V_UA_B "lambda AIN unfiltered" FLOAT32_IEEE CU_AIN_V_UA_B 1 100 0.0 0.0 ECU_ADDRESS 0x400030d8 BYTE_ORDER MSB_FIRST /end MEASUREMENT
/begin COMPU_METHOD CU_AIN_V_UA_B "Conversion method for AIN_V_UA_B" RAT_FUNC "%10.3" "V" COEFFS 0.000000 1.000000 0.000000 0.000000 0.000000 1.000000 /end COMPU_METHOD
/* Scalar measurable for DDE 'AIN_V_UR_A'. */
/begin MEASUREMENT AIN_V_UR_A "sensor temperature AIN unfiltered" FLOAT32_IEEE CU_AIN_V_UR_A 1 100 0.0 0.0 ECU_ADDRESS 0x400030c8 BYTE_ORDER MSB_FIRST /end MEASUREMENT
/begin COMPU_METHOD CU_AIN_V_UR_A "Conversion method for AIN_V_UR_A" RAT_FUNC "%10.3" "V" COEFFS 0.000000 1.000000 0.000000 0.000000 0.000000 1.000000 /end COMPU_METHOD
/* Scalar measurable for DDE 'AIN_V_UR_B'. */
/begin MEASUREMENT AIN_V_UR_B "sensor temperature AIN unfiltered" FLOAT32_IEEE CU_AIN_V_UR_B 1 100 0.0 0.0 ECU_ADDRESS 0x400030d4 BYTE_ORDER MSB_FIRST /end MEASUREMENT
/begin COMPU_METHOD CU_AIN_V_UR_B "Conversion method for AIN_V_UR_B" RAT_FUNC "%10.3" "V" COEFFS 0.000000 1.000000 0.000000 0.000000 0.000000 1.000000 /end COMPU_METHOD
/* Scalar measurable for DDE 'AIN_V_VBatt'. */
/begin MEASUREMENT AIN_V_VBatt "Displayable" FLOAT32_IEEE CU_AIN_V_VBATT 1 100 0.0 0.0 ECU_ADDRESS 0x40003910 BYTE_ORDER MSB_FIRST /end MEASUREMENT
/begin COMPU_METHOD CU_AIN_V_VBATT "Conversion method for AIN_V_VBatt" RAT_FUNC "%10.1" "V" COEFFS 0.000000 1.000000 0.000000 0.000000 0.000000 1.000000 /end COMPU_METHOD
/* Scalar measurable for DDE 'AIN_V_VBattRaw'. */
/begin MEASUREMENT AIN_V_VBattRaw "Displayable" FLOAT32_IEEE CU_AIN_V_VBATTRAW 1 100 0.0 0.0 ECU_ADDRESS 0x40003914 BYTE_ORDER MSB_FIRST /end MEASUREMENT
/begin COMPU_METHOD CU_AIN_V_VBATTRAW "Conversion method for AIN_V_VBattRaw" RAT_FUNC "%10.3" "V" COEFFS 0.000000 1.000000 0.000000 0.000000 0.000000 1.000000 /end COMPU_METHOD
/* Scalar measurable for DDE 'AIN_adv_KnockWinStartAngA'. */
/begin MEASUREMENT AIN_adv_KnockWinStartAngA "Cyl1357 displayble" FLOAT32_IEEE CU_AIN_ADV_KNOCKWINSTARTANGA 1 100 0.0 0.0 ECU_ADDRESS 0x400038c0 BYTE_ORDER MSB_FIRST /end MEASUREMENT
/begin COMPU_METHOD CU_AIN_ADV_KNOCKWINSTARTANGA "Conversion method for AIN_adv_KnockWinStartAngA" RAT_FUNC "%10.1" "adv" COEFFS 0.000000 1.000000 0.000000 0.000000 0.000000 1.000000 /end COMPU_METHOD
/* Scalar measurable for DDE 'AIN_adv_KnockWinStopAngA'. */
/begin MEASUREMENT AIN_adv_KnockWinStopAngA "Cyl1357 displayble" FLOAT32_IEEE CU_AIN_ADV_KNOCKWINSTOPANGA 1 100 0.0 0.0 ECU_ADDRESS 0x400038bc BYTE_ORDER MSB_FIRST /end MEASUREMENT
/begin COMPU_METHOD CU_AIN_ADV_KNOCKWINSTOPANGA "Conversion method for AIN_adv_KnockWinStopAngA" RAT_FUNC "%10.1" "adv" COEFFS 0.000000 1.000000 0.000000 0.000000 0.000000 1.000000 /end COMPU_METHOD
/* Scalar measurable for DDE 'AIN_b_APP1_Valid'. */
/begin MEASUREMENT AIN_b_APP1_Valid "Displayable" UBYTE CU_AIN_B_APP1_VALID 1 100 0.0 1.0 ECU_ADDRESS 0x40002f84 BYTE_ORDER MSB_FIRST /end MEASUREMENT
/begin COMPU_METHOD CU_AIN_B_APP1_VALID "Conversion method for AIN_b_APP1_Valid" RAT_FUNC "%10.0" "b" COEFFS 0.000000 1.000000 0.000000 0.000000 0.000000 1.000000 /end COMPU_METHOD
/* Scalar measurable for DDE 'AIN_b_APP2_Valid'. */
/begin MEASUREMENT AIN_b_APP2_Valid "Displayable" UBYTE CU_AIN_B_APP2_VALID 1 100 0.0 1.0 ECU_ADDRESS 0x40002f85 BYTE_ORDER MSB_FIRST /end MEASUREMENT
/begin COMPU_METHOD CU_AIN_B_APP2_VALID "Conversion method for AIN_b_APP2_Valid" RAT_FUNC "%10.0" "b" COEFFS 0.000000 1.000000 0.000000 0.000000 0.000000 1.000000 /end COMPU_METHOD
/* Scalar measurable for DDE 'AIN_b_CompOutPress_Fault'. */
/begin MEASUREMENT AIN_b_CompOutPress_Fault "Displayable" UBYTE CU_AIN_B_COMPOUTPRESS_FAULT 1 100 0.0 1.0 ECU_ADDRESS 0x40002f86 BYTE_ORDER MSB_FIRST /end MEASUREMENT
/begin COMPU_METHOD CU_AIN_B_COMPOUTPRESS_FAULT "Conversion method for AIN_b_CompOutPress_Fault" RAT_FUNC "%10.0" "b" COEFFS 0.000000 1.000000 0.000000 0.000000 0.000000 1.000000 /end COMPU_METHOD
/* Scalar measurable for DDE 'AIN_b_TP1_Fault'. */
/begin MEASUREMENT AIN_b_TP1_Fault "Displayable" UBYTE CU_AIN_B_TP1_FAULT 1 100 0.0 1.0 ECU_ADDRESS 0x40002f8f BYTE_ORDER MSB_FIRST /end MEASUREMENT
/begin COMPU_METHOD CU_AIN_B_TP1_FAULT "Conversion method for AIN_b_TP1_Fault" RAT_FUNC "%10.0" "b" COEFFS 0.000000 1.000000 0.000000 0.000000 0.000000 1.000000 /end COMPU_METHOD
/* Scalar measurable for DDE 'AIN_b_TP2_Fault'. */
/begin MEASUREMENT AIN_b_TP2_Fault "Displayable" UBYTE CU_AIN_B_TP2_FAULT 1 100 0.0 1.0 ECU_ADDRESS 0x40002f8c BYTE_ORDER MSB_FIRST /end MEASUREMENT
/begin COMPU_METHOD CU_AIN_B_TP2_FAULT "Conversion method for AIN_b_TP2_Fault" RAT_FUNC "%10.0" "b" COEFFS 0.000000 1.000000 0.000000 0.000000 0.000000 1.000000 /end COMPU_METHOD
/* Scalar measurable for DDE 'AIN_b_UEGO1_Valid'. */
/begin MEASUREMENT AIN_b_UEGO1_Valid "Displayable" UBYTE CU_AIN_B_UEGO1_VALID 1 100 0.0 1.0 ECU_ADDRESS 0x40002f83 BYTE_ORDER MSB_FIRST /end MEASUREMENT
/begin COMPU_METHOD CU_AIN_B_UEGO1_VALID "Conversion method for AIN_b_UEGO1_Valid" RAT_FUNC "%10.0" "b" COEFFS 0.000000 1.000000 0.000000 0.000000 0.000000 1.000000 /end COMPU_METHOD
/* Scalar measurable for DDE 'AIN_b_UEGO2_Valid'. */
/begin MEASUREMENT AIN_b_UEGO2_Valid "Displayable" UBYTE CU_AIN_B_UEGO2_VALID 1 100 0.0 1.0 ECU_ADDRESS 0x40002f82 BYTE_ORDER MSB_FIRST /end MEASUREMENT
/begin COMPU_METHOD CU_AIN_B_UEGO2_VALID "Conversion method for AIN_b_UEGO2_Valid" RAT_FUNC "%10.0" "b" COEFFS 0.000000 1.000000 0.000000 0.000000 0.000000 1.000000 /end COMPU_METHOD
/* Scalar measurable for DDE 'AIN_bar_FuelPress'. */
/begin MEASUREMENT AIN_bar_FuelPress "AIN output will be bounded by this range" FLOAT32_IEEE CU_AIN_BAR_FUELPRESS 1 100 0.0 1000.0 ECU_ADDRESS 0x40003848 BYTE_ORDER MSB_FIRST /end MEASUREMENT
/begin COMPU_METHOD CU_AIN_BAR_FUELPRESS "Conversion method for AIN_bar_FuelPress" RAT_FUNC "%10.1" "bar" COEFFS 0.000000 1.000000 0.000000 0.000000 0.000000 1.000000 /end COMPU_METHOD
/* Scalar measurable for DDE 'AIN_cnt_HIP_SPI_Flts'. */
/begin MEASUREMENT AIN_cnt_HIP_SPI_Flts "HIP chip SPI fault counter" ULONG CU_AIN_CNT_HIP_SPI_FLTS 1 100 0.0 0.0 ECU_ADDRESS 0x40003070 BYTE_ORDER MSB_FIRST /end MEASUREMENT
/begin COMPU_METHOD CU_AIN_CNT_HIP_SPI_FLTS "Conversion method for AIN_cnt_HIP_SPI_Flts" RAT_FUNC "%10.0" "cnt" COEFFS 0.000000 1.000000 0.000000 0.000000 0.000000 1.000000 /end COMPU_METHOD
/* Scalar measurable for DDE 'AIN_kPa_Baro'. */
/begin MEASUREMENT AIN_kPa_Baro "Displayable" FLOAT32_IEEE CU_AIN_KPA_BARO 1 100 0.0 0.0 ECU_ADDRESS 0x4000387c BYTE_ORDER MSB_FIRST /end MEASUREMENT
/begin COMPU_METHOD CU_AIN_KPA_BARO "Conversion method for AIN_kPa_Baro" RAT_FUNC "%10.3" "kPa" COEFFS 0.000000 1.000000 0.000000 0.000000 0.000000 1.000000 /end COMPU_METHOD
/* Scalar measurable for DDE 'AIN_kPa_CompOutPress'. */
/begin MEASUREMENT AIN_kPa_CompOutPress "Displayable" FLOAT32_IEEE CU_AIN_KPA_COMPOUTPRESS 1 100 0.0 0.0 ECU_ADDRESS 0x40003854 BYTE_ORDER MSB_FIRST /end MEASUREMENT
/begin COMPU_METHOD CU_AIN_KPA_COMPOUTPRESS "Conversion method for AIN_kPa_CompOutPress" RAT_FUNC "%10.3" "kPa" COEFFS 0.000000 1.000000 0.000000 0.000000 0.000000 1.000000 /end COMPU_METHOD
/* Scalar measurable for DDE 'AIN_kPa_FAP'. */
/begin MEASUREMENT AIN_kPa_FAP "Displayable" FLOAT32_IEEE CU_AIN_KPA_FAP 1 100 0.0 0.0 ECU_ADDRESS 0x400038a4 BYTE_ORDER MSB_FIRST /end MEASUREMENT
/begin COMPU_METHOD CU_AIN_KPA_FAP "Conversion method for AIN_kPa_FAP" RAT_FUNC "%10.1" "kPa" COEFFS 0.000000 1.000000 0.000000 0.000000 0.000000 1.000000 /end COMPU_METHOD
/* Scalar measurable for DDE 'AIN_kPa_MAP'. */
/begin MEASUREMENT AIN_kPa_MAP "Displayable" FLOAT32_IEEE CU_AIN_KPA_MAP 1 100 0.0 0.0 ECU_ADDRESS 0x4000384c BYTE_ORDER MSB_FIRST /end MEASUREMENT
/begin COMPU_METHOD CU_AIN_KPA_MAP "Conversion method for AIN_kPa_MAP" RAT_FUNC "%10.0" "kPa" COEFFS 0.000000 1.000000 0.000000 0.000000 0.000000 1.000000 /end COMPU_METHOD
/* Scalar measurable for DDE 'AIN_kPa_OilPress'. */
/begin MEASUREMENT AIN_kPa_OilPress "Displayable" FLOAT32_IEEE CU_AIN_KPA_OILPRESS 1 100 0.0 1000.0 ECU_ADDRESS 0x40003884 BYTE_ORDER MSB_FIRST /end MEASUREMENT
/begin COMPU_METHOD CU_AIN_KPA_OILPRESS "Conversion method for AIN_kPa_OilPress" RAT_FUNC "%10.3" "kPa" COEFFS 0.000000 1.000000 0.000000 0.000000 0.000000 1.000000 /end COMPU_METHOD
/* Scalar measurable for DDE 'AIN_lam_UEGO1'. */
/begin MEASUREMENT AIN_lam_UEGO1 "Displayable" FLOAT32_IEEE CU_AIN_LAM_UEGO1 1 100 0.0 10.0 ECU_ADDRESS 0x40003868 BYTE_ORDER MSB_FIRST /end MEASUREMENT
/begin COMPU_METHOD CU_AIN_LAM_UEGO1 "Conversion method for AIN_lam_UEGO1" RAT_FUNC "%10.3" "lam" COEFFS 0.000000 1.000000 0.000000 0.000000 0.000000 1.000000 /end COMPU_METHOD
/* Scalar measurable for DDE 'AIN_lam_UEGO2'. */
/begin MEASUREMENT AIN_lam_UEGO2 "Displayable" FLOAT32_IEEE CU_AIN_LAM_UEGO2 1 100 0.0 10.0 ECU_ADDRESS 0x40003864 BYTE_ORDER MSB_FIRST /end MEASUREMENT
/begin COMPU_METHOD CU_AIN_LAM_UEGO2 "Conversion method for AIN_lam_UEGO2" RAT_FUNC "%10.1" "lam" COEFFS 0.000000 1.000000 0.000000 0.000000 0.000000 1.000000 /end COMPU_METHOD
/* Scalar measurable for DDE 'AIN_pct_Cylinder1_Knock'. */
/begin MEASUREMENT AIN_pct_Cylinder1_Knock "Displayable" FLOAT32_IEEE CU_AIN_PCT_CYLINDER1_KNOCK 1 100 0.0 0.0 ECU_ADDRESS 0x4000388c BYTE_ORDER MSB_FIRST /end MEASUREMENT
/begin COMPU_METHOD CU_AIN_PCT_CYLINDER1_KNOCK "Conversion method for AIN_pct_Cylinder1_Knock" RAT_FUNC "%10.2" "pct" COEFFS 0.000000 1.000000 0.000000 0.000000 0.000000 1.000000 /end COMPU_METHOD
/* Scalar measurable for DDE 'AIN_pct_Cylinder2_Knock'. */
/begin MEASUREMENT AIN_pct_Cylinder2_Knock "Displayable" FLOAT32_IEEE CU_AIN_PCT_CYLINDER2_KNOCK 1 100 0.0 0.0 ECU_ADDRESS 0x40003888 BYTE_ORDER MSB_FIRST /end MEASUREMENT
/begin COMPU_METHOD CU_AIN_PCT_CYLINDER2_KNOCK "Conversion method for AIN_pct_Cylinder2_Knock" RAT_FUNC "%10.2" "pct" COEFFS 0.000000 1.000000 0.000000 0.000000 0.000000 1.000000 /end COMPU_METHOD
/* Scalar measurable for DDE 'AIN_pct_Cylinder3_Knock'. */
/begin MEASUREMENT AIN_pct_Cylinder3_Knock "Displayable" FLOAT32_IEEE CU_AIN_PCT_CYLINDER3_KNOCK 1 100 0.0 0.0 ECU_ADDRESS 0x40003894 BYTE_ORDER MSB_FIRST /end MEASUREMENT
/begin COMPU_METHOD CU_AIN_PCT_CYLINDER3_KNOCK "Conversion method for AIN_pct_Cylinder3_Knock" RAT_FUNC "%10.2" "pct" COEFFS 0.000000 1.000000 0.000000 0.000000 0.000000 1.000000 /end COMPU_METHOD
/* Scalar measurable for DDE 'AIN_pct_Cylinder4_Knock'. */
/begin MEASUREMENT AIN_pct_Cylinder4_Knock "Displayable" FLOAT32_IEEE CU_AIN_PCT_CYLINDER4_KNOCK 1 100 0.0 0.0 ECU_ADDRESS 0x40003890 BYTE_ORDER MSB_FIRST /end MEASUREMENT
/begin COMPU_METHOD CU_AIN_PCT_CYLINDER4_KNOCK "Conversion method for AIN_pct_Cylinder4_Knock" RAT_FUNC "%10.2" "pct" COEFFS 0.000000 1.000000 0.000000 0.000000 0.000000 1.000000 /end COMPU_METHOD
/* Scalar measurable for DDE 'AIN_s_DelayLambdas'. */
/begin MEASUREMENT AIN_s_DelayLambdas "Analog input value" FLOAT32_IEEE CU_AIN_S_DELAYLAMBDAS 1 100 0.0 5000.0 ECU_ADDRESS 0x400038fc BYTE_ORDER MSB_FIRST /end MEASUREMENT
/begin COMPU_METHOD CU_AIN_S_DELAYLAMBDAS "Conversion method for AIN_s_DelayLambdas" RAT_FUNC "%10.3" "s" COEFFS 0.000000 1.000000 0.000000 0.000000 0.000000 1.000000 /end COMPU_METHOD
/* Scalar measurable for DDE 'CAL_V_Uoffset_A'. */
/begin MEASUREMENT CAL_V_Uoffset_A "NVM offset value used for Lambda calculation" FLOAT32_IEEE CU_CAL_V_UOFFSET_A 1 100 0.0 0.0 ECU_ADDRESS 0x40003104 BYTE_ORDER MSB_FIRST /end MEASUREMENT
/begin COMPU_METHOD CU_CAL_V_UOFFSET_A "Conversion method for CAL_V_Uoffset_A" RAT_FUNC "%10.3" "V" COEFFS 0.000000 1.000000 0.000000 0.000000 0.000000 1.000000 /end COMPU_METHOD
/* Scalar measurable for DDE 'CAL_V_Uoffset_B'. */
/begin MEASUREMENT CAL_V_Uoffset_B "NVM offset value used for Lambda calculation" FLOAT32_IEEE CU_CAL_V_UOFFSET_B 1 100 0.0 0.0 ECU_ADDRESS 0x40003134 BYTE_ORDER MSB_FIRST /end MEASUREMENT
/begin COMPU_METHOD CU_CAL_V_UOFFSET_B "Conversion method for CAL_V_Uoffset_B" RAT_FUNC "%10.3" "V" COEFFS 0.000000 1.000000 0.000000 0.000000 0.000000 1.000000 /end COMPU_METHOD
/* Scalar measurable for DDE 'CAL_b_CalibrationModeActv_A'. */
/begin MEASUREMENT CAL_b_CalibrationModeActv_A "Calibration mode active flag" UBYTE CU_CAL_B_CALIBRATIONMODEACTV_A 1 100 0.0 1.0 ECU_ADDRESS 0x40002e4b BYTE_ORDER MSB_FIRST /end MEASUREMENT
/begin COMPU_METHOD CU_CAL_B_CALIBRATIONMODEACTV_A "Conversion method for CAL_b_CalibrationModeActv_A" RAT_FUNC "%10.0" "b" COEFFS 0.000000 1.000000 0.000000 0.000000 0.000000 1.000000 /end COMPU_METHOD
/* Scalar measurable for DDE 'CAL_b_CalibrationModeActv_B'. */
/begin MEASUREMENT CAL_b_CalibrationModeActv_B "Calibration mode active flag" UBYTE CU_CAL_B_CALIBRATIONMODEACTV_B 1 100 0.0 1.0 ECU_ADDRESS 0x40002e5c BYTE_ORDER MSB_FIRST /end MEASUREMENT
/begin COMPU_METHOD CU_CAL_B_CALIBRATIONMODEACTV_B "Conversion method for CAL_b_CalibrationModeActv_B" RAT_FUNC "%10.0" "b" COEFFS 0.000000 1.000000 0.000000 0.000000 0.000000 1.000000 /end COMPU_METHOD
/* Scalar measurable for DDE 'CAL_b_CalibrationModeRqst_A'. */
/begin MEASUREMENT CAL_b_CalibrationModeRqst_A "Calibration mode request flag" UBYTE CU_CAL_B_CALIBRATIONMODERQST_A 1 100 0.0 1.0 ECU_ADDRESS 0x40002e4c BYTE_ORDER MSB_FIRST /end MEASUREMENT
/begin COMPU_METHOD CU_CAL_B_CALIBRATIONMODERQST_A "Conversion method for CAL_b_CalibrationModeRqst_A" RAT_FUNC "%10.0" "b" COEFFS 0.000000 1.000000 0.000000 0.000000 0.000000 1.000000 /end COMPU_METHOD
/* Scalar measurable for DDE 'CAL_b_CalibrationModeRqst_B'. */
/begin MEASUREMENT CAL_b_CalibrationModeRqst_B "Calibration mode request flag" UBYTE CU_CAL_B_CALIBRATIONMODERQST_B 1 100 0.0 1.0 ECU_ADDRESS 0x40002e5d BYTE_ORDER MSB_FIRST /end MEASUREMENT
/begin COMPU_METHOD CU_CAL_B_CALIBRATIONMODERQST_B "Conversion method for CAL_b_CalibrationModeRqst_B" RAT_FUNC "%10.0" "b" COEFFS 0.000000 1.000000 0.000000 0.000000 0.000000 1.000000 /end COMPU_METHOD
/* Scalar measurable for DDE 'CIN_NU_EngOvrCtrMd_ESP'. */
/begin MEASUREMENT CIN_NU_EngOvrCtrMd_ESP "Displayable" FLOAT32_IEEE CU_CIN_NU_ENGOVRCTRMD_ESP 1 100 0.0 0.0 ECU_ADDRESS 0x4000383c BYTE_ORDER MSB_FIRST /end MEASUREMENT
/begin COMPU_METHOD CU_CIN_NU_ENGOVRCTRMD_ESP "Conversion method for CIN_NU_EngOvrCtrMd_ESP" RAT_FUNC "%10.0" "NU" COEFFS 0.000000 1.000000 0.000000 0.000000 0.000000 1.000000 /end COMPU_METHOD
/* Scalar measurable for DDE 'CIN_NU_EngOvrCtrMd_TCM'. */
/begin MEASUREMENT CIN_NU_EngOvrCtrMd_TCM "Displayable" FLOAT32_IEEE CU_CIN_NU_ENGOVRCTRMD_TCM 1 100 0.0 0.0 ECU_ADDRESS 0x40003830 BYTE_ORDER MSB_FIRST /end MEASUREMENT
/begin COMPU_METHOD CU_CIN_NU_ENGOVRCTRMD_TCM "Conversion method for CIN_NU_EngOvrCtrMd_TCM" RAT_FUNC "%10.0" "NU" COEFFS 0.000000 1.000000 0.000000 0.000000 0.000000 1.000000 /end COMPU_METHOD
/* Scalar measurable for DDE 'CIN_NU_OvrCtrMd_ESP'. */
/begin MEASUREMENT CIN_NU_OvrCtrMd_ESP "Displayable" FLOAT32_IEEE CU_CIN_NU_OVRCTRMD_ESP 1 100 0.0 0.0 ECU_ADDRESS 0x40003844 BYTE_ORDER MSB_FIRST /end MEASUREMENT
/begin COMPU_METHOD CU_CIN_NU_OVRCTRMD_ESP "Conversion method for CIN_NU_OvrCtrMd_ESP" RAT_FUNC "%10.0" "NU" COEFFS 0.000000 1.000000 0.000000 0.000000 0.000000 1.000000 /end COMPU_METHOD
/* Scalar measurable for DDE 'CIN_NU_OvrCtrMd_TCM'. */
/begin MEASUREMENT CIN_NU_OvrCtrMd_TCM "Displayable" FLOAT32_IEEE CU_CIN_NU_OVRCTRMD_TCM 1 100 0.0 0.0 ECU_ADDRESS 0x40003838 BYTE_ORDER MSB_FIRST /end MEASUREMENT
/begin COMPU_METHOD CU_CIN_NU_OVRCTRMD_TCM "Conversion method for CIN_NU_OvrCtrMd_TCM" RAT_FUNC "%10.0" "NU" COEFFS 0.000000 1.000000 0.000000 0.000000 0.000000 1.000000 /end COMPU_METHOD
/* Scalar measurable for DDE 'CIN_pct_TqCtrRq_ESP'. */
/begin MEASUREMENT CIN_pct_TqCtrRq_ESP "Displayable" FLOAT32_IEEE CU_CIN_PCT_TQCTRRQ_ESP 1 100 0.0 0.0 ECU_ADDRESS 0x40003840 BYTE_ORDER MSB_FIRST /end MEASUREMENT
/begin COMPU_METHOD CU_CIN_PCT_TQCTRRQ_ESP "Conversion method for CIN_pct_TqCtrRq_ESP" RAT_FUNC "%10.0" "pct" COEFFS 0.000000 1.000000 0.000000 0.000000 0.000000 1.000000 /end COMPU_METHOD
/* Scalar measurable for DDE 'CIN_pct_TqCtrRq_TCM'. */
/begin MEASUREMENT CIN_pct_TqCtrRq_TCM "Displayable" FLOAT32_IEEE CU_CIN_PCT_TQCTRRQ_TCM 1 100 0.0 0.0 ECU_ADDRESS 0x40003834 BYTE_ORDER MSB_FIRST /end MEASUREMENT
/begin COMPU_METHOD CU_CIN_PCT_TQCTRRQ_TCM "Conversion method for CIN_pct_TqCtrRq_TCM" RAT_FUNC "%10.0" "pct" COEFFS 0.000000 1.000000 0.000000 0.000000 0.000000 1.000000 /end COMPU_METHOD
/* Scalar measurable for DDE 'DIN_Hz_MAF'. */
/begin MEASUREMENT DIN_Hz_MAF "Raw value" FLOAT32_IEEE CU_DIN_HZ_MAF 1 100 0.0 0.0 ECU_ADDRESS 0x4000303c BYTE_ORDER MSB_FIRST /end MEASUREMENT
/begin COMPU_METHOD CU_DIN_HZ_MAF "Conversion method for DIN_Hz_MAF" RAT_FUNC "%10.3" "Hz" COEFFS 0.000000 1.000000 0.000000 0.000000 0.000000 1.000000 /end COMPU_METHOD
/* Scalar measurable for DDE 'DIN_NU_Gear'. */
/begin MEASUREMENT DIN_NU_Gear "Displayable" FLOAT32_IEEE CU_DIN_NU_GEAR 1 100 0.0 0.0 ECU_ADDRESS 0x40003800 BYTE_ORDER MSB_FIRST /end MEASUREMENT
/begin COMPU_METHOD CU_DIN_NU_GEAR "Conversion method for DIN_NU_Gear" RAT_FUNC "%10.0" "NU" COEFFS 0.000000 1.000000 0.000000 0.000000 0.000000 1.000000 /end COMPU_METHOD
/* Scalar measurable for DDE 'DIN_RPM_EngSpd'. */
/begin MEASUREMENT DIN_RPM_EngSpd "Displayable" FLOAT32_IEEE CU_DIN_RPM_ENGSPD 1 100 0.0 0.0 ECU_ADDRESS 0x40003804 BYTE_ORDER MSB_FIRST /end MEASUREMENT
/begin COMPU_METHOD CU_DIN_RPM_ENGSPD "Conversion method for DIN_RPM_EngSpd" RAT_FUNC "%10.0" "RPM" COEFFS 0.000000 1.000000 0.000000 0.000000 0.000000 1.000000 /end COMPU_METHOD
/* Scalar measurable for DDE 'DIN_RPM_Per720'. */
/begin MEASUREMENT DIN_RPM_Per720 "Displayable" FLOAT32_IEEE CU_DIN_RPM_PER720 1 100 0.0 0.0 ECU_ADDRESS 0x400037fc BYTE_ORDER MSB_FIRST /end MEASUREMENT
/begin COMPU_METHOD CU_DIN_RPM_PER720 "Conversion method for DIN_RPM_Per720" RAT_FUNC "%10.0" "RPM" COEFFS 0.000000 1.000000 0.000000 0.000000 0.000000 1.000000 /end COMPU_METHOD
/* Scalar measurable for DDE 'DIN_RPM_PerCyl'. */
/begin MEASUREMENT DIN_RPM_PerCyl "Displayable" FLOAT32_IEEE CU_DIN_RPM_PERCYL 1 100 0.0 0.0 ECU_ADDRESS 0x400037f8 BYTE_ORDER MSB_FIRST /end MEASUREMENT
/begin COMPU_METHOD CU_DIN_RPM_PERCYL "Conversion method for DIN_RPM_PerCyl" RAT_FUNC "%10.0" "RPM" COEFFS 0.000000 1.000000 0.000000 0.000000 0.000000 1.000000 /end COMPU_METHOD
/* Scalar measurable for DDE 'DIN_RPM_TOSS'. */
/begin MEASUREMENT DIN_RPM_TOSS "Displayable" FLOAT32_IEEE CU_DIN_RPM_TOSS 1 100 0.0 0.0 ECU_ADDRESS 0x400037f0 BYTE_ORDER MSB_FIRST /end MEASUREMENT
/begin COMPU_METHOD CU_DIN_RPM_TOSS "Conversion method for DIN_RPM_TOSS" RAT_FUNC "%10.0" "RPM" COEFFS 0.000000 1.000000 0.000000 0.000000 0.000000 1.000000 /end COMPU_METHOD
/* Scalar measurable for DDE 'DIN_b_AC_PressSw'. */
/begin MEASUREMENT DIN_b_AC_PressSw "Displayable" UBYTE CU_DIN_B_AC_PRESSSW 1 100 0.0 1.0 ECU_ADDRESS 0x40002f6c BYTE_ORDER MSB_FIRST /end MEASUREMENT
/begin COMPU_METHOD CU_DIN_B_AC_PRESSSW "Conversion method for DIN_b_AC_PressSw" RAT_FUNC "%10.0" "b" COEFFS 0.000000 1.000000 0.000000 0.000000 0.000000 1.000000 /end COMPU_METHOD
/* Scalar measurable for DDE 'DIN_b_AC_ReqSw'. */
/begin MEASUREMENT DIN_b_AC_ReqSw "Displayable" UBYTE CU_DIN_B_AC_REQSW 1 100 0.0 1.0 ECU_ADDRESS 0x40002f6b BYTE_ORDER MSB_FIRST /end MEASUREMENT
/begin COMPU_METHOD CU_DIN_B_AC_REQSW "Conversion method for DIN_b_AC_ReqSw" RAT_FUNC "%10.0" "b" COEFFS 0.000000 1.000000 0.000000 0.000000 0.000000 1.000000 /end COMPU_METHOD
/* Scalar measurable for DDE 'DIN_b_Belt'. */
/begin MEASUREMENT DIN_b_Belt "(not defined)" UBYTE CU_DIN_B_BELT 1 100 0.0 1.0 ECU_ADDRESS 0x40002f69 BYTE_ORDER MSB_FIRST /end MEASUREMENT
/begin COMPU_METHOD CU_DIN_B_BELT "Conversion method for DIN_b_Belt" RAT_FUNC "%10.0" "b" COEFFS 0.000000 1.000000 0.000000 0.000000 0.000000 1.000000 /end COMPU_METHOD
/* Scalar measurable for DDE 'DIN_b_CamPhaseValid'. */
/begin MEASUREMENT DIN_b_CamPhaseValid "Displayable" UBYTE CU_DIN_B_CAMPHASEVALID 1 100 0.0 1.0 ECU_ADDRESS 0x40002f77 BYTE_ORDER MSB_FIRST /end MEASUREMENT
/begin COMPU_METHOD CU_DIN_B_CAMPHASEVALID "Conversion method for DIN_b_CamPhaseValid" RAT_FUNC "%10.0" "b" COEFFS 0.000000 1.000000 0.000000 0.000000 0.000000 1.000000 /end COMPU_METHOD
/* Scalar measurable for DDE 'DIN_b_CamTO'. */
/begin MEASUREMENT DIN_b_CamTO "Intake cam timeout flag" UBYTE CU_DIN_B_CAMTO 1 100 0.0 1.0 ECU_ADDRESS 0x40002f78 BYTE_ORDER MSB_FIRST /end MEASUREMENT
/begin COMPU_METHOD CU_DIN_B_CAMTO "Conversion method for DIN_b_CamTO" RAT_FUNC "%10.0" "b" COEFFS 0.000000 1.000000 0.000000 0.000000 0.000000 1.000000 /end COMPU_METHOD
/* Scalar measurable for DDE 'DIN_b_Door'. */
/begin MEASUREMENT DIN_b_Door "(not defined)" UBYTE CU_DIN_B_DOOR 1 100 0.0 1.0 ECU_ADDRESS 0x40002f68 BYTE_ORDER MSB_FIRST /end MEASUREMENT
/begin COMPU_METHOD CU_DIN_B_DOOR "Conversion method for DIN_b_Door" RAT_FUNC "%10.0" "b" COEFFS 0.000000 1.000000 0.000000 0.000000 0.000000 1.000000 /end COMPU_METHOD
/* Scalar measurable for DDE 'DIN_b_EngSync'. */
/begin MEASUREMENT DIN_b_EngSync "Displayable" UBYTE CU_DIN_B_ENGSYNC 1 100 0.0 1.0 ECU_ADDRESS 0x40002f66 BYTE_ORDER MSB_FIRST /end MEASUREMENT
/begin COMPU_METHOD CU_DIN_B_ENGSYNC "Conversion method for DIN_b_EngSync" RAT_FUNC "%10.0" "b" COEFFS 0.000000 1.000000 0.000000 0.000000 0.000000 1.000000 /end COMPU_METHOD
/* Scalar measurable for DDE 'DIN_b_Ign'. */
/begin MEASUREMENT DIN_b_Ign "Displayable" UBYTE CU_DIN_B_IGN 1 100 0.0 1.0 ECU_ADDRESS 0x40002f79 BYTE_ORDER MSB_FIRST /end MEASUREMENT
/begin COMPU_METHOD CU_DIN_B_IGN "Conversion method for DIN_b_Ign" RAT_FUNC "%10.0" "b" COEFFS 0.000000 1.000000 0.000000 0.000000 0.000000 1.000000 /end COMPU_METHOD
/* Scalar measurable for DDE 'DIN_b_MAF_To'. */
/begin MEASUREMENT DIN_b_MAF_To "Timeout flag" UBYTE CU_DIN_B_MAF_TO 1 100 0.0 1.0 ECU_ADDRESS 0x40002f71 BYTE_ORDER MSB_FIRST /end MEASUREMENT
/begin COMPU_METHOD CU_DIN_B_MAF_TO "Conversion method for DIN_b_MAF_To" RAT_FUNC "%10.0" "b" COEFFS 0.000000 1.000000 0.000000 0.000000 0.000000 1.000000 /end COMPU_METHOD
/* Scalar measurable for DDE 'DIN_b_OilPrSw'. */
/begin MEASUREMENT DIN_b_OilPrSw "(not defined)" UBYTE CU_DIN_B_OILPRSW 1 100 0.0 1.0 ECU_ADDRESS 0x40002f6d BYTE_ORDER MSB_FIRST /end MEASUREMENT
/begin COMPU_METHOD CU_DIN_B_OILPRSW "Conversion method for DIN_b_OilPrSw" RAT_FUNC "%10.0" "b" COEFFS 0.000000 1.000000 0.000000 0.000000 0.000000 1.000000 /end COMPU_METHOD
/* Scalar measurable for DDE 'DIN_b_ParkingBrake'. */
/begin MEASUREMENT DIN_b_ParkingBrake "(not defined)" UBYTE CU_DIN_B_PARKINGBRAKE 1 100 0.0 1.0 ECU_ADDRESS 0x40002f67 BYTE_ORDER MSB_FIRST /end MEASUREMENT
/begin COMPU_METHOD CU_DIN_B_PARKINGBRAKE "Conversion method for DIN_b_ParkingBrake" RAT_FUNC "%10.0" "b" COEFFS 0.000000 1.000000 0.000000 0.000000 0.000000 1.000000 /end COMPU_METHOD
/* Scalar measurable for DDE 'DIN_b_PedalBrake'. */
/begin MEASUREMENT DIN_b_PedalBrake "(not defined)" UBYTE CU_DIN_B_PEDALBRAKE 1 100 0.0 1.0 ECU_ADDRESS 0x40002f6a BYTE_ORDER MSB_FIRST /end MEASUREMENT
/begin COMPU_METHOD CU_DIN_B_PEDALBRAKE "Conversion method for DIN_b_PedalBrake" RAT_FUNC "%10.0" "b" COEFFS 0.000000 1.000000 0.000000 0.000000 0.000000 1.000000 /end COMPU_METHOD
/* Scalar measurable for DDE 'DIN_b_RearGear'. */
/begin MEASUREMENT DIN_b_RearGear "Displayable" UBYTE CU_DIN_B_REARGEAR 1 100 0.0 1.0 ECU_ADDRESS 0x40002f75 BYTE_ORDER MSB_FIRST /end MEASUREMENT
/begin COMPU_METHOD CU_DIN_B_REARGEAR "Conversion method for DIN_b_RearGear" RAT_FUNC "%10.0" "b" COEFFS 0.000000 1.000000 0.000000 0.000000 0.000000 1.000000 /end COMPU_METHOD
/* Scalar measurable for DDE 'DIN_cnt_CamExtraTeeth'. */
/begin MEASUREMENT DIN_cnt_CamExtraTeeth "Number of extra cam teeth counted" FLOAT32_IEEE CU_DIN_CNT_CAMEXTRATEETH 1 100 0.0 0.0 ECU_ADDRESS 0x40003820 BYTE_ORDER MSB_FIRST /end MEASUREMENT
/begin COMPU_METHOD CU_DIN_CNT_CAMEXTRATEETH "Conversion method for DIN_cnt_CamExtraTeeth" RAT_FUNC "%10.0" "cnt" COEFFS 0.000000 1.000000 0.000000 0.000000 0.000000 1.000000 /end COMPU_METHOD
/* Scalar measurable for DDE 'DIN_cnt_CamMissTeeth'. */
/begin MEASUREMENT DIN_cnt_CamMissTeeth "Number of cam teeth missed" FLOAT32_IEEE CU_DIN_CNT_CAMMISSTEETH 1 100 0.0 0.0 ECU_ADDRESS 0x40003824 BYTE_ORDER MSB_FIRST /end MEASUREMENT
/begin COMPU_METHOD CU_DIN_CNT_CAMMISSTEETH "Conversion method for DIN_cnt_CamMissTeeth" RAT_FUNC "%10.0" "cnt" COEFFS 0.000000 1.000000 0.000000 0.000000 0.000000 1.000000 /end COMPU_METHOD
/* Scalar measurable for DDE 'DIN_deg_CamTooth1'. */
/begin MEASUREMENT DIN_deg_CamTooth1 "Tooth angle for Tooth 1 of intake cam" FLOAT32_IEEE CU_DIN_DEG_CAMTOOTH1 1 100 0.0 0.0 ECU_ADDRESS 0x40003810 BYTE_ORDER MSB_FIRST /end MEASUREMENT
/begin COMPU_METHOD CU_DIN_DEG_CAMTOOTH1 "Conversion method for DIN_deg_CamTooth1" RAT_FUNC "%10.2" "deg" COEFFS 0.000000 1.000000 0.000000 0.000000 0.000000 1.000000 /end COMPU_METHOD
/* Scalar measurable for DDE 'DIN_deg_CamTooth2'. */
/begin MEASUREMENT DIN_deg_CamTooth2 "Tooth angle for Tooth 2 of intake cam" FLOAT32_IEEE CU_DIN_DEG_CAMTOOTH2 1 100 0.0 0.0 ECU_ADDRESS 0x4000381c BYTE_ORDER MSB_FIRST /end MEASUREMENT
/begin COMPU_METHOD CU_DIN_DEG_CAMTOOTH2 "Conversion method for DIN_deg_CamTooth2" RAT_FUNC "%10.2" "deg" COEFFS 0.000000 1.000000 0.000000 0.000000 0.000000 1.000000 /end COMPU_METHOD
/* Scalar measurable for DDE 'DIN_deg_CamTooth3'. */
/begin MEASUREMENT DIN_deg_CamTooth3 "Tooth angle for Tooth 3 of intake cam" FLOAT32_IEEE CU_DIN_DEG_CAMTOOTH3 1 100 0.0 0.0 ECU_ADDRESS 0x40003818 BYTE_ORDER MSB_FIRST /end MEASUREMENT
/begin COMPU_METHOD CU_DIN_DEG_CAMTOOTH3 "Conversion method for DIN_deg_CamTooth3" RAT_FUNC "%10.2" "deg" COEFFS 0.000000 1.000000 0.000000 0.000000 0.000000 1.000000 /end COMPU_METHOD
/* Scalar measurable for DDE 'DIN_deg_CamTooth4'. */
/begin MEASUREMENT DIN_deg_CamTooth4 "Tooth angle for Tooth 4 of intake cam" FLOAT32_IEEE CU_DIN_DEG_CAMTOOTH4 1 100 0.0 0.0 ECU_ADDRESS 0x4000380c BYTE_ORDER MSB_FIRST /end MEASUREMENT
/begin COMPU_METHOD CU_DIN_DEG_CAMTOOTH4 "Conversion method for DIN_deg_CamTooth4" RAT_FUNC "%10.2" "deg" COEFFS 0.000000 1.000000 0.000000 0.000000 0.000000 1.000000 /end COMPU_METHOD
/* Scalar measurable for DDE 'DIN_deg_CamToothDelta'. */
/begin MEASUREMENT DIN_deg_CamToothDelta "Displayable" FLOAT32_IEEE CU_DIN_DEG_CAMTOOTHDELTA 1 100 0.0 0.0 ECU_ADDRESS 0x40003814 BYTE_ORDER MSB_FIRST /end MEASUREMENT
/begin COMPU_METHOD CU_DIN_DEG_CAMTOOTHDELTA "Conversion method for DIN_deg_CamToothDelta" RAT_FUNC "%10.0" "deg" COEFFS 0.000000 1.000000 0.000000 0.000000 0.000000 1.000000 /end COMPU_METHOD
/* Scalar measurable for DDE 'DIN_e_CurrentCyl'. */
/begin MEASUREMENT DIN_e_CurrentCyl "Angular cylinder number" UBYTE CU_DIN_E_CURRENTCYL 1 100 0.0 0.0 ECU_ADDRESS 0x4000301e BYTE_ORDER MSB_FIRST /end MEASUREMENT
/begin COMPU_METHOD CU_DIN_E_CURRENTCYL "Conversion method for DIN_e_CurrentCyl" RAT_FUNC "%10.0" "e" COEFFS 0.000000 1.000000 0.000000 0.000000 0.000000 1.000000 /end COMPU_METHOD
/* Scalar measurable for DDE 'DIN_gps_MAF'. */
/begin MEASUREMENT DIN_gps_MAF "Displayable" FLOAT32_IEEE CU_DIN_GPS_MAF 1 100 0.0 0.0 ECU_ADDRESS 0x400037e8 BYTE_ORDER MSB_FIRST /end MEASUREMENT
/begin COMPU_METHOD CU_DIN_GPS_MAF "Conversion method for DIN_gps_MAF" RAT_FUNC "%10.0" "gps" COEFFS 0.000000 1.000000 0.000000 0.000000 0.000000 1.000000 /end COMPU_METHOD
/* Scalar measurable for DDE 'DIN_kph_VehSpd'. */
/begin MEASUREMENT DIN_kph_VehSpd "Displayable" FLOAT32_IEEE CU_DIN_KPH_VEHSPD 1 100 0.0 0.0 ECU_ADDRESS 0x400037f4 BYTE_ORDER MSB_FIRST /end MEASUREMENT
/begin COMPU_METHOD CU_DIN_KPH_VEHSPD "Conversion method for DIN_kph_VehSpd" RAT_FUNC "%10.0" "kph" COEFFS 0.000000 1.000000 0.000000 0.000000 0.000000 1.000000 /end COMPU_METHOD
/* Scalar measurable for DDE 'DIN_pct_AltLoad'. */
/begin MEASUREMENT DIN_pct_AltLoad "Displayable" FLOAT32_IEEE CU_DIN_PCT_ALTLOAD 1 100 0.0 0.0 ECU_ADDRESS 0x400037e4 BYTE_ORDER MSB_FIRST /end MEASUREMENT
/begin COMPU_METHOD CU_DIN_PCT_ALTLOAD "Conversion method for DIN_pct_AltLoad" RAT_FUNC "%10.0" "pct" COEFFS 0.000000 1.000000 0.000000 0.000000 0.000000 1.000000 /end COMPU_METHOD
/* Scalar measurable for DDE 'DIN_ret_CamPhase'. */
/begin MEASUREMENT DIN_ret_CamPhase "Intake cam phase angle" FLOAT32_IEEE CU_DIN_RET_CAMPHASE 1 100 0.0 0.0 ECU_ADDRESS 0x400037ec BYTE_ORDER MSB_FIRST /end MEASUREMENT
/begin COMPU_METHOD CU_DIN_RET_CAMPHASE "Conversion method for DIN_ret_CamPhase" RAT_FUNC "%10.2" "ret" COEFFS 0.000000 1.000000 0.000000 0.000000 0.000000 1.000000 /end COMPU_METHOD
/* Scalar measurable for DDE 'DTC_NU_TestTime'. */
/begin MEASUREMENT DTC_NU_TestTime "(not defined)" FLOAT32_IEEE CU_DTC_NU_TESTTIME 1 100 0.0 1000000.0 ECU_ADDRESS 0x40003904 BYTE_ORDER MSB_FIRST /end MEASUREMENT
/begin COMPU_METHOD CU_DTC_NU_TESTTIME "Conversion method for DTC_NU_TestTime" RAT_FUNC "%10.0" "s" COEFFS 0.000000 1.000000 0.000000 0.000000 0.000000 1.000000 /end COMPU_METHOD
/* Scalar measurable for DDE 'DTC_b_1_boostOC'. */
/begin MEASUREMENT DTC_b_1_boostOC "DTC62" UBYTE CU_DTC_B_1_BOOSTOC 1 100 0.0 1.0 ECU_ADDRESS 0x40002f5f BYTE_ORDER MSB_FIRST /end MEASUREMENT
/begin COMPU_METHOD CU_DTC_B_1_BOOSTOC "Conversion method for DTC_b_1_boostOC" RAT_FUNC "%10.0" "b" COEFFS 0.000000 1.000000 0.000000 0.000000 0.000000 1.000000 /end COMPU_METHOD
/* Scalar measurable for DDE 'DTC_b_1_lsol'. */
/begin MEASUREMENT DTC_b_1_lsol "DTC44" UBYTE CU_DTC_B_1_LSOL 1 100 0.0 1.0 ECU_ADDRESS 0x40002f61 BYTE_ORDER MSB_FIRST /end MEASUREMENT
/begin COMPU_METHOD CU_DTC_B_1_LSOL "Conversion method for DTC_b_1_lsol" RAT_FUNC "%10.0" "b" COEFFS 0.000000 1.000000 0.000000 0.000000 0.000000 1.000000 /end COMPU_METHOD
/* Scalar measurable for DDE 'DTC_b_1_sb'. */
/begin MEASUREMENT DTC_b_1_sb "DTC60" UBYTE CU_DTC_B_1_SB 1 100 0.0 1.0 ECU_ADDRESS 0x40002f60 BYTE_ORDER MSB_FIRST /end MEASUREMENT
/begin COMPU_METHOD CU_DTC_B_1_SB "Conversion method for DTC_b_1_sb" RAT_FUNC "%10.0" "b" COEFFS 0.000000 1.000000 0.000000 0.000000 0.000000 1.000000 /end COMPU_METHOD
/* Scalar measurable for DDE 'DTC_b_1_sg'. */
/begin MEASUREMENT DTC_b_1_sg "DTC68" UBYTE CU_DTC_B_1_SG 1 100 0.0 1.0 ECU_ADDRESS 0x40002f5e BYTE_ORDER MSB_FIRST /end MEASUREMENT
/begin COMPU_METHOD CU_DTC_B_1_SG "Conversion method for DTC_b_1_sg" RAT_FUNC "%10.0" "b" COEFFS 0.000000 1.000000 0.000000 0.000000 0.000000 1.000000 /end COMPU_METHOD
/* Scalar measurable for DDE 'DTC_b_2_boostOC'. */
/begin MEASUREMENT DTC_b_2_boostOC "DTC62" UBYTE CU_DTC_B_2_BOOSTOC 1 100 0.0 1.0 ECU_ADDRESS 0x40002f5b BYTE_ORDER MSB_FIRST /end MEASUREMENT
/begin COMPU_METHOD CU_DTC_B_2_BOOSTOC "Conversion method for DTC_b_2_boostOC" RAT_FUNC "%10.0" "b" COEFFS 0.000000 1.000000 0.000000 0.000000 0.000000 1.000000 /end COMPU_METHOD
/* Scalar measurable for DDE 'DTC_b_2_lsol'. */
/begin MEASUREMENT DTC_b_2_lsol "DTC43" UBYTE CU_DTC_B_2_LSOL 1 100 0.0 1.0 ECU_ADDRESS 0x40002f5d BYTE_ORDER MSB_FIRST /end MEASUREMENT
/begin COMPU_METHOD CU_DTC_B_2_LSOL "Conversion method for DTC_b_2_lsol" RAT_FUNC "%10.0" "b" COEFFS 0.000000 1.000000 0.000000 0.000000 0.000000 1.000000 /end COMPU_METHOD
/* Scalar measurable for DDE 'DTC_b_2_sb'. */
/begin MEASUREMENT DTC_b_2_sb "DTC59" UBYTE CU_DTC_B_2_SB 1 100 0.0 1.0 ECU_ADDRESS 0x40002f5c BYTE_ORDER MSB_FIRST /end MEASUREMENT
/begin COMPU_METHOD CU_DTC_B_2_SB "Conversion method for DTC_b_2_sb" RAT_FUNC "%10.0" "b" COEFFS 0.000000 1.000000 0.000000 0.000000 0.000000 1.000000 /end COMPU_METHOD
/* Scalar measurable for DDE 'DTC_b_2_sg'. */
/begin MEASUREMENT DTC_b_2_sg "DTC67" UBYTE CU_DTC_B_2_SG 1 100 0.0 1.0 ECU_ADDRESS 0x40002f5a BYTE_ORDER MSB_FIRST /end MEASUREMENT
/begin COMPU_METHOD CU_DTC_B_2_SG "Conversion method for DTC_b_2_sg" RAT_FUNC "%10.0" "b" COEFFS 0.000000 1.000000 0.000000 0.000000 0.000000 1.000000 /end COMPU_METHOD
/* Scalar measurable for DDE 'DTC_b_3_boostOC'. */
/begin MEASUREMENT DTC_b_3_boostOC "DTC62" UBYTE CU_DTC_B_3_BOOSTOC 1 100 0.0 1.0 ECU_ADDRESS 0x40002f53 BYTE_ORDER MSB_FIRST /end MEASUREMENT
/begin COMPU_METHOD CU_DTC_B_3_BOOSTOC "Conversion method for DTC_b_3_boostOC" RAT_FUNC "%10.0" "b" COEFFS 0.000000 1.000000 0.000000 0.000000 0.000000 1.000000 /end COMPU_METHOD
/* Scalar measurable for DDE 'DTC_b_3_lsol'. */
/begin MEASUREMENT DTC_b_3_lsol "DTC45" UBYTE CU_DTC_B_3_LSOL 1 100 0.0 1.0 ECU_ADDRESS 0x40002f55 BYTE_ORDER MSB_FIRST /end MEASUREMENT
/begin COMPU_METHOD CU_DTC_B_3_LSOL "Conversion method for DTC_b_3_lsol" RAT_FUNC "%10.0" "b" COEFFS 0.000000 1.000000 0.000000 0.000000 0.000000 1.000000 /end COMPU_METHOD
/* Scalar measurable for DDE 'DTC_b_3_sb'. */
/begin MEASUREMENT DTC_b_3_sb "DTC61" UBYTE CU_DTC_B_3_SB 1 100 0.0 1.0 ECU_ADDRESS 0x40002f54 BYTE_ORDER MSB_FIRST /end MEASUREMENT
/begin COMPU_METHOD CU_DTC_B_3_SB "Conversion method for DTC_b_3_sb" RAT_FUNC "%10.0" "b" COEFFS 0.000000 1.000000 0.000000 0.000000 0.000000 1.000000 /end COMPU_METHOD
/* Scalar measurable for DDE 'DTC_b_3_sg'. */
/begin MEASUREMENT DTC_b_3_sg "DTC69" UBYTE CU_DTC_B_3_SG 1 100 0.0 1.0 ECU_ADDRESS 0x40002f52 BYTE_ORDER MSB_FIRST /end MEASUREMENT
/begin COMPU_METHOD CU_DTC_B_3_SG "Conversion method for DTC_b_3_sg" RAT_FUNC "%10.0" "b" COEFFS 0.000000 1.000000 0.000000 0.000000 0.000000 1.000000 /end COMPU_METHOD
/* Scalar measurable for DDE 'DTC_b_4_boostOC'. */
/begin MEASUREMENT DTC_b_4_boostOC "DTC62" UBYTE CU_DTC_B_4_BOOSTOC 1 100 0.0 1.0 ECU_ADDRESS 0x40002f58 BYTE_ORDER MSB_FIRST /end MEASUREMENT
/begin COMPU_METHOD CU_DTC_B_4_BOOSTOC "Conversion method for DTC_b_4_boostOC" RAT_FUNC "%10.0" "b" COEFFS 0.000000 1.000000 0.000000 0.000000 0.000000 1.000000 /end COMPU_METHOD
/* Scalar measurable for DDE 'DTC_b_4_lsol'. */
/begin MEASUREMENT DTC_b_4_lsol "DTC46" UBYTE CU_DTC_B_4_LSOL 1 100 0.0 1.0 ECU_ADDRESS 0x40002f59 BYTE_ORDER MSB_FIRST /end MEASUREMENT
/begin COMPU_METHOD CU_DTC_B_4_LSOL "Conversion method for DTC_b_4_lsol" RAT_FUNC "%10.0" "b" COEFFS 0.000000 1.000000 0.000000 0.000000 0.000000 1.000000 /end COMPU_METHOD
/* Scalar measurable for DDE 'DTC_b_4_sb'. */
/begin MEASUREMENT DTC_b_4_sb "DTC62" UBYTE CU_DTC_B_4_SB 1 100 0.0 1.0 ECU_ADDRESS 0x40002f57 BYTE_ORDER MSB_FIRST /end MEASUREMENT
/begin COMPU_METHOD CU_DTC_B_4_SB "Conversion method for DTC_b_4_sb" RAT_FUNC "%10.0" "b" COEFFS 0.000000 1.000000 0.000000 0.000000 0.000000 1.000000 /end COMPU_METHOD
/* Scalar measurable for DDE 'DTC_b_4_sg'. */
/begin MEASUREMENT DTC_b_4_sg "DTC70" UBYTE CU_DTC_B_4_SG 1 100 0.0 1.0 ECU_ADDRESS 0x40002f56 BYTE_ORDER MSB_FIRST /end MEASUREMENT
/begin COMPU_METHOD CU_DTC_B_4_SG "Conversion method for DTC_b_4_sg" RAT_FUNC "%10.0" "b" COEFFS 0.000000 1.000000 0.000000 0.000000 0.000000 1.000000 /end COMPU_METHOD
/* Scalar measurable for DDE 'DTC_b_BAT_VoltageOutofRange'. */
/begin MEASUREMENT DTC_b_BAT_VoltageOutofRange "DTC176" UBYTE CU_DTC_B_BAT_VOLTAGEOUTOFRANGE 1 100 0.0 1.0 ECU_ADDRESS 0x40002f8b BYTE_ORDER MSB_FIRST /end MEASUREMENT
/begin COMPU_METHOD CU_DTC_B_BAT_VOLTAGEOUTOFRANGE "Conversion method for DTC_b_BAT_VoltageOutofRange" RAT_FUNC "%10.0" "b" COEFFS 0.000000 1.000000 0.000000 0.000000 0.000000 1.000000 /end COMPU_METHOD
/* Scalar measurable for DDE 'DTC_b_CataCounting'. */
/begin MEASUREMENT DTC_b_CataCounting "DTC" UBYTE CU_DTC_B_CATACOUNTING 1 100 0.0 1.0 ECU_ADDRESS 0x40002fb7 BYTE_ORDER MSB_FIRST /end MEASUREMENT
/begin COMPU_METHOD CU_DTC_B_CATACOUNTING "Conversion method for DTC_b_CataCounting" RAT_FUNC "%10.0" "b" COEFFS 0.000000 1.000000 0.000000 0.000000 0.000000 1.000000 /end COMPU_METHOD
/* Scalar measurable for DDE 'DTC_b_Catalyst_A'. */
/begin MEASUREMENT DTC_b_Catalyst_A "DTC40" UBYTE CU_DTC_B_CATALYST_A 1 100 0.0 1.0 ECU_ADDRESS 0x40002fb6 BYTE_ORDER MSB_FIRST /end MEASUREMENT
/begin COMPU_METHOD CU_DTC_B_CATALYST_A "Conversion method for DTC_b_Catalyst_A" RAT_FUNC "%10.0" "b" COEFFS 0.000000 1.000000 0.000000 0.000000 0.000000 1.000000 /end COMPU_METHOD
/* Scalar measurable for DDE 'DTC_b_DiagCataTemp_ena'. */
/begin MEASUREMENT DTC_b_DiagCataTemp_ena "DiagCataTemp_ena" UBYTE CU_DTC_B_DIAGCATATEMP_ENA 1 100 0.0 1.0 ECU_ADDRESS 0x40002fba BYTE_ORDER MSB_FIRST /end MEASUREMENT
/begin COMPU_METHOD CU_DTC_B_DIAGCATATEMP_ENA "Conversion method for DTC_b_DiagCataTemp_ena" RAT_FUNC "%10.0" "b" COEFFS 0.000000 1.000000 0.000000 0.000000 0.000000 1.000000 /end COMPU_METHOD
/* Scalar measurable for DDE 'DTC_b_DiagCata_Condition'. */
/begin MEASUREMENT DTC_b_DiagCata_Condition "DiagCata_Condition" UBYTE CU_DTC_B_DIAGCATA_CONDITION 1 100 0.0 1.0 ECU_ADDRESS 0x40002fb9 BYTE_ORDER MSB_FIRST /end MEASUREMENT
/begin COMPU_METHOD CU_DTC_B_DIAGCATA_CONDITION "Conversion method for DTC_b_DiagCata_Condition" RAT_FUNC "%10.0" "b" COEFFS 0.000000 1.000000 0.000000 0.000000 0.000000 1.000000 /end COMPU_METHOD
/* Scalar measurable for DDE 'DTC_b_DiagCata_Set'. */
/begin MEASUREMENT DTC_b_DiagCata_Set "DiagCata_Set" UBYTE CU_DTC_B_DIAGCATA_SET 1 100 0.0 1.0 ECU_ADDRESS 0x40002fc0 BYTE_ORDER MSB_FIRST /end MEASUREMENT
/begin COMPU_METHOD CU_DTC_B_DIAGCATA_SET "Conversion method for DTC_b_DiagCata_Set" RAT_FUNC "%10.0" "b" COEFFS 0.000000 1.000000 0.000000 0.000000 0.000000 1.000000 /end COMPU_METHOD
/* Scalar measurable for DDE 'DTC_b_DiagCata_TestEnd'. */
/begin MEASUREMENT DTC_b_DiagCata_TestEnd "DiagCata_TestEnd" UBYTE CU_DTC_B_DIAGCATA_TESTEND 1 100 0.0 1.0 ECU_ADDRESS 0x40002f81 BYTE_ORDER MSB_FIRST /end MEASUREMENT
/begin COMPU_METHOD CU_DTC_B_DIAGCATA_TESTEND "Conversion method for DTC_b_DiagCata_TestEnd" RAT_FUNC "%10.0" "b" COEFFS 0.000000 1.000000 0.000000 0.000000 0.000000 1.000000 /end COMPU_METHOD
/* Scalar measurable for DDE 'DTC_b_EnableMIsfire'. */
/begin MEASUREMENT DTC_b_EnableMIsfire "DTC" UBYTE CU_DTC_B_ENABLEMISFIRE 1 100 0.0 1.0 ECU_ADDRESS 0x40002f80 BYTE_ORDER MSB_FIRST /end MEASUREMENT
/begin COMPU_METHOD CU_DTC_B_ENABLEMISFIRE "Conversion method for DTC_b_EnableMIsfire" RAT_FUNC "%10.0" "b" COEFFS 0.000000 1.000000 0.000000 0.000000 0.000000 1.000000 /end COMPU_METHOD
/* Scalar measurable for DDE 'DTC_b_FalloCamShaft'. */
/begin MEASUREMENT DTC_b_FalloCamShaft "DTC141" UBYTE CU_DTC_B_FALLOCAMSHAFT 1 100 0.0 1.0 ECU_ADDRESS 0x40002f76 BYTE_ORDER MSB_FIRST /end MEASUREMENT
/begin COMPU_METHOD CU_DTC_B_FALLOCAMSHAFT "Conversion method for DTC_b_FalloCamShaft" RAT_FUNC "%10.0" "b" COEFFS 0.000000 1.000000 0.000000 0.000000 0.000000 1.000000 /end COMPU_METHOD
/* Scalar measurable for DDE 'DTC_b_FalloCramShaft'. */
/begin MEASUREMENT DTC_b_FalloCramShaft "DTC141" UBYTE CU_DTC_B_FALLOCRAMSHAFT 1 100 0.0 1.0 ECU_ADDRESS 0x40002f7a BYTE_ORDER MSB_FIRST /end MEASUREMENT
/begin COMPU_METHOD CU_DTC_B_FALLOCRAMSHAFT "Conversion method for DTC_b_FalloCramShaft" RAT_FUNC "%10.0" "b" COEFFS 0.000000 1.000000 0.000000 0.000000 0.000000 1.000000 /end COMPU_METHOD
/* Scalar measurable for DDE 'DTC_b_HeatersA_OL'. */
/begin MEASUREMENT DTC_b_HeatersA_OL "DTC13" UBYTE CU_DTC_B_HEATERSA_OL 1 100 0.0 1.0 ECU_ADDRESS 0x40002f98 BYTE_ORDER MSB_FIRST /end MEASUREMENT
/begin COMPU_METHOD CU_DTC_B_HEATERSA_OL "Conversion method for DTC_b_HeatersA_OL" RAT_FUNC "%10.0" "b" COEFFS 0.000000 1.000000 0.000000 0.000000 0.000000 1.000000 /end COMPU_METHOD
/* Scalar measurable for DDE 'DTC_b_HeatersA_SB'. */
/begin MEASUREMENT DTC_b_HeatersA_SB "DTC19" UBYTE CU_DTC_B_HEATERSA_SB 1 100 0.0 1.0 ECU_ADDRESS 0x40002f95 BYTE_ORDER MSB_FIRST /end MEASUREMENT
/begin COMPU_METHOD CU_DTC_B_HEATERSA_SB "Conversion method for DTC_b_HeatersA_SB" RAT_FUNC "%10.0" "b" COEFFS 0.000000 1.000000 0.000000 0.000000 0.000000 1.000000 /end COMPU_METHOD
/* Scalar measurable for DDE 'DTC_b_HeatersA_SG'. */
/begin MEASUREMENT DTC_b_HeatersA_SG "DTC17" UBYTE CU_DTC_B_HEATERSA_SG 1 100 0.0 1.0 ECU_ADDRESS 0x40002f96 BYTE_ORDER MSB_FIRST /end MEASUREMENT
/begin COMPU_METHOD CU_DTC_B_HEATERSA_SG "Conversion method for DTC_b_HeatersA_SG" RAT_FUNC "%10.0" "b" COEFFS 0.000000 1.000000 0.000000 0.000000 0.000000 1.000000 /end COMPU_METHOD
/* Scalar measurable for DDE 'DTC_b_LB11CTFail'. */
/begin MEASUREMENT DTC_b_LB11CTFail "DTC15" UBYTE CU_DTC_B_LB11CTFAIL 1 100 0.0 1.0 ECU_ADDRESS 0x40002f97 BYTE_ORDER MSB_FIRST /end MEASUREMENT
/begin COMPU_METHOD CU_DTC_B_LB11CTFAIL "Conversion method for DTC_b_LB11CTFail" RAT_FUNC "%10.0" "b" COEFFS 0.000000 1.000000 0.000000 0.000000 0.000000 1.000000 /end COMPU_METHOD
/* Scalar measurable for DDE 'DTC_b_LambdaA_SB'. */
/begin MEASUREMENT DTC_b_LambdaA_SB "DTC11" UBYTE CU_DTC_B_LAMBDAA_SB 1 100 0.0 1.0 ECU_ADDRESS 0x40002f99 BYTE_ORDER MSB_FIRST /end MEASUREMENT
/begin COMPU_METHOD CU_DTC_B_LAMBDAA_SB "Conversion method for DTC_b_LambdaA_SB" RAT_FUNC "%10.0" "b" COEFFS 0.000000 1.000000 0.000000 0.000000 0.000000 1.000000 /end COMPU_METHOD
/* Scalar measurable for DDE 'DTC_b_LambdaA_SG'. */
/begin MEASUREMENT DTC_b_LambdaA_SG "DTC9" UBYTE CU_DTC_B_LAMBDAA_SG 1 100 0.0 1.0 ECU_ADDRESS 0x40002f94 BYTE_ORDER MSB_FIRST /end MEASUREMENT
/begin COMPU_METHOD CU_DTC_B_LAMBDAA_SG "Conversion method for DTC_b_LambdaA_SG" RAT_FUNC "%10.0" "b" COEFFS 0.000000 1.000000 0.000000 0.000000 0.000000 1.000000 /end COMPU_METHOD
/* Scalar measurable for DDE 'DTC_b_LambdaB11NOTValid'. */
/begin MEASUREMENT DTC_b_LambdaB11NOTValid "DTC160" UBYTE CU_DTC_B_LAMBDAB11NOTVALID 1 100 0.0 1.0 ECU_ADDRESS 0x40002f93 BYTE_ORDER MSB_FIRST /end MEASUREMENT
/begin COMPU_METHOD CU_DTC_B_LAMBDAB11NOTVALID "Conversion method for DTC_b_LambdaB11NOTValid" RAT_FUNC "%10.0" "b" COEFFS 0.000000 1.000000 0.000000 0.000000 0.000000 1.000000 /end COMPU_METHOD
/* Scalar measurable for DDE 'DTC_b_MAPBefThroHV'. */
/begin MEASUREMENT DTC_b_MAPBefThroHV "DTC167" UBYTE CU_DTC_B_MAPBEFTHROHV 1 100 0.0 1.0 ECU_ADDRESS 0x40002f89 BYTE_ORDER MSB_FIRST /end MEASUREMENT
/begin COMPU_METHOD CU_DTC_B_MAPBEFTHROHV "Conversion method for DTC_b_MAPBefThroHV" RAT_FUNC "%10.0" "b" COEFFS 0.000000 1.000000 0.000000 0.000000 0.000000 1.000000 /end COMPU_METHOD
/* Scalar measurable for DDE 'DTC_b_MAPBefThroOL'. */
/begin MEASUREMENT DTC_b_MAPBefThroOL "DTC168" UBYTE CU_DTC_B_MAPBEFTHROOL 1 100 0.0 1.0 ECU_ADDRESS 0x40002f8a BYTE_ORDER MSB_FIRST /end MEASUREMENT
/begin COMPU_METHOD CU_DTC_B_MAPBEFTHROOL "Conversion method for DTC_b_MAPBefThroOL" RAT_FUNC "%10.0" "b" COEFFS 0.000000 1.000000 0.000000 0.000000 0.000000 1.000000 /end COMPU_METHOD
/* Scalar measurable for DDE 'DTC_b_MAPBeforeThroHPress'. */
/begin MEASUREMENT DTC_b_MAPBeforeThroHPress "DTC16" UBYTE CU_DTC_B_MAPBEFORETHROHPRESS 1 100 0.0 1.0 ECU_ADDRESS 0x40002f87 BYTE_ORDER MSB_FIRST /end MEASUREMENT
/begin COMPU_METHOD CU_DTC_B_MAPBEFORETHROHPRESS "Conversion method for DTC_b_MAPBeforeThroHPress" RAT_FUNC "%10.0" "b" COEFFS 0.000000 1.000000 0.000000 0.000000 0.000000 1.000000 /end COMPU_METHOD
/* Scalar measurable for DDE 'DTC_b_MAPBeforeThroLPress'. */
/begin MEASUREMENT DTC_b_MAPBeforeThroLPress "DTC166" UBYTE CU_DTC_B_MAPBEFORETHROLPRESS 1 100 0.0 1.0 ECU_ADDRESS 0x40002f88 BYTE_ORDER MSB_FIRST /end MEASUREMENT
/begin COMPU_METHOD CU_DTC_B_MAPBEFORETHROLPRESS "Conversion method for DTC_b_MAPBeforeThroLPress" RAT_FUNC "%10.0" "b" COEFFS 0.000000 1.000000 0.000000 0.000000 0.000000 1.000000 /end COMPU_METHOD
/* Scalar measurable for DDE 'DTC_b_Misfire_Bancada'. */
/begin MEASUREMENT DTC_b_Misfire_Bancada "DTC" UBYTE CU_DTC_B_MISFIRE_BANCADA 1 100 0.0 1.0 ECU_ADDRESS 0x40002f7b BYTE_ORDER MSB_FIRST /end MEASUREMENT
/begin COMPU_METHOD CU_DTC_B_MISFIRE_BANCADA "Conversion method for DTC_b_Misfire_Bancada" RAT_FUNC "%10.0" "b" COEFFS 0.000000 1.000000 0.000000 0.000000 0.000000 1.000000 /end COMPU_METHOD
/* Scalar measurable for DDE 'DTC_b_Misfire_Cylinder_1'. */
/begin MEASUREMENT DTC_b_Misfire_Cylinder_1 "DTC" UBYTE CU_DTC_B_MISFIRE_CYLINDER_1 1 100 0.0 1.0 ECU_ADDRESS 0x40002f7f BYTE_ORDER MSB_FIRST /end MEASUREMENT
/begin COMPU_METHOD CU_DTC_B_MISFIRE_CYLINDER_1 "Conversion method for DTC_b_Misfire_Cylinder_1" RAT_FUNC "%10.0" "b" COEFFS 0.000000 1.000000 0.000000 0.000000 0.000000 1.000000 /end COMPU_METHOD
/* Scalar measurable for DDE 'DTC_b_Misfire_Cylinder_2'. */
/begin MEASUREMENT DTC_b_Misfire_Cylinder_2 "DTC" UBYTE CU_DTC_B_MISFIRE_CYLINDER_2 1 100 0.0 1.0 ECU_ADDRESS 0x40002f7e BYTE_ORDER MSB_FIRST /end MEASUREMENT
/begin COMPU_METHOD CU_DTC_B_MISFIRE_CYLINDER_2 "Conversion method for DTC_b_Misfire_Cylinder_2" RAT_FUNC "%10.0" "b" COEFFS 0.000000 1.000000 0.000000 0.000000 0.000000 1.000000 /end COMPU_METHOD
/* Scalar measurable for DDE 'DTC_b_Misfire_Cylinder_3'. */
/begin MEASUREMENT DTC_b_Misfire_Cylinder_3 "DTC" UBYTE CU_DTC_B_MISFIRE_CYLINDER_3 1 100 0.0 1.0 ECU_ADDRESS 0x40002f7d BYTE_ORDER MSB_FIRST /end MEASUREMENT
/begin COMPU_METHOD CU_DTC_B_MISFIRE_CYLINDER_3 "Conversion method for DTC_b_Misfire_Cylinder_3" RAT_FUNC "%10.0" "b" COEFFS 0.000000 1.000000 0.000000 0.000000 0.000000 1.000000 /end COMPU_METHOD
/* Scalar measurable for DDE 'DTC_b_Misfire_Cylinder_4'. */
/begin MEASUREMENT DTC_b_Misfire_Cylinder_4 "DTC" UBYTE CU_DTC_B_MISFIRE_CYLINDER_4 1 100 0.0 1.0 ECU_ADDRESS 0x40002f7c BYTE_ORDER MSB_FIRST /end MEASUREMENT
/begin COMPU_METHOD CU_DTC_B_MISFIRE_CYLINDER_4 "Conversion method for DTC_b_Misfire_Cylinder_4" RAT_FUNC "%10.0" "b" COEFFS 0.000000 1.000000 0.000000 0.000000 0.000000 1.000000 /end COMPU_METHOD
/* Scalar measurable for DDE 'DTC_b_NBValid'. */
/begin MEASUREMENT DTC_b_NBValid "NBValid" UBYTE CU_DTC_B_NBVALID 1 100 0.0 1.0 ECU_ADDRESS 0x40002fbb BYTE_ORDER MSB_FIRST /end MEASUREMENT
/begin COMPU_METHOD CU_DTC_B_NBVALID "Conversion method for DTC_b_NBValid" RAT_FUNC "%10.0" "b" COEFFS 0.000000 1.000000 0.000000 0.000000 0.000000 1.000000 /end COMPU_METHOD
/* Scalar measurable for DDE 'DTC_b_OIL_LPress'. */
/begin MEASUREMENT DTC_b_OIL_LPress "DTC108" UBYTE CU_DTC_B_OIL_LPRESS 1 100 0.0 1.0 ECU_ADDRESS 0x40002f6e BYTE_ORDER MSB_FIRST /end MEASUREMENT
/begin COMPU_METHOD CU_DTC_B_OIL_LPRESS "Conversion method for DTC_b_OIL_LPress" RAT_FUNC "%10.0" "b" COEFFS 0.000000 1.000000 0.000000 0.000000 0.000000 1.000000 /end COMPU_METHOD
/* Scalar measurable for DDE 'DTC_b_OIL_Sensor'. */
/begin MEASUREMENT DTC_b_OIL_Sensor "DTC107" UBYTE CU_DTC_B_OIL_SENSOR 1 100 0.0 1.0 ECU_ADDRESS 0x40002f70 BYTE_ORDER MSB_FIRST /end MEASUREMENT
/begin COMPU_METHOD CU_DTC_B_OIL_SENSOR "Conversion method for DTC_b_OIL_Sensor" RAT_FUNC "%10.0" "b" COEFFS 0.000000 1.000000 0.000000 0.000000 0.000000 1.000000 /end COMPU_METHOD
/* Scalar measurable for DDE 'DTC_b_OIL_SensorOL'. */
/begin MEASUREMENT DTC_b_OIL_SensorOL "DTC111" UBYTE CU_DTC_B_OIL_SENSOROL 1 100 0.0 1.0 ECU_ADDRESS 0x40002f6f BYTE_ORDER MSB_FIRST /end MEASUREMENT
/begin COMPU_METHOD CU_DTC_B_OIL_SENSOROL "Conversion method for DTC_b_OIL_SensorOL" RAT_FUNC "%10.0" "b" COEFFS 0.000000 1.000000 0.000000 0.000000 0.000000 1.000000 /end COMPU_METHOD
/* Scalar measurable for DDE 'DTC_b_THR_Motor_Fail'. */
/begin MEASUREMENT DTC_b_THR_Motor_Fail "DTC136" UBYTE CU_DTC_B_THR_MOTOR_FAIL 1 100 0.0 1.0 ECU_ADDRESS 0x40002f90 BYTE_ORDER MSB_FIRST /end MEASUREMENT
/begin COMPU_METHOD CU_DTC_B_THR_MOTOR_FAIL "Conversion method for DTC_b_THR_Motor_Fail" RAT_FUNC "%10.0" "b" COEFFS 0.000000 1.000000 0.000000 0.000000 0.000000 1.000000 /end COMPU_METHOD
/* Scalar measurable for DDE 'DTC_b_TP1_SensorHV'. */
/begin MEASUREMENT DTC_b_TP1_SensorHV "DTC126" UBYTE CU_DTC_B_TP1_SENSORHV 1 100 0.0 1.0 ECU_ADDRESS 0x40002f91 BYTE_ORDER MSB_FIRST /end MEASUREMENT
/begin COMPU_METHOD CU_DTC_B_TP1_SENSORHV "Conversion method for DTC_b_TP1_SensorHV" RAT_FUNC "%10.0" "b" COEFFS 0.000000 1.000000 0.000000 0.000000 0.000000 1.000000 /end COMPU_METHOD
/* Scalar measurable for DDE 'DTC_b_TP1_SensorLV'. */
/begin MEASUREMENT DTC_b_TP1_SensorLV "DTC124" UBYTE CU_DTC_B_TP1_SENSORLV 1 100 0.0 1.0 ECU_ADDRESS 0x40002f92 BYTE_ORDER MSB_FIRST /end MEASUREMENT
/begin COMPU_METHOD CU_DTC_B_TP1_SENSORLV "Conversion method for DTC_b_TP1_SensorLV" RAT_FUNC "%10.0" "b" COEFFS 0.000000 1.000000 0.000000 0.000000 0.000000 1.000000 /end COMPU_METHOD
/* Scalar measurable for DDE 'DTC_b_TP2_SensorHV'. */
/begin MEASUREMENT DTC_b_TP2_SensorHV "DTC127" UBYTE CU_DTC_B_TP2_SENSORHV 1 100 0.0 1.0 ECU_ADDRESS 0x40002f8d BYTE_ORDER MSB_FIRST /end MEASUREMENT
/begin COMPU_METHOD CU_DTC_B_TP2_SENSORHV "Conversion method for DTC_b_TP2_SensorHV" RAT_FUNC "%10.0" "b" COEFFS 0.000000 1.000000 0.000000 0.000000 0.000000 1.000000 /end COMPU_METHOD
/* Scalar measurable for DDE 'DTC_b_TP2_SensorLV'. */
/begin MEASUREMENT DTC_b_TP2_SensorLV "DTC125" UBYTE CU_DTC_B_TP2_SENSORLV 1 100 0.0 1.0 ECU_ADDRESS 0x40002f8e BYTE_ORDER MSB_FIRST /end MEASUREMENT
/begin COMPU_METHOD CU_DTC_B_TP2_SENSORLV "Conversion method for DTC_b_TP2_SensorLV" RAT_FUNC "%10.0" "b" COEFFS 0.000000 1.000000 0.000000 0.000000 0.000000 1.000000 /end COMPU_METHOD
/* Scalar measurable for DDE 'DTC_s_TimerOut_1'. */
/begin MEASUREMENT DTC_s_TimerOut_1 "timer salida" FLOAT32_IEEE CU_DTC_S_TIMEROUT_1 1 100 0.0 10000000.0 ECU_ADDRESS 0x40003918 BYTE_ORDER MSB_FIRST /end MEASUREMENT
/begin COMPU_METHOD CU_DTC_S_TIMEROUT_1 "Conversion method for DTC_s_TimerOut_1" RAT_FUNC "%10.2" "s" COEFFS 0.000000 1.000000 0.000000 0.000000 0.000000 1.000000 /end COMPU_METHOD
/* Scalar measurable for DDE 'DTC_s_TimerOut_2'. */
/begin MEASUREMENT DTC_s_TimerOut_2 "timer salida" FLOAT32_IEEE CU_DTC_S_TIMEROUT_2 1 100 0.0 10000000.0 ECU_ADDRESS 0x4000391c BYTE_ORDER MSB_FIRST /end MEASUREMENT
/begin COMPU_METHOD CU_DTC_S_TIMEROUT_2 "Conversion method for DTC_s_TimerOut_2" RAT_FUNC "%10.2" "s" COEFFS 0.000000 1.000000 0.000000 0.000000 0.000000 1.000000 /end COMPU_METHOD
/* Scalar measurable for DDE 'FLT_b_EH_Open_A'. */
/begin MEASUREMENT FLT_b_EH_Open_A "DIN fault flag from OE block for external heater open" UBYTE CU_FLT_B_EH_OPEN_A 1 100 0.0 1.0 ECU_ADDRESS 0x40002e33 BYTE_ORDER MSB_FIRST /end MEASUREMENT
/begin COMPU_METHOD CU_FLT_B_EH_OPEN_A "Conversion method for FLT_b_EH_Open_A" RAT_FUNC "%10.0" "b" COEFFS 0.000000 1.000000 0.000000 0.000000 0.000000 1.000000 /end COMPU_METHOD
/* Scalar measurable for DDE 'FLT_b_EH_Open_B'. */
/begin MEASUREMENT FLT_b_EH_Open_B "DIN fault flag from OE block for external heater open" UBYTE CU_FLT_B_EH_OPEN_B 1 100 0.0 1.0 ECU_ADDRESS 0x40002e3e BYTE_ORDER MSB_FIRST /end MEASUREMENT
/begin COMPU_METHOD CU_FLT_B_EH_OPEN_B "Conversion method for FLT_b_EH_Open_B" RAT_FUNC "%10.0" "b" COEFFS 0.000000 1.000000 0.000000 0.000000 0.000000 1.000000 /end COMPU_METHOD
/* Scalar measurable for DDE 'FLT_b_EH_ShrtGrnd_A'. */
/begin MEASUREMENT FLT_b_EH_ShrtGrnd_A "DIN fault flag from OE block for external heater short to ground" UBYTE CU_FLT_B_EH_SHRTGRND_A 1 100 0.0 1.0 ECU_ADDRESS 0x40002e36 BYTE_ORDER MSB_FIRST /end MEASUREMENT
/begin COMPU_METHOD CU_FLT_B_EH_SHRTGRND_A "Conversion method for FLT_b_EH_ShrtGrnd_A" RAT_FUNC "%10.0" "b" COEFFS 0.000000 1.000000 0.000000 0.000000 0.000000 1.000000 /end COMPU_METHOD
/* Scalar measurable for DDE 'FLT_b_EH_ShrtGrnd_B'. */
/begin MEASUREMENT FLT_b_EH_ShrtGrnd_B "DIN fault flag from OE block for external heater short to ground" UBYTE CU_FLT_B_EH_SHRTGRND_B 1 100 0.0 1.0 ECU_ADDRESS 0x40002e41 BYTE_ORDER MSB_FIRST /end MEASUREMENT
/begin COMPU_METHOD CU_FLT_B_EH_SHRTGRND_B "Conversion method for FLT_b_EH_ShrtGrnd_B" RAT_FUNC "%10.0" "b" COEFFS 0.000000 1.000000 0.000000 0.000000 0.000000 1.000000 /end COMPU_METHOD
/* Scalar measurable for DDE 'FLT_b_EH_ShrtVBatt_A'. */
/begin MEASUREMENT FLT_b_EH_ShrtVBatt_A "DIN fault flag from OE block for external heater short to Vbatt" UBYTE CU_FLT_B_EH_SHRTVBATT_A 1 100 0.0 1.0 ECU_ADDRESS 0x40002e35 BYTE_ORDER MSB_FIRST /end MEASUREMENT
/begin COMPU_METHOD CU_FLT_B_EH_SHRTVBATT_A "Conversion method for FLT_b_EH_ShrtVBatt_A" RAT_FUNC "%10.0" "b" COEFFS 0.000000 1.000000 0.000000 0.000000 0.000000 1.000000 /end COMPU_METHOD
/* Scalar measurable for DDE 'FLT_b_EH_ShrtVBatt_B'. */
/begin MEASUREMENT FLT_b_EH_ShrtVBatt_B "DIN fault flag from OE block for external heater short to Vbatt" UBYTE CU_FLT_B_EH_SHRTVBATT_B 1 100 0.0 1.0 ECU_ADDRESS 0x40002e40 BYTE_ORDER MSB_FIRST /end MEASUREMENT
/begin COMPU_METHOD CU_FLT_B_EH_SHRTVBATT_B "Conversion method for FLT_b_EH_ShrtVBatt_B" RAT_FUNC "%10.0" "b" COEFFS 0.000000 1.000000 0.000000 0.000000 0.000000 1.000000 /end COMPU_METHOD
/* Scalar measurable for DDE 'FLT_b_HtrPWM_NoResponse_A'. */
/begin MEASUREMENT FLT_b_HtrPWM_NoResponse_A "Fault flag to indicate heater PWM was on too long without response from UR" UBYTE CU_FLT_B_HTRPWM_NORESPONSE_A 1 100 0.0 1.0 ECU_ADDRESS 0x40002e4d BYTE_ORDER MSB_FIRST /end MEASUREMENT
/begin COMPU_METHOD CU_FLT_B_HTRPWM_NORESPONSE_A "Conversion method for FLT_b_HtrPWM_NoResponse_A" RAT_FUNC "%10.0" "b" COEFFS 0.000000 1.000000 0.000000 0.000000 0.000000 1.000000 /end COMPU_METHOD
/* Scalar measurable for DDE 'FLT_b_HtrPWM_NoResponse_B'. */
/begin MEASUREMENT FLT_b_HtrPWM_NoResponse_B "Fault flag to indicate heater PWM was on too long without response from UR" UBYTE CU_FLT_B_HTRPWM_NORESPONSE_B 1 100 0.0 1.0 ECU_ADDRESS 0x40002e5e BYTE_ORDER MSB_FIRST /end MEASUREMENT
/begin COMPU_METHOD CU_FLT_B_HTRPWM_NORESPONSE_B "Conversion method for FLT_b_HtrPWM_NoResponse_B" RAT_FUNC "%10.0" "b" COEFFS 0.000000 1.000000 0.000000 0.000000 0.000000 1.000000 /end COMPU_METHOD
/* Scalar measurable for DDE 'FLT_b_IaIp_ShrtGrnd_A'. */
/begin MEASUREMENT FLT_b_IaIp_ShrtGrnd_A "DIN fault flag from OE block for setup current/pump current short to ground" UBYTE CU_FLT_B_IAIP_SHRTGRND_A 1 100 0.0 1.0 ECU_ADDRESS 0x40002e32 BYTE_ORDER MSB_FIRST /end MEASUREMENT
/begin COMPU_METHOD CU_FLT_B_IAIP_SHRTGRND_A "Conversion method for FLT_b_IaIp_ShrtGrnd_A" RAT_FUNC "%10.0" "b" COEFFS 0.000000 1.000000 0.000000 0.000000 0.000000 1.000000 /end COMPU_METHOD
/* Scalar measurable for DDE 'FLT_b_IaIp_ShrtGrnd_B'. */
/begin MEASUREMENT FLT_b_IaIp_ShrtGrnd_B "DIN fault flag from OE block for setup current/pump current short to ground" UBYTE CU_FLT_B_IAIP_SHRTGRND_B 1 100 0.0 1.0 ECU_ADDRESS 0x40002e3d BYTE_ORDER MSB_FIRST /end MEASUREMENT
/begin COMPU_METHOD CU_FLT_B_IAIP_SHRTGRND_B "Conversion method for FLT_b_IaIp_ShrtGrnd_B" RAT_FUNC "%10.0" "b" COEFFS 0.000000 1.000000 0.000000 0.000000 0.000000 1.000000 /end COMPU_METHOD
/* Scalar measurable for DDE 'FLT_b_IaIp_ShrtVBatt_A'. */
/begin MEASUREMENT FLT_b_IaIp_ShrtVBatt_A "DIN fault flag from OE block for setup current/pump current short to Vbatt" UBYTE CU_FLT_B_IAIP_SHRTVBATT_A 1 100 0.0 1.0 ECU_ADDRESS 0x40002e31 BYTE_ORDER MSB_FIRST /end MEASUREMENT
/begin COMPU_METHOD CU_FLT_B_IAIP_SHRTVBATT_A "Conversion method for FLT_b_IaIp_ShrtVBatt_A" RAT_FUNC "%10.0" "b" COEFFS 0.000000 1.000000 0.000000 0.000000 0.000000 1.000000 /end COMPU_METHOD
/* Scalar measurable for DDE 'FLT_b_IaIp_ShrtVBatt_B'. */
/begin MEASUREMENT FLT_b_IaIp_ShrtVBatt_B "DIN fault flag from OE block for setup current/pump current short to Vbatt" UBYTE CU_FLT_B_IAIP_SHRTVBATT_B 1 100 0.0 1.0 ECU_ADDRESS 0x40002e3c BYTE_ORDER MSB_FIRST /end MEASUREMENT
/begin COMPU_METHOD CU_FLT_B_IAIP_SHRTVBATT_B "Conversion method for FLT_b_IaIp_ShrtVBatt_B" RAT_FUNC "%10.0" "b" COEFFS 0.000000 1.000000 0.000000 0.000000 0.000000 1.000000 /end COMPU_METHOD
/* Scalar measurable for DDE 'FLT_b_SpiCtrl_A'. */
/begin MEASUREMENT FLT_b_SpiCtrl_A "Fault flag from Spi counter indication" UBYTE CU_FLT_B_SPICTRL_A 1 100 0.0 1.0 ECU_ADDRESS 0x40002e52 BYTE_ORDER MSB_FIRST /end MEASUREMENT
/begin COMPU_METHOD CU_FLT_B_SPICTRL_A "Conversion method for FLT_b_SpiCtrl_A" RAT_FUNC "%10.0" "b" COEFFS 0.000000 1.000000 0.000000 0.000000 0.000000 1.000000 /end COMPU_METHOD
/* Scalar measurable for DDE 'FLT_b_SpiCtrl_B'. */
/begin MEASUREMENT FLT_b_SpiCtrl_B "Fault flag from leaky bucket counter for Spi control diagnostic" UBYTE CU_FLT_B_SPICTRL_B 1 100 0.0 1.0 ECU_ADDRESS 0x40002e63 BYTE_ORDER MSB_FIRST /end MEASUREMENT
/begin COMPU_METHOD CU_FLT_B_SPICTRL_B "Conversion method for FLT_b_SpiCtrl_B" RAT_FUNC "%10.0" "b" COEFFS 0.000000 1.000000 0.000000 0.000000 0.000000 1.000000 /end COMPU_METHOD
/* Scalar measurable for DDE 'FLT_b_UA_OORHi_A'. */
/begin MEASUREMENT FLT_b_UA_OORHi_A "Fault flag for OOR" UBYTE CU_FLT_B_UA_OORHI_A 1 100 0.0 1.0 ECU_ADDRESS 0x40002e51 BYTE_ORDER MSB_FIRST /end MEASUREMENT
/begin COMPU_METHOD CU_FLT_B_UA_OORHI_A "Conversion method for FLT_b_UA_OORHi_A" RAT_FUNC "%10.0" "b" COEFFS 0.000000 1.000000 0.000000 0.000000 0.000000 1.000000 /end COMPU_METHOD
/* Scalar measurable for DDE 'FLT_b_UA_OORHi_B'. */
/begin MEASUREMENT FLT_b_UA_OORHi_B "Fault flag for OOR" UBYTE CU_FLT_B_UA_OORHI_B 1 100 0.0 1.0 ECU_ADDRESS 0x40002e62 BYTE_ORDER MSB_FIRST /end MEASUREMENT
/begin COMPU_METHOD CU_FLT_B_UA_OORHI_B "Conversion method for FLT_b_UA_OORHi_B" RAT_FUNC "%10.0" "b" COEFFS 0.000000 1.000000 0.000000 0.000000 0.000000 1.000000 /end COMPU_METHOD
/* Scalar measurable for DDE 'FLT_b_UA_OORLo_A'. */
/begin MEASUREMENT FLT_b_UA_OORLo_A "Fault flag for OOR" UBYTE CU_FLT_B_UA_OORLO_A 1 100 0.0 1.0 ECU_ADDRESS 0x40002e4f BYTE_ORDER MSB_FIRST /end MEASUREMENT
/begin COMPU_METHOD CU_FLT_B_UA_OORLO_A "Conversion method for FLT_b_UA_OORLo_A" RAT_FUNC "%10.0" "b" COEFFS 0.000000 1.000000 0.000000 0.000000 0.000000 1.000000 /end COMPU_METHOD
/* Scalar measurable for DDE 'FLT_b_UA_OORLo_B'. */
/begin MEASUREMENT FLT_b_UA_OORLo_B "Fault flag for OOR" UBYTE CU_FLT_B_UA_OORLO_B 1 100 0.0 1.0 ECU_ADDRESS 0x40002e60 BYTE_ORDER MSB_FIRST /end MEASUREMENT
/begin COMPU_METHOD CU_FLT_B_UA_OORLO_B "Conversion method for FLT_b_UA_OORLo_B" RAT_FUNC "%10.0" "b" COEFFS 0.000000 1.000000 0.000000 0.000000 0.000000 1.000000 /end COMPU_METHOD
/* Scalar measurable for DDE 'FLT_b_UR_OORHi_A'. */
/begin MEASUREMENT FLT_b_UR_OORHi_A "Fault flag for OOR" UBYTE CU_FLT_B_UR_OORHI_A 1 100 0.0 1.0 ECU_ADDRESS 0x40002e50 BYTE_ORDER MSB_FIRST /end MEASUREMENT
/begin COMPU_METHOD CU_FLT_B_UR_OORHI_A "Conversion method for FLT_b_UR_OORHi_A" RAT_FUNC "%10.0" "b" COEFFS 0.000000 1.000000 0.000000 0.000000 0.000000 1.000000 /end COMPU_METHOD
/* Scalar measurable for DDE 'FLT_b_UR_OORHi_B'. */
/begin MEASUREMENT FLT_b_UR_OORHi_B "Fault flag for OOR" UBYTE CU_FLT_B_UR_OORHI_B 1 100 0.0 1.0 ECU_ADDRESS 0x40002e61 BYTE_ORDER MSB_FIRST /end MEASUREMENT
/begin COMPU_METHOD CU_FLT_B_UR_OORHI_B "Conversion method for FLT_b_UR_OORHi_B" RAT_FUNC "%10.0" "b" COEFFS 0.000000 1.000000 0.000000 0.000000 0.000000 1.000000 /end COMPU_METHOD
/* Scalar measurable for DDE 'FLT_b_UR_OORLo_A'. */
/begin MEASUREMENT FLT_b_UR_OORLo_A "Fault flag for OOR" UBYTE CU_FLT_B_UR_OORLO_A 1 100 0.0 1.0 ECU_ADDRESS 0x40002e4e BYTE_ORDER MSB_FIRST /end MEASUREMENT
/begin COMPU_METHOD CU_FLT_B_UR_OORLO_A "Conversion method for FLT_b_UR_OORLo_A" RAT_FUNC "%10.0" "b" COEFFS 0.000000 1.000000 0.000000 0.000000 0.000000 1.000000 /end COMPU_METHOD
/* Scalar measurable for DDE 'FLT_b_UR_OORLo_B'. */
/begin MEASUREMENT FLT_b_UR_OORLo_B "Fault flag for OOR" UBYTE CU_FLT_B_UR_OORLO_B 1 100 0.0 1.0 ECU_ADDRESS 0x40002e5f BYTE_ORDER MSB_FIRST /end MEASUREMENT
/begin COMPU_METHOD CU_FLT_B_UR_OORLO_B "Conversion method for FLT_b_UR_OORLo_B" RAT_FUNC "%10.0" "b" COEFFS 0.000000 1.000000 0.000000 0.000000 0.000000 1.000000 /end COMPU_METHOD
/* Scalar measurable for DDE 'FLT_b_Un_Open_A'. */
/begin MEASUREMENT FLT_b_Un_Open_A "DIN fault flag from OE block for Nernst cell open" UBYTE CU_FLT_B_UN_OPEN_A 1 100 0.0 1.0 ECU_ADDRESS 0x40002e2d BYTE_ORDER MSB_FIRST /end MEASUREMENT
/begin COMPU_METHOD CU_FLT_B_UN_OPEN_A "Conversion method for FLT_b_Un_Open_A" RAT_FUNC "%10.0" "b" COEFFS 0.000000 1.000000 0.000000 0.000000 0.000000 1.000000 /end COMPU_METHOD
/* Scalar measurable for DDE 'FLT_b_Un_Open_B'. */
/begin MEASUREMENT FLT_b_Un_Open_B "DIN fault flag from OE block for Nernst cell open" UBYTE CU_FLT_B_UN_OPEN_B 1 100 0.0 1.0 ECU_ADDRESS 0x40002e38 BYTE_ORDER MSB_FIRST /end MEASUREMENT
/begin COMPU_METHOD CU_FLT_B_UN_OPEN_B "Conversion method for FLT_b_Un_Open_B" RAT_FUNC "%10.0" "b" COEFFS 0.000000 1.000000 0.000000 0.000000 0.000000 1.000000 /end COMPU_METHOD
/* Scalar measurable for DDE 'FLT_b_Un_ShrtGrnd_A'. */
/begin MEASUREMENT FLT_b_Un_ShrtGrnd_A "DIN fault flag from OE block for Nernst cell short to ground" UBYTE CU_FLT_B_UN_SHRTGRND_A 1 100 0.0 1.0 ECU_ADDRESS 0x40002e30 BYTE_ORDER MSB_FIRST /end MEASUREMENT
/begin COMPU_METHOD CU_FLT_B_UN_SHRTGRND_A "Conversion method for FLT_b_Un_ShrtGrnd_A" RAT_FUNC "%10.0" "b" COEFFS 0.000000 1.000000 0.000000 0.000000 0.000000 1.000000 /end COMPU_METHOD
/* Scalar measurable for DDE 'FLT_b_Un_ShrtGrnd_B'. */
/begin MEASUREMENT FLT_b_Un_ShrtGrnd_B "DIN fault flag from OE block for Nernst cell short to ground" UBYTE CU_FLT_B_UN_SHRTGRND_B 1 100 0.0 1.0 ECU_ADDRESS 0x40002e3b BYTE_ORDER MSB_FIRST /end MEASUREMENT
/begin COMPU_METHOD CU_FLT_B_UN_SHRTGRND_B "Conversion method for FLT_b_Un_ShrtGrnd_B" RAT_FUNC "%10.0" "b" COEFFS 0.000000 1.000000 0.000000 0.000000 0.000000 1.000000 /end COMPU_METHOD
/* Scalar measurable for DDE 'FLT_b_Un_ShrtVBatt_A'. */
/begin MEASUREMENT FLT_b_Un_ShrtVBatt_A "DIN fault flag from OE block for Nernst cell short to Vbatt" UBYTE CU_FLT_B_UN_SHRTVBATT_A 1 100 0.0 1.0 ECU_ADDRESS 0x40002e2f BYTE_ORDER MSB_FIRST /end MEASUREMENT
/begin COMPU_METHOD CU_FLT_B_UN_SHRTVBATT_A "Conversion method for FLT_b_Un_ShrtVBatt_A" RAT_FUNC "%10.0" "b" COEFFS 0.000000 1.000000 0.000000 0.000000 0.000000 1.000000 /end COMPU_METHOD
/* Scalar measurable for DDE 'FLT_b_Un_ShrtVBatt_B'. */
/begin MEASUREMENT FLT_b_Un_ShrtVBatt_B "DIN fault flag from OE block for Nernst cell short to Vbatt" UBYTE CU_FLT_B_UN_SHRTVBATT_B 1 100 0.0 1.0 ECU_ADDRESS 0x40002e3a BYTE_ORDER MSB_FIRST /end MEASUREMENT
/begin COMPU_METHOD CU_FLT_B_UN_SHRTVBATT_B "Conversion method for FLT_b_Un_ShrtVBatt_B" RAT_FUNC "%10.0" "b" COEFFS 0.000000 1.000000 0.000000 0.000000 0.000000 1.000000 /end COMPU_METHOD
/* Scalar measurable for DDE 'FLT_b_Vm_Open_B'. */
/begin MEASUREMENT FLT_b_Vm_Open_B "DIN fault flag from OE block for virtual ground open" UBYTE CU_FLT_B_VM_OPEN_B 1 100 0.0 1.0 ECU_ADDRESS 0x40002e37 BYTE_ORDER MSB_FIRST /end MEASUREMENT
/begin COMPU_METHOD CU_FLT_B_VM_OPEN_B "Conversion method for FLT_b_Vm_Open_B" RAT_FUNC "%10.0" "b" COEFFS 0.000000 1.000000 0.000000 0.000000 0.000000 1.000000 /end COMPU_METHOD
/* Scalar measurable for DDE 'FLT_b_Vm_ShrtGrnd_A'. */
/begin MEASUREMENT FLT_b_Vm_ShrtGrnd_A "DIN fault flag from OE block for virtual ground short to ground" UBYTE CU_FLT_B_VM_SHRTGRND_A 1 100 0.0 1.0 ECU_ADDRESS 0x40002e2e BYTE_ORDER MSB_FIRST /end MEASUREMENT
/begin COMPU_METHOD CU_FLT_B_VM_SHRTGRND_A "Conversion method for FLT_b_Vm_ShrtGrnd_A" RAT_FUNC "%10.0" "b" COEFFS 0.000000 1.000000 0.000000 0.000000 0.000000 1.000000 /end COMPU_METHOD
/* Scalar measurable for DDE 'FLT_b_Vm_ShrtGrnd_B'. */
/begin MEASUREMENT FLT_b_Vm_ShrtGrnd_B "DIN fault flag from OE block for virtual ground short to ground" UBYTE CU_FLT_B_VM_SHRTGRND_B 1 100 0.0 1.0 ECU_ADDRESS 0x40002e39 BYTE_ORDER MSB_FIRST /end MEASUREMENT
/begin COMPU_METHOD CU_FLT_B_VM_SHRTGRND_B "Conversion method for FLT_b_Vm_ShrtGrnd_B" RAT_FUNC "%10.0" "b" COEFFS 0.000000 1.000000 0.000000 0.000000 0.000000 1.000000 /end COMPU_METHOD
/* Scalar measurable for DDE 'FLT_b_Vm_ShrtVBatt_A'. */
/begin MEASUREMENT FLT_b_Vm_ShrtVBatt_A "DIN fault flag from OE block for virtual ground short to Vbatt" UBYTE CU_FLT_B_VM_SHRTVBATT_A 1 100 0.0 1.0 ECU_ADDRESS 0x40002e34 BYTE_ORDER MSB_FIRST /end MEASUREMENT
/begin COMPU_METHOD CU_FLT_B_VM_SHRTVBATT_A "Conversion method for FLT_b_Vm_ShrtVBatt_A" RAT_FUNC "%10.0" "b" COEFFS 0.000000 1.000000 0.000000 0.000000 0.000000 1.000000 /end COMPU_METHOD
/* Scalar measurable for DDE 'FLT_b_Vm_ShrtVBatt_B'. */
/begin MEASUREMENT FLT_b_Vm_ShrtVBatt_B "DIN fault flag from OE block for virtual ground short to Vbatt" UBYTE CU_FLT_B_VM_SHRTVBATT_B 1 100 0.0 1.0 ECU_ADDRESS 0x40002e3f BYTE_ORDER MSB_FIRST /end MEASUREMENT
/begin COMPU_METHOD CU_FLT_B_VM_SHRTVBATT_B "Conversion method for FLT_b_Vm_ShrtVBatt_B" RAT_FUNC "%10.0" "b" COEFFS 0.000000 1.000000 0.000000 0.000000 0.000000 1.000000 /end COMPU_METHOD
/* Scalar measurable for DDE 'HTR_C_SensorTemperature_A'. */
/begin MEASUREMENT HTR_C_SensorTemperature_A "Sensor temperature in deg Celsius" FLOAT32_IEEE CU_HTR_C_SENSORTEMPERATURE_A 1 100 0.0 0.0 ECU_ADDRESS 0x400030f0 BYTE_ORDER MSB_FIRST /end MEASUREMENT
/begin COMPU_METHOD CU_HTR_C_SENSORTEMPERATURE_A "Conversion method for HTR_C_SensorTemperature_A" RAT_FUNC "%10.3" "C" COEFFS 0.000000 1.000000 0.000000 0.000000 0.000000 1.000000 /end COMPU_METHOD
/* Scalar measurable for DDE 'HTR_C_SensorTemperature_B'. */
/begin MEASUREMENT HTR_C_SensorTemperature_B "Sensor temperature in deg Celsius" FLOAT32_IEEE CU_HTR_C_SENSORTEMPERATURE_B 1 100 0.0 0.0 ECU_ADDRESS 0x40003120 BYTE_ORDER MSB_FIRST /end MEASUREMENT
/begin COMPU_METHOD CU_HTR_C_SENSORTEMPERATURE_B "Conversion method for HTR_C_SensorTemperature_B" RAT_FUNC "%10.3" "C" COEFFS 0.000000 1.000000 0.000000 0.000000 0.000000 1.000000 /end COMPU_METHOD
/* Scalar measurable for DDE 'HTR_NU_SysVoltCompCL'. */
/begin MEASUREMENT HTR_NU_SysVoltCompCL "System voltage compensation gain to the Closed Loop PWM command" FLOAT32_IEEE CU_HTR_NU_SYSVOLTCOMPCL 1 100 0.0 0.0 ECU_ADDRESS 0x400030e0 BYTE_ORDER MSB_FIRST /end MEASUREMENT
/begin COMPU_METHOD CU_HTR_NU_SYSVOLTCOMPCL "Conversion method for HTR_NU_SysVoltCompCL" RAT_FUNC "%10.3" "NU" COEFFS 0.000000 1.000000 0.000000 0.000000 0.000000 1.000000 /end COMPU_METHOD
/* Scalar measurable for DDE 'HTR_NU_SysVoltCompCL_B'. */
/begin MEASUREMENT HTR_NU_SysVoltCompCL_B "System voltage compensation gain to the Closed Loop PWM command" FLOAT32_IEEE CU_HTR_NU_SYSVOLTCOMPCL_B 1 100 0.0 0.0 ECU_ADDRESS 0x40003110 BYTE_ORDER MSB_FIRST /end MEASUREMENT
/begin COMPU_METHOD CU_HTR_NU_SYSVOLTCOMPCL_B "Conversion method for HTR_NU_SysVoltCompCL_B" RAT_FUNC "%10.3" "NU" COEFFS 0.000000 1.000000 0.000000 0.000000 0.000000 1.000000 /end COMPU_METHOD
/* Scalar measurable for DDE 'HTR_NU_SysVoltCompOL'. */
/begin MEASUREMENT HTR_NU_SysVoltCompOL "System voltage compensation gain to the Open Loop PWM command" FLOAT32_IEEE CU_HTR_NU_SYSVOLTCOMPOL 1 100 0.0 0.0 ECU_ADDRESS 0x400030e8 BYTE_ORDER MSB_FIRST /end MEASUREMENT
/begin COMPU_METHOD CU_HTR_NU_SYSVOLTCOMPOL "Conversion method for HTR_NU_SysVoltCompOL" RAT_FUNC "%10.3" "NU" COEFFS 0.000000 1.000000 0.000000 0.000000 0.000000 1.000000 /end COMPU_METHOD
/* Scalar measurable for DDE 'HTR_NU_SysVoltCompOL_B'. */
/begin MEASUREMENT HTR_NU_SysVoltCompOL_B "System voltage compensation gain to the Open Loop PWM command" FLOAT32_IEEE CU_HTR_NU_SYSVOLTCOMPOL_B 1 100 0.0 0.0 ECU_ADDRESS 0x40003118 BYTE_ORDER MSB_FIRST /end MEASUREMENT
/begin COMPU_METHOD CU_HTR_NU_SYSVOLTCOMPOL_B "Conversion method for HTR_NU_SysVoltCompOL_B" RAT_FUNC "%10.3" "NU" COEFFS 0.000000 1.000000 0.000000 0.000000 0.000000 1.000000 /end COMPU_METHOD
/* Scalar measurable for DDE 'HTR_b_ClosedLoopActv_A'. */
/begin MEASUREMENT HTR_b_ClosedLoopActv_A "Closed Loop heater control active flag" UBYTE CU_HTR_B_CLOSEDLOOPACTV_A 1 100 0.0 1.0 ECU_ADDRESS 0x40002e43 BYTE_ORDER MSB_FIRST /end MEASUREMENT
/begin COMPU_METHOD CU_HTR_B_CLOSEDLOOPACTV_A "Conversion method for HTR_b_ClosedLoopActv_A" RAT_FUNC "%10.0" "b" COEFFS 0.000000 1.000000 0.000000 0.000000 0.000000 1.000000 /end COMPU_METHOD
/* Scalar measurable for DDE 'HTR_b_ClosedLoopActv_B'. */
/begin MEASUREMENT HTR_b_ClosedLoopActv_B "Closed Loop heater control active flag" UBYTE CU_HTR_B_CLOSEDLOOPACTV_B 1 100 0.0 1.0 ECU_ADDRESS 0x40002e54 BYTE_ORDER MSB_FIRST /end MEASUREMENT
/begin COMPU_METHOD CU_HTR_B_CLOSEDLOOPACTV_B "Conversion method for HTR_b_ClosedLoopActv_B" RAT_FUNC "%10.0" "b" COEFFS 0.000000 1.000000 0.000000 0.000000 0.000000 1.000000 /end COMPU_METHOD
/* Scalar measurable for DDE 'HTR_b_FaultBasedHeaterLimit_A'. */
/begin MEASUREMENT HTR_b_FaultBasedHeaterLimit_A "Flag to indicate heater is disabled due to a cj125 fault" UBYTE CU_HTR_B_FAULTBASEDHEATERLIMIT0 1 100 0.0 1.0 ECU_ADDRESS 0x40002e47 BYTE_ORDER MSB_FIRST /end MEASUREMENT
/begin COMPU_METHOD CU_HTR_B_FAULTBASEDHEATERLIMIT0 "Conversion method for HTR_b_FaultBasedHeaterLimit_A" RAT_FUNC "%10.0" "b" COEFFS 0.000000 1.000000 0.000000 0.000000 0.000000 1.000000 /end COMPU_METHOD
/* Scalar measurable for DDE 'HTR_b_FaultBasedHeaterLimit_B'. */
/begin MEASUREMENT HTR_b_FaultBasedHeaterLimit_B "Flag to indicate heater is disabled due to a cj125 fault" UBYTE CU_HTR_B_FAULTBASEDHEATERLIMIT1 1 100 0.0 1.0 ECU_ADDRESS 0x40002e58 BYTE_ORDER MSB_FIRST /end MEASUREMENT
/begin COMPU_METHOD CU_HTR_B_FAULTBASEDHEATERLIMIT1 "Conversion method for HTR_b_FaultBasedHeaterLimit_B" RAT_FUNC "%10.0" "b" COEFFS 0.000000 1.000000 0.000000 0.000000 0.000000 1.000000 /end COMPU_METHOD
/* Scalar measurable for DDE 'HTR_b_HeaterEnabled_A'. */
/begin MEASUREMENT HTR_b_HeaterEnabled_A "Flag to indicate heater is enabled" UBYTE CU_HTR_B_HEATERENABLED_A 1 100 0.0 1.0 ECU_ADDRESS 0x40002e48 BYTE_ORDER MSB_FIRST /end MEASUREMENT
/begin COMPU_METHOD CU_HTR_B_HEATERENABLED_A "Conversion method for HTR_b_HeaterEnabled_A" RAT_FUNC "%10.0" "b" COEFFS 0.000000 1.000000 0.000000 0.000000 0.000000 1.000000 /end COMPU_METHOD
/* Scalar measurable for DDE 'HTR_b_HeaterEnabled_B'. */
/begin MEASUREMENT HTR_b_HeaterEnabled_B "Flag to indicate heater is enabled" UBYTE CU_HTR_B_HEATERENABLED_B 1 100 0.0 1.0 ECU_ADDRESS 0x40002e59 BYTE_ORDER MSB_FIRST /end MEASUREMENT
/begin COMPU_METHOD CU_HTR_B_HEATERENABLED_B "Conversion method for HTR_b_HeaterEnabled_B" RAT_FUNC "%10.0" "b" COEFFS 0.000000 1.000000 0.000000 0.000000 0.000000 1.000000 /end COMPU_METHOD
/* Scalar measurable for DDE 'HTR_b_OpenLoopActv_A'. */
/begin MEASUREMENT HTR_b_OpenLoopActv_A "Open Loop heater control active flag" UBYTE CU_HTR_B_OPENLOOPACTV_A 1 100 0.0 1.0 ECU_ADDRESS 0x40002e44 BYTE_ORDER MSB_FIRST /end MEASUREMENT
/begin COMPU_METHOD CU_HTR_B_OPENLOOPACTV_A "Conversion method for HTR_b_OpenLoopActv_A" RAT_FUNC "%10.0" "b" COEFFS 0.000000 1.000000 0.000000 0.000000 0.000000 1.000000 /end COMPU_METHOD
/* Scalar measurable for DDE 'HTR_b_OpenLoopActv_B'. */
/begin MEASUREMENT HTR_b_OpenLoopActv_B "Open Loop heater control active flag" UBYTE CU_HTR_B_OPENLOOPACTV_B 1 100 0.0 1.0 ECU_ADDRESS 0x40002e55 BYTE_ORDER MSB_FIRST /end MEASUREMENT
/begin COMPU_METHOD CU_HTR_B_OPENLOOPACTV_B "Conversion method for HTR_b_OpenLoopActv_B" RAT_FUNC "%10.0" "b" COEFFS 0.000000 1.000000 0.000000 0.000000 0.000000 1.000000 /end COMPU_METHOD
/* Scalar measurable for DDE 'HTR_b_OpenLoopReset_A'. */
/begin MEASUREMENT HTR_b_OpenLoopReset_A "Open Loop heater control reset flag" UBYTE CU_HTR_B_OPENLOOPRESET_A 1 100 0.0 1.0 ECU_ADDRESS 0x40002e45 BYTE_ORDER MSB_FIRST /end MEASUREMENT
/begin COMPU_METHOD CU_HTR_B_OPENLOOPRESET_A "Conversion method for HTR_b_OpenLoopReset_A" RAT_FUNC "%10.0" "b" COEFFS 0.000000 1.000000 0.000000 0.000000 0.000000 1.000000 /end COMPU_METHOD
/* Scalar measurable for DDE 'HTR_b_OpenLoopReset_B'. */
/begin MEASUREMENT HTR_b_OpenLoopReset_B "Open Loop heater control reset flag" UBYTE CU_HTR_B_OPENLOOPRESET_B 1 100 0.0 1.0 ECU_ADDRESS 0x40002e56 BYTE_ORDER MSB_FIRST /end MEASUREMENT
/begin COMPU_METHOD CU_HTR_B_OPENLOOPRESET_B "Conversion method for HTR_b_OpenLoopReset_B" RAT_FUNC "%10.0" "b" COEFFS 0.000000 1.000000 0.000000 0.000000 0.000000 1.000000 /end COMPU_METHOD
/* Scalar measurable for DDE 'HTR_b_OpenLoopSet_A'. */
/begin MEASUREMENT HTR_b_OpenLoopSet_A "Open Loop heater control set flag" UBYTE CU_HTR_B_OPENLOOPSET_A 1 100 0.0 1.0 ECU_ADDRESS 0x40002e46 BYTE_ORDER MSB_FIRST /end MEASUREMENT
/begin COMPU_METHOD CU_HTR_B_OPENLOOPSET_A "Conversion method for HTR_b_OpenLoopSet_A" RAT_FUNC "%10.0" "b" COEFFS 0.000000 1.000000 0.000000 0.000000 0.000000 1.000000 /end COMPU_METHOD
/* Scalar measurable for DDE 'HTR_b_OpenLoopSet_B'. */
/begin MEASUREMENT HTR_b_OpenLoopSet_B "Open Loop heater control set flag" UBYTE CU_HTR_B_OPENLOOPSET_B 1 100 0.0 1.0 ECU_ADDRESS 0x40002e57 BYTE_ORDER MSB_FIRST /end MEASUREMENT
/begin COMPU_METHOD CU_HTR_B_OPENLOOPSET_B "Conversion method for HTR_b_OpenLoopSet_B" RAT_FUNC "%10.0" "b" COEFFS 0.000000 1.000000 0.000000 0.000000 0.000000 1.000000 /end COMPU_METHOD
/* Scalar measurable for DDE 'HTR_b_WaterCondensActv_A'. */
/begin MEASUREMENT HTR_b_WaterCondensActv_A "Open Loop heater control Water Condensation period is active flag" UBYTE CU_HTR_B_WATERCONDENSACTV_A 1 100 0.0 1.0 ECU_ADDRESS 0x40002e42 BYTE_ORDER MSB_FIRST /end MEASUREMENT
/begin COMPU_METHOD CU_HTR_B_WATERCONDENSACTV_A "Conversion method for HTR_b_WaterCondensActv_A" RAT_FUNC "%10.0" "b" COEFFS 0.000000 1.000000 0.000000 0.000000 0.000000 1.000000 /end COMPU_METHOD
/* Scalar measurable for DDE 'HTR_b_WaterCondensActv_B'. */
/begin MEASUREMENT HTR_b_WaterCondensActv_B "Open Loop heater control Water Condensation period is active flag" UBYTE CU_HTR_B_WATERCONDENSACTV_B 1 100 0.0 1.0 ECU_ADDRESS 0x40002e53 BYTE_ORDER MSB_FIRST /end MEASUREMENT
/begin COMPU_METHOD CU_HTR_B_WATERCONDENSACTV_B "Conversion method for HTR_b_WaterCondensActv_B" RAT_FUNC "%10.0" "b" COEFFS 0.000000 1.000000 0.000000 0.000000 0.000000 1.000000 /end COMPU_METHOD
/* Scalar measurable for DDE 'HTR_e_RefCurrEnum_A'. */
/begin MEASUREMENT HTR_e_RefCurrEnum_A "Temporary applied reference current enumeration" UBYTE CU_HTR_E_REFCURRENUM_A 1 100 0.0 0.0 ECU_ADDRESS 0x40002fda BYTE_ORDER MSB_FIRST /end MEASUREMENT
/begin COMPU_METHOD CU_HTR_E_REFCURRENUM_A "Conversion method for HTR_e_RefCurrEnum_A" RAT_FUNC "%10.0" "e" COEFFS 0.000000 1.000000 0.000000 0.000000 0.000000 1.000000 /end COMPU_METHOD
/* Scalar measurable for DDE 'HTR_e_RefCurrEnum_B'. */
/begin MEASUREMENT HTR_e_RefCurrEnum_B "Temporary applied reference current enumeration" UBYTE CU_HTR_E_REFCURRENUM_B 1 100 0.0 0.0 ECU_ADDRESS 0x40002fdb BYTE_ORDER MSB_FIRST /end MEASUREMENT
/begin COMPU_METHOD CU_HTR_E_REFCURRENUM_B "Conversion method for HTR_e_RefCurrEnum_B" RAT_FUNC "%10.0" "e" COEFFS 0.000000 1.000000 0.000000 0.000000 0.000000 1.000000 /end COMPU_METHOD
/* Scalar measurable for DDE 'HTR_pct_ClosedLoopPWMCmd_A'. */
/begin MEASUREMENT HTR_pct_ClosedLoopPWMCmd_A "Closed Loop control heater PWM command" FLOAT32_IEEE CU_HTR_PCT_CLOSEDLOOPPWMCMD_A 1 100 0.0 0.0 ECU_ADDRESS 0x400030dc BYTE_ORDER MSB_FIRST /end MEASUREMENT
/begin COMPU_METHOD CU_HTR_PCT_CLOSEDLOOPPWMCMD_A "Conversion method for HTR_pct_ClosedLoopPWMCmd_A" RAT_FUNC "%10.3" "pct" COEFFS 0.000000 1.000000 0.000000 0.000000 0.000000 1.000000 /end COMPU_METHOD
/* Scalar measurable for DDE 'HTR_pct_ClosedLoopPWMCmd_B'. */
/begin MEASUREMENT HTR_pct_ClosedLoopPWMCmd_B "Closed Loop control heater PWM command" FLOAT32_IEEE CU_HTR_PCT_CLOSEDLOOPPWMCMD_B 1 100 0.0 0.0 ECU_ADDRESS 0x4000310c BYTE_ORDER MSB_FIRST /end MEASUREMENT
/begin COMPU_METHOD CU_HTR_PCT_CLOSEDLOOPPWMCMD_B "Conversion method for HTR_pct_ClosedLoopPWMCmd_B" RAT_FUNC "%10.3" "pct" COEFFS 0.000000 1.000000 0.000000 0.000000 0.000000 1.000000 /end COMPU_METHOD
/* Scalar measurable for DDE 'HTR_pct_FinalPWMCmd_A'. */
/begin MEASUREMENT HTR_pct_FinalPWMCmd_A "Final heater PWM command" FLOAT32_IEEE CU_HTR_PCT_FINALPWMCMD_A 1 100 0.0 0.0 ECU_ADDRESS 0x400030ec BYTE_ORDER MSB_FIRST /end MEASUREMENT
/begin COMPU_METHOD CU_HTR_PCT_FINALPWMCMD_A "Conversion method for HTR_pct_FinalPWMCmd_A" RAT_FUNC "%10.3" "pct" COEFFS 0.000000 1.000000 0.000000 0.000000 0.000000 1.000000 /end COMPU_METHOD
/* Scalar measurable for DDE 'HTR_pct_FinalPWMCmd_B'. */
/begin MEASUREMENT HTR_pct_FinalPWMCmd_B "Final heater PWM command" FLOAT32_IEEE CU_HTR_PCT_FINALPWMCMD_B 1 100 0.0 0.0 ECU_ADDRESS 0x4000311c BYTE_ORDER MSB_FIRST /end MEASUREMENT
/begin COMPU_METHOD CU_HTR_PCT_FINALPWMCMD_B "Conversion method for HTR_pct_FinalPWMCmd_B" RAT_FUNC "%10.3" "pct" COEFFS 0.000000 1.000000 0.000000 0.000000 0.000000 1.000000 /end COMPU_METHOD
/* Scalar measurable for DDE 'HTR_pct_OpenLoopPWMCmd_A'. */
/begin MEASUREMENT HTR_pct_OpenLoopPWMCmd_A "Open Loop control heater PWM command" FLOAT32_IEEE CU_HTR_PCT_OPENLOOPPWMCMD_A 1 100 0.0 0.0 ECU_ADDRESS 0x400030e4 BYTE_ORDER MSB_FIRST /end MEASUREMENT
/begin COMPU_METHOD CU_HTR_PCT_OPENLOOPPWMCMD_A "Conversion method for HTR_pct_OpenLoopPWMCmd_A" RAT_FUNC "%10.3" "pct" COEFFS 0.000000 1.000000 0.000000 0.000000 0.000000 1.000000 /end COMPU_METHOD
/* Scalar measurable for DDE 'HTR_pct_OpenLoopPWMCmd_B'. */
/begin MEASUREMENT HTR_pct_OpenLoopPWMCmd_B "Open Loop control heater PWM command" FLOAT32_IEEE CU_HTR_PCT_OPENLOOPPWMCMD_B 1 100 0.0 0.0 ECU_ADDRESS 0x40003114 BYTE_ORDER MSB_FIRST /end MEASUREMENT
/begin COMPU_METHOD CU_HTR_PCT_OPENLOOPPWMCMD_B "Conversion method for HTR_pct_OpenLoopPWMCmd_B" RAT_FUNC "%10.3" "pct" COEFFS 0.000000 1.000000 0.000000 0.000000 0.000000 1.000000 /end COMPU_METHOD
/* Scalar measurable for DDE 'INP_C_AmbientTemp'. */
/begin MEASUREMENT INP_C_AmbientTemp "Displayable" FLOAT32_IEEE CU_INP_C_AMBIENTTEMP 1 100 0.0 0.0 ECU_ADDRESS 0x40003754 BYTE_ORDER MSB_FIRST /end MEASUREMENT
/begin COMPU_METHOD CU_INP_C_AMBIENTTEMP "Conversion method for INP_C_AmbientTemp" RAT_FUNC "%10.3" "C" COEFFS 0.000000 1.000000 0.000000 0.000000 0.000000 1.000000 /end COMPU_METHOD
/* Scalar measurable for DDE 'INP_C_CompOutTemp'. */
/begin MEASUREMENT INP_C_CompOutTemp "Displayable" FLOAT32_IEEE CU_INP_C_COMPOUTTEMP 1 100 0.0 0.0 ECU_ADDRESS 0x40003744 BYTE_ORDER MSB_FIRST /end MEASUREMENT
/begin COMPU_METHOD CU_INP_C_COMPOUTTEMP "Conversion method for INP_C_CompOutTemp" RAT_FUNC "%10.3" "C" COEFFS 0.000000 1.000000 0.000000 0.000000 0.000000 1.000000 /end COMPU_METHOD
/* Scalar measurable for DDE 'INP_C_CoolantTemp'. */
/begin MEASUREMENT INP_C_CoolantTemp "Displayable" FLOAT32_IEEE CU_INP_C_COOLANTTEMP 1 100 0.0 0.0 ECU_ADDRESS 0x40003714 BYTE_ORDER MSB_FIRST /end MEASUREMENT
/begin COMPU_METHOD CU_INP_C_COOLANTTEMP "Conversion method for INP_C_CoolantTemp" RAT_FUNC "%10.0" "C" COEFFS 0.000000 1.000000 0.000000 0.000000 0.000000 1.000000 /end COMPU_METHOD
/* Scalar measurable for DDE 'INP_C_ExhaustTemp'. */
/begin MEASUREMENT INP_C_ExhaustTemp "(not defined)" FLOAT32_IEEE CU_INP_C_EXHAUSTTEMP 1 100 -40.0 1000.0 ECU_ADDRESS 0x40003740 BYTE_ORDER MSB_FIRST /end MEASUREMENT
/begin COMPU_METHOD CU_INP_C_EXHAUSTTEMP "Conversion method for INP_C_ExhaustTemp" RAT_FUNC "%10.1" "C" COEFFS 0.000000 1.000000 0.000000 0.000000 0.000000 1.000000 /end COMPU_METHOD
/* Scalar measurable for DDE 'INP_C_FuelTemp'. */
/begin MEASUREMENT INP_C_FuelTemp "Displayable" FLOAT32_IEEE CU_INP_C_FUELTEMP 1 100 0.0 0.0 ECU_ADDRESS 0x40003720 BYTE_ORDER MSB_FIRST /end MEASUREMENT
/begin COMPU_METHOD CU_INP_C_FUELTEMP "Conversion method for INP_C_FuelTemp" RAT_FUNC "%10.0" "C" COEFFS 0.000000 1.000000 0.000000 0.000000 0.000000 1.000000 /end COMPU_METHOD
/* Scalar measurable for DDE 'INP_C_ManifoldTemp'. */
/begin MEASUREMENT INP_C_ManifoldTemp "Displayable" FLOAT32_IEEE CU_INP_C_MANIFOLDTEMP 1 100 0.0 0.0 ECU_ADDRESS 0x40003718 BYTE_ORDER MSB_FIRST /end MEASUREMENT
/begin COMPU_METHOD CU_INP_C_MANIFOLDTEMP "Conversion method for INP_C_ManifoldTemp" RAT_FUNC "%10.3" "C" COEFFS 0.000000 1.000000 0.000000 0.000000 0.000000 1.000000 /end COMPU_METHOD
/* Scalar measurable for DDE 'INP_C_OilTemp'. */
/begin MEASUREMENT INP_C_OilTemp "Displayable" FLOAT32_IEEE CU_INP_C_OILTEMP 1 100 0.0 0.0 ECU_ADDRESS 0x40003730 BYTE_ORDER MSB_FIRST /end MEASUREMENT
/begin COMPU_METHOD CU_INP_C_OILTEMP "Conversion method for INP_C_OilTemp" RAT_FUNC "%10.2" "C" COEFFS 0.000000 1.000000 0.000000 0.000000 0.000000 1.000000 /end COMPU_METHOD
/* Scalar measurable for DDE 'INP_NU_APP1_Raw'. */
/begin MEASUREMENT INP_NU_APP1_Raw "Displayable" FLOAT32_IEEE CU_INP_NU_APP1_RAW 1 100 0.0 0.0 ECU_ADDRESS 0x40003778 BYTE_ORDER MSB_FIRST /end MEASUREMENT
/begin COMPU_METHOD CU_INP_NU_APP1_RAW "Conversion method for INP_NU_APP1_Raw" RAT_FUNC "%10.3" "NU" COEFFS 0.000000 1.000000 0.000000 0.000000 0.000000 1.000000 /end COMPU_METHOD
/* Scalar measurable for DDE 'INP_NU_APP2_Raw'. */
/begin MEASUREMENT INP_NU_APP2_Raw "Displayable" FLOAT32_IEEE CU_INP_NU_APP2_RAW 1 100 0.0 0.0 ECU_ADDRESS 0x40003774 BYTE_ORDER MSB_FIRST /end MEASUREMENT
/begin COMPU_METHOD CU_INP_NU_APP2_RAW "Conversion method for INP_NU_APP2_Raw" RAT_FUNC "%10.3" "NU" COEFFS 0.000000 1.000000 0.000000 0.000000 0.000000 1.000000 /end COMPU_METHOD
/* Scalar measurable for DDE 'INP_NU_SpiCtrlCnts_A'. */
/begin MEASUREMENT INP_NU_SpiCtrlCnts_A "Counter for SPI control counts - how many times a SPI register write/read error occurred according to OE block" FLOAT32_IEEE CU_INP_NU_SPICTRLCNTS_A 1 100 0.0 0.0 ECU_ADDRESS 0x400030c4 BYTE_ORDER MSB_FIRST /end MEASUREMENT
/begin COMPU_METHOD CU_INP_NU_SPICTRLCNTS_A "Conversion method for INP_NU_SpiCtrlCnts_A" RAT_FUNC "%10.0" "NU" COEFFS 0.000000 1.000000 0.000000 0.000000 0.000000 1.000000 /end COMPU_METHOD
/* Scalar measurable for DDE 'INP_NU_SpiCtrlCnts_B'. */
/begin MEASUREMENT INP_NU_SpiCtrlCnts_B "Counter for SPI control counts - how many times a SPI register write/read error occurred according to OE block" FLOAT32_IEEE CU_INP_NU_SPICTRLCNTS_B 1 100 0.0 0.0 ECU_ADDRESS 0x400030d0 BYTE_ORDER MSB_FIRST /end MEASUREMENT
/begin COMPU_METHOD CU_INP_NU_SPICTRLCNTS_B "Conversion method for INP_NU_SpiCtrlCnts_B" RAT_FUNC "%10.0" "NU" COEFFS 0.000000 1.000000 0.000000 0.000000 0.000000 1.000000 /end COMPU_METHOD
/* Scalar measurable for DDE 'INP_NU_TP1_Raw'. */
/begin MEASUREMENT INP_NU_TP1_Raw "Displayable" FLOAT32_IEEE CU_INP_NU_TP1_RAW 1 100 0.0 0.0 ECU_ADDRESS 0x40003710 BYTE_ORDER MSB_FIRST /end MEASUREMENT
/begin COMPU_METHOD CU_INP_NU_TP1_RAW "Conversion method for INP_NU_TP1_Raw" RAT_FUNC "%10.1" "NU" COEFFS 0.000000 1.000000 0.000000 0.000000 0.000000 1.000000 /end COMPU_METHOD
/* Scalar measurable for DDE 'INP_NU_TP2_Raw'. */
/begin MEASUREMENT INP_NU_TP2_Raw "Displayable" FLOAT32_IEEE CU_INP_NU_TP2_RAW 1 100 0.0 0.0 ECU_ADDRESS 0x40003770 BYTE_ORDER MSB_FIRST /end MEASUREMENT
/begin COMPU_METHOD CU_INP_NU_TP2_RAW "Conversion method for INP_NU_TP2_Raw" RAT_FUNC "%10.1" "NU" COEFFS 0.000000 1.000000 0.000000 0.000000 0.000000 1.000000 /end COMPU_METHOD
/* Scalar measurable for DDE 'INP_RPM_CrankSpd'. */
/begin MEASUREMENT INP_RPM_CrankSpd "(not defined)" FLOAT32_IEEE CU_INP_RPM_CRANKSPD 1 100 0.0 0.0 ECU_ADDRESS 0x40003808 BYTE_ORDER MSB_FIRST /end MEASUREMENT
/begin COMPU_METHOD CU_INP_RPM_CRANKSPD "Conversion method for INP_RPM_CrankSpd" RAT_FUNC "%10.3" "RPM" COEFFS 0.000000 1.000000 0.000000 0.000000 0.000000 1.000000 /end COMPU_METHOD
/* Scalar measurable for DDE 'INP_RPM_EngSpd'. */
/begin MEASUREMENT INP_RPM_EngSpd "Displayable" FLOAT32_IEEE CU_INP_RPM_ENGSPD 1 100 0.0 0.0 ECU_ADDRESS 0x40003734 BYTE_ORDER MSB_FIRST /end MEASUREMENT
/begin COMPU_METHOD CU_INP_RPM_ENGSPD "Conversion method for INP_RPM_EngSpd" RAT_FUNC "%10.0" "RPM" COEFFS 0.000000 1.000000 0.000000 0.000000 0.000000 1.000000 /end COMPU_METHOD
/* Scalar measurable for DDE 'INP_V_EGO11'. */
/begin MEASUREMENT INP_V_EGO11 "Displayable" FLOAT32_IEEE CU_INP_V_EGO11 1 100 0.0 0.0 ECU_ADDRESS 0x40003780 BYTE_ORDER MSB_FIRST /end MEASUREMENT
/begin COMPU_METHOD CU_INP_V_EGO11 "Conversion method for INP_V_EGO11" RAT_FUNC "%10.1" "V" COEFFS 0.000000 1.000000 0.000000 0.000000 0.000000 1.000000 /end COMPU_METHOD
/* Scalar measurable for DDE 'INP_V_EGO21'. */
/begin MEASUREMENT INP_V_EGO21 "Displayable" FLOAT32_IEEE CU_INP_V_EGO21 1 100 0.0 0.0 ECU_ADDRESS 0x40003760 BYTE_ORDER MSB_FIRST /end MEASUREMENT
/begin COMPU_METHOD CU_INP_V_EGO21 "Conversion method for INP_V_EGO21" RAT_FUNC "%10.1" "V" COEFFS 0.000000 1.000000 0.000000 0.000000 0.000000 1.000000 /end COMPU_METHOD
/* Scalar measurable for DDE 'INP_V_VBatt'. */
/begin MEASUREMENT INP_V_VBatt "Displayable" FLOAT32_IEEE CU_INP_V_VBATT 1 100 0.0 0.0 ECU_ADDRESS 0x4000377c BYTE_ORDER MSB_FIRST /end MEASUREMENT
/begin COMPU_METHOD CU_INP_V_VBATT "Conversion method for INP_V_VBatt" RAT_FUNC "%10.1" "V" COEFFS 0.000000 1.000000 0.000000 0.000000 0.000000 1.000000 /end COMPU_METHOD
/* Scalar measurable for DDE 'INP_b_AC_PressSw'. */
/begin MEASUREMENT INP_b_AC_PressSw "Displayable" UBYTE CU_INP_B_AC_PRESSSW 1 100 0.0 1.0 ECU_ADDRESS 0x40002f3c BYTE_ORDER MSB_FIRST /end MEASUREMENT
/begin COMPU_METHOD CU_INP_B_AC_PRESSSW "Conversion method for INP_b_AC_PressSw" RAT_FUNC "%10.0" "b" COEFFS 0.000000 1.000000 0.000000 0.000000 0.000000 1.000000 /end COMPU_METHOD
/* Scalar measurable for DDE 'INP_b_AC_Rqst'. */
/begin MEASUREMENT INP_b_AC_Rqst "Displayable" UBYTE CU_INP_B_AC_RQST 1 100 0.0 1.0 ECU_ADDRESS 0x40002f3b BYTE_ORDER MSB_FIRST /end MEASUREMENT
/begin COMPU_METHOD CU_INP_B_AC_RQST "Conversion method for INP_b_AC_Rqst" RAT_FUNC "%10.0" "b" COEFFS 0.000000 1.000000 0.000000 0.000000 0.000000 1.000000 /end COMPU_METHOD
/* Scalar measurable for DDE 'INP_b_EngSync'. */
/begin MEASUREMENT INP_b_EngSync "Displayable" UBYTE CU_INP_B_ENGSYNC 1 100 0.0 1.0 ECU_ADDRESS 0x40002f3e BYTE_ORDER MSB_FIRST /end MEASUREMENT
/begin COMPU_METHOD CU_INP_B_ENGSYNC "Conversion method for INP_b_EngSync" RAT_FUNC "%10.0" "b" COEFFS 0.000000 1.000000 0.000000 0.000000 0.000000 1.000000 /end COMPU_METHOD
/* Scalar measurable for DDE 'INP_b_Ign'. */
/begin MEASUREMENT INP_b_Ign "Displayable" UBYTE CU_INP_B_IGN 1 100 0.0 1.0 ECU_ADDRESS 0x40002f3a BYTE_ORDER MSB_FIRST /end MEASUREMENT
/begin COMPU_METHOD CU_INP_B_IGN "Conversion method for INP_b_Ign" RAT_FUNC "%10.0" "b" COEFFS 0.000000 1.000000 0.000000 0.000000 0.000000 1.000000 /end COMPU_METHOD
/* Scalar measurable for DDE 'INP_b_OilPrSw'. */
/begin MEASUREMENT INP_b_OilPrSw "(not defined)" UBYTE CU_INP_B_OILPRSW 1 100 0.0 1.0 ECU_ADDRESS 0x40002f3d BYTE_ORDER MSB_FIRST /end MEASUREMENT
/begin COMPU_METHOD CU_INP_B_OILPRSW "Conversion method for INP_b_OilPrSw" RAT_FUNC "%10.0" "b" COEFFS 0.000000 1.000000 0.000000 0.000000 0.000000 1.000000 /end COMPU_METHOD
/* Scalar measurable for DDE 'INP_b_XG4'. */
/begin MEASUREMENT INP_b_XG4 "Displayable" UBYTE CU_INP_B_XG4 1 100 0.0 1.0 ECU_ADDRESS 0x40002f74 BYTE_ORDER MSB_FIRST /end MEASUREMENT
/begin COMPU_METHOD CU_INP_B_XG4 "Conversion method for INP_b_XG4" RAT_FUNC "%10.0" "b" COEFFS 0.000000 1.000000 0.000000 0.000000 0.000000 1.000000 /end COMPU_METHOD
/* Scalar measurable for DDE 'INP_bar_FuelPress'. */
/begin MEASUREMENT INP_bar_FuelPress "ABSOLUTE fuel pressure displayable" FLOAT32_IEEE CU_INP_BAR_FUELPRESS 1 100 0.0 0.0 ECU_ADDRESS 0x40003758 BYTE_ORDER MSB_FIRST /end MEASUREMENT
/begin COMPU_METHOD CU_INP_BAR_FUELPRESS "Conversion method for INP_bar_FuelPress" RAT_FUNC "%10.2" "bar" COEFFS 0.000000 1.000000 0.000000 0.000000 0.000000 1.000000 /end COMPU_METHOD
/* Scalar measurable for DDE 'INP_cnt_count_1'. */
/begin MEASUREMENT INP_cnt_count_1 "Cuenta misfire cil 1" UBYTE CU_INP_CNT_COUNT_1 1 100 1.0 255.0 ECU_ADDRESS 0x40003022 BYTE_ORDER MSB_FIRST /end MEASUREMENT
/begin COMPU_METHOD CU_INP_CNT_COUNT_1 "Conversion method for INP_cnt_count_1" RAT_FUNC "%10.0" "cnt" COEFFS 0.000000 1.000000 0.000000 0.000000 0.000000 1.000000 /end COMPU_METHOD
/* Scalar measurable for DDE 'INP_cnt_count_2'. */
/begin MEASUREMENT INP_cnt_count_2 "Cuenta misfire cil 2" UBYTE CU_INP_CNT_COUNT_2 1 100 1.0 255.0 ECU_ADDRESS 0x40003021 BYTE_ORDER MSB_FIRST /end MEASUREMENT
/begin COMPU_METHOD CU_INP_CNT_COUNT_2 "Conversion method for INP_cnt_count_2" RAT_FUNC "%10.0" "cnt" COEFFS 0.000000 1.000000 0.000000 0.000000 0.000000 1.000000 /end COMPU_METHOD
/* Scalar measurable for DDE 'INP_cnt_count_3'. */
/begin MEASUREMENT INP_cnt_count_3 "Cuenta misfire cil 3" UBYTE CU_INP_CNT_COUNT_3 1 100 1.0 255.0 ECU_ADDRESS 0x40003020 BYTE_ORDER MSB_FIRST /end MEASUREMENT
/begin COMPU_METHOD CU_INP_CNT_COUNT_3 "Conversion method for INP_cnt_count_3" RAT_FUNC "%10.0" "cnt" COEFFS 0.000000 1.000000 0.000000 0.000000 0.000000 1.000000 /end COMPU_METHOD
/* Scalar measurable for DDE 'INP_cnt_count_4'. */
/begin MEASUREMENT INP_cnt_count_4 "Cuenta misfire cil 4" UBYTE CU_INP_CNT_COUNT_4 1 100 1.0 255.0 ECU_ADDRESS 0x4000301f BYTE_ORDER MSB_FIRST /end MEASUREMENT
/begin COMPU_METHOD CU_INP_CNT_COUNT_4 "Conversion method for INP_cnt_count_4" RAT_FUNC "%10.0" "cnt" COEFFS 0.000000 1.000000 0.000000 0.000000 0.000000 1.000000 /end COMPU_METHOD
/* Scalar measurable for DDE 'INP_e_TransGear'. */
/begin MEASUREMENT INP_e_TransGear "Displayable" SBYTE CU_INP_E_TRANSGEAR 1 100 0.0 0.0 ECU_ADDRESS 0x40002fd8 BYTE_ORDER MSB_FIRST /end MEASUREMENT
/begin COMPU_METHOD CU_INP_E_TRANSGEAR "Conversion method for INP_e_TransGear" RAT_FUNC "%10.0" "e" COEFFS 0.000000 1.000000 0.000000 0.000000 0.000000 1.000000 /end COMPU_METHOD
/* Scalar measurable for DDE 'INP_gps_MAF'. */
/begin MEASUREMENT INP_gps_MAF "Displayable" FLOAT32_IEEE CU_INP_GPS_MAF 1 100 0.0 0.0 ECU_ADDRESS 0x40003784 BYTE_ORDER MSB_FIRST /end MEASUREMENT
/begin COMPU_METHOD CU_INP_GPS_MAF "Conversion method for INP_gps_MAF" RAT_FUNC "%10.0" "gps" COEFFS 0.000000 1.000000 0.000000 0.000000 0.000000 1.000000 /end COMPU_METHOD
/* Scalar measurable for DDE 'INP_kPa_Baro'. */
/begin MEASUREMENT INP_kPa_Baro "Displayable" FLOAT32_IEEE CU_INP_KPA_BARO 1 100 0.0 0.0 ECU_ADDRESS 0x4000374c BYTE_ORDER MSB_FIRST /end MEASUREMENT
/begin COMPU_METHOD CU_INP_KPA_BARO "Conversion method for INP_kPa_Baro" RAT_FUNC "%10.3" "kPa" COEFFS 0.000000 1.000000 0.000000 0.000000 0.000000 1.000000 /end COMPU_METHOD
/* Scalar measurable for DDE 'INP_kPa_CompOutPress'. */
/begin MEASUREMENT INP_kPa_CompOutPress "Displayable" FLOAT32_IEEE CU_INP_KPA_COMPOUTPRESS 1 100 0.0 0.0 ECU_ADDRESS 0x40003750 BYTE_ORDER MSB_FIRST /end MEASUREMENT
/begin COMPU_METHOD CU_INP_KPA_COMPOUTPRESS "Conversion method for INP_kPa_CompOutPress" RAT_FUNC "%10.3" "kPa" COEFFS 0.000000 1.000000 0.000000 0.000000 0.000000 1.000000 /end COMPU_METHOD
/* Scalar measurable for DDE 'INP_kPa_MAP'. */
/begin MEASUREMENT INP_kPa_MAP "Displayable" FLOAT32_IEEE CU_INP_KPA_MAP 1 100 0.0 0.0 ECU_ADDRESS 0x40003724 BYTE_ORDER MSB_FIRST /end MEASUREMENT
/begin COMPU_METHOD CU_INP_KPA_MAP "Conversion method for INP_kPa_MAP" RAT_FUNC "%10.0" "kPa" COEFFS 0.000000 1.000000 0.000000 0.000000 0.000000 1.000000 /end COMPU_METHOD
/* Scalar measurable for DDE 'INP_kPa_OilPress'. */
/begin MEASUREMENT INP_kPa_OilPress "Displayable" FLOAT32_IEEE CU_INP_KPA_OILPRESS 1 100 0.0 0.0 ECU_ADDRESS 0x4000375c BYTE_ORDER MSB_FIRST /end MEASUREMENT
/begin COMPU_METHOD CU_INP_KPA_OILPRESS "Conversion method for INP_kPa_OilPress" RAT_FUNC "%10.3" "kPa" COEFFS 0.000000 1.000000 0.000000 0.000000 0.000000 1.000000 /end COMPU_METHOD
/* Scalar measurable for DDE 'INP_kph_VehSpd'. */
/begin MEASUREMENT INP_kph_VehSpd "Displayable" FLOAT32_IEEE CU_INP_KPH_VEHSPD 1 100 0.0 0.0 ECU_ADDRESS 0x40003738 BYTE_ORDER MSB_FIRST /end MEASUREMENT
/begin COMPU_METHOD CU_INP_KPH_VEHSPD "Conversion method for INP_kph_VehSpd" RAT_FUNC "%10.2" "kph" COEFFS 0.000000 1.000000 0.000000 0.000000 0.000000 1.000000 /end COMPU_METHOD
/* Scalar measurable for DDE 'INP_lam_UEGO1'. */
/begin MEASUREMENT INP_lam_UEGO1 "Displayable" FLOAT32_IEEE CU_INP_LAM_UEGO1 1 100 0.0 0.0 ECU_ADDRESS 0x4000372c BYTE_ORDER MSB_FIRST /end MEASUREMENT
/begin COMPU_METHOD CU_INP_LAM_UEGO1 "Conversion method for INP_lam_UEGO1" RAT_FUNC "%10.1" "lam" COEFFS 0.000000 1.000000 0.000000 0.000000 0.000000 1.000000 /end COMPU_METHOD
/* Scalar measurable for DDE 'INP_lam_UEGO2'. */
/begin MEASUREMENT INP_lam_UEGO2 "Displayable" FLOAT32_IEEE CU_INP_LAM_UEGO2 1 100 0.0 0.0 ECU_ADDRESS 0x40003728 BYTE_ORDER MSB_FIRST /end MEASUREMENT
/begin COMPU_METHOD CU_INP_LAM_UEGO2 "Conversion method for INP_lam_UEGO2" RAT_FUNC "%10.1" "lam" COEFFS 0.000000 1.000000 0.000000 0.000000 0.000000 1.000000 /end COMPU_METHOD
/* Scalar measurable for DDE 'INP_pct_AltLoad'. */
/begin MEASUREMENT INP_pct_AltLoad "Displayable" FLOAT32_IEEE CU_INP_PCT_ALTLOAD 1 100 0.0 0.0 ECU_ADDRESS 0x4000373c BYTE_ORDER MSB_FIRST /end MEASUREMENT
/begin COMPU_METHOD CU_INP_PCT_ALTLOAD "Conversion method for INP_pct_AltLoad" RAT_FUNC "%10.3" "pct" COEFFS 0.000000 1.000000 0.000000 0.000000 0.000000 1.000000 /end COMPU_METHOD
/* Scalar measurable for DDE 'INP_pct_Cylinder1_Knock'. */
/begin MEASUREMENT INP_pct_Cylinder1_Knock "Displayable" FLOAT32_IEEE CU_INP_PCT_CYLINDER1_KNOCK 1 100 0.0 0.0 ECU_ADDRESS 0x4000371c BYTE_ORDER MSB_FIRST /end MEASUREMENT
/begin COMPU_METHOD CU_INP_PCT_CYLINDER1_KNOCK "Conversion method for INP_pct_Cylinder1_Knock" RAT_FUNC "%10.2" "pct" COEFFS 0.000000 1.000000 0.000000 0.000000 0.000000 1.000000 /end COMPU_METHOD
/* Scalar measurable for DDE 'INP_pct_Cylinder2_Knock'. */
/begin MEASUREMENT INP_pct_Cylinder2_Knock "Displayable" FLOAT32_IEEE CU_INP_PCT_CYLINDER2_KNOCK 1 100 0.0 0.0 ECU_ADDRESS 0x4000376c BYTE_ORDER MSB_FIRST /end MEASUREMENT
/begin COMPU_METHOD CU_INP_PCT_CYLINDER2_KNOCK "Conversion method for INP_pct_Cylinder2_Knock" RAT_FUNC "%10.2" "pct" COEFFS 0.000000 1.000000 0.000000 0.000000 0.000000 1.000000 /end COMPU_METHOD
/* Scalar measurable for DDE 'INP_pct_Cylinder3_Knock'. */
/begin MEASUREMENT INP_pct_Cylinder3_Knock "Displayable" FLOAT32_IEEE CU_INP_PCT_CYLINDER3_KNOCK 1 100 0.0 0.0 ECU_ADDRESS 0x40003768 BYTE_ORDER MSB_FIRST /end MEASUREMENT
/begin COMPU_METHOD CU_INP_PCT_CYLINDER3_KNOCK "Conversion method for INP_pct_Cylinder3_Knock" RAT_FUNC "%10.2" "pct" COEFFS 0.000000 1.000000 0.000000 0.000000 0.000000 1.000000 /end COMPU_METHOD
/* Scalar measurable for DDE 'INP_pct_Cylinder4_Knock'. */
/begin MEASUREMENT INP_pct_Cylinder4_Knock "Displayable" FLOAT32_IEEE CU_INP_PCT_CYLINDER4_KNOCK 1 100 0.0 0.0 ECU_ADDRESS 0x40003764 BYTE_ORDER MSB_FIRST /end MEASUREMENT
/begin COMPU_METHOD CU_INP_PCT_CYLINDER4_KNOCK "Conversion method for INP_pct_Cylinder4_Knock" RAT_FUNC "%10.2" "pct" COEFFS 0.000000 1.000000 0.000000 0.000000 0.000000 1.000000 /end COMPU_METHOD
/* Scalar measurable for DDE 'INP_pct_EstimatedGearRatio'. */
/begin MEASUREMENT INP_pct_EstimatedGearRatio "Estimate ratio between EngSpd & TOSS" FLOAT32_IEEE CU_INP_PCT_ESTIMATEDGEARRATIO 1 100 0.0 0.0 ECU_ADDRESS 0x40003788 BYTE_ORDER MSB_FIRST /end MEASUREMENT
/begin COMPU_METHOD CU_INP_PCT_ESTIMATEDGEARRATIO "Conversion method for INP_pct_EstimatedGearRatio" RAT_FUNC "%10.2" "pct" COEFFS 0.000000 1.000000 0.000000 0.000000 0.000000 1.000000 /end COMPU_METHOD
/* Scalar measurable for DDE 'INP_ret_VCP_Pos'. */
/begin MEASUREMENT INP_ret_VCP_Pos "Displayable" FLOAT32_IEEE CU_INP_RET_VCP_POS 1 100 0.0 0.0 ECU_ADDRESS 0x40003748 BYTE_ORDER MSB_FIRST /end MEASUREMENT
/begin COMPU_METHOD CU_INP_RET_VCP_POS "Conversion method for INP_ret_VCP_Pos" RAT_FUNC "%10.2" "ret" COEFFS 0.000000 1.000000 0.000000 0.000000 0.000000 1.000000 /end COMPU_METHOD
/* Scalar measurable for DDE 'INP_rpm_EngSpdPre_ang_1'. */
/begin MEASUREMENT INP_rpm_EngSpdPre_ang_1 "(not defined)" FLOAT32_IEEE CU_INP_RPM_ENGSPDPRE_ANG_1 1 100 0.0 10000.0 ECU_ADDRESS 0x400030b8 BYTE_ORDER MSB_FIRST /end MEASUREMENT
/begin COMPU_METHOD CU_INP_RPM_ENGSPDPRE_ANG_1 "Conversion method for INP_rpm_EngSpdPre_ang_1" RAT_FUNC "%10.0" "RPM" COEFFS 0.000000 1.000000 0.000000 0.000000 0.000000 1.000000 /end COMPU_METHOD
/* Scalar measurable for DDE 'INP_rpm_EngSpdPre_ang_2'. */
/begin MEASUREMENT INP_rpm_EngSpdPre_ang_2 "(not defined)" FLOAT32_IEEE CU_INP_RPM_ENGSPDPRE_ANG_2 1 100 0.0 10000.0 ECU_ADDRESS 0x400030a8 BYTE_ORDER MSB_FIRST /end MEASUREMENT
/begin COMPU_METHOD CU_INP_RPM_ENGSPDPRE_ANG_2 "Conversion method for INP_rpm_EngSpdPre_ang_2" RAT_FUNC "%10.0" "RPM" COEFFS 0.000000 1.000000 0.000000 0.000000 0.000000 1.000000 /end COMPU_METHOD
/* Scalar measurable for DDE 'INP_rpm_EngSpdPre_ang_3'. */
/begin MEASUREMENT INP_rpm_EngSpdPre_ang_3 "(not defined)" FLOAT32_IEEE CU_INP_RPM_ENGSPDPRE_ANG_3 1 100 0.0 10000.0 ECU_ADDRESS 0x40003098 BYTE_ORDER MSB_FIRST /end MEASUREMENT
/begin COMPU_METHOD CU_INP_RPM_ENGSPDPRE_ANG_3 "Conversion method for INP_rpm_EngSpdPre_ang_3" RAT_FUNC "%10.0" "RPM" COEFFS 0.000000 1.000000 0.000000 0.000000 0.000000 1.000000 /end COMPU_METHOD
/* Scalar measurable for DDE 'INP_rpm_EngSpdPre_ang_4'. */
/begin MEASUREMENT INP_rpm_EngSpdPre_ang_4 "(not defined)" FLOAT32_IEEE CU_INP_RPM_ENGSPDPRE_ANG_4 1 100 0.0 10000.0 ECU_ADDRESS 0x40003088 BYTE_ORDER MSB_FIRST /end MEASUREMENT
/begin COMPU_METHOD CU_INP_RPM_ENGSPDPRE_ANG_4 "Conversion method for INP_rpm_EngSpdPre_ang_4" RAT_FUNC "%10.0" "RPM" COEFFS 0.000000 1.000000 0.000000 0.000000 0.000000 1.000000 /end COMPU_METHOD
/* Scalar measurable for DDE 'INP_rpm_EngSpdPst_ang_1'. */
/begin MEASUREMENT INP_rpm_EngSpdPst_ang_1 "(not defined)" FLOAT32_IEEE CU_INP_RPM_ENGSPDPST_ANG_1 1 100 0.0 10000.0 ECU_ADDRESS 0x400030b4 BYTE_ORDER MSB_FIRST /end MEASUREMENT
/begin COMPU_METHOD CU_INP_RPM_ENGSPDPST_ANG_1 "Conversion method for INP_rpm_EngSpdPst_ang_1" RAT_FUNC "%10.0" "RPM" COEFFS 0.000000 1.000000 0.000000 0.000000 0.000000 1.000000 /end COMPU_METHOD
/* Scalar measurable for DDE 'INP_rpm_EngSpdPst_ang_2'. */
/begin MEASUREMENT INP_rpm_EngSpdPst_ang_2 "(not defined)" FLOAT32_IEEE CU_INP_RPM_ENGSPDPST_ANG_2 1 100 0.0 10000.0 ECU_ADDRESS 0x400030a4 BYTE_ORDER MSB_FIRST /end MEASUREMENT
/begin COMPU_METHOD CU_INP_RPM_ENGSPDPST_ANG_2 "Conversion method for INP_rpm_EngSpdPst_ang_2" RAT_FUNC "%10.0" "RPM" COEFFS 0.000000 1.000000 0.000000 0.000000 0.000000 1.000000 /end COMPU_METHOD
/* Scalar measurable for DDE 'INP_rpm_EngSpdPst_ang_3'. */
/begin MEASUREMENT INP_rpm_EngSpdPst_ang_3 "(not defined)" FLOAT32_IEEE CU_INP_RPM_ENGSPDPST_ANG_3 1 100 0.0 10000.0 ECU_ADDRESS 0x40003094 BYTE_ORDER MSB_FIRST /end MEASUREMENT
/begin COMPU_METHOD CU_INP_RPM_ENGSPDPST_ANG_3 "Conversion method for INP_rpm_EngSpdPst_ang_3" RAT_FUNC "%10.0" "RPM" COEFFS 0.000000 1.000000 0.000000 0.000000 0.000000 1.000000 /end COMPU_METHOD
/* Scalar measurable for DDE 'INP_rpm_EngSpdPst_ang_4'. */
/begin MEASUREMENT INP_rpm_EngSpdPst_ang_4 "(not defined)" FLOAT32_IEEE CU_INP_RPM_ENGSPDPST_ANG_4 1 100 0.0 10000.0 ECU_ADDRESS 0x40003084 BYTE_ORDER MSB_FIRST /end MEASUREMENT
/begin COMPU_METHOD CU_INP_RPM_ENGSPDPST_ANG_4 "Conversion method for INP_rpm_EngSpdPst_ang_4" RAT_FUNC "%10.0" "RPM" COEFFS 0.000000 1.000000 0.000000 0.000000 0.000000 1.000000 /end COMPU_METHOD
/* Scalar measurable for DDE 'LAM_NU_AmpFactor_A'. */
/begin MEASUREMENT LAM_NU_AmpFactor_A "Amplification factor used for Lambda calculation" FLOAT32_IEEE CU_LAM_NU_AMPFACTOR_A 1 100 0.0 0.0 ECU_ADDRESS 0x400030fc BYTE_ORDER MSB_FIRST /end MEASUREMENT
/begin COMPU_METHOD CU_LAM_NU_AMPFACTOR_A "Conversion method for LAM_NU_AmpFactor_A" RAT_FUNC "%10.0" "NU" COEFFS 0.000000 1.000000 0.000000 0.000000 0.000000 1.000000 /end COMPU_METHOD
/* Scalar measurable for DDE 'LAM_NU_AmpFactor_B'. */
/begin MEASUREMENT LAM_NU_AmpFactor_B "Amplification factor used for Lambda calculation" FLOAT32_IEEE CU_LAM_NU_AMPFACTOR_B 1 100 0.0 0.0 ECU_ADDRESS 0x4000312c BYTE_ORDER MSB_FIRST /end MEASUREMENT
/begin COMPU_METHOD CU_LAM_NU_AMPFACTOR_B "Conversion method for LAM_NU_AmpFactor_B" RAT_FUNC "%10.0" "NU" COEFFS 0.000000 1.000000 0.000000 0.000000 0.000000 1.000000 /end COMPU_METHOD
/* Scalar measurable for DDE 'LAM_NU_Lambda_A'. */
/begin MEASUREMENT LAM_NU_Lambda_A "Lambda value" FLOAT32_IEEE CU_LAM_NU_LAMBDA_A 1 100 0.0 0.0 ECU_ADDRESS 0x400030f4 BYTE_ORDER MSB_FIRST /end MEASUREMENT
/begin COMPU_METHOD CU_LAM_NU_LAMBDA_A "Conversion method for LAM_NU_Lambda_A" RAT_FUNC "%10.3" "NU" COEFFS 0.000000 1.000000 0.000000 0.000000 0.000000 1.000000 /end COMPU_METHOD
/* Scalar measurable for DDE 'LAM_NU_Lambda_B'. */
/begin MEASUREMENT LAM_NU_Lambda_B "Lambda value" FLOAT32_IEEE CU_LAM_NU_LAMBDA_B 1 100 0.0 0.0 ECU_ADDRESS 0x40003124 BYTE_ORDER MSB_FIRST /end MEASUREMENT
/begin COMPU_METHOD CU_LAM_NU_LAMBDA_B "Conversion method for LAM_NU_Lambda_B" RAT_FUNC "%10.3" "NU" COEFFS 0.000000 1.000000 0.000000 0.000000 0.000000 1.000000 /end COMPU_METHOD
/* Scalar measurable for DDE 'LAM_b_AmpFactorFlag_A'. */
/begin MEASUREMENT LAM_b_AmpFactorFlag_A "Amplification factor flag used to switch OE block" UBYTE CU_LAM_B_AMPFACTORFLAG_A 1 100 0.0 1.0 ECU_ADDRESS 0x40002e4a BYTE_ORDER MSB_FIRST /end MEASUREMENT
/begin COMPU_METHOD CU_LAM_B_AMPFACTORFLAG_A "Conversion method for LAM_b_AmpFactorFlag_A" RAT_FUNC "%10.0" "b" COEFFS 0.000000 1.000000 0.000000 0.000000 0.000000 1.000000 /end COMPU_METHOD
/* Scalar measurable for DDE 'LAM_b_AmpFactorFlag_B'. */
/begin MEASUREMENT LAM_b_AmpFactorFlag_B "Amplification factor flag used to switch OE block" UBYTE CU_LAM_B_AMPFACTORFLAG_B 1 100 0.0 1.0 ECU_ADDRESS 0x40002e5b BYTE_ORDER MSB_FIRST /end MEASUREMENT
/begin COMPU_METHOD CU_LAM_B_AMPFACTORFLAG_B "Conversion method for LAM_b_AmpFactorFlag_B" RAT_FUNC "%10.0" "b" COEFFS 0.000000 1.000000 0.000000 0.000000 0.000000 1.000000 /end COMPU_METHOD
/* Scalar measurable for DDE 'LAM_b_LambdaValidFlag_A'. */
/begin MEASUREMENT LAM_b_LambdaValidFlag_A "Flag to indicate the Lambda calculation is valid" UBYTE CU_LAM_B_LAMBDAVALIDFLAG_A 1 100 0.0 1.0 ECU_ADDRESS 0x40002e49 BYTE_ORDER MSB_FIRST /end MEASUREMENT
/begin COMPU_METHOD CU_LAM_B_LAMBDAVALIDFLAG_A "Conversion method for LAM_b_LambdaValidFlag_A" RAT_FUNC "%10.0" "b" COEFFS 0.000000 1.000000 0.000000 0.000000 0.000000 1.000000 /end COMPU_METHOD
/* Scalar measurable for DDE 'LAM_b_LambdaValidFlag_B'. */
/begin MEASUREMENT LAM_b_LambdaValidFlag_B "Flag to indicate the Lambda calculation is valid" UBYTE CU_LAM_B_LAMBDAVALIDFLAG_B 1 100 0.0 1.0 ECU_ADDRESS 0x40002e5a BYTE_ORDER MSB_FIRST /end MEASUREMENT
/begin COMPU_METHOD CU_LAM_B_LAMBDAVALIDFLAG_B "Conversion method for LAM_b_LambdaValidFlag_B" RAT_FUNC "%10.0" "b" COEFFS 0.000000 1.000000 0.000000 0.000000 0.000000 1.000000 /end COMPU_METHOD
/* Scalar measurable for DDE 'LAM_mA_Ip_A'. */
/begin MEASUREMENT LAM_mA_Ip_A "Pump cell current" FLOAT32_IEEE CU_LAM_MA_IP_A 1 100 0.0 0.0 ECU_ADDRESS 0x400030f8 BYTE_ORDER MSB_FIRST /end MEASUREMENT
/begin COMPU_METHOD CU_LAM_MA_IP_A "Conversion method for LAM_mA_Ip_A" RAT_FUNC "%10.3" "mA" COEFFS 0.000000 1.000000 0.000000 0.000000 0.000000 1.000000 /end COMPU_METHOD
/* Scalar measurable for DDE 'LAM_mA_Ip_B'. */
/begin MEASUREMENT LAM_mA_Ip_B "Pump cell current" FLOAT32_IEEE CU_LAM_MA_IP_B 1 100 0.0 0.0 ECU_ADDRESS 0x40003128 BYTE_ORDER MSB_FIRST /end MEASUREMENT
/begin COMPU_METHOD CU_LAM_MA_IP_B "Conversion method for LAM_mA_Ip_B" RAT_FUNC "%10.3" "mA" COEFFS 0.000000 1.000000 0.000000 0.000000 0.000000 1.000000 /end COMPU_METHOD
/* Scalar measurable for DDE 'NVM_NU_EngRunTime'. */
/begin MEASUREMENT NVM_NU_EngRunTime "(not defined)" FLOAT32_IEEE CU_NVM_NU_ENGRUNTIME 1 100 0.0 4294967295.0 ECU_ADDRESS 0x4000366c BYTE_ORDER MSB_FIRST /end MEASUREMENT
/begin COMPU_METHOD CU_NVM_NU_ENGRUNTIME "Conversion method for NVM_NU_EngRunTime" RAT_FUNC "%10.2" "s" COEFFS 0.000000 1.000000 0.000000 0.000000 0.000000 1.000000 /end COMPU_METHOD
/* Scalar measurable for DDE 'OUT_Hz_FreqUEGOA'. */
/begin MEASUREMENT OUT_Hz_FreqUEGOA "Displayable" FLOAT32_IEEE CU_OUT_HZ_FREQUEGOA 1 100 0.0 10000.0 ECU_ADDRESS 0x400038b4 BYTE_ORDER MSB_FIRST /end MEASUREMENT
/begin COMPU_METHOD CU_OUT_HZ_FREQUEGOA "Conversion method for OUT_Hz_FreqUEGOA" RAT_FUNC "%10.0" "Hz" COEFFS 0.000000 1.000000 0.000000 0.000000 0.000000 1.000000 /end COMPU_METHOD
/* Scalar measurable for DDE 'OUT_b_24V_WarmupA'. */
/begin MEASUREMENT OUT_b_24V_WarmupA "displayable" UBYTE CU_OUT_B_24V_WARMUPA 1 100 0.0 1.0 ECU_ADDRESS 0x40002f9a BYTE_ORDER MSB_FIRST /end MEASUREMENT
/begin COMPU_METHOD CU_OUT_B_24V_WARMUPA "Conversion method for OUT_b_24V_WarmupA" RAT_FUNC "%10.0" "b" COEFFS 0.000000 1.000000 0.000000 0.000000 0.000000 1.000000 /end COMPU_METHOD
/* Scalar measurable for DDE 'OUT_pct_UEGO_HTR_DC_A'. */
/begin MEASUREMENT OUT_pct_UEGO_HTR_DC_A "Displayable signal for UEGO HTR DC" FLOAT32_IEEE CU_OUT_PCT_UEGO_HTR_DC_A 1 100 0.0 1.0 ECU_ADDRESS 0x400038b8 BYTE_ORDER MSB_FIRST /end MEASUREMENT
/begin COMPU_METHOD CU_OUT_PCT_UEGO_HTR_DC_A "Conversion method for OUT_pct_UEGO_HTR_DC_A" RAT_FUNC "%10.2" "pct" COEFFS 0.000000 1.000000 0.000000 0.000000 0.000000 1.000000 /end COMPU_METHOD
/* Scalar measurable for DDE 'SYS_EngSpedDelta1'. */
/begin MEASUREMENT SYS_EngSpedDelta1 "(not defined)" FLOAT32_IEEE CU_SYS_ENGSPEDDELTA1 1 100 -10000.0 10000.0 ECU_ADDRESS 0x400030b0 BYTE_ORDER MSB_FIRST /end MEASUREMENT
/begin COMPU_METHOD CU_SYS_ENGSPEDDELTA1 "Conversion method for SYS_EngSpedDelta1" RAT_FUNC "%10.3" "RPM" COEFFS 0.000000 1.000000 0.000000 0.000000 0.000000 1.000000 /end COMPU_METHOD
/* Scalar measurable for DDE 'SYS_EngSpedDelta1_after'. */
/begin MEASUREMENT SYS_EngSpedDelta1_after "(not defined)" FLOAT32_IEEE CU_SYS_ENGSPEDDELTA1_AFTER 1 100 -10000.0 10000.0 ECU_ADDRESS 0x400030ac BYTE_ORDER MSB_FIRST /end MEASUREMENT
/begin COMPU_METHOD CU_SYS_ENGSPEDDELTA1_AFTER "Conversion method for SYS_EngSpedDelta1_after" RAT_FUNC "%10.3" "RPM" COEFFS 0.000000 1.000000 0.000000 0.000000 0.000000 1.000000 /end COMPU_METHOD
/* Scalar measurable for DDE 'SYS_EngSpedDelta2'. */
/begin MEASUREMENT SYS_EngSpedDelta2 "(not defined)" FLOAT32_IEEE CU_SYS_ENGSPEDDELTA2 1 100 -10000.0 10000.0 ECU_ADDRESS 0x400030a0 BYTE_ORDER MSB_FIRST /end MEASUREMENT
/begin COMPU_METHOD CU_SYS_ENGSPEDDELTA2 "Conversion method for SYS_EngSpedDelta2" RAT_FUNC "%10.3" "RPM" COEFFS 0.000000 1.000000 0.000000 0.000000 0.000000 1.000000 /end COMPU_METHOD
/* Scalar measurable for DDE 'SYS_EngSpedDelta2_after'. */
/begin MEASUREMENT SYS_EngSpedDelta2_after "(not defined)" FLOAT32_IEEE CU_SYS_ENGSPEDDELTA2_AFTER 1 100 -10000.0 10000.0 ECU_ADDRESS 0x4000309c BYTE_ORDER MSB_FIRST /end MEASUREMENT
/begin COMPU_METHOD CU_SYS_ENGSPEDDELTA2_AFTER "Conversion method for SYS_EngSpedDelta2_after" RAT_FUNC "%10.3" "RPM" COEFFS 0.000000 1.000000 0.000000 0.000000 0.000000 1.000000 /end COMPU_METHOD
/* Scalar measurable for DDE 'SYS_EngSpedDelta3'. */
/begin MEASUREMENT SYS_EngSpedDelta3 "(not defined)" FLOAT32_IEEE CU_SYS_ENGSPEDDELTA3 1 100 -10000.0 10000.0 ECU_ADDRESS 0x40003090 BYTE_ORDER MSB_FIRST /end MEASUREMENT
/begin COMPU_METHOD CU_SYS_ENGSPEDDELTA3 "Conversion method for SYS_EngSpedDelta3" RAT_FUNC "%10.3" "RPM" COEFFS 0.000000 1.000000 0.000000 0.000000 0.000000 1.000000 /end COMPU_METHOD
/* Scalar measurable for DDE 'SYS_EngSpedDelta3_after'. */
/begin MEASUREMENT SYS_EngSpedDelta3_after "(not defined)" FLOAT32_IEEE CU_SYS_ENGSPEDDELTA3_AFTER 1 100 -10000.0 10000.0 ECU_ADDRESS 0x4000308c BYTE_ORDER MSB_FIRST /end MEASUREMENT
/begin COMPU_METHOD CU_SYS_ENGSPEDDELTA3_AFTER "Conversion method for SYS_EngSpedDelta3_after" RAT_FUNC "%10.3" "RPM" COEFFS 0.000000 1.000000 0.000000 0.000000 0.000000 1.000000 /end COMPU_METHOD
/* Scalar measurable for DDE 'SYS_EngSpedDelta4'. */
/begin MEASUREMENT SYS_EngSpedDelta4 "(not defined)" FLOAT32_IEEE CU_SYS_ENGSPEDDELTA4 1 100 -10000.0 10000.0 ECU_ADDRESS 0x40003080 BYTE_ORDER MSB_FIRST /end MEASUREMENT
/begin COMPU_METHOD CU_SYS_ENGSPEDDELTA4 "Conversion method for SYS_EngSpedDelta4" RAT_FUNC "%10.3" "RPM" COEFFS 0.000000 1.000000 0.000000 0.000000 0.000000 1.000000 /end COMPU_METHOD
/* Scalar measurable for DDE 'SYS_EngSpedDelta4_after'. */
/begin MEASUREMENT SYS_EngSpedDelta4_after "(not defined)" FLOAT32_IEEE CU_SYS_ENGSPEDDELTA4_AFTER 1 100 -10000.0 10000.0 ECU_ADDRESS 0x4000307c BYTE_ORDER MSB_FIRST /end MEASUREMENT
/begin COMPU_METHOD CU_SYS_ENGSPEDDELTA4_AFTER "Conversion method for SYS_EngSpedDelta4_after" RAT_FUNC "%10.3" "RPM" COEFFS 0.000000 1.000000 0.000000 0.000000 0.000000 1.000000 /end COMPU_METHOD
/* Scalar measurable for DDE 'SYS_b_CrankAngValid'. */
/begin MEASUREMENT SYS_b_CrankAngValid "Displayable" UBYTE CU_SYS_B_CRANKANGVALID 1 100 0.0 1.0 ECU_ADDRESS 0x40003828 BYTE_ORDER MSB_FIRST /end MEASUREMENT
/begin COMPU_METHOD CU_SYS_B_CRANKANGVALID "Conversion method for SYS_b_CrankAngValid" RAT_FUNC "%10.0" "b" COEFFS 0.000000 1.000000 0.000000 0.000000 0.000000 1.000000 /end COMPU_METHOD
/* Scalar measurable for DDE 'SYS_b_CrankSync'. */
/begin MEASUREMENT SYS_b_CrankSync "Crank sync flag" UBYTE CU_SYS_B_CRANKSYNC 1 100 0.0 1.0 ECU_ADDRESS 0x40002f73 BYTE_ORDER MSB_FIRST /end MEASUREMENT
/begin COMPU_METHOD CU_SYS_B_CRANKSYNC "Conversion method for SYS_b_CrankSync" RAT_FUNC "%10.0" "b" COEFFS 0.000000 1.000000 0.000000 0.000000 0.000000 1.000000 /end COMPU_METHOD
/* Scalar measurable for DDE 'SYS_b_EngSync'. */
/begin MEASUREMENT SYS_b_EngSync "Engine sync status" UBYTE CU_SYS_B_ENGSYNC 1 100 0.0 1.0 ECU_ADDRESS 0x40002f72 BYTE_ORDER MSB_FIRST /end MEASUREMENT
/begin COMPU_METHOD CU_SYS_B_ENGSYNC "Conversion method for SYS_b_EngSync" RAT_FUNC "%10.0" "b" COEFFS 0.000000 1.000000 0.000000 0.000000 0.000000 1.000000 /end COMPU_METHOD
/* Scalar measurable for DDE 'SYS_deg_CrankAng'. */
/begin MEASUREMENT SYS_deg_CrankAng "Crank angle relative to missing tooth region" FLOAT32_IEEE CU_SYS_DEG_CRANKANG 1 100 0.0 0.0 ECU_ADDRESS 0x4000382c BYTE_ORDER MSB_FIRST /end MEASUREMENT
/begin COMPU_METHOD CU_SYS_DEG_CRANKANG "Conversion method for SYS_deg_CrankAng" RAT_FUNC "%10.0" "deg" COEFFS 0.000000 1.000000 0.000000 0.000000 0.000000 1.000000 /end COMPU_METHOD
/begin FUNCTION Knock1 "Group /ByModelHeirarchy/Gasoline/1.Input_Processing/Analog inputs/Knock/Knock"
 /begin SUB_FUNCTION Cylinder_up_counter Knock_sensor_A_settings Knock_sensor_B_settings /end SUB_FUNCTION
 /begin LOC_MEASUREMENT AIN_V_KnockSignalCyl1 AIN_adv_KnockWinStartAngA AIN_adv_KnockWinStopAngA /end LOC_MEASUREMENT
 /begin REF_CHARACTERISTIC AINc_b_KnockWinSPT_Ofst AINm_deg_KnockWinDur_x AINm_deg_KnockWinDur_z AINm_deg_KnockWinStartOfst_x AINm_deg_KnockWinStartOfst_z TSTc_b_StopKnockChanges /end REF_CHARACTERISTIC
/end FUNCTION
/begin FUNCTION Knock "Group /ByModelHeirarchy/Gasoline/1.Input_Processing/Analog inputs/Knock" /begin SUB_FUNCTION Knock1 /end SUB_FUNCTION /begin LOC_MEASUREMENT AIN_cnt_HIP_SPI_Flts /end LOC_MEASUREMENT
 /begin REF_CHARACTERISTIC AINc_adv_KnockRegionStartAng AINm_NU_KnockGain_x AINm_NU_KnockGain_z AINm_NU_KnockOfst_x AINm_NU_KnockOfst_z /end REF_CHARACTERISTIC
/end FUNCTION
/begin FUNCTION OVR_AndExport00 "Group /ByModelHeirarchy/Gasoline/1.Input_Processing/Analog inputs/M670 UEGO/LSU4.9 Handling/DTCs1/OVR_AndExport1" /begin LOC_MEASUREMENT DTC_b_HeatersA_SB /end LOC_MEASUREMENT /begin REF_CHARACTERISTIC DTCc_b_HeatersA_SB DTCc_o_HeatersA_SB /end REF_CHARACTERISTIC /end FUNCTION
/begin FUNCTION OVR_AndExport27 "Group /ByModelHeirarchy/Gasoline/1.Input_Processing/Analog inputs/M670 UEGO/LSU4.9 Handling/DTCs1/OVR_AndExport2" /begin LOC_MEASUREMENT DTC_b_HeatersA_OL /end LOC_MEASUREMENT /begin REF_CHARACTERISTIC DTCc_b_HeatersA_OL DTCc_o_HeatersA_OL /end REF_CHARACTERISTIC /end FUNCTION
/begin FUNCTION OVR_AndExport37 "Group /ByModelHeirarchy/Gasoline/1.Input_Processing/Analog inputs/M670 UEGO/LSU4.9 Handling/DTCs1/OVR_AndExport3" /begin LOC_MEASUREMENT DTC_b_LambdaA_SG /end LOC_MEASUREMENT /begin REF_CHARACTERISTIC DTCc_b_LambdaA_SG DTCc_o_LambdaA_SG /end REF_CHARACTERISTIC /end FUNCTION
/begin FUNCTION OVR_AndExport308 "Group /ByModelHeirarchy/Gasoline/1.Input_Processing/Analog inputs/M670 UEGO/LSU4.9 Handling/DTCs1/OVR_AndExport34" /begin LOC_MEASUREMENT DTC_b_HeatersA_SG /end LOC_MEASUREMENT /begin REF_CHARACTERISTIC DTCc_b_HeatersA_SG DTCc_o_HeatersA_SG /end REF_CHARACTERISTIC /end FUNCTION
/begin FUNCTION OVR_AndExport44 "Group /ByModelHeirarchy/Gasoline/1.Input_Processing/Analog inputs/M670 UEGO/LSU4.9 Handling/DTCs1/OVR_AndExport4" /begin LOC_MEASUREMENT DTC_b_LambdaA_SB /end LOC_MEASUREMENT /begin REF_CHARACTERISTIC DTCc_b_LambdaA_SB DTCc_o_LambdaA_SB /end REF_CHARACTERISTIC /end FUNCTION
/begin FUNCTION OVR_AndExport53 "Group /ByModelHeirarchy/Gasoline/1.Input_Processing/Analog inputs/M670 UEGO/LSU4.9 Handling/DTCs1/OVR_AndExport5" /begin LOC_MEASUREMENT DTC_b_LambdaB11NOTValid /end LOC_MEASUREMENT /begin REF_CHARACTERISTIC DTCc_b_LambdaB11NOTValid DTCc_o_LambdaB11NOTValid /end REF_CHARACTERISTIC /end FUNCTION
/begin FUNCTION OVR_AndExport61 "Group /ByModelHeirarchy/Gasoline/1.Input_Processing/Analog inputs/M670 UEGO/LSU4.9 Handling/DTCs1/OVR_AndExport6" /begin LOC_MEASUREMENT DTC_b_LB11CTFail /end LOC_MEASUREMENT /begin REF_CHARACTERISTIC DTCc_b_LB11CTFail DTCc_o_LB11CTFail /end REF_CHARACTERISTIC /end FUNCTION
/begin FUNCTION DTCs1 "Group /ByModelHeirarchy/Gasoline/1.Input_Processing/Analog inputs/M670 UEGO/LSU4.9 Handling/DTCs1"
 /begin SUB_FUNCTION OVR_AndExport00 OVR_AndExport27 OVR_AndExport37 OVR_AndExport308 OVR_AndExport44 OVR_AndExport53 OVR_AndExport61 /end SUB_FUNCTION
 /begin REF_CHARACTERISTIC AINc_HZ_pdl1_dat_nok_FR AINc_HZ_pdl1_dat_nok_RR /end REF_CHARACTERISTIC
/end FUNCTION
/begin FUNCTION Inputs_UEGO_A "Group /ByModelHeirarchy/Gasoline/1.Input_Processing/Analog inputs/M670 UEGO/LSU4.9 Handling/Inputs UEGO A"
 /begin LOC_MEASUREMENT AIN_V_UA_A AIN_V_UR_A FLT_b_EH_Open_A FLT_b_EH_ShrtGrnd_A FLT_b_EH_ShrtVBatt_A FLT_b_IaIp_ShrtGrnd_A FLT_b_IaIp_ShrtVBatt_A FLT_b_Un_Open_A FLT_b_Un_ShrtGrnd_A FLT_b_Un_ShrtVBatt_A FLT_b_Vm_ShrtGrnd_A FLT_b_Vm_ShrtVBatt_A INP_NU_SpiCtrlCnts_A /end LOC_MEASUREMENT
 /begin REF_CHARACTERISTIC AINc_s_L1DeadTime AINc_s_L1ResetTime /end REF_CHARACTERISTIC
/end FUNCTION
/begin FUNCTION Inputs_UEGO_B "Group /ByModelHeirarchy/Gasoline/1.Input_Processing/Analog inputs/M670 UEGO/LSU4.9 Handling/Inputs UEGO B"
 /begin LOC_MEASUREMENT AIN_V_UA_B AIN_V_UR_B FLT_b_EH_Open_B FLT_b_EH_ShrtGrnd_B FLT_b_EH_ShrtVBatt_B FLT_b_IaIp_ShrtGrnd_B FLT_b_IaIp_ShrtVBatt_B FLT_b_Un_Open_B FLT_b_Un_ShrtGrnd_B FLT_b_Un_ShrtVBatt_B FLT_b_Vm_Open_B FLT_b_Vm_ShrtGrnd_B FLT_b_Vm_ShrtVBatt_B INP_NU_SpiCtrlCnts_B /end LOC_MEASUREMENT
/end FUNCTION
/begin FUNCTION Calibration_Mode "Group /ByModelHeirarchy/Gasoline/1.Input_Processing/Analog inputs/M670 UEGO/LSU4.9 Handling/UEGO A/Control/Calibration Mode"
 /begin LOC_MEASUREMENT CAL_V_Uoffset_A CAL_b_CalibrationModeActv_A CAL_b_CalibrationModeRqst_A /end LOC_MEASUREMENT
 /begin REF_CHARACTERISTIC CALc_V_UoffsetDfltValue CALc_b_EnblCalibrationMode_A CALc_b_ResetUoffset_A CALca_V_UoffsetDfltValue /end REF_CHARACTERISTIC
/end FUNCTION
/begin FUNCTION ClosedLoop_Heater_Control "Group /ByModelHeirarchy/Gasoline/1.Input_Processing/Analog inputs/M670 UEGO/LSU4.9 Handling/UEGO A/Control/Heater/ClosedLoop Heater Control" /begin LOC_MEASUREMENT HTR_NU_SysVoltCompCL HTR_pct_ClosedLoopPWMCmd_A /end LOC_MEASUREMENT
 /begin REF_CHARACTERISTIC HTRc_C_OptimalSensorTemp_A HTRc_NU_IGain_A HTRc_NU_PGain_A HTRc_pct_HeaterLimitCLPWMCmd_A HTRc_pct_MaxDutyCyc HTRm_NU_SysVoltageCompA_x HTRm_NU_SysVoltageCompA_z /end REF_CHARACTERISTIC
/end FUNCTION
/begin FUNCTION Heater_timeout "Group /ByModelHeirarchy/Gasoline/1.Input_Processing/Analog inputs/M670 UEGO/LSU4.9 Handling/UEGO A/Control/Heater/Enable Temperature Sensor and Heater/Heater timeout" /begin REF_CHARACTERISTIC HTRc_s_EngineStopTimeout /end REF_CHARACTERISTIC /end FUNCTION
/begin FUNCTION Enable_Temperature_Sensor_and_0 "Group /ByModelHeirarchy/Gasoline/1.Input_Processing/Analog inputs/M670 UEGO/LSU4.9 Handling/UEGO A/Control/Heater/Enable Temperature Sensor and Heater" /begin SUB_FUNCTION Heater_timeout /end SUB_FUNCTION
 /begin LOC_MEASUREMENT HTR_C_SensorTemperature_A HTR_b_FaultBasedHeaterLimit_A HTR_b_HeaterEnabled_A HTR_e_RefCurrEnum_A /end LOC_MEASUREMENT
 /begin REF_CHARACTERISTIC HTRc_NU_RefCurrEnum_A HTRc_b_EnblHeater_A HTRc_b_EnblTempSensor_A HTRc_s_FaultFlagDbnc HTRm_C_SensorTempA_x HTRm_C_SensorTempA_z /end REF_CHARACTERISTIC
/end FUNCTION
/begin FUNCTION OpenLoop_Heater_Control "Group /ByModelHeirarchy/Gasoline/1.Input_Processing/Analog inputs/M670 UEGO/LSU4.9 Handling/UEGO A/Control/Heater/OpenLoop Heater Control"
 /begin LOC_MEASUREMENT HTR_NU_SysVoltCompOL HTR_b_WaterCondensActv_A HTR_pct_OpenLoopPWMCmd_A /end LOC_MEASUREMENT
 /begin REF_CHARACTERISTIC HTRc_C_WaterCondensTemp_A HTRc_pct_HeaterLimitOLPWMCmd_A HTRc_pct_LinRampPWMCmd_A HTRc_pct_OpenLoopLinRamp_A HTRc_pct_WaterCondensPWMCmd_A HTRc_s_OpenLoopWatrCondnsDbnc_A HTRm_NU_SysVoltageCompA_x HTRm_NU_SysVoltageCompA_z /end REF_CHARACTERISTIC
/end FUNCTION
/begin FUNCTION Heater "Group /ByModelHeirarchy/Gasoline/1.Input_Processing/Analog inputs/M670 UEGO/LSU4.9 Handling/UEGO A/Control/Heater"
 /begin SUB_FUNCTION ClosedLoop_Heater_Control Enable_Temperature_Sensor_and_0 OpenLoop_Heater_Control /end SUB_FUNCTION
 /begin LOC_MEASUREMENT HTR_b_ClosedLoopActv_A HTR_b_OpenLoopActv_A HTR_b_OpenLoopReset_A HTR_b_OpenLoopSet_A HTR_pct_FinalPWMCmd_A /end LOC_MEASUREMENT
 /begin REF_CHARACTERISTIC HTRc_C_OptimalSensorTemp_A HTRc_pct_PID_OutputMax_A /end REF_CHARACTERISTIC
/end FUNCTION
/begin FUNCTION Lambda_Calc "Group /ByModelHeirarchy/Gasoline/1.Input_Processing/Analog inputs/M670 UEGO/LSU4.9 Handling/UEGO A/Control/Lambda Calc"
 /begin LOC_MEASUREMENT LAM_NU_AmpFactor_A LAM_NU_Lambda_A LAM_b_AmpFactorFlag_A LAM_mA_Ip_A /end LOC_MEASUREMENT
 /begin REF_CHARACTERISTIC LAMc_NU_AmpFactorHyst_A LAMm_NU_LambdaA_x LAMm_NU_LambdaA_z /end REF_CHARACTERISTIC
/end FUNCTION
/begin FUNCTION Lambda_Valid "Group /ByModelHeirarchy/Gasoline/1.Input_Processing/Analog inputs/M670 UEGO/LSU4.9 Handling/UEGO A/Control/Lambda Valid" /begin LOC_MEASUREMENT LAM_b_LambdaValidFlag_A /end LOC_MEASUREMENT /begin REF_CHARACTERISTIC LAMc_C_SensorTempValidThresh_A /end REF_CHARACTERISTIC /end FUNCTION
/begin FUNCTION Control "Group /ByModelHeirarchy/Gasoline/1.Input_Processing/Analog inputs/M670 UEGO/LSU4.9 Handling/UEGO A/Control" /begin SUB_FUNCTION Calibration_Mode Heater Lambda_Calc Lambda_Valid /end SUB_FUNCTION /end FUNCTION
/begin FUNCTION OORFaults "Group /ByModelHeirarchy/Gasoline/1.Input_Processing/Analog inputs/M670 UEGO/LSU4.9 Handling/UEGO A/Diagnostics/OORFaults"
 /begin LOC_MEASUREMENT FLT_b_EH_Open_A FLT_b_EH_ShrtGrnd_A FLT_b_EH_ShrtVBatt_A FLT_b_HtrPWM_NoResponse_A FLT_b_IaIp_ShrtGrnd_A FLT_b_IaIp_ShrtVBatt_A FLT_b_UA_OORHi_A FLT_b_UA_OORLo_A FLT_b_UR_OORHi_A FLT_b_UR_OORLo_A FLT_b_Un_Open_A FLT_b_Un_ShrtGrnd_A FLT_b_Un_ShrtVBatt_A FLT_b_Vm_ShrtGrnd_A FLT_b_Vm_ShrtVBatt_A /end LOC_MEASUREMENT
 /begin REF_CHARACTERISTIC DIAc_V_HtrNoRspnsURRstThrsh_A DIAc_V_HtrNoRspnsURThrsh_A DIAc_V_UA_OORHi DIAc_V_UA_OORLo DIAc_V_UR_OORHi DIAc_V_UR_OORLo DIAc_pct_HtrNoRspnsPWMThrsh DIAc_s_HtrNoResponseDbnc DIAc_s_HtrNoResponseRstDbnc DIAc_s_OORHiDbnc DIAc_s_OORLoDbnc /end REF_CHARACTERISTIC
/end FUNCTION
/begin FUNCTION SpiFaults "Group /ByModelHeirarchy/Gasoline/1.Input_Processing/Analog inputs/M670 UEGO/LSU4.9 Handling/UEGO A/Diagnostics/SpiFaults" /begin LOC_MEASUREMENT FLT_b_SpiCtrl_A INP_NU_SpiCtrlCnts_A /end LOC_MEASUREMENT
 /begin REF_CHARACTERISTIC DIAc_NU_SpiCtrlCntsThresh DIAc_pct_SpiCtrl_BucketFallWgt DIAc_pct_SpiCtrl_BucketRiseWgt /end REF_CHARACTERISTIC
/end FUNCTION
/begin FUNCTION Diagnostics "Group /ByModelHeirarchy/Gasoline/1.Input_Processing/Analog inputs/M670 UEGO/LSU4.9 Handling/UEGO A/Diagnostics" /begin SUB_FUNCTION OORFaults SpiFaults /end SUB_FUNCTION /end FUNCTION
/begin FUNCTION Input_Conditioning "Group /ByModelHeirarchy/Gasoline/1.Input_Processing/Analog inputs/M670 UEGO/LSU4.9 Handling/UEGO A/Input Conditioning" /begin LOC_MEASUREMENT AIN_V_FiltUA_A AIN_V_FiltUR_A /end LOC_MEASUREMENT /begin REF_CHARACTERISTIC INPc_Hz_UaFiltConst INPc_Hz_UrFiltConst /end REF_CHARACTERISTIC /end FUNCTION
/begin FUNCTION UEGO_A "Group /ByModelHeirarchy/Gasoline/1.Input_Processing/Analog inputs/M670 UEGO/LSU4.9 Handling/UEGO A" /begin SUB_FUNCTION Control Diagnostics Input_Conditioning /end SUB_FUNCTION /end FUNCTION
/begin FUNCTION Calibration_Mode1 "Group /ByModelHeirarchy/Gasoline/1.Input_Processing/Analog inputs/M670 UEGO/LSU4.9 Handling/UEGO B/Control/Calibration Mode"
 /begin LOC_MEASUREMENT CAL_V_Uoffset_B CAL_b_CalibrationModeActv_B CAL_b_CalibrationModeRqst_B /end LOC_MEASUREMENT
 /begin REF_CHARACTERISTIC CALc_V_UoffsetDfltValue CALc_b_EnblCalibrationMode_B CALc_b_ResetUoffset_B CALca_V_UoffsetDfltValue /end REF_CHARACTERISTIC
/end FUNCTION
/begin FUNCTION ClosedLoop_Heater_Control1 "Group /ByModelHeirarchy/Gasoline/1.Input_Processing/Analog inputs/M670 UEGO/LSU4.9 Handling/UEGO B/Control/Heater/ClosedLoop Heater Control" /begin LOC_MEASUREMENT HTR_NU_SysVoltCompCL_B HTR_pct_ClosedLoopPWMCmd_B /end LOC_MEASUREMENT
 /begin REF_CHARACTERISTIC HTRc_C_OptimalSensorTemp_B HTRc_NU_IGain_B HTRc_NU_PGain_B HTRc_pct_HeaterLimitCLPWMCmd_B HTRc_pct_MaxDutyCyc HTRm_NU_SysVoltageCompB_x HTRm_NU_SysVoltageCompB_z /end REF_CHARACTERISTIC
/end FUNCTION
/begin FUNCTION Heater_timeout1 "Group /ByModelHeirarchy/Gasoline/1.Input_Processing/Analog inputs/M670 UEGO/LSU4.9 Handling/UEGO B/Control/Heater/Enable Temperature Sensor and Heater/Heater timeout" /begin REF_CHARACTERISTIC HTRc_s_EngineStopTimeout /end REF_CHARACTERISTIC /end FUNCTION
/begin FUNCTION Enable_Temperature_Sensor_and_1 "Group /ByModelHeirarchy/Gasoline/1.Input_Processing/Analog inputs/M670 UEGO/LSU4.9 Handling/UEGO B/Control/Heater/Enable Temperature Sensor and Heater" /begin SUB_FUNCTION Heater_timeout1 /end SUB_FUNCTION
 /begin LOC_MEASUREMENT HTR_C_SensorTemperature_B HTR_b_FaultBasedHeaterLimit_B HTR_b_HeaterEnabled_B HTR_e_RefCurrEnum_B /end LOC_MEASUREMENT
 /begin REF_CHARACTERISTIC HTRc_NU_RefCurrEnum_B HTRc_b_EnblHeater_B HTRc_b_EnblTempSensor_B HTRc_s_FaultFlagDbnc HTRm_C_SensorTempB_x HTRm_C_SensorTempB_z /end REF_CHARACTERISTIC
/end FUNCTION
/begin FUNCTION OpenLoop_Heater_Control1 "Group /ByModelHeirarchy/Gasoline/1.Input_Processing/Analog inputs/M670 UEGO/LSU4.9 Handling/UEGO B/Control/Heater/OpenLoop Heater Control"
 /begin LOC_MEASUREMENT HTR_NU_SysVoltCompOL_B HTR_b_WaterCondensActv_B HTR_pct_OpenLoopPWMCmd_B /end LOC_MEASUREMENT
 /begin REF_CHARACTERISTIC HTRc_C_WaterCondensTemp_B HTRc_pct_HeaterLimitOLPWMCmd_B HTRc_pct_LinRampPWMCmd_B HTRc_pct_OpenLoopLinRamp_B HTRc_pct_WaterCondensPWMCmd_B HTRc_s_OpenLoopWatrCondnsDbnc_B HTRm_NU_SysVoltageCompB_x HTRm_NU_SysVoltageCompB_z /end REF_CHARACTERISTIC
/end FUNCTION
/begin FUNCTION Heater1 "Group /ByModelHeirarchy/Gasoline/1.Input_Processing/Analog inputs/M670 UEGO/LSU4.9 Handling/UEGO B/Control/Heater"
 /begin SUB_FUNCTION ClosedLoop_Heater_Control1 Enable_Temperature_Sensor_and_1 OpenLoop_Heater_Control1 /end SUB_FUNCTION
 /begin LOC_MEASUREMENT HTR_b_ClosedLoopActv_B HTR_b_OpenLoopActv_B HTR_b_OpenLoopReset_B HTR_b_OpenLoopSet_B HTR_pct_FinalPWMCmd_B /end LOC_MEASUREMENT
 /begin REF_CHARACTERISTIC HTRc_C_OptimalSensorTemp_B HTRc_pct_PID_OutputMax_B /end REF_CHARACTERISTIC
/end FUNCTION
/begin FUNCTION Lambda_Calc1 "Group /ByModelHeirarchy/Gasoline/1.Input_Processing/Analog inputs/M670 UEGO/LSU4.9 Handling/UEGO B/Control/Lambda Calc"
 /begin LOC_MEASUREMENT LAM_NU_AmpFactor_B LAM_NU_Lambda_B LAM_b_AmpFactorFlag_B LAM_mA_Ip_B /end LOC_MEASUREMENT
 /begin REF_CHARACTERISTIC LAMc_NU_AmpFactorHyst_B LAMm_NU_LambdaB_x LAMm_NU_LambdaB_z /end REF_CHARACTERISTIC
/end FUNCTION
/begin FUNCTION Lambda_Valid1 "Group /ByModelHeirarchy/Gasoline/1.Input_Processing/Analog inputs/M670 UEGO/LSU4.9 Handling/UEGO B/Control/Lambda Valid" /begin LOC_MEASUREMENT LAM_b_LambdaValidFlag_B /end LOC_MEASUREMENT /begin REF_CHARACTERISTIC LAMc_C_SensorTempValidThresh_B /end REF_CHARACTERISTIC /end FUNCTION
/begin FUNCTION Control1 "Group /ByModelHeirarchy/Gasoline/1.Input_Processing/Analog inputs/M670 UEGO/LSU4.9 Handling/UEGO B/Control" /begin SUB_FUNCTION Calibration_Mode1 Heater1 Lambda_Calc1 Lambda_Valid1 /end SUB_FUNCTION /end FUNCTION
/begin FUNCTION OORFaults1 "Group /ByModelHeirarchy/Gasoline/1.Input_Processing/Analog inputs/M670 UEGO/LSU4.9 Handling/UEGO B/Diagnostics/OORFaults"
 /begin LOC_MEASUREMENT FLT_b_EH_Open_B FLT_b_EH_ShrtGrnd_B FLT_b_EH_ShrtVBatt_B FLT_b_HtrPWM_NoResponse_B FLT_b_IaIp_ShrtGrnd_B FLT_b_IaIp_ShrtVBatt_B FLT_b_UA_OORHi_B FLT_b_UA_OORLo_B FLT_b_UR_OORHi_B FLT_b_UR_OORLo_B FLT_b_Un_Open_B FLT_b_Un_ShrtGrnd_B FLT_b_Un_ShrtVBatt_B FLT_b_Vm_Open_B FLT_b_Vm_ShrtGrnd_B FLT_b_Vm_ShrtVBatt_B /end LOC_MEASUREMENT
 /begin REF_CHARACTERISTIC DIAc_V_HtrNoRspnsURRstThrsh_B DIAc_V_HtrNoRspnsURThrsh_B DIAc_V_UA_OORHi DIAc_V_UA_OORLo DIAc_V_UR_OORHi DIAc_V_UR_OORLo DIAc_pct_HtrNoRspnsPWMThrsh DIAc_s_HtrNoResponseDbnc DIAc_s_HtrNoResponseRstDbnc DIAc_s_OORHiDbnc DIAc_s_OORLoDbnc /end REF_CHARACTERISTIC
/end FUNCTION
/begin FUNCTION SpiFaults1 "Group /ByModelHeirarchy/Gasoline/1.Input_Processing/Analog inputs/M670 UEGO/LSU4.9 Handling/UEGO B/Diagnostics/SpiFaults" /begin LOC_MEASUREMENT FLT_b_SpiCtrl_B INP_NU_SpiCtrlCnts_B /end LOC_MEASUREMENT
 /begin REF_CHARACTERISTIC DIAc_NU_SpiCtrlCntsThresh DIAc_pct_SpiCtrl_BucketFallWgt DIAc_pct_SpiCtrl_BucketRiseWgt /end REF_CHARACTERISTIC
/end FUNCTION
/begin FUNCTION Diagnostics1 "Group /ByModelHeirarchy/Gasoline/1.Input_Processing/Analog inputs/M670 UEGO/LSU4.9 Handling/UEGO B/Diagnostics" /begin SUB_FUNCTION OORFaults1 SpiFaults1 /end SUB_FUNCTION /end FUNCTION
/begin FUNCTION Input_Conditioning1 "Group /ByModelHeirarchy/Gasoline/1.Input_Processing/Analog inputs/M670 UEGO/LSU4.9 Handling/UEGO B/Input Conditioning" /begin LOC_MEASUREMENT AIN_V_FiltUA_B AIN_V_FiltUR_B /end LOC_MEASUREMENT /begin REF_CHARACTERISTIC INPc_Hz_UaFiltConst INPc_Hz_UrFiltConst /end REF_CHARACTERISTIC /end FUNCTION
/begin FUNCTION UEGO_B "Group /ByModelHeirarchy/Gasoline/1.Input_Processing/Analog inputs/M670 UEGO/LSU4.9 Handling/UEGO B" /begin SUB_FUNCTION Control1 Diagnostics1 Input_Conditioning1 /end SUB_FUNCTION /end FUNCTION
/begin FUNCTION LSU4.9_Handling "Group /ByModelHeirarchy/Gasoline/1.Input_Processing/Analog inputs/M670 UEGO/LSU4.9 Handling" /begin SUB_FUNCTION DTCs1 Inputs_UEGO_A Inputs_UEGO_B UEGO_A UEGO_B /end SUB_FUNCTION /end FUNCTION
/begin FUNCTION _24V_UEGO_warmup "Group /ByModelHeirarchy/Gasoline/1.Input_Processing/Analog inputs/M670 UEGO/Outputs UEGO A/24V UEGO warmup" /begin REF_CHARACTERISTIC OUTc_V_VoltUEGOThrsh /end REF_CHARACTERISTIC /end FUNCTION
/begin FUNCTION DC "Group /ByModelHeirarchy/Gasoline/1.Input_Processing/Analog inputs/M670 UEGO/Outputs UEGO A/DC"
 /begin REF_CHARACTERISTIC OUTc_pct_DC_StepsUEGOA OUTc_pct_DC_UEGO_A OUTc_pct_HiThrshUEGOA OUTc_pct_RampDC_A OUTc_s_DbncStepsDC_UEGOA OUTc_s_DbncStepsDC_UEGOA2 /end REF_CHARACTERISTIC
/end FUNCTION
/begin FUNCTION Slowly_decrease_PWM_Frq "Group /ByModelHeirarchy/Gasoline/1.Input_Processing/Analog inputs/M670 UEGO/Outputs UEGO A/Freq/Slowly decrease PWM Frq"
 /begin REF_CHARACTERISTIC OUTc_Hz_FreqStepsUEGOA OUTc_Hz_FreqUEGO_A OUTc_Hz_LoThrshUEGOA OUTc_Hz_RampFreq_A OUTc_s_DbncStepsFreqUEGOA OUTc_s_DbncStepsFreqUEGOA2 /end REF_CHARACTERISTIC
/end FUNCTION
/begin FUNCTION Freq "Group /ByModelHeirarchy/Gasoline/1.Input_Processing/Analog inputs/M670 UEGO/Outputs UEGO A/Freq" /begin SUB_FUNCTION Slowly_decrease_PWM_Frq /end SUB_FUNCTION /begin REF_CHARACTERISTIC OUTm_Hz_FreqUEGO_x OUTm_Hz_FreqUEGO_z /end REF_CHARACTERISTIC /end FUNCTION
/begin FUNCTION OVR_AndExport1 "Group /ByModelHeirarchy/Gasoline/1.Input_Processing/Analog inputs/M670 UEGO/Outputs UEGO A/OVR_AndExport" /begin LOC_MEASUREMENT OUT_pct_UEGO_HTR_DC_A /end LOC_MEASUREMENT /begin REF_CHARACTERISTIC OUTc_o_UEGO_HTR_DC_A OUTc_pct_UEGO_HTR_DC_A /end REF_CHARACTERISTIC /end FUNCTION
/begin FUNCTION OVR_AndExport02 "Group /ByModelHeirarchy/Gasoline/1.Input_Processing/Analog inputs/M670 UEGO/Outputs UEGO A/OVR_AndExport1" /begin LOC_MEASUREMENT OUT_Hz_FreqUEGOA /end LOC_MEASUREMENT /begin REF_CHARACTERISTIC OUTc_Hz_FreqUEGOA OUTc_o_FreqUEGOA /end REF_CHARACTERISTIC /end FUNCTION
/begin FUNCTION Outputs_UEGO_A "Group /ByModelHeirarchy/Gasoline/1.Input_Processing/Analog inputs/M670 UEGO/Outputs UEGO A" /begin SUB_FUNCTION _24V_UEGO_warmup DC Freq OVR_AndExport1 OVR_AndExport02 /end SUB_FUNCTION /begin LOC_MEASUREMENT OUT_b_24V_WarmupA /end LOC_MEASUREMENT /end FUNCTION
/begin FUNCTION M670_UEGO "Group /ByModelHeirarchy/Gasoline/1.Input_Processing/Analog inputs/M670 UEGO" /begin SUB_FUNCTION LSU4.9_Handling Outputs_UEGO_A /end SUB_FUNCTION /end FUNCTION
/begin FUNCTION OVR_AndExport03 "Group /ByModelHeirarchy/Gasoline/1.Input_Processing/Analog inputs/OVR_AndExport1" /begin LOC_MEASUREMENT DTC_b_CataCounting /end LOC_MEASUREMENT /begin REF_CHARACTERISTIC DTCc_b_CataCounting DTCc_o_CataCounting /end REF_CHARACTERISTIC /end FUNCTION
/begin FUNCTION OVR_AndExport10 "Group /ByModelHeirarchy/Gasoline/1.Input_Processing/Analog inputs/OVR_AndExport10" /begin LOC_MEASUREMENT AIN_V_EGO21 /end LOC_MEASUREMENT /begin REF_CHARACTERISTIC AINc_V_EGO21 AINc_o_EGO21 /end REF_CHARACTERISTIC /end FUNCTION
/begin FUNCTION OVR_AndExport11 "Group /ByModelHeirarchy/Gasoline/1.Input_Processing/Analog inputs/OVR_AndExport11" /begin LOC_MEASUREMENT AIN_NU_TP1_Raw /end LOC_MEASUREMENT /begin REF_CHARACTERISTIC AINc_NU_TP1_Raw AINc_o_TP1_Raw /end REF_CHARACTERISTIC /end FUNCTION
/begin FUNCTION OVR_AndExport12 "Group /ByModelHeirarchy/Gasoline/1.Input_Processing/Analog inputs/OVR_AndExport12" /begin LOC_MEASUREMENT AIN_NU_TP2_Raw /end LOC_MEASUREMENT /begin REF_CHARACTERISTIC AINc_NU_TP2_Raw AINc_o_TP2_Raw /end REF_CHARACTERISTIC /end FUNCTION
/begin FUNCTION OVR_AndExport13 "Group /ByModelHeirarchy/Gasoline/1.Input_Processing/Analog inputs/OVR_AndExport13" /begin LOC_MEASUREMENT AIN_pct_Cylinder3_Knock /end LOC_MEASUREMENT /begin REF_CHARACTERISTIC AINc_o_Cylinder3_Knock AINc_pct_Cylinder3_Knock /end REF_CHARACTERISTIC /end FUNCTION
/begin FUNCTION OVR_AndExport14 "Group /ByModelHeirarchy/Gasoline/1.Input_Processing/Analog inputs/OVR_AndExport14" /begin LOC_MEASUREMENT AIN_pct_Cylinder4_Knock /end LOC_MEASUREMENT /begin REF_CHARACTERISTIC AINc_o_Cylinder4_Knock AINc_pct_Cylinder4_Knock /end REF_CHARACTERISTIC /end FUNCTION
/begin FUNCTION OVR_AndExport15 "Group /ByModelHeirarchy/Gasoline/1.Input_Processing/Analog inputs/OVR_AndExport15" /begin LOC_MEASUREMENT AIN_pct_Cylinder1_Knock /end LOC_MEASUREMENT /begin REF_CHARACTERISTIC AINc_o_Cylinder1_Knock AINc_pct_Cylinder1_Knock /end REF_CHARACTERISTIC /end FUNCTION
/begin FUNCTION OVR_AndExport16 "Group /ByModelHeirarchy/Gasoline/1.Input_Processing/Analog inputs/OVR_AndExport16" /begin LOC_MEASUREMENT AIN_pct_Cylinder2_Knock /end LOC_MEASUREMENT /begin REF_CHARACTERISTIC AINc_o_Cylinder2_Knock AINc_pct_Cylinder2_Knock /end REF_CHARACTERISTIC /end FUNCTION
/begin FUNCTION OVR_AndExport17 "Group /ByModelHeirarchy/Gasoline/1.Input_Processing/Analog inputs/OVR_AndExport17" /begin LOC_MEASUREMENT AIN_kPa_OilPress /end LOC_MEASUREMENT /begin REF_CHARACTERISTIC AINc_kPa_OilPress AINc_o_OilPress /end REF_CHARACTERISTIC /end FUNCTION
/begin FUNCTION OVR_AndExport18 "Group /ByModelHeirarchy/Gasoline/1.Input_Processing/Analog inputs/OVR_AndExport18" /begin LOC_MEASUREMENT AIN_C_AmbientTemp /end LOC_MEASUREMENT /begin REF_CHARACTERISTIC AINc_C_AmbientTemp AINc_o_AmbientTemp /end REF_CHARACTERISTIC /end FUNCTION
/begin FUNCTION OVR_AndExport19 "Group /ByModelHeirarchy/Gasoline/1.Input_Processing/Analog inputs/OVR_AndExport19" /begin LOC_MEASUREMENT AIN_kPa_Baro /end LOC_MEASUREMENT /begin REF_CHARACTERISTIC AINc_kPa_Baro AINc_o_Baro /end REF_CHARACTERISTIC /end FUNCTION
/begin FUNCTION OVR_AndExport28 "Group /ByModelHeirarchy/Gasoline/1.Input_Processing/Analog inputs/OVR_AndExport2" /begin LOC_MEASUREMENT AIN_V_EGO11 /end LOC_MEASUREMENT /begin REF_CHARACTERISTIC AINc_V_EGO11 AINc_o_EGO11 /end REF_CHARACTERISTIC /end FUNCTION
/begin FUNCTION OVR_AndExport20 "Group /ByModelHeirarchy/Gasoline/1.Input_Processing/Analog inputs/OVR_AndExport20" /begin LOC_MEASUREMENT AIN_C_ExhaustTemp /end LOC_MEASUREMENT /begin REF_CHARACTERISTIC AINc_C_ExhaustTemp AINc_o_ExhaustTemp /end REF_CHARACTERISTIC /end FUNCTION
/begin FUNCTION OVR_AndExport21 "Group /ByModelHeirarchy/Gasoline/1.Input_Processing/Analog inputs/OVR_AndExport21" /begin LOC_MEASUREMENT AIN_b_APP2_Valid /end LOC_MEASUREMENT /begin REF_CHARACTERISTIC AINc_b_APP2_Valid AINc_o_APP2_Valid /end REF_CHARACTERISTIC /end FUNCTION
/begin FUNCTION OVR_AndExport22 "Group /ByModelHeirarchy/Gasoline/1.Input_Processing/Analog inputs/OVR_AndExport22" /begin LOC_MEASUREMENT AIN_C_OilTemp /end LOC_MEASUREMENT /begin REF_CHARACTERISTIC AINc_C_OilTemp AINc_o_OilTemp /end REF_CHARACTERISTIC /end FUNCTION
/begin FUNCTION OVR_AndExport24 "Group /ByModelHeirarchy/Gasoline/1.Input_Processing/Analog inputs/OVR_AndExport24" /begin LOC_MEASUREMENT AIN_b_APP1_Valid /end LOC_MEASUREMENT /begin REF_CHARACTERISTIC AINc_b_APP1_Valid AINc_o_APP1_Valid /end REF_CHARACTERISTIC /end FUNCTION
/begin FUNCTION OVR_AndExport25 "Group /ByModelHeirarchy/Gasoline/1.Input_Processing/Analog inputs/OVR_AndExport25" /begin LOC_MEASUREMENT AIN_NU_APP1_Raw /end LOC_MEASUREMENT /begin REF_CHARACTERISTIC AINc_NU_APP1_Raw AINc_o_APP1_Raw /end REF_CHARACTERISTIC /end FUNCTION
/begin FUNCTION OVR_AndExport28 "Group /ByModelHeirarchy/Gasoline/1.Input_Processing/Analog inputs/OVR_AndExport28" /begin LOC_MEASUREMENT AIN_V_EGO12 /end LOC_MEASUREMENT /begin REF_CHARACTERISTIC AINc_V_EGO12 AINc_o_EGO12 /end REF_CHARACTERISTIC /end FUNCTION
/begin FUNCTION OVR_AndExport29 "Group /ByModelHeirarchy/Gasoline/1.Input_Processing/Analog inputs/OVR_AndExport29" /begin LOC_MEASUREMENT DTC_NU_TestTime /end LOC_MEASUREMENT /begin REF_CHARACTERISTIC DTCc_NU_TestTime DTCc_o_TestTime /end REF_CHARACTERISTIC /end FUNCTION
/begin FUNCTION OVR_AndExport39 "Group /ByModelHeirarchy/Gasoline/1.Input_Processing/Analog inputs/OVR_AndExport3" /begin LOC_MEASUREMENT AIN_NU_APP2_Raw /end LOC_MEASUREMENT /begin REF_CHARACTERISTIC AINc_NU_APP2_Raw AINc_o_APP2_Raw /end REF_CHARACTERISTIC /end FUNCTION
/begin FUNCTION OVR_AndExport30 "Group /ByModelHeirarchy/Gasoline/1.Input_Processing/Analog inputs/OVR_AndExport30" /begin LOC_MEASUREMENT AIN_lam_UEGO1 /end LOC_MEASUREMENT /begin REF_CHARACTERISTIC AINc_lam_UEGO1 AINc_o_UEGO1 /end REF_CHARACTERISTIC /end FUNCTION
/begin FUNCTION OVR_AndExport31 "Group /ByModelHeirarchy/Gasoline/1.Input_Processing/Analog inputs/OVR_AndExport31" /begin LOC_MEASUREMENT AIN_b_UEGO1_Valid /end LOC_MEASUREMENT /begin REF_CHARACTERISTIC AINc_b_UEGO1_Valid AINc_o_UEGO1_Valid /end REF_CHARACTERISTIC /end FUNCTION
/begin FUNCTION OVR_AndExport32 "Group /ByModelHeirarchy/Gasoline/1.Input_Processing/Analog inputs/OVR_AndExport32" /begin LOC_MEASUREMENT AIN_lam_UEGO2 /end LOC_MEASUREMENT /begin REF_CHARACTERISTIC AINc_lam_UEGO2 AINc_o_UEGO2 /end REF_CHARACTERISTIC /end FUNCTION
/begin FUNCTION OVR_AndExport33 "Group /ByModelHeirarchy/Gasoline/1.Input_Processing/Analog inputs/OVR_AndExport33" /begin LOC_MEASUREMENT AIN_b_UEGO2_Valid /end LOC_MEASUREMENT /begin REF_CHARACTERISTIC AINc_b_UEGO2_Valid AINc_o_UEGO2_Valid /end REF_CHARACTERISTIC /end FUNCTION
/begin FUNCTION OVR_AndExport310 "Group /ByModelHeirarchy/Gasoline/1.Input_Processing/Analog inputs/OVR_AndExport34" /begin LOC_MEASUREMENT AIN_C_CompOutTemp /end LOC_MEASUREMENT /begin REF_CHARACTERISTIC AINc_C_CompOutTemp AINc_o_CompOutTemp /end REF_CHARACTERISTIC /end FUNCTION
/begin FUNCTION OVR_AndExport35 "Group /ByModelHeirarchy/Gasoline/1.Input_Processing/Analog inputs/OVR_AndExport35" /begin LOC_MEASUREMENT AIN_C_FuelTemp /end LOC_MEASUREMENT /begin REF_CHARACTERISTIC AINc_C_FuelTemp AINc_o_FuelTemp /end REF_CHARACTERISTIC /end FUNCTION
/begin FUNCTION OVR_AndExport36 "Group /ByModelHeirarchy/Gasoline/1.Input_Processing/Analog inputs/OVR_AndExport36" /begin LOC_MEASUREMENT DTC_b_Catalyst_A /end LOC_MEASUREMENT /begin REF_CHARACTERISTIC DTCc_b_Catalyst_A DTCc_o_Catalyst_A /end REF_CHARACTERISTIC /end FUNCTION
/begin FUNCTION OVR_AndExport37 "Group /ByModelHeirarchy/Gasoline/1.Input_Processing/Analog inputs/OVR_AndExport37" /begin LOC_MEASUREMENT DTC_b_NBValid /end LOC_MEASUREMENT /begin REF_CHARACTERISTIC DTCc_b_NBValid DTCc_o_NBValid /end REF_CHARACTERISTIC /end FUNCTION
/begin FUNCTION OVR_AndExport38 "Group /ByModelHeirarchy/Gasoline/1.Input_Processing/Analog inputs/OVR_AndExport38" /begin LOC_MEASUREMENT AIN_kPa_FAP /end LOC_MEASUREMENT /begin REF_CHARACTERISTIC AINc_kPa_FAP AINc_o_FAP /end REF_CHARACTERISTIC /end FUNCTION
/begin FUNCTION OVR_AndExport39 "Group /ByModelHeirarchy/Gasoline/1.Input_Processing/Analog inputs/OVR_AndExport39" /begin LOC_MEASUREMENT DTC_b_DiagCata_TestEnd /end LOC_MEASUREMENT /begin REF_CHARACTERISTIC DTCc_b_DiagCata_TestEnd DTCc_o_DiagCata_TestEnd /end REF_CHARACTERISTIC /end FUNCTION
/begin FUNCTION OVR_AndExport45 "Group /ByModelHeirarchy/Gasoline/1.Input_Processing/Analog inputs/OVR_AndExport4" /begin LOC_MEASUREMENT AIN_C_ManifoldTemp /end LOC_MEASUREMENT /begin REF_CHARACTERISTIC AINc_C_ManifoldTemp AINc_o_ManifoldTemp /end REF_CHARACTERISTIC /end FUNCTION
/begin FUNCTION OVR_AndExport54 "Group /ByModelHeirarchy/Gasoline/1.Input_Processing/Analog inputs/OVR_AndExport5" /begin LOC_MEASUREMENT AIN_kPa_CompOutPress /end LOC_MEASUREMENT /begin REF_CHARACTERISTIC AINc_kPa_CompOutPress AINc_o_CompOutPress /end REF_CHARACTERISTIC /end FUNCTION
/begin FUNCTION OVR_AndExport62 "Group /ByModelHeirarchy/Gasoline/1.Input_Processing/Analog inputs/OVR_AndExport6" /begin LOC_MEASUREMENT AIN_C_CoolantTemp /end LOC_MEASUREMENT /begin REF_CHARACTERISTIC AINc_C_CoolantTemp AINc_o_CoolantTemp /end REF_CHARACTERISTIC /end FUNCTION
/begin FUNCTION OVR_AndExport71 "Group /ByModelHeirarchy/Gasoline/1.Input_Processing/Analog inputs/OVR_AndExport7" /begin LOC_MEASUREMENT AIN_kPa_MAP /end LOC_MEASUREMENT /begin REF_CHARACTERISTIC AINc_kPa_MAP AINc_o_MAP /end REF_CHARACTERISTIC /end FUNCTION
/begin FUNCTION OVR_AndExport81 "Group /ByModelHeirarchy/Gasoline/1.Input_Processing/Analog inputs/OVR_AndExport8" /begin LOC_MEASUREMENT AIN_bar_FuelPress /end LOC_MEASUREMENT /begin REF_CHARACTERISTIC AINc_bar_FuelPress AINc_o_FuelPress /end REF_CHARACTERISTIC /end FUNCTION
/begin FUNCTION Subsystem "Group /ByModelHeirarchy/Gasoline/1.Input_Processing/Analog inputs/Subsystem" /begin LOC_MEASUREMENT DTC_s_TimerOut_1 /end LOC_MEASUREMENT /end FUNCTION
/begin FUNCTION Subsystem1 "Group /ByModelHeirarchy/Gasoline/1.Input_Processing/Analog inputs/Subsystem1" /begin LOC_MEASUREMENT DTC_s_TimerOut_2 /end LOC_MEASUREMENT /end FUNCTION
/begin FUNCTION OVR_AndExport04 "Group /ByModelHeirarchy/Gasoline/1.Input_Processing/Analog inputs/TP1/OVR_AndExport1" /begin LOC_MEASUREMENT DTC_b_TP1_SensorHV /end LOC_MEASUREMENT /begin REF_CHARACTERISTIC DTCc_b_TP1_SensorHV DTCc_o_TP1_SensorHV /end REF_CHARACTERISTIC /end FUNCTION
/begin FUNCTION OVR_AndExport29 "Group /ByModelHeirarchy/Gasoline/1.Input_Processing/Analog inputs/TP1/OVR_AndExport2" /begin LOC_MEASUREMENT DTC_b_THR_Motor_Fail /end LOC_MEASUREMENT /begin REF_CHARACTERISTIC DTCc_b_THR_Motor_Fail DTCc_o_THR_Motor_Fail /end REF_CHARACTERISTIC /end FUNCTION
/begin FUNCTION OVR_AndExport311 "Group /ByModelHeirarchy/Gasoline/1.Input_Processing/Analog inputs/TP1/OVR_AndExport34" /begin LOC_MEASUREMENT DTC_b_TP1_SensorLV /end LOC_MEASUREMENT /begin REF_CHARACTERISTIC DTCc_b_TP1_SensorLV DTCc_o_TP1_SensorLV /end REF_CHARACTERISTIC /end FUNCTION
/begin FUNCTION TP1 "Group /ByModelHeirarchy/Gasoline/1.Input_Processing/Analog inputs/TP1" /begin SUB_FUNCTION OVR_AndExport04 OVR_AndExport29 OVR_AndExport311 /end SUB_FUNCTION /begin LOC_MEASUREMENT AIN_V_TP1 AIN_b_TP1_Fault /end LOC_MEASUREMENT
 /begin REF_CHARACTERISTIC AINc_Hz_TP1_BktFR AINc_Hz_TP1_BktRR AINc_NU_TP1_BktHys AINc_NU_TP1_Dflt AINc_NU_TP1_Gain AINc_NU_TP1_SlewLim AINc_V_TP1_Max AINc_V_TP1_Min AINc_V_TP1_Ofst AINc_s_THRDeadTime AINc_s_THRResetTime /end REF_CHARACTERISTIC
/end FUNCTION
/begin FUNCTION OVR_AndExport05 "Group /ByModelHeirarchy/Gasoline/1.Input_Processing/Analog inputs/TP2/OVR_AndExport1" /begin LOC_MEASUREMENT DTC_b_TP2_SensorHV /end LOC_MEASUREMENT /begin REF_CHARACTERISTIC DTCc_b_TP2_SensorHV DTCc_o_TP2_SensorHV /end REF_CHARACTERISTIC /end FUNCTION
/begin FUNCTION OVR_AndExport312 "Group /ByModelHeirarchy/Gasoline/1.Input_Processing/Analog inputs/TP2/OVR_AndExport34" /begin LOC_MEASUREMENT DTC_b_TP2_SensorLV /end LOC_MEASUREMENT /begin REF_CHARACTERISTIC DTCc_b_TP2_SensorLV DTCc_o_TP2_SensorLV /end REF_CHARACTERISTIC /end FUNCTION
/begin FUNCTION TP2 "Group /ByModelHeirarchy/Gasoline/1.Input_Processing/Analog inputs/TP2" /begin SUB_FUNCTION OVR_AndExport05 OVR_AndExport312 /end SUB_FUNCTION /begin LOC_MEASUREMENT AIN_V_TP2 AIN_b_TP2_Fault /end LOC_MEASUREMENT
 /begin REF_CHARACTERISTIC AINc_Hz_TP2_BktFR AINc_Hz_TP2_BktRR AINc_NU_TP2_BktHys AINc_NU_TP2_Dflt AINc_NU_TP2_Gain AINc_NU_TP2_SlewLim AINc_V_TP2_Max AINc_V_TP2_Min AINc_V_TP2_Ofst /end REF_CHARACTERISTIC
/end FUNCTION
/begin FUNCTION OVR_AndExport06 "Group /ByModelHeirarchy/Gasoline/1.Input_Processing/Analog inputs/VBatt/OVR_AndExport1" /begin LOC_MEASUREMENT AIN_V_VBatt /end LOC_MEASUREMENT /begin REF_CHARACTERISTIC AINc_V_VBatt AINc_o_VBatt /end REF_CHARACTERISTIC /end FUNCTION
/begin FUNCTION OVR_AndExport07 "Group /ByModelHeirarchy/Gasoline/1.Input_Processing/Analog inputs/VBatt/OVR_AndExport2" /begin LOC_MEASUREMENT DTC_b_BAT_VoltageOutofRange /end LOC_MEASUREMENT /begin REF_CHARACTERISTIC DTCc_b_BAT_VoltageOutofRange DTCc_o_BAT_VoltageOutofRange /end REF_CHARACTERISTIC /end FUNCTION
/begin FUNCTION VBatt "Group /ByModelHeirarchy/Gasoline/1.Input_Processing/Analog inputs/VBatt" /begin SUB_FUNCTION OVR_AndExport06 OVR_AndExport07 /end SUB_FUNCTION /begin LOC_MEASUREMENT AIN_V_VBattRaw /end LOC_MEASUREMENT
 /begin REF_CHARACTERISTIC AINc_Hz_bat_dat_nok_FR AINc_Hz_bat_dat_nok_RR AINc_NU_VBattGain AINc_V_VBattLow AINc_V_VBattTop /end REF_CHARACTERISTIC
/end FUNCTION
/begin FUNCTION OVR_AndExport08 "Group /ByModelHeirarchy/Gasoline/1.Input_Processing/Analog inputs/before throtle Press/OVR_AndExport1" /begin LOC_MEASUREMENT DTC_b_MAPBefThroHV /end LOC_MEASUREMENT /begin REF_CHARACTERISTIC DTCc_b_MAPBefThroHV DTCc_o_MAPBefThroHV /end REF_CHARACTERISTIC /end FUNCTION
/begin FUNCTION OVR_AndExport09 "Group /ByModelHeirarchy/Gasoline/1.Input_Processing/Analog inputs/before throtle Press/OVR_AndExport2" /begin LOC_MEASUREMENT DTC_b_MAPBeforeThroHPress /end LOC_MEASUREMENT /begin REF_CHARACTERISTIC DTCc_b_MAPBeforeThroHPress DTCc_o_MAPBeforeThroHPress /end REF_CHARACTERISTIC /end FUNCTION
/begin FUNCTION OVR_AndExport10 "Group /ByModelHeirarchy/Gasoline/1.Input_Processing/Analog inputs/before throtle Press/OVR_AndExport3" /begin LOC_MEASUREMENT DTC_b_MAPBeforeThroLPress /end LOC_MEASUREMENT /begin REF_CHARACTERISTIC DTCc_b_MAPBeforeThroLPress DTCc_o_MAPBeforeThroLPress /end REF_CHARACTERISTIC /end FUNCTION
/begin FUNCTION OVR_AndExport313 "Group /ByModelHeirarchy/Gasoline/1.Input_Processing/Analog inputs/before throtle Press/OVR_AndExport34" /begin LOC_MEASUREMENT DTC_b_MAPBefThroOL /end LOC_MEASUREMENT /begin REF_CHARACTERISTIC DTCc_b_MAPBefThroOL DTCc_o_MAPBefThroOL /end REF_CHARACTERISTIC /end FUNCTION
/begin FUNCTION before_throtle_Press "Group /ByModelHeirarchy/Gasoline/1.Input_Processing/Analog inputs/before throtle Press"
 /begin SUB_FUNCTION OVR_AndExport08 OVR_AndExport09 OVR_AndExport10 OVR_AndExport313 /end SUB_FUNCTION
 /begin LOC_MEASUREMENT AIN_V_MAP_BeforeThro AIN_b_CompOutPress_Fault /end LOC_MEASUREMENT
 /begin REF_CHARACTERISTIC AINc_Hz_CompOutPress_BktFR AINc_Hz_CompOutPress_BktRR AINc_NU_CompOutPress_BktHys AINc_NU_CompOutPress_Gain AINc_NU_CompOutPress_SlewLim AINc_V_CompOutPress_Max AINc_V_CompOutPress_Min AINc_V_CompOutPress_Ofst AINc_kPa_CompOutPress_Dflt AINc_kPa_CompOutPress_Max AINc_kPa_CompOutPress_Min AINc_kPa_CompOutPress_Ofst /end REF_CHARACTERISTIC
/end FUNCTION
/begin FUNCTION Analog_inputs "Group /ByModelHeirarchy/Gasoline/1.Input_Processing/Analog inputs"
 /begin SUB_FUNCTION AAT1 APP1 APP2 AT1IMG1_FAP Angular_MAP_input BARO ECT Exhaust_Temp FAP Fuel_Press Fuel_Temp FuelLevel1 IAT1 Inicio_Reinicio_Temporizaci__n Knock M670_UEGO OVR_AndExport03 OVR_AndExport10 OVR_AndExport11 OVR_AndExport12 OVR_AndExport13 OVR_AndExport14 OVR_AndExport15 OVR_AndExport16 OVR_AndExport17 OVR_AndExport18 OVR_AndExport19 OVR_AndExport28 OVR_AndExport20 OVR_AndExport21 OVR_AndExport22 OVR_AndExport24 OVR_AndExport25 OVR_AndExport28 OVR_AndExport29 OVR_AndExport39 OVR_AndExport30 OVR_AndExport31 OVR_AndExport32 OVR_AndExport33 OVR_AndExport310 OVR_AndExport35 OVR_AndExport36 OVR_AndExport37 OVR_AndExport38 OVR_AndExport39 OVR_AndExport45 OVR_AndExport54 OVR_AndExport62 OVR_AndExport71 OVR_AndExport81 Subsystem Subsystem1 TP1 TP2 VBatt before_throtle_Press /end SUB_FUNCTION
 /begin LOC_MEASUREMENT AIN_s_DelayLambdas DTC_b_DiagCataTemp_ena DTC_b_DiagCata_Condition DTC_b_DiagCata_Set DTC_s_TimerOut_1 /end LOC_MEASUREMENT
 /begin REF_CHARACTERISTIC AINc_b_UseHalfVBatt DTCc_C_DiagCata_MaxEGT DTCc_C_DiagCata_MinEGT DTCc_NU_CatalystTimeThreshold DTCc_NU_TimeRichLean DTCc_s_DiagCataActv_IdlDelay /end REF_CHARACTERISTIC
/end FUNCTION
/begin FUNCTION Cylinder_1_speed_meas "Group /ByModelHeirarchy/Gasoline/1.Input_Processing/Angular_speed_input/Cylinder 1 speed_meas"
 /begin REF_CHARACTERISTIC INPc_nu_EngineSpeedCyl_1 INPc_nu_num_toothpost INPc_nu_num_toothpre /end REF_CHARACTERISTIC
/end FUNCTION
/begin FUNCTION Cylinder_1_speed_meas1 "Group /ByModelHeirarchy/Gasoline/1.Input_Processing/Angular_speed_input/Cylinder 1 speed_meas1"
 /begin REF_CHARACTERISTIC INPc_nu_EngineSpeedCyl_2 INPc_nu_num_toothpost INPc_nu_num_toothpre /end REF_CHARACTERISTIC
/end FUNCTION
/begin FUNCTION Cylinder_1_speed_meas2 "Group /ByModelHeirarchy/Gasoline/1.Input_Processing/Angular_speed_input/Cylinder 1 speed_meas2"
 /begin REF_CHARACTERISTIC INPc_nu_EngineSpeedCyl_3 INPc_nu_num_toothpost INPc_nu_num_toothpre /end REF_CHARACTERISTIC
/end FUNCTION
/begin FUNCTION Cylinder_1_speed_meas3 "Group /ByModelHeirarchy/Gasoline/1.Input_Processing/Angular_speed_input/Cylinder 1 speed_meas3"
 /begin REF_CHARACTERISTIC INPc_nu_EngineSpeedCyl_4 INPc_nu_num_toothpost INPc_nu_num_toothpre /end REF_CHARACTERISTIC
/end FUNCTION
/begin FUNCTION ToothModulo "Group /ByModelHeirarchy/Gasoline/1.Input_Processing/Angular_speed_input/ToothModulo" /begin REF_CHARACTERISTIC INPc_nu_toothmodulo /end REF_CHARACTERISTIC /end FUNCTION
/begin FUNCTION ToothModulo1 "Group /ByModelHeirarchy/Gasoline/1.Input_Processing/Angular_speed_input/ToothModulo1" /begin REF_CHARACTERISTIC INPc_nu_toothmodulo /end REF_CHARACTERISTIC /end FUNCTION
/begin FUNCTION Angular_speed_input "Group /ByModelHeirarchy/Gasoline/1.Input_Processing/Angular_speed_input"
 /begin SUB_FUNCTION Cylinder_1_speed_meas Cylinder_1_speed_meas1 Cylinder_1_speed_meas2 Cylinder_1_speed_meas3 ToothModulo ToothModulo1 /end SUB_FUNCTION
 /begin LOC_MEASUREMENT INP_rpm_EngSpdPre_ang_1 INP_rpm_EngSpdPre_ang_2 INP_rpm_EngSpdPre_ang_3 INP_rpm_EngSpdPre_ang_4 INP_rpm_EngSpdPst_ang_1 INP_rpm_EngSpdPst_ang_2 INP_rpm_EngSpdPst_ang_3 INP_rpm_EngSpdPst_ang_4 SYS_EngSpedDelta1 SYS_EngSpedDelta1_after SYS_EngSpedDelta2 SYS_EngSpedDelta2_after SYS_EngSpedDelta3 SYS_EngSpedDelta3_after SYS_EngSpedDelta4 SYS_EngSpedDelta4_after /end LOC_MEASUREMENT
 /begin REF_CHARACTERISTIC INPc_nu_toothpost INPc_nu_toothpre /end REF_CHARACTERISTIC
/end FUNCTION
/begin FUNCTION OVR_AndExport11 "Group /ByModelHeirarchy/Gasoline/1.Input_Processing/CAN inputs/OVR_AndExport1" /begin LOC_MEASUREMENT CIN_NU_OvrCtrMd_ESP /end LOC_MEASUREMENT /begin REF_CHARACTERISTIC CINc_NU_OvrCtrMd_ESP CINc_o_OvrCtrMd_ESP /end REF_CHARACTERISTIC /end FUNCTION
/begin FUNCTION OVR_AndExport111 "Group /ByModelHeirarchy/Gasoline/1.Input_Processing/CAN inputs/OVR_AndExport11" /begin LOC_MEASUREMENT CIN_pct_TqCtrRq_ESP /end LOC_MEASUREMENT /begin REF_CHARACTERISTIC CINc_o_TqCtrRq_ESP CINc_pct_TqCtrRq_ESP /end REF_CHARACTERISTIC /end FUNCTION
/begin FUNCTION OVR_AndExport12 "Group /ByModelHeirarchy/Gasoline/1.Input_Processing/CAN inputs/OVR_AndExport2" /begin LOC_MEASUREMENT CIN_NU_EngOvrCtrMd_ESP /end LOC_MEASUREMENT /begin REF_CHARACTERISTIC CINc_NU_EngOvrCtrMd_ESP CINc_o_EngOvrCtrMd_ESP /end REF_CHARACTERISTIC /end FUNCTION
/begin FUNCTION OVR_AndExport13 "Group /ByModelHeirarchy/Gasoline/1.Input_Processing/CAN inputs/OVR_AndExport3" /begin LOC_MEASUREMENT CIN_NU_OvrCtrMd_TCM /end LOC_MEASUREMENT /begin REF_CHARACTERISTIC CINc_NU_OvrCtrMd_TCM CINc_o_OvrCtrMd_TCM /end REF_CHARACTERISTIC /end FUNCTION
/begin FUNCTION OVR_AndExport46 "Group /ByModelHeirarchy/Gasoline/1.Input_Processing/CAN inputs/OVR_AndExport4" /begin LOC_MEASUREMENT CIN_pct_TqCtrRq_TCM /end LOC_MEASUREMENT /begin REF_CHARACTERISTIC CINc_o_TqCtrRq_TCM CINc_pct_TqCtrRq_TCM /end REF_CHARACTERISTIC /end FUNCTION
/begin FUNCTION OVR_AndExport55 "Group /ByModelHeirarchy/Gasoline/1.Input_Processing/CAN inputs/OVR_AndExport5" /begin LOC_MEASUREMENT CIN_NU_EngOvrCtrMd_TCM /end LOC_MEASUREMENT /begin REF_CHARACTERISTIC CINc_NU_EngOvrCtrMd_TCM CINc_o_EngOvrCtrMd_TCM /end REF_CHARACTERISTIC /end FUNCTION
/begin FUNCTION CAN_inputs "Group /ByModelHeirarchy/Gasoline/1.Input_Processing/CAN inputs"
 /begin SUB_FUNCTION OVR_AndExport11 OVR_AndExport111 OVR_AndExport12 OVR_AndExport13 OVR_AndExport46 OVR_AndExport55 /end SUB_FUNCTION
/end FUNCTION
/begin FUNCTION LogEnable6 "Group /ByModelHeirarchy/Gasoline/1.Input_Processing/DTCs/LogEnable6" /begin REF_CHARACTERISTIC LOGc_b_EnableCanLog /end REF_CHARACTERISTIC /end FUNCTION
/begin FUNCTION Missfire_Counter "Group /ByModelHeirarchy/Gasoline/1.Input_Processing/DTCs/Missfire_Counter" /begin REF_CHARACTERISTIC INPc_s_MisfireDelay SYSc_NU_MaxMissfire /end REF_CHARACTERISTIC /end FUNCTION
/begin FUNCTION Missfire_Counter1 "Group /ByModelHeirarchy/Gasoline/1.Input_Processing/DTCs/Missfire_Counter1" /begin REF_CHARACTERISTIC INPc_s_MisfireDelay SYSc_NU_MaxMissfire /end REF_CHARACTERISTIC /end FUNCTION
/begin FUNCTION Missfire_Counter2 "Group /ByModelHeirarchy/Gasoline/1.Input_Processing/DTCs/Missfire_Counter2" /begin REF_CHARACTERISTIC INPc_s_MisfireDelay SYSc_NU_MaxMissfire /end REF_CHARACTERISTIC /end FUNCTION
/begin FUNCTION Missfire_Counter3 "Group /ByModelHeirarchy/Gasoline/1.Input_Processing/DTCs/Missfire_Counter3" /begin REF_CHARACTERISTIC INPc_s_MisfireDelay SYSc_NU_MaxMissfire /end REF_CHARACTERISTIC /end FUNCTION
/begin FUNCTION OVR_AndExport101 "Group /ByModelHeirarchy/Gasoline/1.Input_Processing/DTCs/OVR_AndExport10" /begin LOC_MEASUREMENT DTC_b_Misfire_Cylinder_3 /end LOC_MEASUREMENT /begin REF_CHARACTERISTIC DTCc_b_Misfire_Cylinder_3 DTCc_o_Misfire_Cylinder_3 /end REF_CHARACTERISTIC /end FUNCTION
/begin FUNCTION OVR_AndExport112 "Group /ByModelHeirarchy/Gasoline/1.Input_Processing/DTCs/OVR_AndExport11" /begin LOC_MEASUREMENT DTC_b_EnableMIsfire /end LOC_MEASUREMENT /begin REF_CHARACTERISTIC DTCc_b_EnableMIsfire DTCc_o_EnableMIsfire /end REF_CHARACTERISTIC /end FUNCTION
/begin FUNCTION OVR_AndExport56 "Group /ByModelHeirarchy/Gasoline/1.Input_Processing/DTCs/OVR_AndExport5" /begin LOC_MEASUREMENT DTC_b_Misfire_Bancada /end LOC_MEASUREMENT /begin REF_CHARACTERISTIC DTCc_b_Misfire_Bancada DTCc_o_Misfire_Bancada /end REF_CHARACTERISTIC /end FUNCTION
/begin FUNCTION OVR_AndExport63 "Group /ByModelHeirarchy/Gasoline/1.Input_Processing/DTCs/OVR_AndExport6" /begin LOC_MEASUREMENT DTC_b_Misfire_Cylinder_2 /end LOC_MEASUREMENT /begin REF_CHARACTERISTIC DTCc_b_Misfire_Cylinder_2 DTCc_o_Misfire_Cylinder_2 /end REF_CHARACTERISTIC /end FUNCTION
/begin FUNCTION OVR_AndExport72 "Group /ByModelHeirarchy/Gasoline/1.Input_Processing/DTCs/OVR_AndExport7" /begin LOC_MEASUREMENT DTC_b_Misfire_Cylinder_4 /end LOC_MEASUREMENT /begin REF_CHARACTERISTIC DTCc_b_Misfire_Cylinder_4 DTCc_o_Misfire_Cylinder_4 /end REF_CHARACTERISTIC /end FUNCTION
/begin FUNCTION OVR_AndExport9 "Group /ByModelHeirarchy/Gasoline/1.Input_Processing/DTCs/OVR_AndExport9" /begin LOC_MEASUREMENT DTC_b_Misfire_Cylinder_1 /end LOC_MEASUREMENT /begin REF_CHARACTERISTIC DTCc_b_Misfire_Cylinder_1 DTCc_o_Misfire_Cylinder_1 /end REF_CHARACTERISTIC /end FUNCTION
/begin FUNCTION DTCs "Group /ByModelHeirarchy/Gasoline/1.Input_Processing/DTCs"
 /begin SUB_FUNCTION LogEnable6 Missfire_Counter Missfire_Counter1 Missfire_Counter2 Missfire_Counter3 OVR_AndExport101 OVR_AndExport112 OVR_AndExport56 OVR_AndExport63 OVR_AndExport72 OVR_AndExport9 /end SUB_FUNCTION
 /begin LOC_MEASUREMENT INP_cnt_count_1 INP_cnt_count_2 INP_cnt_count_3 INP_cnt_count_4 /end LOC_MEASUREMENT
 /begin REF_CHARACTERISTIC DTCc_RPM_EntryThrshMisf INPc_s_DelayEnableMis LOGc_s_ResMisfCounter /end REF_CHARACTERISTIC
/end FUNCTION
/begin FUNCTION AltLoad "Group /ByModelHeirarchy/Gasoline/1.Input_Processing/Digital Inputs/AltLoad" /begin LOC_MEASUREMENT INP_b_XG4 /end LOC_MEASUREMENT /end FUNCTION
/begin FUNCTION OVR_AndExport14 "Group /ByModelHeirarchy/Gasoline/1.Input_Processing/Digital Inputs/CAM & CRANshaft DTCs/OVR_AndExport1" /begin LOC_MEASUREMENT DTC_b_FalloCramShaft /end LOC_MEASUREMENT /begin REF_CHARACTERISTIC DTCc_b_FalloCramShaft DTCc_o_FalloCramShaft /end REF_CHARACTERISTIC /end FUNCTION
/begin FUNCTION OVR_AndExport314 "Group /ByModelHeirarchy/Gasoline/1.Input_Processing/Digital Inputs/CAM & CRANshaft DTCs/OVR_AndExport34" /begin LOC_MEASUREMENT DTC_b_FalloCamShaft /end LOC_MEASUREMENT /begin REF_CHARACTERISTIC DTCc_b_FalloCamShaft DTCc_o_FalloCamShaft /end REF_CHARACTERISTIC /end FUNCTION
/begin FUNCTION CAM___CRANshaft_DTCs "Group /ByModelHeirarchy/Gasoline/1.Input_Processing/Digital Inputs/CAM & CRANshaft DTCs" /begin SUB_FUNCTION OVR_AndExport14 OVR_AndExport314 /end SUB_FUNCTION /begin REF_CHARACTERISTIC AINc_NU_MinRPMCaCr AINc_s_SyncCranktime /end REF_CHARACTERISTIC /end FUNCTION
/begin FUNCTION EngSpd "Group /ByModelHeirarchy/Gasoline/1.Input_Processing/Digital Inputs/EngSpd"
 /begin LOC_MEASUREMENT DIN_RPM_Per720 DIN_RPM_PerCyl INP_RPM_CrankSpd SYS_b_CrankSync /end LOC_MEASUREMENT
 /begin REF_CHARACTERISTIC DINc_Hz_EngSpdLPF /end REF_CHARACTERISTIC
/end FUNCTION
/begin FUNCTION EngSync "Group /ByModelHeirarchy/Gasoline/1.Input_Processing/Digital Inputs/EngSync" /begin LOC_MEASUREMENT SYS_b_EngSync /end LOC_MEASUREMENT /end FUNCTION
/begin FUNCTION IntakeCam "Group /ByModelHeirarchy/Gasoline/1.Input_Processing/Digital Inputs/IntakeCam"
 /begin LOC_MEASUREMENT DIN_b_CamTO DIN_cnt_CamExtraTeeth DIN_cnt_CamMissTeeth DIN_deg_CamTooth1 DIN_deg_CamTooth2 DIN_deg_CamTooth3 DIN_deg_CamTooth4 DIN_deg_CamToothDelta /end LOC_MEASUREMENT
 /begin REF_CHARACTERISTIC DINc_deg_Tooth2AngHi DINc_deg_Tooth2AngLo DINc_deg_Tooth2BaseAng DINc_deg_Tooth3BaseAng DINc_deg_ValidCamDelta DINc_ret_CamPhaseMax DINc_s_ValidCamDbnc1 DINc_s_ValidCamDbnc2 /end REF_CHARACTERISTIC
/end FUNCTION
/begin FUNCTION MAF "Group /ByModelHeirarchy/Gasoline/1.Input_Processing/Digital Inputs/MAF" /begin LOC_MEASUREMENT DIN_Hz_MAF DIN_b_MAF_To /end LOC_MEASUREMENT
 /begin REF_CHARACTERISTIC DINc_Hz_MAF_To DINc_NU_MAF_FallRate DINc_NU_MAF_RiseRate DINm_NU_MAF_x DINm_NU_MAF_z /end REF_CHARACTERISTIC
/end FUNCTION
/begin FUNCTION OVR_AndExport15 "Group /ByModelHeirarchy/Gasoline/1.Input_Processing/Digital Inputs/OVR_AndExport1" /begin LOC_MEASUREMENT DIN_b_Ign /end LOC_MEASUREMENT /begin REF_CHARACTERISTIC DINc_b_Ign DINc_o_Ign /end REF_CHARACTERISTIC /end FUNCTION
/begin FUNCTION OVR_AndExport102 "Group /ByModelHeirarchy/Gasoline/1.Input_Processing/Digital Inputs/OVR_AndExport10" /begin LOC_MEASUREMENT DIN_kph_VehSpd /end LOC_MEASUREMENT /begin REF_CHARACTERISTIC DINc_kph_VehSpd DINc_o_VehSpd /end REF_CHARACTERISTIC /end FUNCTION
/begin FUNCTION OVR_AndExport113 "Group /ByModelHeirarchy/Gasoline/1.Input_Processing/Digital Inputs/OVR_AndExport11" /begin LOC_MEASUREMENT DIN_b_OilPrSw /end LOC_MEASUREMENT /begin REF_CHARACTERISTIC DINc_b_OilPrSw DINc_o_OilPrSw /end REF_CHARACTERISTIC /end FUNCTION
/begin FUNCTION OVR_AndExport121 "Group /ByModelHeirarchy/Gasoline/1.Input_Processing/Digital Inputs/OVR_AndExport12" /begin LOC_MEASUREMENT DIN_b_AC_PressSw /end LOC_MEASUREMENT /begin REF_CHARACTERISTIC DINc_b_AC_PressSw DINc_o_AC_PressSw /end REF_CHARACTERISTIC /end FUNCTION
/begin FUNCTION OVR_AndExport131 "Group /ByModelHeirarchy/Gasoline/1.Input_Processing/Digital Inputs/OVR_AndExport13" /begin LOC_MEASUREMENT DIN_b_AC_ReqSw /end LOC_MEASUREMENT /begin REF_CHARACTERISTIC DINc_b_AC_ReqSw DINc_o_AC_ReqSw /end REF_CHARACTERISTIC /end FUNCTION
/begin FUNCTION OVR_AndExport141 "Group /ByModelHeirarchy/Gasoline/1.Input_Processing/Digital Inputs/OVR_AndExport14" /begin LOC_MEASUREMENT DIN_RPM_TOSS /end LOC_MEASUREMENT /begin REF_CHARACTERISTIC DINc_RPM_TOSS DINc_o_TOSS /end REF_CHARACTERISTIC /end FUNCTION
/begin FUNCTION OVR_AndExport151 "Group /ByModelHeirarchy/Gasoline/1.Input_Processing/Digital Inputs/OVR_AndExport15" /begin LOC_MEASUREMENT DIN_b_RearGear /end LOC_MEASUREMENT /begin REF_CHARACTERISTIC DINc_b_RearGear DINc_o_RearGear /end REF_CHARACTERISTIC /end FUNCTION
/begin FUNCTION OVR_AndExport161 "Group /ByModelHeirarchy/Gasoline/1.Input_Processing/Digital Inputs/OVR_AndExport16" /begin LOC_MEASUREMENT SYS_b_CrankAngValid /end LOC_MEASUREMENT /begin REF_CHARACTERISTIC SYSc_b_CrankAngValid SYSc_o_CrankAngValid /end REF_CHARACTERISTIC /end FUNCTION
/begin FUNCTION OVR_AndExport171 "Group /ByModelHeirarchy/Gasoline/1.Input_Processing/Digital Inputs/OVR_AndExport17" /begin LOC_MEASUREMENT DIN_b_PedalBrake /end LOC_MEASUREMENT /begin REF_CHARACTERISTIC DINc_b_PedalBrake DINc_o_PedalBrake /end REF_CHARACTERISTIC /end FUNCTION
/begin FUNCTION OVR_AndExport181 "Group /ByModelHeirarchy/Gasoline/1.Input_Processing/Digital Inputs/OVR_AndExport18" /begin LOC_MEASUREMENT DIN_b_Belt /end LOC_MEASUREMENT /begin REF_CHARACTERISTIC DINc_b_Belt DINc_o_Belt /end REF_CHARACTERISTIC /end FUNCTION
/begin FUNCTION OVR_AndExport191 "Group /ByModelHeirarchy/Gasoline/1.Input_Processing/Digital Inputs/OVR_AndExport19" /begin LOC_MEASUREMENT DIN_b_Door /end LOC_MEASUREMENT /begin REF_CHARACTERISTIC DINc_b_Door DINc_o_Door /end REF_CHARACTERISTIC /end FUNCTION
/begin FUNCTION OVR_AndExport16 "Group /ByModelHeirarchy/Gasoline/1.Input_Processing/Digital Inputs/OVR_AndExport2" /begin LOC_MEASUREMENT DIN_RPM_EngSpd /end LOC_MEASUREMENT /begin REF_CHARACTERISTIC DINc_RPM_EngSpd DINc_o_EngSpd /end REF_CHARACTERISTIC /end FUNCTION
/begin FUNCTION OVR_AndExport17 "Group /ByModelHeirarchy/Gasoline/1.Input_Processing/Digital Inputs/OVR_AndExport3" /begin LOC_MEASUREMENT DIN_ret_CamPhase /end LOC_MEASUREMENT /begin REF_CHARACTERISTIC DINc_o_CamPhase DINc_ret_CamPhase /end REF_CHARACTERISTIC /end FUNCTION
/begin FUNCTION OVR_AndExport47 "Group /ByModelHeirarchy/Gasoline/1.Input_Processing/Digital Inputs/OVR_AndExport4" /begin LOC_MEASUREMENT DIN_b_ParkingBrake /end LOC_MEASUREMENT /begin REF_CHARACTERISTIC DINc_b_ParkingBrake DINc_o_ParkingBrake /end REF_CHARACTERISTIC /end FUNCTION
/begin FUNCTION OVR_AndExport57 "Group /ByModelHeirarchy/Gasoline/1.Input_Processing/Digital Inputs/OVR_AndExport5" /begin LOC_MEASUREMENT DIN_gps_MAF /end LOC_MEASUREMENT /begin REF_CHARACTERISTIC DINc_gps_MAF DINc_o_MAF /end REF_CHARACTERISTIC /end FUNCTION
/begin FUNCTION OVR_AndExport64 "Group /ByModelHeirarchy/Gasoline/1.Input_Processing/Digital Inputs/OVR_AndExport6" /begin LOC_MEASUREMENT DIN_b_CamPhaseValid /end LOC_MEASUREMENT /begin REF_CHARACTERISTIC DINc_b_CamPhaseValid DINc_o_CamPhaseValid /end REF_CHARACTERISTIC /end FUNCTION
/begin FUNCTION OVR_AndExport73 "Group /ByModelHeirarchy/Gasoline/1.Input_Processing/Digital Inputs/OVR_AndExport7" /begin LOC_MEASUREMENT DIN_NU_Gear /end LOC_MEASUREMENT /begin REF_CHARACTERISTIC DINc_NU_Gear DINc_o_Gear /end REF_CHARACTERISTIC /end FUNCTION
/begin FUNCTION OVR_AndExport82 "Group /ByModelHeirarchy/Gasoline/1.Input_Processing/Digital Inputs/OVR_AndExport8" /begin LOC_MEASUREMENT DIN_b_EngSync /end LOC_MEASUREMENT /begin REF_CHARACTERISTIC DINc_b_EngSync DINc_o_EngSync /end REF_CHARACTERISTIC /end FUNCTION
/begin FUNCTION OVR_AndExport91 "Group /ByModelHeirarchy/Gasoline/1.Input_Processing/Digital Inputs/OVR_AndExport9" /begin LOC_MEASUREMENT DIN_pct_AltLoad /end LOC_MEASUREMENT /begin REF_CHARACTERISTIC DINc_o_AltLoad DINc_pct_AltLoad /end REF_CHARACTERISTIC /end FUNCTION
/begin FUNCTION OVR_AndExport18 "Group /ByModelHeirarchy/Gasoline/1.Input_Processing/Digital Inputs/OilPress/OVR_AndExport1" /begin LOC_MEASUREMENT DTC_b_OIL_LPress /end LOC_MEASUREMENT /begin REF_CHARACTERISTIC DTCc_b_OIL_LPress DTCc_o_OIL_LPress /end REF_CHARACTERISTIC /end FUNCTION
/begin FUNCTION OVR_AndExport19 "Group /ByModelHeirarchy/Gasoline/1.Input_Processing/Digital Inputs/OilPress/OVR_AndExport2" /begin LOC_MEASUREMENT DTC_b_OIL_Sensor /end LOC_MEASUREMENT /begin REF_CHARACTERISTIC DTCc_b_OIL_Sensor DTCc_o_OIL_Sensor /end REF_CHARACTERISTIC /end FUNCTION
/begin FUNCTION OVR_AndExport315 "Group /ByModelHeirarchy/Gasoline/1.Input_Processing/Digital Inputs/OilPress/OVR_AndExport34" /begin LOC_MEASUREMENT DTC_b_OIL_SensorOL /end LOC_MEASUREMENT /begin REF_CHARACTERISTIC DTCc_b_OIL_SensorOL DTCc_o_OIL_SensorOL /end REF_CHARACTERISTIC /end FUNCTION
/begin FUNCTION OilPress "Group /ByModelHeirarchy/Gasoline/1.Input_Processing/Digital Inputs/OilPress" /begin SUB_FUNCTION OVR_AndExport18 OVR_AndExport19 OVR_AndExport315 /end SUB_FUNCTION
 /begin REF_CHARACTERISTIC AINc_Hz_eng_oil_pres_dat_l3_FR AINc_Hz_eng_oil_pres_dat_l3_RR AINc_Hz_eng_oil_pres_oc_FR AINc_Hz_eng_oil_pres_oc_RR /end REF_CHARACTERISTIC
/end FUNCTION
/begin FUNCTION Digital_Inputs "Group /ByModelHeirarchy/Gasoline/1.Input_Processing/Digital Inputs"
 /begin SUB_FUNCTION AltLoad CAM___CRANshaft_DTCs EngSpd EngSync IntakeCam MAF OVR_AndExport15 OVR_AndExport102 OVR_AndExport113 OVR_AndExport121 OVR_AndExport131 OVR_AndExport141 OVR_AndExport151 OVR_AndExport161 OVR_AndExport171 OVR_AndExport181 OVR_AndExport191 OVR_AndExport16 OVR_AndExport17 OVR_AndExport47 OVR_AndExport57 OVR_AndExport64 OVR_AndExport73 OVR_AndExport82 OVR_AndExport91 OilPress /end SUB_FUNCTION
 /begin LOC_MEASUREMENT DIN_e_CurrentCyl SYS_b_CrankAngValid SYS_deg_CrankAng /end LOC_MEASUREMENT
/end FUNCTION
/begin FUNCTION Horometer1 "Group /ByModelHeirarchy/Gasoline/1.Input_Processing/Horometer1" /begin LOC_MEASUREMENT NVM_NU_EngRunTime /end LOC_MEASUREMENT
 /begin REF_CHARACTERISTIC NVMc_NU_EngineRuntimeDflt NVMc_b_ResetDataCollected NVMca_NU_EngineRuntimeDflt /end REF_CHARACTERISTIC
/end FUNCTION
/begin FUNCTION Gear_ratio_estimation "Group /ByModelHeirarchy/Gasoline/1.Input_Processing/Input Arbitration/Gear ratio estimation" /begin LOC_MEASUREMENT INP_pct_EstimatedGearRatio /end LOC_MEASUREMENT
 /begin REF_CHARACTERISTIC INPc_pct_NeutralRatioHigh INPc_pct_NeutralRatioLow INPv_pct_GearRatios /end REF_CHARACTERISTIC
/end FUNCTION
/begin FUNCTION OVR_AndExport20 "Group /ByModelHeirarchy/Gasoline/1.Input_Processing/Input Arbitration/OVR_AndExport1" /begin LOC_MEASUREMENT INP_gps_MAF /end LOC_MEASUREMENT /begin REF_CHARACTERISTIC INPc_gps_MAF INPc_o_MAF /end REF_CHARACTERISTIC /end FUNCTION
/begin FUNCTION OVR_AndExport103 "Group /ByModelHeirarchy/Gasoline/1.Input_Processing/Input Arbitration/OVR_AndExport10" /begin LOC_MEASUREMENT INP_V_EGO11 /end LOC_MEASUREMENT /begin REF_CHARACTERISTIC INPc_V_EGO11 INPc_o_EGO11 /end REF_CHARACTERISTIC /end FUNCTION
/begin FUNCTION OVR_AndExport114 "Group /ByModelHeirarchy/Gasoline/1.Input_Processing/Input Arbitration/OVR_AndExport11" /begin LOC_MEASUREMENT INP_V_VBatt /end LOC_MEASUREMENT /begin REF_CHARACTERISTIC INPc_V_VBatt INPc_o_VBatt /end REF_CHARACTERISTIC /end FUNCTION
/begin FUNCTION OVR_AndExport122 "Group /ByModelHeirarchy/Gasoline/1.Input_Processing/Input Arbitration/OVR_AndExport12" /begin LOC_MEASUREMENT INP_NU_APP1_Raw /end LOC_MEASUREMENT /begin REF_CHARACTERISTIC INPc_NU_APP1_Raw INPc_o_APP1_Raw /end REF_CHARACTERISTIC /end FUNCTION
/begin FUNCTION OVR_AndExport132 "Group /ByModelHeirarchy/Gasoline/1.Input_Processing/Input Arbitration/OVR_AndExport13" /begin LOC_MEASUREMENT INP_NU_APP2_Raw /end LOC_MEASUREMENT /begin REF_CHARACTERISTIC INPc_NU_APP2_Raw INPc_o_APP2_Raw /end REF_CHARACTERISTIC /end FUNCTION
/begin FUNCTION OVR_AndExport142 "Group /ByModelHeirarchy/Gasoline/1.Input_Processing/Input Arbitration/OVR_AndExport14" /begin LOC_MEASUREMENT INP_NU_TP2_Raw /end LOC_MEASUREMENT /begin REF_CHARACTERISTIC INPc_NU_TP2_Raw INPc_o_TP2_Raw /end REF_CHARACTERISTIC /end FUNCTION
/begin FUNCTION OVR_AndExport152 "Group /ByModelHeirarchy/Gasoline/1.Input_Processing/Input Arbitration/OVR_AndExport15" /begin LOC_MEASUREMENT INP_pct_Cylinder2_Knock /end LOC_MEASUREMENT /begin REF_CHARACTERISTIC INPc_o_Cylinder2_Knock INPc_pct_Cylinder2_Knock /end REF_CHARACTERISTIC /end FUNCTION
/begin FUNCTION OVR_AndExport162 "Group /ByModelHeirarchy/Gasoline/1.Input_Processing/Input Arbitration/OVR_AndExport16" /begin LOC_MEASUREMENT INP_pct_Cylinder3_Knock /end LOC_MEASUREMENT /begin REF_CHARACTERISTIC INPc_o_Cylinder3_Knock INPc_pct_Cylinder3_Knock /end REF_CHARACTERISTIC /end FUNCTION
/begin FUNCTION OVR_AndExport172 "Group /ByModelHeirarchy/Gasoline/1.Input_Processing/Input Arbitration/OVR_AndExport17" /begin LOC_MEASUREMENT INP_pct_Cylinder4_Knock /end LOC_MEASUREMENT /begin REF_CHARACTERISTIC INPc_o_Cylinder4_Knock INPc_pct_Cylinder4_Knock /end REF_CHARACTERISTIC /end FUNCTION
/begin FUNCTION OVR_AndExport182 "Group /ByModelHeirarchy/Gasoline/1.Input_Processing/Input Arbitration/OVR_AndExport18" /begin LOC_MEASUREMENT INP_V_EGO21 /end LOC_MEASUREMENT /begin REF_CHARACTERISTIC INPc_V_EGO21 INPc_o_EGO21 /end REF_CHARACTERISTIC /end FUNCTION
/begin FUNCTION OVR_AndExport192 "Group /ByModelHeirarchy/Gasoline/1.Input_Processing/Input Arbitration/OVR_AndExport19" /begin LOC_MEASUREMENT INP_kPa_OilPress /end LOC_MEASUREMENT /begin REF_CHARACTERISTIC INPc_kPa_OilPress INPc_o_OilPress /end REF_CHARACTERISTIC /end FUNCTION
/begin FUNCTION OVR_AndExport21 "Group /ByModelHeirarchy/Gasoline/1.Input_Processing/Input Arbitration/OVR_AndExport2" /begin LOC_MEASUREMENT INP_bar_FuelPress /end LOC_MEASUREMENT /begin REF_CHARACTERISTIC INPc_bar_FuelPress INPc_o_FuelPress /end REF_CHARACTERISTIC /end FUNCTION
/begin FUNCTION OVR_AndExport201 "Group /ByModelHeirarchy/Gasoline/1.Input_Processing/Input Arbitration/OVR_AndExport20" /begin LOC_MEASUREMENT INP_C_AmbientTemp /end LOC_MEASUREMENT /begin REF_CHARACTERISTIC INPc_C_AmbientTemp INPc_o_AmbientTemp /end REF_CHARACTERISTIC /end FUNCTION
/begin FUNCTION OVR_AndExport211 "Group /ByModelHeirarchy/Gasoline/1.Input_Processing/Input Arbitration/OVR_AndExport21" /begin LOC_MEASUREMENT INP_kPa_CompOutPress /end LOC_MEASUREMENT /begin REF_CHARACTERISTIC INPc_kPa_CompOutPress INPc_o_CompOutPress /end REF_CHARACTERISTIC /end FUNCTION
/begin FUNCTION OVR_AndExport221 "Group /ByModelHeirarchy/Gasoline/1.Input_Processing/Input Arbitration/OVR_AndExport22" /begin LOC_MEASUREMENT INP_kPa_Baro /end LOC_MEASUREMENT /begin REF_CHARACTERISTIC INPc_kPa_Baro INPc_o_Baro /end REF_CHARACTERISTIC /end FUNCTION
/begin FUNCTION OVR_AndExport23 "Group /ByModelHeirarchy/Gasoline/1.Input_Processing/Input Arbitration/OVR_AndExport23" /begin LOC_MEASUREMENT INP_ret_VCP_Pos /end LOC_MEASUREMENT /begin REF_CHARACTERISTIC INPc_o_VCP_Pos INPc_ret_VCP_Pos /end REF_CHARACTERISTIC /end FUNCTION
/begin FUNCTION OVR_AndExport241 "Group /ByModelHeirarchy/Gasoline/1.Input_Processing/Input Arbitration/OVR_AndExport24" /begin LOC_MEASUREMENT INP_C_CompOutTemp /end LOC_MEASUREMENT /begin REF_CHARACTERISTIC INPc_C_CompOutTemp INPc_o_CompOutTemp /end REF_CHARACTERISTIC /end FUNCTION
/begin FUNCTION OVR_AndExport251 "Group /ByModelHeirarchy/Gasoline/1.Input_Processing/Input Arbitration/OVR_AndExport25" /begin LOC_MEASUREMENT INP_C_ExhaustTemp /end LOC_MEASUREMENT /begin REF_CHARACTERISTIC INPc_C_ExhaustTemp INPc_o_ExhaustTemp /end REF_CHARACTERISTIC /end FUNCTION
/begin FUNCTION OVR_AndExport26 "Group /ByModelHeirarchy/Gasoline/1.Input_Processing/Input Arbitration/OVR_AndExport26" /begin LOC_MEASUREMENT INP_b_EngSync /end LOC_MEASUREMENT /begin REF_CHARACTERISTIC INPc_b_EngSync INPc_o_EngSync /end REF_CHARACTERISTIC /end FUNCTION
/begin FUNCTION OVR_AndExport27 "Group /ByModelHeirarchy/Gasoline/1.Input_Processing/Input Arbitration/OVR_AndExport27" /begin LOC_MEASUREMENT INP_pct_AltLoad /end LOC_MEASUREMENT /begin REF_CHARACTERISTIC INPc_o_AltLoad INPc_pct_AltLoad /end REF_CHARACTERISTIC /end FUNCTION
/begin FUNCTION OVR_AndExport281 "Group /ByModelHeirarchy/Gasoline/1.Input_Processing/Input Arbitration/OVR_AndExport28" /begin LOC_MEASUREMENT INP_kph_VehSpd /end LOC_MEASUREMENT /begin REF_CHARACTERISTIC INPc_kph_VehSpd INPc_o_VehSpd /end REF_CHARACTERISTIC /end FUNCTION
/begin FUNCTION OVR_AndExport291 "Group /ByModelHeirarchy/Gasoline/1.Input_Processing/Input Arbitration/OVR_AndExport29" /begin LOC_MEASUREMENT INP_b_OilPrSw /end LOC_MEASUREMENT /begin REF_CHARACTERISTIC INPc_b_OilPrSw INPc_o_OilPrSw /end REF_CHARACTERISTIC /end FUNCTION
/begin FUNCTION OVR_AndExport22 "Group /ByModelHeirarchy/Gasoline/1.Input_Processing/Input Arbitration/OVR_AndExport3" /begin LOC_MEASUREMENT INP_RPM_EngSpd /end LOC_MEASUREMENT /begin REF_CHARACTERISTIC INPc_RPM_EngSpd INPc_o_EngSpd /end REF_CHARACTERISTIC /end FUNCTION
/begin FUNCTION OVR_AndExport301 "Group /ByModelHeirarchy/Gasoline/1.Input_Processing/Input Arbitration/OVR_AndExport30" /begin LOC_MEASUREMENT INP_b_AC_PressSw /end LOC_MEASUREMENT /begin REF_CHARACTERISTIC INPc_b_AC_PressSw INPc_o_AC_PressSw /end REF_CHARACTERISTIC /end FUNCTION
/begin FUNCTION OVR_AndExport311 "Group /ByModelHeirarchy/Gasoline/1.Input_Processing/Input Arbitration/OVR_AndExport31" /begin LOC_MEASUREMENT INP_b_AC_Rqst /end LOC_MEASUREMENT /begin REF_CHARACTERISTIC INPc_b_AC_Rqst INPc_o_AC_Rqst /end REF_CHARACTERISTIC /end FUNCTION
/begin FUNCTION OVR_AndExport321 "Group /ByModelHeirarchy/Gasoline/1.Input_Processing/Input Arbitration/OVR_AndExport32" /begin LOC_MEASUREMENT INP_C_OilTemp /end LOC_MEASUREMENT /begin REF_CHARACTERISTIC INPc_C_OilTemp INPc_o_OilTemp /end REF_CHARACTERISTIC /end FUNCTION
/begin FUNCTION OVR_AndExport331 "Group /ByModelHeirarchy/Gasoline/1.Input_Processing/Input Arbitration/OVR_AndExport33" /begin LOC_MEASUREMENT INP_e_TransGear /end LOC_MEASUREMENT /begin REF_CHARACTERISTIC INPc_e_TransGear INPc_o_TransGear /end REF_CHARACTERISTIC /end FUNCTION
/begin FUNCTION OVR_AndExport381 "Group /ByModelHeirarchy/Gasoline/1.Input_Processing/Input Arbitration/OVR_AndExport38" /begin LOC_MEASUREMENT INP_lam_UEGO1 /end LOC_MEASUREMENT /begin REF_CHARACTERISTIC INPc_lam_UEGO1 INPc_o_UEGO1 /end REF_CHARACTERISTIC /end FUNCTION
/begin FUNCTION OVR_AndExport391 "Group /ByModelHeirarchy/Gasoline/1.Input_Processing/Input Arbitration/OVR_AndExport39" /begin LOC_MEASUREMENT INP_lam_UEGO2 /end LOC_MEASUREMENT /begin REF_CHARACTERISTIC INPc_lam_UEGO2 INPc_o_UEGO2 /end REF_CHARACTERISTIC /end FUNCTION
/begin FUNCTION OVR_AndExport48 "Group /ByModelHeirarchy/Gasoline/1.Input_Processing/Input Arbitration/OVR_AndExport4" /begin LOC_MEASUREMENT INP_kPa_MAP /end LOC_MEASUREMENT /begin REF_CHARACTERISTIC INPc_kPa_MAP INPc_o_MAP /end REF_CHARACTERISTIC /end FUNCTION
/begin FUNCTION OVR_AndExport40 "Group /ByModelHeirarchy/Gasoline/1.Input_Processing/Input Arbitration/OVR_AndExport40" /begin LOC_MEASUREMENT INP_C_FuelTemp /end LOC_MEASUREMENT /begin REF_CHARACTERISTIC INPc_C_FuelTemp INPc_o_FuelTemp /end REF_CHARACTERISTIC /end FUNCTION
/begin FUNCTION OVR_AndExport58 "Group /ByModelHeirarchy/Gasoline/1.Input_Processing/Input Arbitration/OVR_AndExport5" /begin LOC_MEASUREMENT INP_pct_Cylinder1_Knock /end LOC_MEASUREMENT /begin REF_CHARACTERISTIC INPc_o_Cylinder1_Knock INPc_pct_Cylinder1_Knock /end REF_CHARACTERISTIC /end FUNCTION
/begin FUNCTION OVR_AndExport65 "Group /ByModelHeirarchy/Gasoline/1.Input_Processing/Input Arbitration/OVR_AndExport6" /begin LOC_MEASUREMENT INP_C_ManifoldTemp /end LOC_MEASUREMENT /begin REF_CHARACTERISTIC INPc_C_ManifoldTemp INPc_o_ManifoldTemp /end REF_CHARACTERISTIC /end FUNCTION
/begin FUNCTION OVR_AndExport74 "Group /ByModelHeirarchy/Gasoline/1.Input_Processing/Input Arbitration/OVR_AndExport7" /begin LOC_MEASUREMENT INP_b_Ign /end LOC_MEASUREMENT /begin REF_CHARACTERISTIC INPc_b_Ign INPc_o_Ign /end REF_CHARACTERISTIC /end FUNCTION
/begin FUNCTION OVR_AndExport83 "Group /ByModelHeirarchy/Gasoline/1.Input_Processing/Input Arbitration/OVR_AndExport8" /begin LOC_MEASUREMENT INP_C_CoolantTemp /end LOC_MEASUREMENT /begin REF_CHARACTERISTIC INPc_C_CoolantTemp INPc_o_CoolantTemp /end REF_CHARACTERISTIC /end FUNCTION
/begin FUNCTION OVR_AndExport92 "Group /ByModelHeirarchy/Gasoline/1.Input_Processing/Input Arbitration/OVR_AndExport9" /begin LOC_MEASUREMENT INP_NU_TP1_Raw /end LOC_MEASUREMENT /begin REF_CHARACTERISTIC INPc_NU_TP1_Raw INPc_o_TP1_Raw /end REF_CHARACTERISTIC /end FUNCTION
/begin FUNCTION Input_Arbitration "Group /ByModelHeirarchy/Gasoline/1.Input_Processing/Input Arbitration"
 /begin SUB_FUNCTION Gear_ratio_estimation OVR_AndExport20 OVR_AndExport103 OVR_AndExport114 OVR_AndExport122 OVR_AndExport132 OVR_AndExport142 OVR_AndExport152 OVR_AndExport162 OVR_AndExport172 OVR_AndExport182 OVR_AndExport192 OVR_AndExport21 OVR_AndExport201 OVR_AndExport211 OVR_AndExport221 OVR_AndExport23 OVR_AndExport241 OVR_AndExport251 OVR_AndExport26 OVR_AndExport27 OVR_AndExport281 OVR_AndExport291 OVR_AndExport22 OVR_AndExport301 OVR_AndExport311 OVR_AndExport321 OVR_AndExport331 OVR_AndExport381 OVR_AndExport391 OVR_AndExport48 OVR_AndExport40 OVR_AndExport58 OVR_AndExport65 OVR_AndExport74 OVR_AndExport83 OVR_AndExport92 /end SUB_FUNCTION
 /begin REF_CHARACTERISTIC AINc_b_RealGear /end REF_CHARACTERISTIC
/end FUNCTION
/begin FUNCTION Misfire_Thres_Map2 "Group /ByModelHeirarchy/Gasoline/1.Input_Processing/Misfire_Thres_Map2"
 /begin REF_CHARACTERISTIC DTCm_NU_TherMisfire_x DTCm_NU_TherMisfire_y DTCm_NU_TherMisfire_z /end REF_CHARACTERISTIC
/end FUNCTION
/begin FUNCTION OVR_AndExport23 "Group /ByModelHeirarchy/Gasoline/1.Input_Processing/Monitors/BankA injector faults/Z18 faults/OVR_AndExport1" /begin LOC_MEASUREMENT DTC_b_1_boostOC /end LOC_MEASUREMENT /begin REF_CHARACTERISTIC DTCc_b_1_boostOC DTCc_o_1_boostOC /end REF_CHARACTERISTIC /end FUNCTION
/begin FUNCTION OVR_AndExport316 "Group /ByModelHeirarchy/Gasoline/1.Input_Processing/Monitors/BankA injector faults/Z18 faults/OVR_AndExport34" /begin LOC_MEASUREMENT DTC_b_1_lsol /end LOC_MEASUREMENT /begin REF_CHARACTERISTIC DTCc_b_1_lsol DTCc_o_1_lsol /end REF_CHARACTERISTIC /end FUNCTION
/begin FUNCTION OVR_AndExport59 "Group /ByModelHeirarchy/Gasoline/1.Input_Processing/Monitors/BankA injector faults/Z18 faults/OVR_AndExport5" /begin LOC_MEASUREMENT DTC_b_1_sg /end LOC_MEASUREMENT /begin REF_CHARACTERISTIC DTCc_b_1_sg DTCc_o_1_sg /end REF_CHARACTERISTIC /end FUNCTION
/begin FUNCTION OVR_AndExport66 "Group /ByModelHeirarchy/Gasoline/1.Input_Processing/Monitors/BankA injector faults/Z18 faults/OVR_AndExport6" /begin LOC_MEASUREMENT DTC_b_1_sb /end LOC_MEASUREMENT /begin REF_CHARACTERISTIC DTCc_b_1_sb DTCc_o_1_sb /end REF_CHARACTERISTIC /end FUNCTION
/begin FUNCTION Z18_faults "Group /ByModelHeirarchy/Gasoline/1.Input_Processing/Monitors/BankA injector faults/Z18 faults"
 /begin SUB_FUNCTION OVR_AndExport23 OVR_AndExport316 OVR_AndExport59 OVR_AndExport66 /end SUB_FUNCTION
 /begin REF_CHARACTERISTIC AINc_s_cyl_inj_RDT AINc_s_cyl_inj_SDT /end REF_CHARACTERISTIC
/end FUNCTION
/begin FUNCTION OVR_AndExport24 "Group /ByModelHeirarchy/Gasoline/1.Input_Processing/Monitors/BankA injector faults/Z29 faults/OVR_AndExport1" /begin LOC_MEASUREMENT DTC_b_2_boostOC /end LOC_MEASUREMENT /begin REF_CHARACTERISTIC DTCc_b_2_boostOC DTCc_o_2_boostOC /end REF_CHARACTERISTIC /end FUNCTION
/begin FUNCTION OVR_AndExport123 "Group /ByModelHeirarchy/Gasoline/1.Input_Processing/Monitors/BankA injector faults/Z29 faults/OVR_AndExport12" /begin LOC_MEASUREMENT DTC_b_2_sb /end LOC_MEASUREMENT /begin REF_CHARACTERISTIC DTCc_b_2_sb DTCc_o_2_sb /end REF_CHARACTERISTIC /end FUNCTION
/begin FUNCTION OVR_AndExport25 "Group /ByModelHeirarchy/Gasoline/1.Input_Processing/Monitors/BankA injector faults/Z29 faults/OVR_AndExport2" /begin LOC_MEASUREMENT DTC_b_2_lsol /end LOC_MEASUREMENT /begin REF_CHARACTERISTIC DTCc_b_2_lsol DTCc_o_2_lsol /end REF_CHARACTERISTIC /end FUNCTION
/begin FUNCTION OVR_AndExport93 "Group /ByModelHeirarchy/Gasoline/1.Input_Processing/Monitors/BankA injector faults/Z29 faults/OVR_AndExport9" /begin LOC_MEASUREMENT DTC_b_2_sg /end LOC_MEASUREMENT /begin REF_CHARACTERISTIC DTCc_b_2_sg DTCc_o_2_sg /end REF_CHARACTERISTIC /end FUNCTION
/begin FUNCTION Z29_faults "Group /ByModelHeirarchy/Gasoline/1.Input_Processing/Monitors/BankA injector faults/Z29 faults"
 /begin SUB_FUNCTION OVR_AndExport24 OVR_AndExport123 OVR_AndExport25 OVR_AndExport93 /end SUB_FUNCTION
 /begin REF_CHARACTERISTIC AINc_s_cyl_inj_RDT AINc_s_cyl_inj_SDT /end REF_CHARACTERISTIC
/end FUNCTION
/begin FUNCTION OVR_AndExport26 "Group /ByModelHeirarchy/Gasoline/1.Input_Processing/Monitors/BankA injector faults/Z30 faults/OVR_AndExport1" /begin LOC_MEASUREMENT DTC_b_4_lsol /end LOC_MEASUREMENT /begin REF_CHARACTERISTIC DTCc_b_4_lsol DTCc_o_4_lsol /end REF_CHARACTERISTIC /end FUNCTION
/begin FUNCTION OVR_AndExport115 "Group /ByModelHeirarchy/Gasoline/1.Input_Processing/Monitors/BankA injector faults/Z30 faults/OVR_AndExport11" /begin LOC_MEASUREMENT DTC_b_4_sb /end LOC_MEASUREMENT /begin REF_CHARACTERISTIC DTCc_b_4_sb DTCc_o_4_sb /end REF_CHARACTERISTIC /end FUNCTION
/begin FUNCTION OVR_AndExport27 "Group /ByModelHeirarchy/Gasoline/1.Input_Processing/Monitors/BankA injector faults/Z30 faults/OVR_AndExport2" /begin LOC_MEASUREMENT DTC_b_4_boostOC /end LOC_MEASUREMENT /begin REF_CHARACTERISTIC DTCc_b_4_boostOC DTCc_o_4_boostOC /end REF_CHARACTERISTIC /end FUNCTION
/begin FUNCTION OVR_AndExport75 "Group /ByModelHeirarchy/Gasoline/1.Input_Processing/Monitors/BankA injector faults/Z30 faults/OVR_AndExport7" /begin LOC_MEASUREMENT DTC_b_4_sg /end LOC_MEASUREMENT /begin REF_CHARACTERISTIC DTCc_b_4_sg DTCc_o_4_sg /end REF_CHARACTERISTIC /end FUNCTION
/begin FUNCTION Z30_faults "Group /ByModelHeirarchy/Gasoline/1.Input_Processing/Monitors/BankA injector faults/Z30 faults"
 /begin SUB_FUNCTION OVR_AndExport26 OVR_AndExport115 OVR_AndExport27 OVR_AndExport75 /end SUB_FUNCTION
 /begin REF_CHARACTERISTIC AINc_s_cyl_inj_RDT AINc_s_cyl_inj_SDT /end REF_CHARACTERISTIC
/end FUNCTION
/begin FUNCTION OVR_AndExport28 "Group /ByModelHeirarchy/Gasoline/1.Input_Processing/Monitors/BankA injector faults/Z41 faults/OVR_AndExport1" /begin LOC_MEASUREMENT DTC_b_3_boostOC /end LOC_MEASUREMENT /begin REF_CHARACTERISTIC DTCc_b_3_boostOC DTCc_o_3_boostOC /end REF_CHARACTERISTIC /end FUNCTION
/begin FUNCTION OVR_AndExport193 "Group /ByModelHeirarchy/Gasoline/1.Input_Processing/Monitors/BankA injector faults/Z41 faults/OVR_AndExport19" /begin LOC_MEASUREMENT DTC_b_3_lsol /end LOC_MEASUREMENT /begin REF_CHARACTERISTIC DTCc_b_3_lsol DTCc_o_3_lsol /end REF_CHARACTERISTIC /end FUNCTION
/begin FUNCTION OVR_AndExport202 "Group /ByModelHeirarchy/Gasoline/1.Input_Processing/Monitors/BankA injector faults/Z41 faults/OVR_AndExport20" /begin LOC_MEASUREMENT DTC_b_3_sg /end LOC_MEASUREMENT /begin REF_CHARACTERISTIC DTCc_b_3_sg DTCc_o_3_sg /end REF_CHARACTERISTIC /end FUNCTION
/begin FUNCTION OVR_AndExport212 "Group /ByModelHeirarchy/Gasoline/1.Input_Processing/Monitors/BankA injector faults/Z41 faults/OVR_AndExport21" /begin LOC_MEASUREMENT DTC_b_3_sb /end LOC_MEASUREMENT /begin REF_CHARACTERISTIC DTCc_b_3_sb DTCc_o_3_sb /end REF_CHARACTERISTIC /end FUNCTION
/begin FUNCTION Z41_faults "Group /ByModelHeirarchy/Gasoline/1.Input_Processing/Monitors/BankA injector faults/Z41 faults"
 /begin SUB_FUNCTION OVR_AndExport28 OVR_AndExport193 OVR_AndExport202 OVR_AndExport212 /end SUB_FUNCTION
 /begin REF_CHARACTERISTIC AINc_s_cyl_inj_RDT AINc_s_cyl_inj_SDT /end REF_CHARACTERISTIC
/end FUNCTION
/end MODULE
/end PROJECT
