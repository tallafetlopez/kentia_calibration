ASAP2_VERSION 1 31
/begin PROJECT M670_Engine_Control_1.2.0_M670_000 "BeGas B430LG Turbocharged engine"
/begin HEADER "Begas Motor 2017-2022 (c)" VERSION "1_2_0" /end HEADER
/begin MODULE OpenECU_M670_000 ""
/* Scalar measurable for DDE 'AIN_V_AmbientTemp'. */
/begin MEASUREMENT AIN_V_AmbientTemp "Analog input value" FLOAT32_IEEE CU_AIN_V_AMBIENTTEMP 1 100 0.0 0.0 ECU_ADDRESS 0x40003968 BYTE_ORDER MSB_FIRST /end MEASUREMENT
/begin COMPU_METHOD CU_AIN_V_AMBIENTTEMP "Conversion method for AIN_V_AmbientTemp" RAT_FUNC "%10.3" "V" COEFFS 0.000000 1.000000 0.000000 0.000000 0.000000 1.000000 /end COMPU_METHOD
/* Scalar measurable for DDE 'AIN_V_Baro'. */
/begin MEASUREMENT AIN_V_Baro "Analog input value" FLOAT32_IEEE CU_AIN_V_BARO 1 100 0.0 0.0 ECU_ADDRESS 0x40003920 BYTE_ORDER MSB_FIRST /end MEASUREMENT
/begin COMPU_METHOD CU_AIN_V_BARO "Conversion method for AIN_V_Baro" RAT_FUNC "%10.3" "V" COEFFS 0.000000 1.000000 0.000000 0.000000 0.000000 1.000000 /end COMPU_METHOD
/* Scalar measurable for DDE 'AIN_V_CoolantTemp'. */
/begin MEASUREMENT AIN_V_CoolantTemp "Analog input value" FLOAT32_IEEE CU_AIN_V_COOLANTTEMP 1 100 0.0 0.0 ECU_ADDRESS 0x400038f8 BYTE_ORDER MSB_FIRST /end MEASUREMENT
/begin COMPU_METHOD CU_AIN_V_COOLANTTEMP "Conversion method for AIN_V_CoolantTemp" RAT_FUNC "%10.3" "V" COEFFS 0.000000 1.000000 0.000000 0.000000 0.000000 1.000000 /end COMPU_METHOD
/* Scalar measurable for DDE 'AIN_V_EGT'. */
/begin MEASUREMENT AIN_V_EGT "Analog input value" FLOAT32_IEEE CU_AIN_V_EGT 1 100 0.0 5.0 ECU_ADDRESS 0x400038f4 BYTE_ORDER MSB_FIRST /end MEASUREMENT
/begin COMPU_METHOD CU_AIN_V_EGT "Conversion method for AIN_V_EGT" RAT_FUNC "%10.3" "V" COEFFS 0.000000 1.000000 0.000000 0.000000 0.000000 1.000000 /end COMPU_METHOD
/* Scalar measurable for DDE 'AIN_V_FAPRaw'. */
/begin MEASUREMENT AIN_V_FAPRaw "Displayable" FLOAT32_IEEE CU_AIN_V_FAPRAW 1 100 0.0 5.0 ECU_ADDRESS 0x400038f0 BYTE_ORDER MSB_FIRST /end MEASUREMENT
/begin COMPU_METHOD CU_AIN_V_FAPRAW "Conversion method for AIN_V_FAPRaw" RAT_FUNC "%10.3" "V" COEFFS 0.000000 1.000000 0.000000 0.000000 0.000000 1.000000 /end COMPU_METHOD
/* Scalar measurable for DDE 'AIN_V_FuelPressRaw'. */
/begin MEASUREMENT AIN_V_FuelPressRaw "Analog input value" FLOAT32_IEEE CU_AIN_V_FUELPRESSRAW 1 100 0.0 5.0 ECU_ADDRESS 0x400038ec BYTE_ORDER MSB_FIRST /end MEASUREMENT
/begin COMPU_METHOD CU_AIN_V_FUELPRESSRAW "Conversion method for AIN_V_FuelPressRaw" RAT_FUNC "%10.3" "V" COEFFS 0.000000 1.000000 0.000000 0.000000 0.000000 1.000000 /end COMPU_METHOD
/* Scalar measurable for DDE 'AIN_V_FuelTempRaw'. */
/begin MEASUREMENT AIN_V_FuelTempRaw "Analog input value" FLOAT32_IEEE CU_AIN_V_FUELTEMPRAW 1 100 0.0 0.0 ECU_ADDRESS 0x400038e8 BYTE_ORDER MSB_FIRST /end MEASUREMENT
/begin COMPU_METHOD CU_AIN_V_FUELTEMPRAW "Conversion method for AIN_V_FuelTempRaw" RAT_FUNC "%10.3" "V" COEFFS 0.000000 1.000000 0.000000 0.000000 0.000000 1.000000 /end COMPU_METHOD
/* Scalar measurable for DDE 'AIN_V_MAP_Raw'. */
/begin MEASUREMENT AIN_V_MAP_Raw "Raw value" FLOAT32_IEEE CU_AIN_V_MAP_RAW 1 100 0.0 0.0 ECU_ADDRESS 0x40003924 BYTE_ORDER MSB_FIRST /end MEASUREMENT
/begin COMPU_METHOD CU_AIN_V_MAP_RAW "Conversion method for AIN_V_MAP_Raw" RAT_FUNC "%10.3" "V" COEFFS 0.000000 1.000000 0.000000 0.000000 0.000000 1.000000 /end COMPU_METHOD
/* Scalar measurable for DDE 'AIN_V_MAP_Sample1'. */
/begin MEASUREMENT AIN_V_MAP_Sample1 "Raw value sampled in angular domain" FLOAT32_IEEE CU_AIN_V_MAP_SAMPLE1 1 100 0.0 0.0 ECU_ADDRESS 0x40003964 BYTE_ORDER MSB_FIRST /end MEASUREMENT
/begin COMPU_METHOD CU_AIN_V_MAP_SAMPLE1 "Conversion method for AIN_V_MAP_Sample1" RAT_FUNC "%10.3" "V" COEFFS 0.000000 1.000000 0.000000 0.000000 0.000000 1.000000 /end COMPU_METHOD
/* Scalar measurable for DDE 'AIN_V_MAP_Sample10'. */
/begin MEASUREMENT AIN_V_MAP_Sample10 "Raw value sampled in angular domain" FLOAT32_IEEE CU_AIN_V_MAP_SAMPLE10 1 100 0.0 0.0 ECU_ADDRESS 0x40003928 BYTE_ORDER MSB_FIRST /end MEASUREMENT
/begin COMPU_METHOD CU_AIN_V_MAP_SAMPLE10 "Conversion method for AIN_V_MAP_Sample10" RAT_FUNC "%10.3" "V" COEFFS 0.000000 1.000000 0.000000 0.000000 0.000000 1.000000 /end COMPU_METHOD
/* Scalar measurable for DDE 'AIN_V_MAP_Sample11'. */
/begin MEASUREMENT AIN_V_MAP_Sample11 "Raw value sampled in angular domain" FLOAT32_IEEE CU_AIN_V_MAP_SAMPLE11 1 100 0.0 0.0 ECU_ADDRESS 0x4000395c BYTE_ORDER MSB_FIRST /end MEASUREMENT
/begin COMPU_METHOD CU_AIN_V_MAP_SAMPLE11 "Conversion method for AIN_V_MAP_Sample11" RAT_FUNC "%10.3" "V" COEFFS 0.000000 1.000000 0.000000 0.000000 0.000000 1.000000 /end COMPU_METHOD
/* Scalar measurable for DDE 'AIN_V_MAP_Sample12'. */
/begin MEASUREMENT AIN_V_MAP_Sample12 "Raw value sampled in angular domain" FLOAT32_IEEE CU_AIN_V_MAP_SAMPLE12 1 100 0.0 0.0 ECU_ADDRESS 0x40003958 BYTE_ORDER MSB_FIRST /end MEASUREMENT
/begin COMPU_METHOD CU_AIN_V_MAP_SAMPLE12 "Conversion method for AIN_V_MAP_Sample12" RAT_FUNC "%10.3" "V" COEFFS 0.000000 1.000000 0.000000 0.000000 0.000000 1.000000 /end COMPU_METHOD
/* Scalar measurable for DDE 'AIN_V_MAP_Sample13'. */
/begin MEASUREMENT AIN_V_MAP_Sample13 "Raw value sampled in angular domain" FLOAT32_IEEE CU_AIN_V_MAP_SAMPLE13 1 100 0.0 0.0 ECU_ADDRESS 0x40003954 BYTE_ORDER MSB_FIRST /end MEASUREMENT
/begin COMPU_METHOD CU_AIN_V_MAP_SAMPLE13 "Conversion method for AIN_V_MAP_Sample13" RAT_FUNC "%10.3" "V" COEFFS 0.000000 1.000000 0.000000 0.000000 0.000000 1.000000 /end COMPU_METHOD
/* Scalar measurable for DDE 'AIN_V_MAP_Sample14'. */
/begin MEASUREMENT AIN_V_MAP_Sample14 "Raw value sampled in angular domain" FLOAT32_IEEE CU_AIN_V_MAP_SAMPLE14 1 100 0.0 0.0 ECU_ADDRESS 0x40003950 BYTE_ORDER MSB_FIRST /end MEASUREMENT
/begin COMPU_METHOD CU_AIN_V_MAP_SAMPLE14 "Conversion method for AIN_V_MAP_Sample14" RAT_FUNC "%10.3" "V" COEFFS 0.000000 1.000000 0.000000 0.000000 0.000000 1.000000 /end COMPU_METHOD
/* Scalar measurable for DDE 'AIN_V_MAP_Sample15'. */
/begin MEASUREMENT AIN_V_MAP_Sample15 "Raw value sampled in angular domain" FLOAT32_IEEE CU_AIN_V_MAP_SAMPLE15 1 100 0.0 0.0 ECU_ADDRESS 0x4000394c BYTE_ORDER MSB_FIRST /end MEASUREMENT
/begin COMPU_METHOD CU_AIN_V_MAP_SAMPLE15 "Conversion method for AIN_V_MAP_Sample15" RAT_FUNC "%10.3" "V" COEFFS 0.000000 1.000000 0.000000 0.000000 0.000000 1.000000 /end COMPU_METHOD
/* Scalar measurable for DDE 'AIN_V_MAP_Sample16'. */
/begin MEASUREMENT AIN_V_MAP_Sample16 "Raw value sampled in angular domain" FLOAT32_IEEE CU_AIN_V_MAP_SAMPLE16 1 100 0.0 0.0 ECU_ADDRESS 0x40003948 BYTE_ORDER MSB_FIRST /end MEASUREMENT
/begin COMPU_METHOD CU_AIN_V_MAP_SAMPLE16 "Conversion method for AIN_V_MAP_Sample16" RAT_FUNC "%10.3" "V" COEFFS 0.000000 1.000000 0.000000 0.000000 0.000000 1.000000 /end COMPU_METHOD
/* Scalar measurable for DDE 'AIN_V_MAP_Sample2'. */
/begin MEASUREMENT AIN_V_MAP_Sample2 "Raw value sampled in angular domain" FLOAT32_IEEE CU_AIN_V_MAP_SAMPLE2 1 100 0.0 0.0 ECU_ADDRESS 0x40003960 BYTE_ORDER MSB_FIRST /end MEASUREMENT
/begin COMPU_METHOD CU_AIN_V_MAP_SAMPLE2 "Conversion method for AIN_V_MAP_Sample2" RAT_FUNC "%10.3" "V" COEFFS 0.000000 1.000000 0.000000 0.000000 0.000000 1.000000 /end COMPU_METHOD
/* Scalar measurable for DDE 'AIN_V_MAP_Sample3'. */
/begin MEASUREMENT AIN_V_MAP_Sample3 "Raw value sampled in angular domain" FLOAT32_IEEE CU_AIN_V_MAP_SAMPLE3 1 100 0.0 0.0 ECU_ADDRESS 0x40003944 BYTE_ORDER MSB_FIRST /end MEASUREMENT
/begin COMPU_METHOD CU_AIN_V_MAP_SAMPLE3 "Conversion method for AIN_V_MAP_Sample3" RAT_FUNC "%10.3" "V" COEFFS 0.000000 1.000000 0.000000 0.000000 0.000000 1.000000 /end COMPU_METHOD
/* Scalar measurable for DDE 'AIN_V_MAP_Sample4'. */
/begin MEASUREMENT AIN_V_MAP_Sample4 "Raw value sampled in angular domain" FLOAT32_IEEE CU_AIN_V_MAP_SAMPLE4 1 100 0.0 0.0 ECU_ADDRESS 0x40003940 BYTE_ORDER MSB_FIRST /end MEASUREMENT
/begin COMPU_METHOD CU_AIN_V_MAP_SAMPLE4 "Conversion method for AIN_V_MAP_Sample4" RAT_FUNC "%10.3" "V" COEFFS 0.000000 1.000000 0.000000 0.000000 0.000000 1.000000 /end COMPU_METHOD
/* Scalar measurable for DDE 'AIN_V_MAP_Sample5'. */
/begin MEASUREMENT AIN_V_MAP_Sample5 "Raw value sampled in angular domain" FLOAT32_IEEE CU_AIN_V_MAP_SAMPLE5 1 100 0.0 0.0 ECU_ADDRESS 0x4000393c BYTE_ORDER MSB_FIRST /end MEASUREMENT
/begin COMPU_METHOD CU_AIN_V_MAP_SAMPLE5 "Conversion method for AIN_V_MAP_Sample5" RAT_FUNC "%10.3" "V" COEFFS 0.000000 1.000000 0.000000 0.000000 0.000000 1.000000 /end COMPU_METHOD
/* Scalar measurable for DDE 'AIN_V_MAP_Sample6'. */
/begin MEASUREMENT AIN_V_MAP_Sample6 "Raw value sampled in angular domain" FLOAT32_IEEE CU_AIN_V_MAP_SAMPLE6 1 100 0.0 0.0 ECU_ADDRESS 0x40003938 BYTE_ORDER MSB_FIRST /end MEASUREMENT
/begin COMPU_METHOD CU_AIN_V_MAP_SAMPLE6 "Conversion method for AIN_V_MAP_Sample6" RAT_FUNC "%10.3" "V" COEFFS 0.000000 1.000000 0.000000 0.000000 0.000000 1.000000 /end COMPU_METHOD
/* Scalar measurable for DDE 'AIN_V_MAP_Sample7'. */
/begin MEASUREMENT AIN_V_MAP_Sample7 "Raw value sampled in angular domain" FLOAT32_IEEE CU_AIN_V_MAP_SAMPLE7 1 100 0.0 0.0 ECU_ADDRESS 0x40003934 BYTE_ORDER MSB_FIRST /end MEASUREMENT
/begin COMPU_METHOD CU_AIN_V_MAP_SAMPLE7 "Conversion method for AIN_V_MAP_Sample7" RAT_FUNC "%10.3" "V" COEFFS 0.000000 1.000000 0.000000 0.000000 0.000000 1.000000 /end COMPU_METHOD
/* Scalar measurable for DDE 'AIN_V_MAP_Sample8'. */
/begin MEASUREMENT AIN_V_MAP_Sample8 "Raw value sampled in angular domain" FLOAT32_IEEE CU_AIN_V_MAP_SAMPLE8 1 100 0.0 0.0 ECU_ADDRESS 0x40003930 BYTE_ORDER MSB_FIRST /end MEASUREMENT
/begin COMPU_METHOD CU_AIN_V_MAP_SAMPLE8 "Conversion method for AIN_V_MAP_Sample8" RAT_FUNC "%10.3" "V" COEFFS 0.000000 1.000000 0.000000 0.000000 0.000000 1.000000 /end COMPU_METHOD
/* Scalar measurable for DDE 'AIN_V_MAP_Sample9'. */
/begin MEASUREMENT AIN_V_MAP_Sample9 "Raw value sampled in angular domain" FLOAT32_IEEE CU_AIN_V_MAP_SAMPLE9 1 100 0.0 0.0 ECU_ADDRESS 0x4000392c BYTE_ORDER MSB_FIRST /end MEASUREMENT
/begin COMPU_METHOD CU_AIN_V_MAP_SAMPLE9 "Conversion method for AIN_V_MAP_Sample9" RAT_FUNC "%10.3" "V" COEFFS 0.000000 1.000000 0.000000 0.000000 0.000000 1.000000 /end COMPU_METHOD
/* Scalar measurable for DDE 'AIN_V_ManifoldTemp'. */
/begin MEASUREMENT AIN_V_ManifoldTemp "Analog input value" FLOAT32_IEEE CU_AIN_V_MANIFOLDTEMP 1 100 -40.0 120.0 ECU_ADDRESS 0x400038c8 BYTE_ORDER MSB_FIRST /end MEASUREMENT
/begin COMPU_METHOD CU_AIN_V_MANIFOLDTEMP "Conversion method for AIN_V_ManifoldTemp" RAT_FUNC "%10.3" "V" COEFFS 0.000000 1.000000 0.000000 0.000000 0.000000 1.000000 /end COMPU_METHOD
/* Scalar measurable for DDE 'AIN_b_AmbientTemp_Fault'. */
/begin MEASUREMENT AIN_b_AmbientTemp_Fault "Displayable" UBYTE CU_AIN_B_AMBIENTTEMP_FAULT 1 100 0.0 1.0 ECU_ADDRESS 0x40002fcc BYTE_ORDER MSB_FIRST /end MEASUREMENT
/begin COMPU_METHOD CU_AIN_B_AMBIENTTEMP_FAULT "Conversion method for AIN_b_AmbientTemp_Fault" RAT_FUNC "%10.0" "b" COEFFS 0.000000 1.000000 0.000000 0.000000 0.000000 1.000000 /end COMPU_METHOD
/* Scalar measurable for DDE 'AIN_b_Baro_Fault'. */
/begin MEASUREMENT AIN_b_Baro_Fault "Displayable" UBYTE CU_AIN_B_BARO_FAULT 1 100 0.0 1.0 ECU_ADDRESS 0x40002fc1 BYTE_ORDER MSB_FIRST /end MEASUREMENT
/begin COMPU_METHOD CU_AIN_B_BARO_FAULT "Conversion method for AIN_b_Baro_Fault" RAT_FUNC "%10.0" "b" COEFFS 0.000000 1.000000 0.000000 0.000000 0.000000 1.000000 /end COMPU_METHOD
/* Scalar measurable for DDE 'AIN_b_CoolantTemp_Fault'. */
/begin MEASUREMENT AIN_b_CoolantTemp_Fault "Displayable" UBYTE CU_AIN_B_COOLANTTEMP_FAULT 1 100 0.0 1.0 ECU_ADDRESS 0x40002fb1 BYTE_ORDER MSB_FIRST /end MEASUREMENT
/begin COMPU_METHOD CU_AIN_B_COOLANTTEMP_FAULT "Conversion method for AIN_b_CoolantTemp_Fault" RAT_FUNC "%10.0" "b" COEFFS 0.000000 1.000000 0.000000 0.000000 0.000000 1.000000 /end COMPU_METHOD
/* Scalar measurable for DDE 'AIN_b_EGT_Fault'. */
/begin MEASUREMENT AIN_b_EGT_Fault "Displayable" UBYTE CU_AIN_B_EGT_FAULT 1 100 0.0 1.0 ECU_ADDRESS 0x40002fad BYTE_ORDER MSB_FIRST /end MEASUREMENT
/begin COMPU_METHOD CU_AIN_B_EGT_FAULT "Conversion method for AIN_b_EGT_Fault" RAT_FUNC "%10.0" "b" COEFFS 0.000000 1.000000 0.000000 0.000000 0.000000 1.000000 /end COMPU_METHOD
/* Scalar measurable for DDE 'AIN_b_FuelPress_Fault'. */
/begin MEASUREMENT AIN_b_FuelPress_Fault "Displayable" UBYTE CU_AIN_B_FUELPRESS_FAULT 1 100 0.0 1.0 ECU_ADDRESS 0x40002fa6 BYTE_ORDER MSB_FIRST /end MEASUREMENT
/begin COMPU_METHOD CU_AIN_B_FUELPRESS_FAULT "Conversion method for AIN_b_FuelPress_Fault" RAT_FUNC "%10.0" "b" COEFFS 0.000000 1.000000 0.000000 0.000000 0.000000 1.000000 /end COMPU_METHOD
/* Scalar measurable for DDE 'AIN_b_FuelTemp_Fault'. */
/begin MEASUREMENT AIN_b_FuelTemp_Fault "Displayable" UBYTE CU_AIN_B_FUELTEMP_FAULT 1 100 0.0 1.0 ECU_ADDRESS 0x40002fa1 BYTE_ORDER MSB_FIRST /end MEASUREMENT
/begin COMPU_METHOD CU_AIN_B_FUELTEMP_FAULT "Conversion method for AIN_b_FuelTemp_Fault" RAT_FUNC "%10.0" "b" COEFFS 0.000000 1.000000 0.000000 0.000000 0.000000 1.000000 /end COMPU_METHOD
/* Scalar measurable for DDE 'AIN_b_ManifoldTemp_Fault'. */
/begin MEASUREMENT AIN_b_ManifoldTemp_Fault "Displayable" UBYTE CU_AIN_B_MANIFOLDTEMP_FAULT 1 100 0.0 1.0 ECU_ADDRESS 0x40002f9b BYTE_ORDER MSB_FIRST /end MEASUREMENT
/begin COMPU_METHOD CU_AIN_B_MANIFOLDTEMP_FAULT "Conversion method for AIN_b_ManifoldTemp_Fault" RAT_FUNC "%10.0" "b" COEFFS 0.000000 1.000000 0.000000 0.000000 0.000000 1.000000 /end COMPU_METHOD
/* Scalar measurable for DDE 'AIN_b_UsingPeriodic'. */
/begin MEASUREMENT AIN_b_UsingPeriodic "Displayable" UBYTE CU_AIN_B_USINGPERIODIC 1 100 0.0 1.0 ECU_ADDRESS 0x40002fc7 BYTE_ORDER MSB_FIRST /end MEASUREMENT
/begin COMPU_METHOD CU_AIN_B_USINGPERIODIC "Conversion method for AIN_b_UsingPeriodic" RAT_FUNC "%10.0" "b" COEFFS 0.000000 1.000000 0.000000 0.000000 0.000000 1.000000 /end COMPU_METHOD
/* Scalar measurable for DDE 'AIN_cnt_CylIdxA'. */
/begin MEASUREMENT AIN_cnt_CylIdxA "Displayable" UBYTE CU_AIN_CNT_CYLIDXA 1 100 0.0 0.0 ECU_ADDRESS 0x40003024 BYTE_ORDER MSB_FIRST /end MEASUREMENT
/begin COMPU_METHOD CU_AIN_CNT_CYLIDXA "Conversion method for AIN_cnt_CylIdxA" RAT_FUNC "%10.0" "cnt" COEFFS 0.000000 1.000000 0.000000 0.000000 0.000000 1.000000 /end COMPU_METHOD
/* Scalar measurable for DDE 'AIN_cnt_CylIdxB'. */
/begin MEASUREMENT AIN_cnt_CylIdxB "Displayable" UBYTE CU_AIN_CNT_CYLIDXB 1 100 0.0 0.0 ECU_ADDRESS 0x40003023 BYTE_ORDER MSB_FIRST /end MEASUREMENT
/begin COMPU_METHOD CU_AIN_CNT_CYLIDXB "Conversion method for AIN_cnt_CylIdxB" RAT_FUNC "%10.0" "cnt" COEFFS 0.000000 1.000000 0.000000 0.000000 0.000000 1.000000 /end COMPU_METHOD
/* Scalar measurable for DDE 'DTC_b_APP1_NonValidVoltage'. */
/begin MEASUREMENT DTC_b_APP1_NonValidVoltage "DTC150" UBYTE CU_DTC_B_APP1_NONVALIDVOLTAGE 1 100 0.0 1.0 ECU_ADDRESS 0x40002fcb BYTE_ORDER MSB_FIRST /end MEASUREMENT
/begin COMPU_METHOD CU_DTC_B_APP1_NONVALIDVOLTAGE "Conversion method for DTC_b_APP1_NonValidVoltage" RAT_FUNC "%10.0" "b" COEFFS 0.000000 1.000000 0.000000 0.000000 0.000000 1.000000 /end COMPU_METHOD
/* Scalar measurable for DDE 'DTC_b_APP2_NonValidVoltage'. */
/begin MEASUREMENT DTC_b_APP2_NonValidVoltage "DTC151" UBYTE CU_DTC_B_APP2_NONVALIDVOLTAGE 1 100 0.0 1.0 ECU_ADDRESS 0x40002fca BYTE_ORDER MSB_FIRST /end MEASUREMENT
/begin COMPU_METHOD CU_DTC_B_APP2_NONVALIDVOLTAGE "Conversion method for DTC_b_APP2_NonValidVoltage" RAT_FUNC "%10.0" "b" COEFFS 0.000000 1.000000 0.000000 0.000000 0.000000 1.000000 /end COMPU_METHOD
/* Scalar measurable for DDE 'DTC_b_Air_HTemp'. */
/begin MEASUREMENT DTC_b_Air_HTemp "DTC118" UBYTE CU_DTC_B_AIR_HTEMP 1 100 0.0 1.0 ECU_ADDRESS 0x40002fcd BYTE_ORDER MSB_FIRST /end MEASUREMENT
/begin COMPU_METHOD CU_DTC_B_AIR_HTEMP "Conversion method for DTC_b_Air_HTemp" RAT_FUNC "%10.0" "b" COEFFS 0.000000 1.000000 0.000000 0.000000 0.000000 1.000000 /end COMPU_METHOD
/* Scalar measurable for DDE 'DTC_b_Air_TempHV'. */
/begin MEASUREMENT DTC_b_Air_TempHV "DTC117" UBYTE CU_DTC_B_AIR_TEMPHV 1 100 0.0 1.0 ECU_ADDRESS 0x40002fce BYTE_ORDER MSB_FIRST /end MEASUREMENT
/begin COMPU_METHOD CU_DTC_B_AIR_TEMPHV "Conversion method for DTC_b_Air_TempHV" RAT_FUNC "%10.0" "b" COEFFS 0.000000 1.000000 0.000000 0.000000 0.000000 1.000000 /end COMPU_METHOD
/* Scalar measurable for DDE 'DTC_b_Air_TempLV'. */
/begin MEASUREMENT DTC_b_Air_TempLV "DTC116" UBYTE CU_DTC_B_AIR_TEMPLV 1 100 0.0 1.0 ECU_ADDRESS 0x40002fcf BYTE_ORDER MSB_FIRST /end MEASUREMENT
/begin COMPU_METHOD CU_DTC_B_AIR_TEMPLV "Conversion method for DTC_b_Air_TempLV" RAT_FUNC "%10.0" "b" COEFFS 0.000000 1.000000 0.000000 0.000000 0.000000 1.000000 /end COMPU_METHOD
/* Scalar measurable for DDE 'DTC_b_BARO_ErraticValue'. */
/begin MEASUREMENT DTC_b_BARO_ErraticValue "DTC203" UBYTE CU_DTC_B_BARO_ERRATICVALUE 1 100 0.0 1.0 ECU_ADDRESS 0x40002fc2 BYTE_ORDER MSB_FIRST /end MEASUREMENT
/begin COMPU_METHOD CU_DTC_B_BARO_ERRATICVALUE "Conversion method for DTC_b_BARO_ErraticValue" RAT_FUNC "%10.0" "b" COEFFS 0.000000 1.000000 0.000000 0.000000 0.000000 1.000000 /end COMPU_METHOD
/* Scalar measurable for DDE 'DTC_b_BARO_PressHVoltage'. */
/begin MEASUREMENT DTC_b_BARO_PressHVoltage "DTC123" UBYTE CU_DTC_B_BARO_PRESSHVOLTAGE 1 100 0.0 1.0 ECU_ADDRESS 0x40002fc3 BYTE_ORDER MSB_FIRST /end MEASUREMENT
/begin COMPU_METHOD CU_DTC_B_BARO_PRESSHVOLTAGE "Conversion method for DTC_b_BARO_PressHVoltage" RAT_FUNC "%10.0" "b" COEFFS 0.000000 1.000000 0.000000 0.000000 0.000000 1.000000 /end COMPU_METHOD
/* Scalar measurable for DDE 'DTC_b_BARO_PressLVoltage'. */
/begin MEASUREMENT DTC_b_BARO_PressLVoltage "DTC122" UBYTE CU_DTC_B_BARO_PRESSLVOLTAGE 1 100 0.0 1.0 ECU_ADDRESS 0x40002fc4 BYTE_ORDER MSB_FIRST /end MEASUREMENT
/begin COMPU_METHOD CU_DTC_B_BARO_PRESSLVOLTAGE "Conversion method for DTC_b_BARO_PressLVoltage" RAT_FUNC "%10.0" "b" COEFFS 0.000000 1.000000 0.000000 0.000000 0.000000 1.000000 /end COMPU_METHOD
/* Scalar measurable for DDE 'DTC_b_CompIAT_HTemp'. */
/begin MEASUREMENT DTC_b_CompIAT_HTemp "DTC172" UBYTE CU_DTC_B_COMPIAT_HTEMP 1 100 0.0 1.0 ECU_ADDRESS 0x40002f9c BYTE_ORDER MSB_FIRST /end MEASUREMENT
/begin COMPU_METHOD CU_DTC_B_COMPIAT_HTEMP "Conversion method for DTC_b_CompIAT_HTemp" RAT_FUNC "%10.0" "b" COEFFS 0.000000 1.000000 0.000000 0.000000 0.000000 1.000000 /end COMPU_METHOD
/* Scalar measurable for DDE 'DTC_b_CompIAT_TempHV'. */
/begin MEASUREMENT DTC_b_CompIAT_TempHV "DTC171" UBYTE CU_DTC_B_COMPIAT_TEMPHV 1 100 0.0 1.0 ECU_ADDRESS 0x40002f9d BYTE_ORDER MSB_FIRST /end MEASUREMENT
/begin COMPU_METHOD CU_DTC_B_COMPIAT_TEMPHV "Conversion method for DTC_b_CompIAT_TempHV" RAT_FUNC "%10.0" "b" COEFFS 0.000000 1.000000 0.000000 0.000000 0.000000 1.000000 /end COMPU_METHOD
/* Scalar measurable for DDE 'DTC_b_CompIAT_TempLV'. */
/begin MEASUREMENT DTC_b_CompIAT_TempLV "DTC170" UBYTE CU_DTC_B_COMPIAT_TEMPLV 1 100 0.0 1.0 ECU_ADDRESS 0x40002f9e BYTE_ORDER MSB_FIRST /end MEASUREMENT
/begin COMPU_METHOD CU_DTC_B_COMPIAT_TEMPLV "Conversion method for DTC_b_CompIAT_TempLV" RAT_FUNC "%10.0" "b" COEFFS 0.000000 1.000000 0.000000 0.000000 0.000000 1.000000 /end COMPU_METHOD
/* Scalar measurable for DDE 'DTC_b_DiagCata_Reset'. */
/begin MEASUREMENT DTC_b_DiagCata_Reset "DiagCata_Reset" UBYTE CU_DTC_B_DIAGCATA_RESET 1 100 0.0 1.0 ECU_ADDRESS 0x40002fb8 BYTE_ORDER MSB_FIRST /end MEASUREMENT
/begin COMPU_METHOD CU_DTC_B_DIAGCATA_RESET "Conversion method for DTC_b_DiagCata_Reset" RAT_FUNC "%10.0" "b" COEFFS 0.000000 1.000000 0.000000 0.000000 0.000000 1.000000 /end COMPU_METHOD
/* Scalar measurable for DDE 'DTC_b_ECT_HTemp'. */
/begin MEASUREMENT DTC_b_ECT_HTemp "DTC91" UBYTE CU_DTC_B_ECT_HTEMP 1 100 0.0 1.0 ECU_ADDRESS 0x40002fb3 BYTE_ORDER MSB_FIRST /end MEASUREMENT
/begin COMPU_METHOD CU_DTC_B_ECT_HTEMP "Conversion method for DTC_b_ECT_HTemp" RAT_FUNC "%10.0" "b" COEFFS 0.000000 1.000000 0.000000 0.000000 0.000000 1.000000 /end COMPU_METHOD
/* Scalar measurable for DDE 'DTC_b_ECT_LTemp'. */
/begin MEASUREMENT DTC_b_ECT_LTemp "DTC92" UBYTE CU_DTC_B_ECT_LTEMP 1 100 0.0 1.0 ECU_ADDRESS 0x40002fb2 BYTE_ORDER MSB_FIRST /end MEASUREMENT
/begin COMPU_METHOD CU_DTC_B_ECT_LTEMP "Conversion method for DTC_b_ECT_LTemp" RAT_FUNC "%10.0" "b" COEFFS 0.000000 1.000000 0.000000 0.000000 0.000000 1.000000 /end COMPU_METHOD
/* Scalar measurable for DDE 'DTC_b_ECT_TempHVoltage'. */
/begin MEASUREMENT DTC_b_ECT_TempHVoltage "DTC89" UBYTE CU_DTC_B_ECT_TEMPHVOLTAGE 1 100 0.0 1.0 ECU_ADDRESS 0x40002fb5 BYTE_ORDER MSB_FIRST /end MEASUREMENT
/begin COMPU_METHOD CU_DTC_B_ECT_TEMPHVOLTAGE "Conversion method for DTC_b_ECT_TempHVoltage" RAT_FUNC "%10.0" "b" COEFFS 0.000000 1.000000 0.000000 0.000000 0.000000 1.000000 /end COMPU_METHOD
/* Scalar measurable for DDE 'DTC_b_ECT_TempLVoltage'. */
/begin MEASUREMENT DTC_b_ECT_TempLVoltage "DTC90" UBYTE CU_DTC_B_ECT_TEMPLVOLTAGE 1 100 0.0 1.0 ECU_ADDRESS 0x40002fb4 BYTE_ORDER MSB_FIRST /end MEASUREMENT
/begin COMPU_METHOD CU_DTC_B_ECT_TEMPLVOLTAGE "Conversion method for DTC_b_ECT_TempLVoltage" RAT_FUNC "%10.0" "b" COEFFS 0.000000 1.000000 0.000000 0.000000 0.000000 1.000000 /end COMPU_METHOD
/* Scalar measurable for DDE 'DTC_b_EGT_TempHV'. */
/begin MEASUREMENT DTC_b_EGT_TempHV "DTC171" UBYTE CU_DTC_B_EGT_TEMPHV 1 100 0.0 1.0 ECU_ADDRESS 0x40002fb0 BYTE_ORDER MSB_FIRST /end MEASUREMENT
/begin COMPU_METHOD CU_DTC_B_EGT_TEMPHV "Conversion method for DTC_b_EGT_TempHV" RAT_FUNC "%10.0" "b" COEFFS 0.000000 1.000000 0.000000 0.000000 0.000000 1.000000 /end COMPU_METHOD
/* Scalar measurable for DDE 'DTC_b_EGT_TempLV'. */
/begin MEASUREMENT DTC_b_EGT_TempLV "DTC171" UBYTE CU_DTC_B_EGT_TEMPLV 1 100 0.0 1.0 ECU_ADDRESS 0x40002faf BYTE_ORDER MSB_FIRST /end MEASUREMENT
/begin COMPU_METHOD CU_DTC_B_EGT_TEMPLV "Conversion method for DTC_b_EGT_TempLV" RAT_FUNC "%10.0" "b" COEFFS 0.000000 1.000000 0.000000 0.000000 0.000000 1.000000 /end COMPU_METHOD
/* Scalar measurable for DDE 'DTC_b_EcuMemFault'. */
/begin MEASUREMENT DTC_b_EcuMemFault "DTC141" UBYTE CU_DTC_B_ECUMEMFAULT 1 100 0.0 1.0 ECU_ADDRESS 0x40002fd7 BYTE_ORDER MSB_FIRST /end MEASUREMENT
/begin COMPU_METHOD CU_DTC_B_ECUMEMFAULT "Conversion method for DTC_b_EcuMemFault" RAT_FUNC "%10.0" "b" COEFFS 0.000000 1.000000 0.000000 0.000000 0.000000 1.000000 /end COMPU_METHOD
/* Scalar measurable for DDE 'DTC_b_Exhaust_HTemp'. */
/begin MEASUREMENT DTC_b_Exhaust_HTemp "Turbo_HTemp" UBYTE CU_DTC_B_EXHAUST_HTEMP 1 100 0.0 1.0 ECU_ADDRESS 0x40002fae BYTE_ORDER MSB_FIRST /end MEASUREMENT
/begin COMPU_METHOD CU_DTC_B_EXHAUST_HTEMP "Conversion method for DTC_b_Exhaust_HTemp" RAT_FUNC "%10.0" "b" COEFFS 0.000000 1.000000 0.000000 0.000000 0.000000 1.000000 /end COMPU_METHOD
/* Scalar measurable for DDE 'DTC_b_FAP_Disconected'. */
/begin MEASUREMENT DTC_b_FAP_Disconected "Displayable" UBYTE CU_DTC_B_FAP_DISCONECTED 1 100 0.0 1.0 ECU_ADDRESS 0x40002fab BYTE_ORDER MSB_FIRST /end MEASUREMENT
/begin COMPU_METHOD CU_DTC_B_FAP_DISCONECTED "Conversion method for DTC_b_FAP_Disconected" RAT_FUNC "%10.0" "b" COEFFS 0.000000 1.000000 0.000000 0.000000 0.000000 1.000000 /end COMPU_METHOD
/* Scalar measurable for DDE 'DTC_b_FAP_HPress'. */
/begin MEASUREMENT DTC_b_FAP_HPress "Displayable" UBYTE CU_DTC_B_FAP_HPRESS 1 100 0.0 1.0 ECU_ADDRESS 0x40002fac BYTE_ORDER MSB_FIRST /end MEASUREMENT
/begin COMPU_METHOD CU_DTC_B_FAP_HPRESS "Conversion method for DTC_b_FAP_HPress" RAT_FUNC "%10.0" "b" COEFFS 0.000000 1.000000 0.000000 0.000000 0.000000 1.000000 /end COMPU_METHOD
/* Scalar measurable for DDE 'DTC_b_GLP1_HVoltage'. */
/begin MEASUREMENT DTC_b_GLP1_HVoltage "DTC147" UBYTE CU_DTC_B_GLP1_HVOLTAGE 1 100 0.0 1.0 ECU_ADDRESS 0x40002fa0 BYTE_ORDER MSB_FIRST /end MEASUREMENT
/begin COMPU_METHOD CU_DTC_B_GLP1_HVOLTAGE "Conversion method for DTC_b_GLP1_HVoltage" RAT_FUNC "%10.0" "b" COEFFS 0.000000 1.000000 0.000000 0.000000 0.000000 1.000000 /end COMPU_METHOD
/* Scalar measurable for DDE 'DTC_b_GLP2_HVoltage'. */
/begin MEASUREMENT DTC_b_GLP2_HVoltage "DTC147" UBYTE CU_DTC_B_GLP2_HVOLTAGE 1 100 0.0 1.0 ECU_ADDRESS 0x40002f9f BYTE_ORDER MSB_FIRST /end MEASUREMENT
/begin COMPU_METHOD CU_DTC_B_GLP2_HVOLTAGE "Conversion method for DTC_b_GLP2_HVoltage" RAT_FUNC "%10.0" "b" COEFFS 0.000000 1.000000 0.000000 0.000000 0.000000 1.000000 /end COMPU_METHOD
/* Scalar measurable for DDE 'DTC_b_GLP_HPress'. */
/begin MEASUREMENT DTC_b_GLP_HPress "DTC144" UBYTE CU_DTC_B_GLP_HPRESS 1 100 0.0 1.0 ECU_ADDRESS 0x40002fa9 BYTE_ORDER MSB_FIRST /end MEASUREMENT
/begin COMPU_METHOD CU_DTC_B_GLP_HPRESS "Conversion method for DTC_b_GLP_HPress" RAT_FUNC "%10.0" "b" COEFFS 0.000000 1.000000 0.000000 0.000000 0.000000 1.000000 /end COMPU_METHOD
/* Scalar measurable for DDE 'DTC_b_GLP_HTemp'. */
/begin MEASUREMENT DTC_b_GLP_HTemp "DTC178" UBYTE CU_DTC_B_GLP_HTEMP 1 100 0.0 1.0 ECU_ADDRESS 0x40002fa3 BYTE_ORDER MSB_FIRST /end MEASUREMENT
/begin COMPU_METHOD CU_DTC_B_GLP_HTEMP "Conversion method for DTC_b_GLP_HTemp" RAT_FUNC "%10.0" "b" COEFFS 0.000000 1.000000 0.000000 0.000000 0.000000 1.000000 /end COMPU_METHOD
/* Scalar measurable for DDE 'DTC_b_GLP_LPress'. */
/begin MEASUREMENT DTC_b_GLP_LPress "DTC145" UBYTE CU_DTC_B_GLP_LPRESS 1 100 0.0 1.0 ECU_ADDRESS 0x40002fa7 BYTE_ORDER MSB_FIRST /end MEASUREMENT
/begin COMPU_METHOD CU_DTC_B_GLP_LPRESS "Conversion method for DTC_b_GLP_LPress" RAT_FUNC "%10.0" "b" COEFFS 0.000000 1.000000 0.000000 0.000000 0.000000 1.000000 /end COMPU_METHOD
/* Scalar measurable for DDE 'DTC_b_GLP_LTemp'. */
/begin MEASUREMENT DTC_b_GLP_LTemp "DTC179" UBYTE CU_DTC_B_GLP_LTEMP 1 100 0.0 1.0 ECU_ADDRESS 0x40002fa2 BYTE_ORDER MSB_FIRST /end MEASUREMENT
/begin COMPU_METHOD CU_DTC_B_GLP_LTEMP "Conversion method for DTC_b_GLP_LTemp" RAT_FUNC "%10.0" "b" COEFFS 0.000000 1.000000 0.000000 0.000000 0.000000 1.000000 /end COMPU_METHOD
/* Scalar measurable for DDE 'DTC_b_GLP_OL'. */
/begin MEASUREMENT DTC_b_GLP_OL "DTCxxx" UBYTE CU_DTC_B_GLP_OL 1 100 0.0 1.0 ECU_ADDRESS 0x40002fa8 BYTE_ORDER MSB_FIRST /end MEASUREMENT
/begin COMPU_METHOD CU_DTC_B_GLP_OL "Conversion method for DTC_b_GLP_OL" RAT_FUNC "%10.0" "b" COEFFS 0.000000 1.000000 0.000000 0.000000 0.000000 1.000000 /end COMPU_METHOD
/* Scalar measurable for DDE 'DTC_b_GLP_TempHVoltage'. */
/begin MEASUREMENT DTC_b_GLP_TempHVoltage "DTC177" UBYTE CU_DTC_B_GLP_TEMPHVOLTAGE 1 100 0.0 1.0 ECU_ADDRESS 0x40002fa5 BYTE_ORDER MSB_FIRST /end MEASUREMENT
/begin COMPU_METHOD CU_DTC_B_GLP_TEMPHVOLTAGE "Conversion method for DTC_b_GLP_TempHVoltage" RAT_FUNC "%10.0" "b" COEFFS 0.000000 1.000000 0.000000 0.000000 0.000000 1.000000 /end COMPU_METHOD
/* Scalar measurable for DDE 'DTC_b_GLP_TempLVoltage'. */
/begin MEASUREMENT DTC_b_GLP_TempLVoltage "DTCxxx" UBYTE CU_DTC_B_GLP_TEMPLVOLTAGE 1 100 0.0 1.0 ECU_ADDRESS 0x40002fa4 BYTE_ORDER MSB_FIRST /end MEASUREMENT
/begin COMPU_METHOD CU_DTC_B_GLP_TEMPLVOLTAGE "Conversion method for DTC_b_GLP_TempLVoltage" RAT_FUNC "%10.0" "b" COEFFS 0.000000 1.000000 0.000000 0.000000 0.000000 1.000000 /end COMPU_METHOD
/* Scalar measurable for DDE 'DTC_b_MAPAfterThInfraPress'. */
/begin MEASUREMENT DTC_b_MAPAfterThInfraPress "DTC166" UBYTE CU_DTC_B_MAPAFTERTHINFRAPRESS 1 100 0.0 1.0 ECU_ADDRESS 0x40002fc5 BYTE_ORDER MSB_FIRST /end MEASUREMENT
/begin COMPU_METHOD CU_DTC_B_MAPAFTERTHINFRAPRESS "Conversion method for DTC_b_MAPAfterThInfraPress" RAT_FUNC "%10.0" "b" COEFFS 0.000000 1.000000 0.000000 0.000000 0.000000 1.000000 /end COMPU_METHOD
/* Scalar measurable for DDE 'DTC_b_MAPAfterThOverPress'. */
/begin MEASUREMENT DTC_b_MAPAfterThOverPress "DTC16" UBYTE CU_DTC_B_MAPAFTERTHOVERPRESS 1 100 0.0 1.0 ECU_ADDRESS 0x40002fc6 BYTE_ORDER MSB_FIRST /end MEASUREMENT
/begin COMPU_METHOD CU_DTC_B_MAPAFTERTHOVERPRESS "Conversion method for DTC_b_MAPAfterThOverPress" RAT_FUNC "%10.0" "b" COEFFS 0.000000 1.000000 0.000000 0.000000 0.000000 1.000000 /end COMPU_METHOD
/* Scalar measurable for DDE 'DTC_b_MAPAfterThr_LV'. */
/begin MEASUREMENT DTC_b_MAPAfterThr_LV "DTC168" UBYTE CU_DTC_B_MAPAFTERTHR_LV 1 100 0.0 1.0 ECU_ADDRESS 0x40002fc8 BYTE_ORDER MSB_FIRST /end MEASUREMENT
/begin COMPU_METHOD CU_DTC_B_MAPAFTERTHR_LV "Conversion method for DTC_b_MAPAfterThr_LV" RAT_FUNC "%10.0" "b" COEFFS 0.000000 1.000000 0.000000 0.000000 0.000000 1.000000 /end COMPU_METHOD
/* Scalar measurable for DDE 'DTC_b_MAPAftrThr_HV'. */
/begin MEASUREMENT DTC_b_MAPAftrThr_HV "DTC167" UBYTE CU_DTC_B_MAPAFTRTHR_HV 1 100 0.0 1.0 ECU_ADDRESS 0x40002fc9 BYTE_ORDER MSB_FIRST /end MEASUREMENT
/begin COMPU_METHOD CU_DTC_B_MAPAFTRTHR_HV "Conversion method for DTC_b_MAPAftrThr_HV" RAT_FUNC "%10.0" "b" COEFFS 0.000000 1.000000 0.000000 0.000000 0.000000 1.000000 /end COMPU_METHOD
/* Scalar measurable for DDE 'INP_C_AmbientTemp'. */
/begin MEASUREMENT INP_C_AmbientTemp "Displayable" FLOAT32_IEEE CU_INP_C_AMBIENTTEMP 1 100 0.0 0.0 ECU_ADDRESS 0x40003754 BYTE_ORDER MSB_FIRST /end MEASUREMENT
/begin COMPU_METHOD CU_INP_C_AMBIENTTEMP "Conversion method for INP_C_AmbientTemp" RAT_FUNC "%10.3" "C" COEFFS 0.000000 1.000000 0.000000 0.000000 0.000000 1.000000 /end COMPU_METHOD
/* Scalar measurable for DDE 'INP_C_CompOutTemp'. */
/begin MEASUREMENT INP_C_CompOutTemp "Displayable" FLOAT32_IEEE CU_INP_C_COMPOUTTEMP 1 100 0.0 0.0 ECU_ADDRESS 0x40003744 BYTE_ORDER MSB_FIRST /end MEASUREMENT
/begin COMPU_METHOD CU_INP_C_COMPOUTTEMP "Conversion method for INP_C_CompOutTemp" RAT_FUNC "%10.3" "C" COEFFS 0.000000 1.000000 0.000000 0.000000 0.000000 1.000000 /end COMPU_METHOD
/* Scalar measurable for DDE 'INP_C_CoolantTemp'. */
/begin MEASUREMENT INP_C_CoolantTemp "Displayable" FLOAT32_IEEE CU_INP_C_COOLANTTEMP 1 100 0.0 0.0 ECU_ADDRESS 0x40003714 BYTE_ORDER MSB_FIRST /end MEASUREMENT
/begin COMPU_METHOD CU_INP_C_COOLANTTEMP "Conversion method for INP_C_CoolantTemp" RAT_FUNC "%10.0" "C" COEFFS 0.000000 1.000000 0.000000 0.000000 0.000000 1.000000 /end COMPU_METHOD
/* Scalar measurable for DDE 'INP_C_ExhaustTemp'. */
/begin MEASUREMENT INP_C_ExhaustTemp "(not defined)" FLOAT32_IEEE CU_INP_C_EXHAUSTTEMP 1 100 -40.0 1000.0 ECU_ADDRESS 0x40003740 BYTE_ORDER MSB_FIRST /end MEASUREMENT
/begin COMPU_METHOD CU_INP_C_EXHAUSTTEMP "Conversion method for INP_C_ExhaustTemp" RAT_FUNC "%10.1" "C" COEFFS 0.000000 1.000000 0.000000 0.000000 0.000000 1.000000 /end COMPU_METHOD
/* Scalar measurable for DDE 'INP_C_FuelTemp'. */
/begin MEASUREMENT INP_C_FuelTemp "Displayable" FLOAT32_IEEE CU_INP_C_FUELTEMP 1 100 0.0 0.0 ECU_ADDRESS 0x40003720 BYTE_ORDER MSB_FIRST /end MEASUREMENT
/begin COMPU_METHOD CU_INP_C_FUELTEMP "Conversion method for INP_C_FuelTemp" RAT_FUNC "%10.0" "C" COEFFS 0.000000 1.000000 0.000000 0.000000 0.000000 1.000000 /end COMPU_METHOD
/* Scalar measurable for DDE 'INP_C_ManifoldTemp'. */
/begin MEASUREMENT INP_C_ManifoldTemp "Displayable" FLOAT32_IEEE CU_INP_C_MANIFOLDTEMP 1 100 0.0 0.0 ECU_ADDRESS 0x40003718 BYTE_ORDER MSB_FIRST /end MEASUREMENT
/begin COMPU_METHOD CU_INP_C_MANIFOLDTEMP "Conversion method for INP_C_ManifoldTemp" RAT_FUNC "%10.3" "C" COEFFS 0.000000 1.000000 0.000000 0.000000 0.000000 1.000000 /end COMPU_METHOD
/* Scalar measurable for DDE 'INP_C_OilTemp'. */
/begin MEASUREMENT INP_C_OilTemp "Displayable" FLOAT32_IEEE CU_INP_C_OILTEMP 1 100 0.0 0.0 ECU_ADDRESS 0x40003730 BYTE_ORDER MSB_FIRST /end MEASUREMENT
/begin COMPU_METHOD CU_INP_C_OILTEMP "Conversion method for INP_C_OilTemp" RAT_FUNC "%10.2" "C" COEFFS 0.000000 1.000000 0.000000 0.000000 0.000000 1.000000 /end COMPU_METHOD
/* Scalar measurable for DDE 'INP_L_TotalFuelLevel_L'. */
/begin MEASUREMENT INP_L_TotalFuelLevel_L "Displayable" FLOAT32_IEEE CU_INP_L_TOTALFUELLEVEL_L 1 100 0.0 0.0 ECU_ADDRESS 0x400038cc BYTE_ORDER MSB_FIRST /end MEASUREMENT
/begin COMPU_METHOD CU_INP_L_TOTALFUELLEVEL_L "Conversion method for INP_L_TotalFuelLevel_L" RAT_FUNC "%10.2" "L" COEFFS 0.000000 1.000000 0.000000 0.000000 0.000000 1.000000 /end COMPU_METHOD
/* Scalar measurable for DDE 'INP_NU_APP1_Raw'. */
/begin MEASUREMENT INP_NU_APP1_Raw "Displayable" FLOAT32_IEEE CU_INP_NU_APP1_RAW 1 100 0.0 0.0 ECU_ADDRESS 0x40003778 BYTE_ORDER MSB_FIRST /end MEASUREMENT
/begin COMPU_METHOD CU_INP_NU_APP1_RAW "Conversion method for INP_NU_APP1_Raw" RAT_FUNC "%10.3" "NU" COEFFS 0.000000 1.000000 0.000000 0.000000 0.000000 1.000000 /end COMPU_METHOD
/* Scalar measurable for DDE 'INP_NU_APP2_Raw'. */
/begin MEASUREMENT INP_NU_APP2_Raw "Displayable" FLOAT32_IEEE CU_INP_NU_APP2_RAW 1 100 0.0 0.0 ECU_ADDRESS 0x40003774 BYTE_ORDER MSB_FIRST /end MEASUREMENT
/begin COMPU_METHOD CU_INP_NU_APP2_RAW "Conversion method for INP_NU_APP2_Raw" RAT_FUNC "%10.3" "NU" COEFFS 0.000000 1.000000 0.000000 0.000000 0.000000 1.000000 /end COMPU_METHOD
/* Scalar measurable for DDE 'INP_NU_SpiCtrlCnts_A'. */
/begin MEASUREMENT INP_NU_SpiCtrlCnts_A "Counter for SPI control counts - how many times a SPI register write/read error occurred according to OE block" FLOAT32_IEEE CU_INP_NU_SPICTRLCNTS_A 1 100 0.0 0.0 ECU_ADDRESS 0x400030c4 BYTE_ORDER MSB_FIRST /end MEASUREMENT
/begin COMPU_METHOD CU_INP_NU_SPICTRLCNTS_A "Conversion method for INP_NU_SpiCtrlCnts_A" RAT_FUNC "%10.0" "NU" COEFFS 0.000000 1.000000 0.000000 0.000000 0.000000 1.000000 /end COMPU_METHOD
/* Scalar measurable for DDE 'INP_NU_SpiCtrlCnts_B'. */
/begin MEASUREMENT INP_NU_SpiCtrlCnts_B "Counter for SPI control counts - how many times a SPI register write/read error occurred according to OE block" FLOAT32_IEEE CU_INP_NU_SPICTRLCNTS_B 1 100 0.0 0.0 ECU_ADDRESS 0x400030d0 BYTE_ORDER MSB_FIRST /end MEASUREMENT
/begin COMPU_METHOD CU_INP_NU_SPICTRLCNTS_B "Conversion method for INP_NU_SpiCtrlCnts_B" RAT_FUNC "%10.0" "NU" COEFFS 0.000000 1.000000 0.000000 0.000000 0.000000 1.000000 /end COMPU_METHOD
/* Scalar measurable for DDE 'INP_NU_TP1_Raw'. */
/begin MEASUREMENT INP_NU_TP1_Raw "Displayable" FLOAT32_IEEE CU_INP_NU_TP1_RAW 1 100 0.0 0.0 ECU_ADDRESS 0x40003710 BYTE_ORDER MSB_FIRST /end MEASUREMENT
/begin COMPU_METHOD CU_INP_NU_TP1_RAW "Conversion method for INP_NU_TP1_Raw" RAT_FUNC "%10.1" "NU" COEFFS 0.000000 1.000000 0.000000 0.000000 0.000000 1.000000 /end COMPU_METHOD
/* Scalar measurable for DDE 'INP_NU_TP2_Raw'. */
/begin MEASUREMENT INP_NU_TP2_Raw "Displayable" FLOAT32_IEEE CU_INP_NU_TP2_RAW 1 100 0.0 0.0 ECU_ADDRESS 0x40003770 BYTE_ORDER MSB_FIRST /end MEASUREMENT
/begin COMPU_METHOD CU_INP_NU_TP2_RAW "Conversion method for INP_NU_TP2_Raw" RAT_FUNC "%10.1" "NU" COEFFS 0.000000 1.000000 0.000000 0.000000 0.000000 1.000000 /end COMPU_METHOD
/* Scalar measurable for DDE 'INP_RPM_CrankSpd'. */
/begin MEASUREMENT INP_RPM_CrankSpd "(not defined)" FLOAT32_IEEE CU_INP_RPM_CRANKSPD 1 100 0.0 0.0 ECU_ADDRESS 0x40003808 BYTE_ORDER MSB_FIRST /end MEASUREMENT
/begin COMPU_METHOD CU_INP_RPM_CRANKSPD "Conversion method for INP_RPM_CrankSpd" RAT_FUNC "%10.3" "RPM" COEFFS 0.000000 1.000000 0.000000 0.000000 0.000000 1.000000 /end COMPU_METHOD
/* Scalar measurable for DDE 'INP_RPM_EngSpd'. */
/begin MEASUREMENT INP_RPM_EngSpd "Displayable" FLOAT32_IEEE CU_INP_RPM_ENGSPD 1 100 0.0 0.0 ECU_ADDRESS 0x40003734 BYTE_ORDER MSB_FIRST /end MEASUREMENT
/begin COMPU_METHOD CU_INP_RPM_ENGSPD "Conversion method for INP_RPM_EngSpd" RAT_FUNC "%10.0" "RPM" COEFFS 0.000000 1.000000 0.000000 0.000000 0.000000 1.000000 /end COMPU_METHOD
/* Scalar measurable for DDE 'INP_V_EGO11'. */
/begin MEASUREMENT INP_V_EGO11 "Displayable" FLOAT32_IEEE CU_INP_V_EGO11 1 100 0.0 0.0 ECU_ADDRESS 0x40003780 BYTE_ORDER MSB_FIRST /end MEASUREMENT
/begin COMPU_METHOD CU_INP_V_EGO11 "Conversion method for INP_V_EGO11" RAT_FUNC "%10.1" "V" COEFFS 0.000000 1.000000 0.000000 0.000000 0.000000 1.000000 /end COMPU_METHOD
/* Scalar measurable for DDE 'INP_V_EGO21'. */
/begin MEASUREMENT INP_V_EGO21 "Displayable" FLOAT32_IEEE CU_INP_V_EGO21 1 100 0.0 0.0 ECU_ADDRESS 0x40003760 BYTE_ORDER MSB_FIRST /end MEASUREMENT
/begin COMPU_METHOD CU_INP_V_EGO21 "Conversion method for INP_V_EGO21" RAT_FUNC "%10.1" "V" COEFFS 0.000000 1.000000 0.000000 0.000000 0.000000 1.000000 /end COMPU_METHOD
/* Scalar measurable for DDE 'INP_V_FuelLevel1'. */
/begin MEASUREMENT INP_V_FuelLevel1 "Displayable" FLOAT32_IEEE CU_INP_V_FUELLEVEL1 1 100 0.0 0.0 ECU_ADDRESS 0x400038e4 BYTE_ORDER MSB_FIRST /end MEASUREMENT
/begin COMPU_METHOD CU_INP_V_FUELLEVEL1 "Conversion method for INP_V_FuelLevel1" RAT_FUNC "%10.2" "V" COEFFS 0.000000 1.000000 0.000000 0.000000 0.000000 1.000000 /end COMPU_METHOD
/* Scalar measurable for DDE 'INP_V_FuelLevel2'. */
/begin MEASUREMENT INP_V_FuelLevel2 "Displayable" FLOAT32_IEEE CU_INP_V_FUELLEVEL2 1 100 0.0 0.0 ECU_ADDRESS 0x400038e0 BYTE_ORDER MSB_FIRST /end MEASUREMENT
/begin COMPU_METHOD CU_INP_V_FUELLEVEL2 "Conversion method for INP_V_FuelLevel2" RAT_FUNC "%10.2" "V" COEFFS 0.000000 1.000000 0.000000 0.000000 0.000000 1.000000 /end COMPU_METHOD
/* Scalar measurable for DDE 'INP_V_VBatt'. */
/begin MEASUREMENT INP_V_VBatt "Displayable" FLOAT32_IEEE CU_INP_V_VBATT 1 100 0.0 0.0 ECU_ADDRESS 0x4000377c BYTE_ORDER MSB_FIRST /end MEASUREMENT
/begin COMPU_METHOD CU_INP_V_VBATT "Conversion method for INP_V_VBatt" RAT_FUNC "%10.1" "V" COEFFS 0.000000 1.000000 0.000000 0.000000 0.000000 1.000000 /end COMPU_METHOD
/* Scalar measurable for DDE 'INP_b_AC_PressSw'. */
/begin MEASUREMENT INP_b_AC_PressSw "Displayable" UBYTE CU_INP_B_AC_PRESSSW 1 100 0.0 1.0 ECU_ADDRESS 0x40002f3c BYTE_ORDER MSB_FIRST /end MEASUREMENT
/begin COMPU_METHOD CU_INP_B_AC_PRESSSW "Conversion method for INP_b_AC_PressSw" RAT_FUNC "%10.0" "b" COEFFS 0.000000 1.000000 0.000000 0.000000 0.000000 1.000000 /end COMPU_METHOD
/* Scalar measurable for DDE 'INP_b_AC_Rqst'. */
/begin MEASUREMENT INP_b_AC_Rqst "Displayable" UBYTE CU_INP_B_AC_RQST 1 100 0.0 1.0 ECU_ADDRESS 0x40002f3b BYTE_ORDER MSB_FIRST /end MEASUREMENT
/begin COMPU_METHOD CU_INP_B_AC_RQST "Conversion method for INP_b_AC_Rqst" RAT_FUNC "%10.0" "b" COEFFS 0.000000 1.000000 0.000000 0.000000 0.000000 1.000000 /end COMPU_METHOD
/* Scalar measurable for DDE 'INP_b_CamWheelMvmt'. */
/begin MEASUREMENT INP_b_CamWheelMvmt "(not defined)" UBYTE CU_INP_B_CAMWHEELMVMT 1 100 0.0 1.0 ECU_ADDRESS 0x40002fd4 BYTE_ORDER MSB_FIRST /end MEASUREMENT
/begin COMPU_METHOD CU_INP_B_CAMWHEELMVMT "Conversion method for INP_b_CamWheelMvmt" RAT_FUNC "%10.0" "b" COEFFS 0.000000 1.000000 0.000000 0.000000 0.000000 1.000000 /end COMPU_METHOD
/* Scalar measurable for DDE 'INP_b_CrankAngValid'. */
/begin MEASUREMENT INP_b_CrankAngValid "(not defined)" UBYTE CU_INP_B_CRANKANGVALID 1 100 0.0 1.0 ECU_ADDRESS 0x40002fd6 BYTE_ORDER MSB_FIRST /end MEASUREMENT
/begin COMPU_METHOD CU_INP_B_CRANKANGVALID "Conversion method for INP_b_CrankAngValid" RAT_FUNC "%10.0" "b" COEFFS 0.000000 1.000000 0.000000 0.000000 0.000000 1.000000 /end COMPU_METHOD
/* Scalar measurable for DDE 'INP_b_CrankMvmt'. */
/begin MEASUREMENT INP_b_CrankMvmt "(not defined)" UBYTE CU_INP_B_CRANKMVMT 1 100 0.0 1.0 ECU_ADDRESS 0x40002fd3 BYTE_ORDER MSB_FIRST /end MEASUREMENT
/begin COMPU_METHOD CU_INP_B_CRANKMVMT "Conversion method for INP_b_CrankMvmt" RAT_FUNC "%10.0" "b" COEFFS 0.000000 1.000000 0.000000 0.000000 0.000000 1.000000 /end COMPU_METHOD
/* Scalar measurable for DDE 'INP_b_EngAngValid'. */
/begin MEASUREMENT INP_b_EngAngValid "(not defined)" UBYTE CU_INP_B_ENGANGVALID 1 100 0.0 1.0 ECU_ADDRESS 0x40002fd5 BYTE_ORDER MSB_FIRST /end MEASUREMENT
/begin COMPU_METHOD CU_INP_B_ENGANGVALID "Conversion method for INP_b_EngAngValid" RAT_FUNC "%10.0" "b" COEFFS 0.000000 1.000000 0.000000 0.000000 0.000000 1.000000 /end COMPU_METHOD
/* Scalar measurable for DDE 'INP_b_EngSync'. */
/begin MEASUREMENT INP_b_EngSync "Displayable" UBYTE CU_INP_B_ENGSYNC 1 100 0.0 1.0 ECU_ADDRESS 0x40002f3e BYTE_ORDER MSB_FIRST /end MEASUREMENT
/begin COMPU_METHOD CU_INP_B_ENGSYNC "Conversion method for INP_b_EngSync" RAT_FUNC "%10.0" "b" COEFFS 0.000000 1.000000 0.000000 0.000000 0.000000 1.000000 /end COMPU_METHOD
/* Scalar measurable for DDE 'INP_b_Ign'. */
/begin MEASUREMENT INP_b_Ign "Displayable" UBYTE CU_INP_B_IGN 1 100 0.0 1.0 ECU_ADDRESS 0x40002f3a BYTE_ORDER MSB_FIRST /end MEASUREMENT
/begin COMPU_METHOD CU_INP_B_IGN "Conversion method for INP_b_Ign" RAT_FUNC "%10.0" "b" COEFFS 0.000000 1.000000 0.000000 0.000000 0.000000 1.000000 /end COMPU_METHOD
/* Scalar measurable for DDE 'INP_b_OilPrSw'. */
/begin MEASUREMENT INP_b_OilPrSw "(not defined)" UBYTE CU_INP_B_OILPRSW 1 100 0.0 1.0 ECU_ADDRESS 0x40002f3d BYTE_ORDER MSB_FIRST /end MEASUREMENT
/begin COMPU_METHOD CU_INP_B_OILPRSW "Conversion method for INP_b_OilPrSw" RAT_FUNC "%10.0" "b" COEFFS 0.000000 1.000000 0.000000 0.000000 0.000000 1.000000 /end COMPU_METHOD
/* Scalar measurable for DDE 'INP_b_XG4'. */
/begin MEASUREMENT INP_b_XG4 "Displayable" UBYTE CU_INP_B_XG4 1 100 0.0 1.0 ECU_ADDRESS 0x40002f74 BYTE_ORDER MSB_FIRST /end MEASUREMENT
/begin COMPU_METHOD CU_INP_B_XG4 "Conversion method for INP_b_XG4" RAT_FUNC "%10.0" "b" COEFFS 0.000000 1.000000 0.000000 0.000000 0.000000 1.000000 /end COMPU_METHOD
/* Scalar measurable for DDE 'INP_bar_FuelPress'. */
/begin MEASUREMENT INP_bar_FuelPress "ABSOLUTE fuel pressure displayable" FLOAT32_IEEE CU_INP_BAR_FUELPRESS 1 100 0.0 0.0 ECU_ADDRESS 0x40003758 BYTE_ORDER MSB_FIRST /end MEASUREMENT
/begin COMPU_METHOD CU_INP_BAR_FUELPRESS "Conversion method for INP_bar_FuelPress" RAT_FUNC "%10.2" "bar" COEFFS 0.000000 1.000000 0.000000 0.000000 0.000000 1.000000 /end COMPU_METHOD
/* Scalar measurable for DDE 'INP_cnt_IgnCount'. */
/begin MEASUREMENT INP_cnt_IgnCount "Cuenta Ignition" UWORD CU_INP_CNT_IGNCOUNT 1 100 1.0 65535.0 ECU_ADDRESS 0x40003028 BYTE_ORDER MSB_FIRST /end MEASUREMENT
/begin COMPU_METHOD CU_INP_CNT_IGNCOUNT "Conversion method for INP_cnt_IgnCount" RAT_FUNC "%10.0" "cnt" COEFFS 0.000000 1.000000 0.000000 0.000000 0.000000 1.000000 /end COMPU_METHOD
/* Scalar measurable for DDE 'INP_cnt_count_1'. */
/begin MEASUREMENT INP_cnt_count_1 "Cuenta misfire cil 1" UBYTE CU_INP_CNT_COUNT_1 1 100 1.0 255.0 ECU_ADDRESS 0x40003022 BYTE_ORDER MSB_FIRST /end MEASUREMENT
/begin COMPU_METHOD CU_INP_CNT_COUNT_1 "Conversion method for INP_cnt_count_1" RAT_FUNC "%10.0" "cnt" COEFFS 0.000000 1.000000 0.000000 0.000000 0.000000 1.000000 /end COMPU_METHOD
/* Scalar measurable for DDE 'INP_cnt_count_2'. */
/begin MEASUREMENT INP_cnt_count_2 "Cuenta misfire cil 2" UBYTE CU_INP_CNT_COUNT_2 1 100 1.0 255.0 ECU_ADDRESS 0x40003021 BYTE_ORDER MSB_FIRST /end MEASUREMENT
/begin COMPU_METHOD CU_INP_CNT_COUNT_2 "Conversion method for INP_cnt_count_2" RAT_FUNC "%10.0" "cnt" COEFFS 0.000000 1.000000 0.000000 0.000000 0.000000 1.000000 /end COMPU_METHOD
/* Scalar measurable for DDE 'INP_cnt_count_3'. */
/begin MEASUREMENT INP_cnt_count_3 "Cuenta misfire cil 3" UBYTE CU_INP_CNT_COUNT_3 1 100 1.0 255.0 ECU_ADDRESS 0x40003020 BYTE_ORDER MSB_FIRST /end MEASUREMENT
/begin COMPU_METHOD CU_INP_CNT_COUNT_3 "Conversion method for INP_cnt_count_3" RAT_FUNC "%10.0" "cnt" COEFFS 0.000000 1.000000 0.000000 0.000000 0.000000 1.000000 /end COMPU_METHOD
/* Scalar measurable for DDE 'INP_cnt_count_4'. */
/begin MEASUREMENT INP_cnt_count_4 "Cuenta misfire cil 4" UBYTE CU_INP_CNT_COUNT_4 1 100 1.0 255.0 ECU_ADDRESS 0x4000301f BYTE_ORDER MSB_FIRST /end MEASUREMENT
/begin COMPU_METHOD CU_INP_CNT_COUNT_4 "Conversion method for INP_cnt_count_4" RAT_FUNC "%10.0" "cnt" COEFFS 0.000000 1.000000 0.000000 0.000000 0.000000 1.000000 /end COMPU_METHOD
/* Scalar measurable for DDE 'INP_deg_CrankAng'. */
/begin MEASUREMENT INP_deg_CrankAng "(not defined)" FLOAT32_IEEE CU_INP_DEG_CRANKANG 1 100 0.0 0.0 ECU_ADDRESS 0x40003994 BYTE_ORDER MSB_FIRST /end MEASUREMENT
/begin COMPU_METHOD CU_INP_DEG_CRANKANG "Conversion method for INP_deg_CrankAng" RAT_FUNC "%10.3" "deg" COEFFS 0.000000 1.000000 0.000000 0.000000 0.000000 1.000000 /end COMPU_METHOD
/* Scalar measurable for DDE 'INP_deg_EngAng'. */
/begin MEASUREMENT INP_deg_EngAng "(not defined)" FLOAT32_IEEE CU_INP_DEG_ENGANG 1 100 0.0 0.0 ECU_ADDRESS 0x40003990 BYTE_ORDER MSB_FIRST /end MEASUREMENT
/begin COMPU_METHOD CU_INP_DEG_ENGANG "Conversion method for INP_deg_EngAng" RAT_FUNC "%10.3" "deg" COEFFS 0.000000 1.000000 0.000000 0.000000 0.000000 1.000000 /end COMPU_METHOD
/* Scalar measurable for DDE 'INP_e_TransGear'. */
/begin MEASUREMENT INP_e_TransGear "Displayable" SBYTE CU_INP_E_TRANSGEAR 1 100 0.0 0.0 ECU_ADDRESS 0x40002fd8 BYTE_ORDER MSB_FIRST /end MEASUREMENT
/begin COMPU_METHOD CU_INP_E_TRANSGEAR "Conversion method for INP_e_TransGear" RAT_FUNC "%10.0" "e" COEFFS 0.000000 1.000000 0.000000 0.000000 0.000000 1.000000 /end COMPU_METHOD
/* Scalar measurable for DDE 'INP_gps_MAF'. */
/begin MEASUREMENT INP_gps_MAF "Displayable" FLOAT32_IEEE CU_INP_GPS_MAF 1 100 0.0 0.0 ECU_ADDRESS 0x40003784 BYTE_ORDER MSB_FIRST /end MEASUREMENT
/begin COMPU_METHOD CU_INP_GPS_MAF "Conversion method for INP_gps_MAF" RAT_FUNC "%10.0" "gps" COEFFS 0.000000 1.000000 0.000000 0.000000 0.000000 1.000000 /end COMPU_METHOD
/* Scalar measurable for DDE 'INP_kPa_Baro'. */
/begin MEASUREMENT INP_kPa_Baro "Displayable" FLOAT32_IEEE CU_INP_KPA_BARO 1 100 0.0 0.0 ECU_ADDRESS 0x4000374c BYTE_ORDER MSB_FIRST /end MEASUREMENT
/begin COMPU_METHOD CU_INP_KPA_BARO "Conversion method for INP_kPa_Baro" RAT_FUNC "%10.3" "kPa" COEFFS 0.000000 1.000000 0.000000 0.000000 0.000000 1.000000 /end COMPU_METHOD
/* Scalar measurable for DDE 'INP_kPa_CompOutPress'. */
/begin MEASUREMENT INP_kPa_CompOutPress "Displayable" FLOAT32_IEEE CU_INP_KPA_COMPOUTPRESS 1 100 0.0 0.0 ECU_ADDRESS 0x40003750 BYTE_ORDER MSB_FIRST /end MEASUREMENT
/begin COMPU_METHOD CU_INP_KPA_COMPOUTPRESS "Conversion method for INP_kPa_CompOutPress" RAT_FUNC "%10.3" "kPa" COEFFS 0.000000 1.000000 0.000000 0.000000 0.000000 1.000000 /end COMPU_METHOD
/* Scalar measurable for DDE 'INP_kPa_MAP'. */
/begin MEASUREMENT INP_kPa_MAP "Displayable" FLOAT32_IEEE CU_INP_KPA_MAP 1 100 0.0 0.0 ECU_ADDRESS 0x40003724 BYTE_ORDER MSB_FIRST /end MEASUREMENT
/begin COMPU_METHOD CU_INP_KPA_MAP "Conversion method for INP_kPa_MAP" RAT_FUNC "%10.0" "kPa" COEFFS 0.000000 1.000000 0.000000 0.000000 0.000000 1.000000 /end COMPU_METHOD
/* Scalar measurable for DDE 'INP_kPa_OilPress'. */
/begin MEASUREMENT INP_kPa_OilPress "Displayable" FLOAT32_IEEE CU_INP_KPA_OILPRESS 1 100 0.0 0.0 ECU_ADDRESS 0x4000375c BYTE_ORDER MSB_FIRST /end MEASUREMENT
/begin COMPU_METHOD CU_INP_KPA_OILPRESS "Conversion method for INP_kPa_OilPress" RAT_FUNC "%10.3" "kPa" COEFFS 0.000000 1.000000 0.000000 0.000000 0.000000 1.000000 /end COMPU_METHOD
/* Scalar measurable for DDE 'INP_kph_VehSpd'. */
/begin MEASUREMENT INP_kph_VehSpd "Displayable" FLOAT32_IEEE CU_INP_KPH_VEHSPD 1 100 0.0 0.0 ECU_ADDRESS 0x40003738 BYTE_ORDER MSB_FIRST /end MEASUREMENT
/begin COMPU_METHOD CU_INP_KPH_VEHSPD "Conversion method for INP_kph_VehSpd" RAT_FUNC "%10.2" "kph" COEFFS 0.000000 1.000000 0.000000 0.000000 0.000000 1.000000 /end COMPU_METHOD
/* Scalar measurable for DDE 'INP_lam_UEGO1'. */
/begin MEASUREMENT INP_lam_UEGO1 "Displayable" FLOAT32_IEEE CU_INP_LAM_UEGO1 1 100 0.0 0.0 ECU_ADDRESS 0x4000372c BYTE_ORDER MSB_FIRST /end MEASUREMENT
/begin COMPU_METHOD CU_INP_LAM_UEGO1 "Conversion method for INP_lam_UEGO1" RAT_FUNC "%10.1" "lam" COEFFS 0.000000 1.000000 0.000000 0.000000 0.000000 1.000000 /end COMPU_METHOD
/* Scalar measurable for DDE 'INP_lam_UEGO2'. */
/begin MEASUREMENT INP_lam_UEGO2 "Displayable" FLOAT32_IEEE CU_INP_LAM_UEGO2 1 100 0.0 0.0 ECU_ADDRESS 0x40003728 BYTE_ORDER MSB_FIRST /end MEASUREMENT
/begin COMPU_METHOD CU_INP_LAM_UEGO2 "Conversion method for INP_lam_UEGO2" RAT_FUNC "%10.1" "lam" COEFFS 0.000000 1.000000 0.000000 0.000000 0.000000 1.000000 /end COMPU_METHOD
/* Scalar measurable for DDE 'INP_pct_AltLoad'. */
/begin MEASUREMENT INP_pct_AltLoad "Displayable" FLOAT32_IEEE CU_INP_PCT_ALTLOAD 1 100 0.0 0.0 ECU_ADDRESS 0x4000373c BYTE_ORDER MSB_FIRST /end MEASUREMENT
/begin COMPU_METHOD CU_INP_PCT_ALTLOAD "Conversion method for INP_pct_AltLoad" RAT_FUNC "%10.3" "pct" COEFFS 0.000000 1.000000 0.000000 0.000000 0.000000 1.000000 /end COMPU_METHOD
/* Scalar measurable for DDE 'INP_pct_Cylinder1_Knock'. */
/begin MEASUREMENT INP_pct_Cylinder1_Knock "Displayable" FLOAT32_IEEE CU_INP_PCT_CYLINDER1_KNOCK 1 100 0.0 0.0 ECU_ADDRESS 0x4000371c BYTE_ORDER MSB_FIRST /end MEASUREMENT
/begin COMPU_METHOD CU_INP_PCT_CYLINDER1_KNOCK "Conversion method for INP_pct_Cylinder1_Knock" RAT_FUNC "%10.2" "pct" COEFFS 0.000000 1.000000 0.000000 0.000000 0.000000 1.000000 /end COMPU_METHOD
/* Scalar measurable for DDE 'INP_pct_Cylinder2_Knock'. */
/begin MEASUREMENT INP_pct_Cylinder2_Knock "Displayable" FLOAT32_IEEE CU_INP_PCT_CYLINDER2_KNOCK 1 100 0.0 0.0 ECU_ADDRESS 0x4000376c BYTE_ORDER MSB_FIRST /end MEASUREMENT
/begin COMPU_METHOD CU_INP_PCT_CYLINDER2_KNOCK "Conversion method for INP_pct_Cylinder2_Knock" RAT_FUNC "%10.2" "pct" COEFFS 0.000000 1.000000 0.000000 0.000000 0.000000 1.000000 /end COMPU_METHOD
/* Scalar measurable for DDE 'INP_pct_Cylinder3_Knock'. */
/begin MEASUREMENT INP_pct_Cylinder3_Knock "Displayable" FLOAT32_IEEE CU_INP_PCT_CYLINDER3_KNOCK 1 100 0.0 0.0 ECU_ADDRESS 0x40003768 BYTE_ORDER MSB_FIRST /end MEASUREMENT
/begin COMPU_METHOD CU_INP_PCT_CYLINDER3_KNOCK "Conversion method for INP_pct_Cylinder3_Knock" RAT_FUNC "%10.2" "pct" COEFFS 0.000000 1.000000 0.000000 0.000000 0.000000 1.000000 /end COMPU_METHOD
/* Scalar measurable for DDE 'INP_pct_Cylinder4_Knock'. */
/begin MEASUREMENT INP_pct_Cylinder4_Knock "Displayable" FLOAT32_IEEE CU_INP_PCT_CYLINDER4_KNOCK 1 100 0.0 0.0 ECU_ADDRESS 0x40003764 BYTE_ORDER MSB_FIRST /end MEASUREMENT
/begin COMPU_METHOD CU_INP_PCT_CYLINDER4_KNOCK "Conversion method for INP_pct_Cylinder4_Knock" RAT_FUNC "%10.2" "pct" COEFFS 0.000000 1.000000 0.000000 0.000000 0.000000 1.000000 /end COMPU_METHOD
/* Scalar measurable for DDE 'INP_pct_EstimatedGearRatio'. */
/begin MEASUREMENT INP_pct_EstimatedGearRatio "Estimate ratio between EngSpd & TOSS" FLOAT32_IEEE CU_INP_PCT_ESTIMATEDGEARRATIO 1 100 0.0 0.0 ECU_ADDRESS 0x40003788 BYTE_ORDER MSB_FIRST /end MEASUREMENT
/begin COMPU_METHOD CU_INP_PCT_ESTIMATEDGEARRATIO "Conversion method for INP_pct_EstimatedGearRatio" RAT_FUNC "%10.2" "pct" COEFFS 0.000000 1.000000 0.000000 0.000000 0.000000 1.000000 /end COMPU_METHOD
/* Scalar measurable for DDE 'INP_pct_GLPLevel1'. */
/begin MEASUREMENT INP_pct_GLPLevel1 "Displayable" FLOAT32_IEEE CU_INP_PCT_GLPLEVEL1 1 100 0.0 0.0 ECU_ADDRESS 0x400038d0 BYTE_ORDER MSB_FIRST /end MEASUREMENT
/begin COMPU_METHOD CU_INP_PCT_GLPLEVEL1 "Conversion method for INP_pct_GLPLevel1" RAT_FUNC "%10.2" "V" COEFFS 0.000000 1.000000 0.000000 0.000000 0.000000 1.000000 /end COMPU_METHOD
/* Scalar measurable for DDE 'INP_pct_GLPLevel2'. */
/begin MEASUREMENT INP_pct_GLPLevel2 "Displayable" FLOAT32_IEEE CU_INP_PCT_GLPLEVEL2 1 100 0.0 0.0 ECU_ADDRESS 0x400038dc BYTE_ORDER MSB_FIRST /end MEASUREMENT
/begin COMPU_METHOD CU_INP_PCT_GLPLEVEL2 "Conversion method for INP_pct_GLPLevel2" RAT_FUNC "%10.2" "V" COEFFS 0.000000 1.000000 0.000000 0.000000 0.000000 1.000000 /end COMPU_METHOD
/* Scalar measurable for DDE 'INP_pct_PrefiltTotalFuelLevel'. */
/begin MEASUREMENT INP_pct_PrefiltTotalFuelLevel "Displayable" FLOAT32_IEEE CU_INP_PCT_PREFILTTOTALFUELLEV0 1 100 0.0 0.0 ECU_ADDRESS 0x400038d8 BYTE_ORDER MSB_FIRST /end MEASUREMENT
/begin COMPU_METHOD CU_INP_PCT_PREFILTTOTALFUELLEV0 "Conversion method for INP_pct_PrefiltTotalFuelLevel" RAT_FUNC "%10.2" "pct" COEFFS 0.000000 1.000000 0.000000 0.000000 0.000000 1.000000 /end COMPU_METHOD
/* Scalar measurable for DDE 'INP_pct_TotalFuelLevel'. */
/begin MEASUREMENT INP_pct_TotalFuelLevel "Displayable" FLOAT32_IEEE CU_INP_PCT_TOTALFUELLEVEL 1 100 0.0 0.0 ECU_ADDRESS 0x400038d4 BYTE_ORDER MSB_FIRST /end MEASUREMENT
/begin COMPU_METHOD CU_INP_PCT_TOTALFUELLEVEL "Conversion method for INP_pct_TotalFuelLevel" RAT_FUNC "%10.2" "pct" COEFFS 0.000000 1.000000 0.000000 0.000000 0.000000 1.000000 /end COMPU_METHOD
/* Scalar measurable for DDE 'INP_ret_VCP_Pos'. */
/begin MEASUREMENT INP_ret_VCP_Pos "Displayable" FLOAT32_IEEE CU_INP_RET_VCP_POS 1 100 0.0 0.0 ECU_ADDRESS 0x40003748 BYTE_ORDER MSB_FIRST /end MEASUREMENT
/begin COMPU_METHOD CU_INP_RET_VCP_POS "Conversion method for INP_ret_VCP_Pos" RAT_FUNC "%10.2" "ret" COEFFS 0.000000 1.000000 0.000000 0.000000 0.000000 1.000000 /end COMPU_METHOD
/* Scalar measurable for DDE 'INP_rpm_EngSpdPre_ang_1'. */
/begin MEASUREMENT INP_rpm_EngSpdPre_ang_1 "(not defined)" FLOAT32_IEEE CU_INP_RPM_ENGSPDPRE_ANG_1 1 100 0.0 10000.0 ECU_ADDRESS 0x400030b8 BYTE_ORDER MSB_FIRST /end MEASUREMENT
/begin COMPU_METHOD CU_INP_RPM_ENGSPDPRE_ANG_1 "Conversion method for INP_rpm_EngSpdPre_ang_1" RAT_FUNC "%10.0" "RPM" COEFFS 0.000000 1.000000 0.000000 0.000000 0.000000 1.000000 /end COMPU_METHOD
/* Scalar measurable for DDE 'INP_rpm_EngSpdPre_ang_2'. */
/begin MEASUREMENT INP_rpm_EngSpdPre_ang_2 "(not defined)" FLOAT32_IEEE CU_INP_RPM_ENGSPDPRE_ANG_2 1 100 0.0 10000.0 ECU_ADDRESS 0x400030a8 BYTE_ORDER MSB_FIRST /end MEASUREMENT
/begin COMPU_METHOD CU_INP_RPM_ENGSPDPRE_ANG_2 "Conversion method for INP_rpm_EngSpdPre_ang_2" RAT_FUNC "%10.0" "RPM" COEFFS 0.000000 1.000000 0.000000 0.000000 0.000000 1.000000 /end COMPU_METHOD
/* Scalar measurable for DDE 'INP_rpm_EngSpdPre_ang_3'. */
/begin MEASUREMENT INP_rpm_EngSpdPre_ang_3 "(not defined)" FLOAT32_IEEE CU_INP_RPM_ENGSPDPRE_ANG_3 1 100 0.0 10000.0 ECU_ADDRESS 0x40003098 BYTE_ORDER MSB_FIRST /end MEASUREMENT
/begin COMPU_METHOD CU_INP_RPM_ENGSPDPRE_ANG_3 "Conversion method for INP_rpm_EngSpdPre_ang_3" RAT_FUNC "%10.0" "RPM" COEFFS 0.000000 1.000000 0.000000 0.000000 0.000000 1.000000 /end COMPU_METHOD
/* Scalar measurable for DDE 'INP_rpm_EngSpdPre_ang_4'. */
/begin MEASUREMENT INP_rpm_EngSpdPre_ang_4 "(not defined)" FLOAT32_IEEE CU_INP_RPM_ENGSPDPRE_ANG_4 1 100 0.0 10000.0 ECU_ADDRESS 0x40003088 BYTE_ORDER MSB_FIRST /end MEASUREMENT
/begin COMPU_METHOD CU_INP_RPM_ENGSPDPRE_ANG_4 "Conversion method for INP_rpm_EngSpdPre_ang_4" RAT_FUNC "%10.0" "RPM" COEFFS 0.000000 1.000000 0.000000 0.000000 0.000000 1.000000 /end COMPU_METHOD
/* Scalar measurable for DDE 'INP_rpm_EngSpdPst_ang_1'. */
/begin MEASUREMENT INP_rpm_EngSpdPst_ang_1 "(not defined)" FLOAT32_IEEE CU_INP_RPM_ENGSPDPST_ANG_1 1 100 0.0 10000.0 ECU_ADDRESS 0x400030b4 BYTE_ORDER MSB_FIRST /end MEASUREMENT
/begin COMPU_METHOD CU_INP_RPM_ENGSPDPST_ANG_1 "Conversion method for INP_rpm_EngSpdPst_ang_1" RAT_FUNC "%10.0" "RPM" COEFFS 0.000000 1.000000 0.000000 0.000000 0.000000 1.000000 /end COMPU_METHOD
/* Scalar measurable for DDE 'INP_rpm_EngSpdPst_ang_2'. */
/begin MEASUREMENT INP_rpm_EngSpdPst_ang_2 "(not defined)" FLOAT32_IEEE CU_INP_RPM_ENGSPDPST_ANG_2 1 100 0.0 10000.0 ECU_ADDRESS 0x400030a4 BYTE_ORDER MSB_FIRST /end MEASUREMENT
/begin COMPU_METHOD CU_INP_RPM_ENGSPDPST_ANG_2 "Conversion method for INP_rpm_EngSpdPst_ang_2" RAT_FUNC "%10.0" "RPM" COEFFS 0.000000 1.000000 0.000000 0.000000 0.000000 1.000000 /end COMPU_METHOD
/* Scalar measurable for DDE 'INP_rpm_EngSpdPst_ang_3'. */
/begin MEASUREMENT INP_rpm_EngSpdPst_ang_3 "(not defined)" FLOAT32_IEEE CU_INP_RPM_ENGSPDPST_ANG_3 1 100 0.0 10000.0 ECU_ADDRESS 0x40003094 BYTE_ORDER MSB_FIRST /end MEASUREMENT
/begin COMPU_METHOD CU_INP_RPM_ENGSPDPST_ANG_3 "Conversion method for INP_rpm_EngSpdPst_ang_3" RAT_FUNC "%10.0" "RPM" COEFFS 0.000000 1.000000 0.000000 0.000000 0.000000 1.000000 /end COMPU_METHOD
/* Scalar measurable for DDE 'INP_rpm_EngSpdPst_ang_4'. */
/begin MEASUREMENT INP_rpm_EngSpdPst_ang_4 "(not defined)" FLOAT32_IEEE CU_INP_RPM_ENGSPDPST_ANG_4 1 100 0.0 10000.0 ECU_ADDRESS 0x40003084 BYTE_ORDER MSB_FIRST /end MEASUREMENT
/begin COMPU_METHOD CU_INP_RPM_ENGSPDPST_ANG_4 "Conversion method for INP_rpm_EngSpdPst_ang_4" RAT_FUNC "%10.0" "RPM" COEFFS 0.000000 1.000000 0.000000 0.000000 0.000000 1.000000 /end COMPU_METHOD
/* Scalar measurable for DDE 'KNK_NU_EngSpdCorr'. */
/begin MEASUREMENT KNK_NU_EngSpdCorr "Map output displayable" FLOAT32_IEEE CU_KNK_NU_ENGSPDCORR 1 100 0.0 0.0 ECU_ADDRESS 0x4000349c BYTE_ORDER MSB_FIRST /end MEASUREMENT
/begin COMPU_METHOD CU_KNK_NU_ENGSPDCORR "Conversion method for KNK_NU_EngSpdCorr" RAT_FUNC "%10.2" "pct" COEFFS 0.000000 1.000000 0.000000 0.000000 0.000000 1.000000 /end COMPU_METHOD
/* Scalar measurable for DDE 'KNK_b_EnrichFuel'. */
/begin MEASUREMENT KNK_b_EnrichFuel "Displayable" UBYTE CU_KNK_B_ENRICHFUEL 1 100 0.0 1.0 ECU_ADDRESS 0x40002e73 BYTE_ORDER MSB_FIRST /end MEASUREMENT
/begin COMPU_METHOD CU_KNK_B_ENRICHFUEL "Conversion method for KNK_b_EnrichFuel" RAT_FUNC "%10.0" "b" COEFFS 0.000000 1.000000 0.000000 0.000000 0.000000 1.000000 /end COMPU_METHOD
/* Scalar measurable for DDE 'KNK_b_NewKnockEvent'. */
/begin MEASUREMENT KNK_b_NewKnockEvent "Displayable" UBYTE CU_KNK_B_NEWKNOCKEVENT 1 100 0.0 1.0 ECU_ADDRESS 0x40002ee2 BYTE_ORDER MSB_FIRST /end MEASUREMENT
/begin COMPU_METHOD CU_KNK_B_NEWKNOCKEVENT "Conversion method for KNK_b_NewKnockEvent" RAT_FUNC "%10.0" "b" COEFFS 0.000000 1.000000 0.000000 0.000000 0.000000 1.000000 /end COMPU_METHOD
/* Scalar measurable for DDE 'KNK_lam_AFR_Lim'. */
/begin MEASUREMENT KNK_lam_AFR_Lim "AFR limit" FLOAT32_IEEE CU_KNK_LAM_AFR_LIM 1 100 0.0 0.0 ECU_ADDRESS 0x400031f0 BYTE_ORDER MSB_FIRST /end MEASUREMENT
/begin COMPU_METHOD CU_KNK_LAM_AFR_LIM "Conversion method for KNK_lam_AFR_Lim" RAT_FUNC "%10.2" "lam" COEFFS 0.000000 1.000000 0.000000 0.000000 0.000000 1.000000 /end COMPU_METHOD
/* Scalar measurable for DDE 'KNK_ret_SensorBased'. */
/begin MEASUREMENT KNK_ret_SensorBased "Output from sensor-based retard logic" FLOAT32_IEEE CU_KNK_RET_SENSORBASED 1 100 0.0 0.0 ECU_ADDRESS 0x400031ac BYTE_ORDER MSB_FIRST /end MEASUREMENT
/begin COMPU_METHOD CU_KNK_RET_SENSORBASED "Conversion method for KNK_ret_SensorBased" RAT_FUNC "%10.1" "ret" COEFFS 0.000000 1.000000 0.000000 0.000000 0.000000 1.000000 /end COMPU_METHOD
/* Scalar measurable for DDE 'KNK_ret_SparkMod'. */
/begin MEASUREMENT KNK_ret_SparkMod "Final knock spark modifier" FLOAT32_IEEE CU_KNK_RET_SPARKMOD 1 100 0.0 0.0 ECU_ADDRESS 0x40003494 BYTE_ORDER MSB_FIRST /end MEASUREMENT
/begin COMPU_METHOD CU_KNK_RET_SPARKMOD "Conversion method for KNK_ret_SparkMod" RAT_FUNC "%10.2" "ret" COEFFS 0.000000 1.000000 0.000000 0.000000 0.000000 1.000000 /end COMPU_METHOD
/* Scalar measurable for DDE 'KNK_ret_TempBased'. */
/begin MEASUREMENT KNK_ret_TempBased "Open-loop retard command" FLOAT32_IEEE CU_KNK_RET_TEMPBASED 1 100 0.0 0.0 ECU_ADDRESS 0x40003498 BYTE_ORDER MSB_FIRST /end MEASUREMENT
/begin COMPU_METHOD CU_KNK_RET_TEMPBASED "Conversion method for KNK_ret_TempBased" RAT_FUNC "%10.1" "ret" COEFFS 0.000000 1.000000 0.000000 0.000000 0.000000 1.000000 /end COMPU_METHOD
/* Scalar measurable for DDE 'LAM_NU_AmpFactor_A'. */
/begin MEASUREMENT LAM_NU_AmpFactor_A "Amplification factor used for Lambda calculation" FLOAT32_IEEE CU_LAM_NU_AMPFACTOR_A 1 100 0.0 0.0 ECU_ADDRESS 0x400030fc BYTE_ORDER MSB_FIRST /end MEASUREMENT
/begin COMPU_METHOD CU_LAM_NU_AMPFACTOR_A "Conversion method for LAM_NU_AmpFactor_A" RAT_FUNC "%10.0" "NU" COEFFS 0.000000 1.000000 0.000000 0.000000 0.000000 1.000000 /end COMPU_METHOD
/* Scalar measurable for DDE 'LAM_NU_AmpFactor_B'. */
/begin MEASUREMENT LAM_NU_AmpFactor_B "Amplification factor used for Lambda calculation" FLOAT32_IEEE CU_LAM_NU_AMPFACTOR_B 1 100 0.0 0.0 ECU_ADDRESS 0x4000312c BYTE_ORDER MSB_FIRST /end MEASUREMENT
/begin COMPU_METHOD CU_LAM_NU_AMPFACTOR_B "Conversion method for LAM_NU_AmpFactor_B" RAT_FUNC "%10.0" "NU" COEFFS 0.000000 1.000000 0.000000 0.000000 0.000000 1.000000 /end COMPU_METHOD
/* Scalar measurable for DDE 'LAM_NU_Lambda_A'. */
/begin MEASUREMENT LAM_NU_Lambda_A "Lambda value" FLOAT32_IEEE CU_LAM_NU_LAMBDA_A 1 100 0.0 0.0 ECU_ADDRESS 0x400030f4 BYTE_ORDER MSB_FIRST /end MEASUREMENT
/begin COMPU_METHOD CU_LAM_NU_LAMBDA_A "Conversion method for LAM_NU_Lambda_A" RAT_FUNC "%10.3" "NU" COEFFS 0.000000 1.000000 0.000000 0.000000 0.000000 1.000000 /end COMPU_METHOD
/* Scalar measurable for DDE 'LAM_NU_Lambda_B'. */
/begin MEASUREMENT LAM_NU_Lambda_B "Lambda value" FLOAT32_IEEE CU_LAM_NU_LAMBDA_B 1 100 0.0 0.0 ECU_ADDRESS 0x40003124 BYTE_ORDER MSB_FIRST /end MEASUREMENT
/begin COMPU_METHOD CU_LAM_NU_LAMBDA_B "Conversion method for LAM_NU_Lambda_B" RAT_FUNC "%10.3" "NU" COEFFS 0.000000 1.000000 0.000000 0.000000 0.000000 1.000000 /end COMPU_METHOD
/* Scalar measurable for DDE 'LAM_b_AmpFactorFlag_A'. */
/begin MEASUREMENT LAM_b_AmpFactorFlag_A "Amplification factor flag used to switch OE block" UBYTE CU_LAM_B_AMPFACTORFLAG_A 1 100 0.0 1.0 ECU_ADDRESS 0x40002e4a BYTE_ORDER MSB_FIRST /end MEASUREMENT
/begin COMPU_METHOD CU_LAM_B_AMPFACTORFLAG_A "Conversion method for LAM_b_AmpFactorFlag_A" RAT_FUNC "%10.0" "b" COEFFS 0.000000 1.000000 0.000000 0.000000 0.000000 1.000000 /end COMPU_METHOD
/* Scalar measurable for DDE 'LAM_b_AmpFactorFlag_B'. */
/begin MEASUREMENT LAM_b_AmpFactorFlag_B "Amplification factor flag used to switch OE block" UBYTE CU_LAM_B_AMPFACTORFLAG_B 1 100 0.0 1.0 ECU_ADDRESS 0x40002e5b BYTE_ORDER MSB_FIRST /end MEASUREMENT
/begin COMPU_METHOD CU_LAM_B_AMPFACTORFLAG_B "Conversion method for LAM_b_AmpFactorFlag_B" RAT_FUNC "%10.0" "b" COEFFS 0.000000 1.000000 0.000000 0.000000 0.000000 1.000000 /end COMPU_METHOD
/* Scalar measurable for DDE 'LAM_b_LambdaValidFlag_A'. */
/begin MEASUREMENT LAM_b_LambdaValidFlag_A "Flag to indicate the Lambda calculation is valid" UBYTE CU_LAM_B_LAMBDAVALIDFLAG_A 1 100 0.0 1.0 ECU_ADDRESS 0x40002e49 BYTE_ORDER MSB_FIRST /end MEASUREMENT
/begin COMPU_METHOD CU_LAM_B_LAMBDAVALIDFLAG_A "Conversion method for LAM_b_LambdaValidFlag_A" RAT_FUNC "%10.0" "b" COEFFS 0.000000 1.000000 0.000000 0.000000 0.000000 1.000000 /end COMPU_METHOD
/* Scalar measurable for DDE 'LAM_b_LambdaValidFlag_B'. */
/begin MEASUREMENT LAM_b_LambdaValidFlag_B "Flag to indicate the Lambda calculation is valid" UBYTE CU_LAM_B_LAMBDAVALIDFLAG_B 1 100 0.0 1.0 ECU_ADDRESS 0x40002e5a BYTE_ORDER MSB_FIRST /end MEASUREMENT
/begin COMPU_METHOD CU_LAM_B_LAMBDAVALIDFLAG_B "Conversion method for LAM_b_LambdaValidFlag_B" RAT_FUNC "%10.0" "b" COEFFS 0.000000 1.000000 0.000000 0.000000 0.000000 1.000000 /end COMPU_METHOD
/* Scalar measurable for DDE 'LAM_mA_Ip_A'. */
/begin MEASUREMENT LAM_mA_Ip_A "Pump cell current" FLOAT32_IEEE CU_LAM_MA_IP_A 1 100 0.0 0.0 ECU_ADDRESS 0x400030f8 BYTE_ORDER MSB_FIRST /end MEASUREMENT
/begin COMPU_METHOD CU_LAM_MA_IP_A "Conversion method for LAM_mA_Ip_A" RAT_FUNC "%10.3" "mA" COEFFS 0.000000 1.000000 0.000000 0.000000 0.000000 1.000000 /end COMPU_METHOD
/* Scalar measurable for DDE 'LAM_mA_Ip_B'. */
/begin MEASUREMENT LAM_mA_Ip_B "Pump cell current" FLOAT32_IEEE CU_LAM_MA_IP_B 1 100 0.0 0.0 ECU_ADDRESS 0x40003128 BYTE_ORDER MSB_FIRST /end MEASUREMENT
/begin COMPU_METHOD CU_LAM_MA_IP_B "Conversion method for LAM_mA_Ip_B" RAT_FUNC "%10.3" "mA" COEFFS 0.000000 1.000000 0.000000 0.000000 0.000000 1.000000 /end COMPU_METHOD
/* Scalar measurable for DDE 'LOG_NU_ManualPump'. */
/begin MEASUREMENT LOG_NU_ManualPump "Corrected Throttle Angle request output" ULONG CU_LOG_NU_MANUALPUMP 1 100 0.0 0.0 ECU_ADDRESS 0x40003058 BYTE_ORDER MSB_FIRST /end MEASUREMENT
/begin COMPU_METHOD CU_LOG_NU_MANUALPUMP "Conversion method for LOG_NU_ManualPump" RAT_FUNC "%10.0" "NU" COEFFS 0.000000 1.000000 0.000000 0.000000 0.000000 1.000000 /end COMPU_METHOD
/* Scalar measurable for DDE 'LOG_NU_TqCvLuEngg'. */
/begin MEASUREMENT LOG_NU_TqCvLuEngg "(not defined)" FLOAT32_IEEE CU_LOG_NU_TQCVLUENGG 1 100 0.0 0.0 ECU_ADDRESS 0x4000379c BYTE_ORDER MSB_FIRST /end MEASUREMENT
/begin COMPU_METHOD CU_LOG_NU_TQCVLUENGG "Conversion method for LOG_NU_TqCvLuEngg" RAT_FUNC "%10.0" "NU" COEFFS 0.000000 1.000000 0.000000 0.000000 0.000000 1.000000 /end COMPU_METHOD
/* Scalar measurable for DDE 'LOG_NU_TransDrvEngg'. */
/begin MEASUREMENT LOG_NU_TransDrvEngg "(not defined)" FLOAT32_IEEE CU_LOG_NU_TRANSDRVENGG 1 100 0.0 0.0 ECU_ADDRESS 0x400037a0 BYTE_ORDER MSB_FIRST /end MEASUREMENT
/begin COMPU_METHOD CU_LOG_NU_TRANSDRVENGG "Conversion method for LOG_NU_TransDrvEngg" RAT_FUNC "%10.0" "NU" COEFFS 0.000000 1.000000 0.000000 0.000000 0.000000 1.000000 /end COMPU_METHOD
/* Scalar measurable for DDE 'LOG_NU_TransShftPrcs'. */
/begin MEASUREMENT LOG_NU_TransShftPrcs "(not defined)" FLOAT32_IEEE CU_LOG_NU_TRANSSHFTPRCS 1 100 0.0 0.0 ECU_ADDRESS 0x40003798 BYTE_ORDER MSB_FIRST /end MEASUREMENT
/begin COMPU_METHOD CU_LOG_NU_TRANSSHFTPRCS "Conversion method for LOG_NU_TransShftPrcs" RAT_FUNC "%10.0" "NU" COEFFS 0.000000 1.000000 0.000000 0.000000 0.000000 1.000000 /end COMPU_METHOD
/* Scalar measurable for DDE 'LOG_PWM_BLOWER'. */
/begin MEASUREMENT LOG_PWM_BLOWER "Displayable" FLOAT32_IEEE CU_LOG_PWM_BLOWER 1 100 0.0 1.0 ECU_ADDRESS 0x400036a4 BYTE_ORDER MSB_FIRST /end MEASUREMENT
/begin COMPU_METHOD CU_LOG_PWM_BLOWER "Conversion method for LOG_PWM_BLOWER" RAT_FUNC "%10.2" "V" COEFFS 0.000000 1.000000 0.000000 0.000000 0.000000 1.000000 /end COMPU_METHOD
/* Scalar measurable for DDE 'LOG_PWM_PUMP'. */
/begin MEASUREMENT LOG_PWM_PUMP "Displayable" FLOAT32_IEEE CU_LOG_PWM_PUMP 1 100 0.0 1.0 ECU_ADDRESS 0x400036a8 BYTE_ORDER MSB_FIRST /end MEASUREMENT
/begin COMPU_METHOD CU_LOG_PWM_PUMP "Conversion method for LOG_PWM_PUMP" RAT_FUNC "%10.2" "V" COEFFS 0.000000 1.000000 0.000000 0.000000 0.000000 1.000000 /end COMPU_METHOD
/* Scalar measurable for DDE 'LOG_b_EC1_state'. */
/begin MEASUREMENT LOG_b_EC1_state "(not defined)" UBYTE CU_LOG_B_EC1_STATE 1 100 0.0 1.0 ECU_ADDRESS 0x40002e7c BYTE_ORDER MSB_FIRST /end MEASUREMENT
/begin COMPU_METHOD CU_LOG_B_EC1_STATE "Conversion method for LOG_b_EC1_state" RAT_FUNC "%10.0" "b" COEFFS 0.000000 1.000000 0.000000 0.000000 0.000000 1.000000 /end COMPU_METHOD
/* Scalar measurable for DDE 'LOG_b_ENBOBD'. */
/begin MEASUREMENT LOG_b_ENBOBD "Displayable" UBYTE CU_LOG_B_ENBOBD 1 100 0.0 1.0 ECU_ADDRESS 0x40002f34 BYTE_ORDER MSB_FIRST /end MEASUREMENT
/begin COMPU_METHOD CU_LOG_B_ENBOBD "Conversion method for LOG_b_ENBOBD" RAT_FUNC "%10.0" "b" COEFFS 0.000000 1.000000 0.000000 0.000000 0.000000 1.000000 /end COMPU_METHOD
/* Scalar measurable for DDE 'LOG_b_RelePump1'. */
/begin MEASUREMENT LOG_b_RelePump1 "(not defined)" UBYTE CU_LOG_B_RELEPUMP1 1 100 0.0 1.0 ECU_ADDRESS 0x40002f22 BYTE_ORDER MSB_FIRST /end MEASUREMENT
/begin COMPU_METHOD CU_LOG_B_RELEPUMP1 "Conversion method for LOG_b_RelePump1" RAT_FUNC "%10.0" "b" COEFFS 0.000000 1.000000 0.000000 0.000000 0.000000 1.000000 /end COMPU_METHOD
/* Scalar measurable for DDE 'LOG_b_RelePump2'. */
/begin MEASUREMENT LOG_b_RelePump2 "(not defined)" UBYTE CU_LOG_B_RELEPUMP2 1 100 0.0 1.0 ECU_ADDRESS 0x40002f21 BYTE_ORDER MSB_FIRST /end MEASUREMENT
/begin COMPU_METHOD CU_LOG_B_RELEPUMP2 "Conversion method for LOG_b_RelePump2" RAT_FUNC "%10.0" "b" COEFFS 0.000000 1.000000 0.000000 0.000000 0.000000 1.000000 /end COMPU_METHOD
/* Scalar measurable for DDE 'LOG_b_ZF_Auto'. */
/begin MEASUREMENT LOG_b_ZF_Auto "(not defined)" UBYTE CU_LOG_B_ZF_AUTO 1 100 0.0 1.0 ECU_ADDRESS 0x40002e8e BYTE_ORDER MSB_FIRST /end MEASUREMENT
/begin COMPU_METHOD CU_LOG_B_ZF_AUTO "Conversion method for LOG_b_ZF_Auto" RAT_FUNC "%10.0" "b" COEFFS 0.000000 1.000000 0.000000 0.000000 0.000000 1.000000 /end COMPU_METHOD
/* Scalar measurable for DDE 'LOG_pct_PercentClutchSlip'. */
/begin MEASUREMENT LOG_pct_PercentClutchSlip "Displayable" FLOAT32_IEEE CU_LOG_PCT_PERCENTCLUTCHSLIP 1 100 0.0 0.0 ECU_ADDRESS 0x40003794 BYTE_ORDER MSB_FIRST /end MEASUREMENT
/begin COMPU_METHOD CU_LOG_PCT_PERCENTCLUTCHSLIP "Conversion method for LOG_pct_PercentClutchSlip" RAT_FUNC "%10.0" "pct" COEFFS 0.000000 1.000000 0.000000 0.000000 0.000000 1.000000 /end COMPU_METHOD
/* Scalar measurable for DDE 'LOG_s_EC1_counter'. */
/begin MEASUREMENT LOG_s_EC1_counter "(not defined)" FLOAT32_IEEE CU_LOG_S_EC1_COUNTER 1 100 0.0 0.0 ECU_ADDRESS 0x40003164 BYTE_ORDER MSB_FIRST /end MEASUREMENT
/begin COMPU_METHOD CU_LOG_S_EC1_COUNTER "Conversion method for LOG_s_EC1_counter" RAT_FUNC "%10.1" "s" COEFFS 0.000000 1.000000 0.000000 0.000000 0.000000 1.000000 /end COMPU_METHOD
/* Scalar measurable for DDE 'Log_b_TPDT1'. */
/begin MEASUREMENT Log_b_TPDT1 "Displayable- global fault management control signal, sent to each FBM" UBYTE CU_LOG_B_TPDT1 1 100 0.0 1.0 ECU_ADDRESS 0x40002e7a BYTE_ORDER MSB_FIRST /end MEASUREMENT
/begin COMPU_METHOD CU_LOG_B_TPDT1 "Conversion method for Log_b_TPDT1" RAT_FUNC "%10.0" "b" COEFFS 0.000000 1.000000 0.000000 0.000000 0.000000 1.000000 /end COMPU_METHOD
/* Scalar measurable for DDE 'Log_b_TPDT2'. */
/begin MEASUREMENT Log_b_TPDT2 "Displayable- global fault management control signal, sent to each FBM" UBYTE CU_LOG_B_TPDT2 1 100 0.0 1.0 ECU_ADDRESS 0x40002e79 BYTE_ORDER MSB_FIRST /end MEASUREMENT
/begin COMPU_METHOD CU_LOG_B_TPDT2 "Conversion method for Log_b_TPDT2" RAT_FUNC "%10.0" "b" COEFFS 0.000000 1.000000 0.000000 0.000000 0.000000 1.000000 /end COMPU_METHOD
/* Scalar measurable for DDE 'Log_b_TPDT3'. */
/begin MEASUREMENT Log_b_TPDT3 "Displayable- global fault management control signal, sent to each FBM" UBYTE CU_LOG_B_TPDT3 1 100 0.0 1.0 ECU_ADDRESS 0x40002e78 BYTE_ORDER MSB_FIRST /end MEASUREMENT
/begin COMPU_METHOD CU_LOG_B_TPDT3 "Conversion method for Log_b_TPDT3" RAT_FUNC "%10.0" "b" COEFFS 0.000000 1.000000 0.000000 0.000000 0.000000 1.000000 /end COMPU_METHOD
/* Scalar measurable for DDE 'Log_b_TPDT4'. */
/begin MEASUREMENT Log_b_TPDT4 "Displayable- global fault management control signal, sent to each FBM" UBYTE CU_LOG_B_TPDT4 1 100 0.0 1.0 ECU_ADDRESS 0x40002e77 BYTE_ORDER MSB_FIRST /end MEASUREMENT
/begin COMPU_METHOD CU_LOG_B_TPDT4 "Conversion method for Log_b_TPDT4" RAT_FUNC "%10.0" "b" COEFFS 0.000000 1.000000 0.000000 0.000000 0.000000 1.000000 /end COMPU_METHOD
/* Scalar measurable for DDE 'Log_b_TPDT5'. */
/begin MEASUREMENT Log_b_TPDT5 "Displayable- global fault management control signal, sent to each FBM" UBYTE CU_LOG_B_TPDT5 1 100 0.0 1.0 ECU_ADDRESS 0x40002e76 BYTE_ORDER MSB_FIRST /end MEASUREMENT
/begin COMPU_METHOD CU_LOG_B_TPDT5 "Conversion method for Log_b_TPDT5" RAT_FUNC "%10.0" "b" COEFFS 0.000000 1.000000 0.000000 0.000000 0.000000 1.000000 /end COMPU_METHOD
/* Scalar measurable for DDE 'Log_b_TPDT6'. */
/begin MEASUREMENT Log_b_TPDT6 "Displayable- global fault management control signal, sent to each FBM" UBYTE CU_LOG_B_TPDT6 1 100 0.0 1.0 ECU_ADDRESS 0x40002e75 BYTE_ORDER MSB_FIRST /end MEASUREMENT
/begin COMPU_METHOD CU_LOG_B_TPDT6 "Conversion method for Log_b_TPDT6" RAT_FUNC "%10.0" "b" COEFFS 0.000000 1.000000 0.000000 0.000000 0.000000 1.000000 /end COMPU_METHOD
/* Scalar measurable for DDE 'NVM_NU_EngRunTime'. */
/begin MEASUREMENT NVM_NU_EngRunTime "(not defined)" FLOAT32_IEEE CU_NVM_NU_ENGRUNTIME 1 100 0.0 4294967295.0 ECU_ADDRESS 0x4000366c BYTE_ORDER MSB_FIRST /end MEASUREMENT
/begin COMPU_METHOD CU_NVM_NU_ENGRUNTIME "Conversion method for NVM_NU_EngRunTime" RAT_FUNC "%10.2" "s" COEFFS 0.000000 1.000000 0.000000 0.000000 0.000000 1.000000 /end COMPU_METHOD
/* Scalar measurable for DDE 'OUT_C_FAN_ZF'. */
/begin MEASUREMENT OUT_C_FAN_ZF "Displayable" FLOAT32_IEEE CU_OUT_C_FAN_ZF 1 100 0.0 0.0 ECU_ADDRESS 0x40003578 BYTE_ORDER MSB_FIRST /end MEASUREMENT
/begin COMPU_METHOD CU_OUT_C_FAN_ZF "Conversion method for OUT_C_FAN_ZF" RAT_FUNC "%10.3" "NU" COEFFS 0.000000 1.000000 0.000000 0.000000 0.000000 1.000000 /end COMPU_METHOD
/* Scalar measurable for DDE 'OUT_Hz_EngSpd'. */
/begin MEASUREMENT OUT_Hz_EngSpd "(not defined)" FLOAT32_IEEE CU_OUT_HZ_ENGSPD 1 100 0.0 0.0 ECU_ADDRESS 0x400036ac BYTE_ORDER MSB_FIRST /end MEASUREMENT
/begin COMPU_METHOD CU_OUT_HZ_ENGSPD "Conversion method for OUT_Hz_EngSpd" RAT_FUNC "%10.4" "Hz" COEFFS 0.000000 1.000000 0.000000 0.000000 0.000000 1.000000 /end COMPU_METHOD
/* Scalar measurable for DDE 'OUT_Hz_FreqUEGOA'. */
/begin MEASUREMENT OUT_Hz_FreqUEGOA "Displayable" FLOAT32_IEEE CU_OUT_HZ_FREQUEGOA 1 100 0.0 10000.0 ECU_ADDRESS 0x400038b4 BYTE_ORDER MSB_FIRST /end MEASUREMENT
/begin COMPU_METHOD CU_OUT_HZ_FREQUEGOA "Conversion method for OUT_Hz_FreqUEGOA" RAT_FUNC "%10.0" "Hz" COEFFS 0.000000 1.000000 0.000000 0.000000 0.000000 1.000000 /end COMPU_METHOD
/* Scalar measurable for DDE 'OUT_Hz_VhSpd'. */
/begin MEASUREMENT OUT_Hz_VhSpd "(not defined)" FLOAT32_IEEE CU_OUT_HZ_VHSPD 1 100 0.0 0.0 ECU_ADDRESS 0x400036b0 BYTE_ORDER MSB_FIRST /end MEASUREMENT
/begin COMPU_METHOD CU_OUT_HZ_VHSPD "Conversion method for OUT_Hz_VhSpd" RAT_FUNC "%10.4" "Hz" COEFFS 0.000000 1.000000 0.000000 0.000000 0.000000 1.000000 /end COMPU_METHOD
/* Scalar measurable for DDE 'OUT_NU_BankA_Faults'. */
/begin MEASUREMENT OUT_NU_BankA_Faults "Fault status bits" UBYTE CU_OUT_NU_BANKA_FAULTS 1 100 0.0 0.0 ECU_ADDRESS 0x4000301d BYTE_ORDER MSB_FIRST /end MEASUREMENT
/begin COMPU_METHOD CU_OUT_NU_BANKA_FAULTS "Conversion method for OUT_NU_BankA_Faults" RAT_FUNC "%10.0" "NU" COEFFS 0.000000 1.000000 0.000000 0.000000 0.000000 1.000000 /end COMPU_METHOD
/* Scalar measurable for DDE 'OUT_NU_DM19CVN'. */
/begin MEASUREMENT OUT_NU_DM19CVN "Fuel Pump PWM signal frequency" ULONG CU_OUT_NU_DM19CVN 1 100 0.0 4294967295.0 ECU_ADDRESS 0x40003054 BYTE_ORDER MSB_FIRST /end MEASUREMENT
/begin COMPU_METHOD CU_OUT_NU_DM19CVN "Conversion method for OUT_NU_DM19CVN" RAT_FUNC "%10.0" "NU" COEFFS 0.000000 1.000000 0.000000 0.000000 0.000000 1.000000 /end COMPU_METHOD
/* Scalar measurable for DDE 'OUT_NU_FCV_Faults'. */
/begin MEASUREMENT OUT_NU_FCV_Faults "Fault status bits" UBYTE CU_OUT_NU_FCV_FAULTS 1 100 0.0 0.0 ECU_ADDRESS 0x40003016 BYTE_ORDER MSB_FIRST /end MEASUREMENT
/begin COMPU_METHOD CU_OUT_NU_FCV_FAULTS "Conversion method for OUT_NU_FCV_Faults" RAT_FUNC "%10.0" "NU" COEFFS 0.000000 1.000000 0.000000 0.000000 0.000000 1.000000 /end COMPU_METHOD
/* Scalar measurable for DDE 'OUT_NU_INJ_A1_Faults'. */
/begin MEASUREMENT OUT_NU_INJ_A1_Faults "Fault status bits" UBYTE CU_OUT_NU_INJ_A1_FAULTS 1 100 0.0 0.0 ECU_ADDRESS 0x4000301c BYTE_ORDER MSB_FIRST /end MEASUREMENT
/begin COMPU_METHOD CU_OUT_NU_INJ_A1_FAULTS "Conversion method for OUT_NU_INJ_A1_Faults" RAT_FUNC "%10.0" "NU" COEFFS 0.000000 1.000000 0.000000 0.000000 0.000000 1.000000 /end COMPU_METHOD
/* Scalar measurable for DDE 'OUT_NU_INJ_A2_Faults'. */
/begin MEASUREMENT OUT_NU_INJ_A2_Faults "Fault status bits" UBYTE CU_OUT_NU_INJ_A2_FAULTS 1 100 0.0 0.0 ECU_ADDRESS 0x4000301b BYTE_ORDER MSB_FIRST /end MEASUREMENT
/begin COMPU_METHOD CU_OUT_NU_INJ_A2_FAULTS "Conversion method for OUT_NU_INJ_A2_Faults" RAT_FUNC "%10.0" "NU" COEFFS 0.000000 1.000000 0.000000 0.000000 0.000000 1.000000 /end COMPU_METHOD
/* Scalar measurable for DDE 'OUT_NU_INJ_A3_Faults'. */
/begin MEASUREMENT OUT_NU_INJ_A3_Faults "Fault status bits" UBYTE CU_OUT_NU_INJ_A3_FAULTS 1 100 0.0 0.0 ECU_ADDRESS 0x40003019 BYTE_ORDER MSB_FIRST /end MEASUREMENT
/begin COMPU_METHOD CU_OUT_NU_INJ_A3_FAULTS "Conversion method for OUT_NU_INJ_A3_Faults" RAT_FUNC "%10.0" "NU" COEFFS 0.000000 1.000000 0.000000 0.000000 0.000000 1.000000 /end COMPU_METHOD
/* Scalar measurable for DDE 'OUT_NU_INJ_A4_Faults'. */
/begin MEASUREMENT OUT_NU_INJ_A4_Faults "Fault status bits" UBYTE CU_OUT_NU_INJ_A4_FAULTS 1 100 0.0 0.0 ECU_ADDRESS 0x4000301a BYTE_ORDER MSB_FIRST /end MEASUREMENT
/begin COMPU_METHOD CU_OUT_NU_INJ_A4_FAULTS "Conversion method for OUT_NU_INJ_A4_Faults" RAT_FUNC "%10.0" "NU" COEFFS 0.000000 1.000000 0.000000 0.000000 0.000000 1.000000 /end COMPU_METHOD
/* Scalar measurable for DDE 'OUT_b_18F00000_ena'. */
/begin MEASUREMENT OUT_b_18F00000_ena "Value of enable ERC1 msg @ 250ms" UBYTE CU_OUT_B_18F00000_ENA 1 100 0.0 1.0 ECU_ADDRESS 0x40002e85 BYTE_ORDER MSB_FIRST /end MEASUREMENT
/begin COMPU_METHOD CU_OUT_B_18F00000_ENA "Conversion method for OUT_b_18F00000_ena" RAT_FUNC "%10.0" "NU" COEFFS 0.000000 1.000000 0.000000 0.000000 0.000000 1.000000 /end COMPU_METHOD
/* Scalar measurable for DDE 'OUT_b_18F0010B_ena'. */
/begin MEASUREMENT OUT_b_18F0010B_ena "Value of enable EBC1 msg" UBYTE CU_OUT_B_18F0010B_ENA 1 100 0.0 1.0 ECU_ADDRESS 0x40002e8b BYTE_ORDER MSB_FIRST /end MEASUREMENT
/begin COMPU_METHOD CU_OUT_B_18F0010B_ENA "Conversion method for OUT_b_18F0010B_ena" RAT_FUNC "%10.0" "NU" COEFFS 0.000000 1.000000 0.000000 0.000000 0.000000 1.000000 /end COMPU_METHOD
/* Scalar measurable for DDE 'OUT_b_18FDC40B_ena'. */
/begin MEASUREMENT OUT_b_18FDC40B_ena "Value of enable EBC5 msg @ 100ms" UBYTE CU_OUT_B_18FDC40B_ENA 1 100 0.0 1.0 ECU_ADDRESS 0x40002e8a BYTE_ORDER MSB_FIRST /end MEASUREMENT
/begin COMPU_METHOD CU_OUT_B_18FDC40B_ENA "Conversion method for OUT_b_18FDC40B_ena" RAT_FUNC "%10.0" "NU" COEFFS 0.000000 1.000000 0.000000 0.000000 0.000000 1.000000 /end COMPU_METHOD
/* Scalar measurable for DDE 'OUT_b_18FE6E00_ena'. */
/begin MEASUREMENT OUT_b_18FE6E00_ena "Value of enable HRW msg @ 20ms" UBYTE CU_OUT_B_18FE6E00_ENA 1 100 0.0 1.0 ECU_ADDRESS 0x40002e88 BYTE_ORDER MSB_FIRST /end MEASUREMENT
/begin COMPU_METHOD CU_OUT_B_18FE6E00_ENA "Conversion method for OUT_b_18FE6E00_ena" RAT_FUNC "%10.0" "NU" COEFFS 0.000000 1.000000 0.000000 0.000000 0.000000 1.000000 /end COMPU_METHOD
/* Scalar measurable for DDE 'OUT_b_18FEE100_ena'. */
/begin MEASUREMENT OUT_b_18FEE100_ena "Value of enable FEE1 msg @ 250ms" UBYTE CU_OUT_B_18FEE100_ENA 1 100 0.0 1.0 ECU_ADDRESS 0x40002e84 BYTE_ORDER MSB_FIRST /end MEASUREMENT
/begin COMPU_METHOD CU_OUT_B_18FEE100_ENA "Conversion method for OUT_b_18FEE100_ena" RAT_FUNC "%10.0" "NU" COEFFS 0.000000 1.000000 0.000000 0.000000 0.000000 1.000000 /end COMPU_METHOD
/* Scalar measurable for DDE 'OUT_b_18FEE600_ena'. */
/begin MEASUREMENT OUT_b_18FEE600_ena "Value of enable FEE6 msg @ 1000ms" UBYTE CU_OUT_B_18FEE600_ENA 1 100 0.0 1.0 ECU_ADDRESS 0x40002e86 BYTE_ORDER MSB_FIRST /end MEASUREMENT
/begin COMPU_METHOD CU_OUT_B_18FEE600_ENA "Conversion method for OUT_b_18FEE600_ena" RAT_FUNC "%10.0" "NU" COEFFS 0.000000 1.000000 0.000000 0.000000 0.000000 1.000000 /end COMPU_METHOD
/* Scalar measurable for DDE 'OUT_b_18FEEE00_ena'. */
/begin MEASUREMENT OUT_b_18FEEE00_ena "Value of enable FEEE msg @ 1000ms" UBYTE CU_OUT_B_18FEEE00_ENA 1 100 0.0 1.0 ECU_ADDRESS 0x40002e89 BYTE_ORDER MSB_FIRST /end MEASUREMENT
/begin COMPU_METHOD CU_OUT_B_18FEEE00_ENA "Conversion method for OUT_b_18FEEE00_ena" RAT_FUNC "%10.0" "NU" COEFFS 0.000000 1.000000 0.000000 0.000000 0.000000 1.000000 /end COMPU_METHOD
/* Scalar measurable for DDE 'OUT_b_24V_WarmupA'. */
/begin MEASUREMENT OUT_b_24V_WarmupA "displayable" UBYTE CU_OUT_B_24V_WARMUPA 1 100 0.0 1.0 ECU_ADDRESS 0x40002f9a BYTE_ORDER MSB_FIRST /end MEASUREMENT
/begin COMPU_METHOD CU_OUT_B_24V_WARMUPA "Conversion method for OUT_b_24V_WarmupA" RAT_FUNC "%10.0" "b" COEFFS 0.000000 1.000000 0.000000 0.000000 0.000000 1.000000 /end COMPU_METHOD
/* Scalar measurable for DDE 'OUT_b_BCM_ZF_ena'. */
/begin MEASUREMENT OUT_b_BCM_ZF_ena "Value of enable BCM" UBYTE CU_OUT_B_BCM_ZF_ENA 1 100 0.0 1.0 ECU_ADDRESS 0x40002e8c BYTE_ORDER MSB_FIRST /end MEASUREMENT
/begin COMPU_METHOD CU_OUT_B_BCM_ZF_ENA "Conversion method for OUT_b_BCM_ZF_ena" RAT_FUNC "%10.0" "NU" COEFFS 0.000000 1.000000 0.000000 0.000000 0.000000 1.000000 /end COMPU_METHOD
/* Scalar measurable for DDE 'OUT_b_BCM_ena'. */
/begin MEASUREMENT OUT_b_BCM_ena "Value of enable BCM" UBYTE CU_OUT_B_BCM_ENA 1 100 0.0 1.0 ECU_ADDRESS 0x40002e8d BYTE_ORDER MSB_FIRST /end MEASUREMENT
/begin COMPU_METHOD CU_OUT_B_BCM_ENA "Conversion method for OUT_b_BCM_ena" RAT_FUNC "%10.0" "NU" COEFFS 0.000000 1.000000 0.000000 0.000000 0.000000 1.000000 /end COMPU_METHOD
/* Scalar measurable for DDE 'OUT_b_BankA_Enbld'. */
/begin MEASUREMENT OUT_b_BankA_Enbld "Injections will not occur until this is enabled" UBYTE CU_OUT_B_BANKA_ENBLD 1 100 0.0 1.0 ECU_ADDRESS 0x40002f1d BYTE_ORDER MSB_FIRST /end MEASUREMENT
/begin COMPU_METHOD CU_OUT_B_BANKA_ENBLD "Conversion method for OUT_b_BankA_Enbld" RAT_FUNC "%10.0" "b" COEFFS 0.000000 1.000000 0.000000 0.000000 0.000000 1.000000 /end COMPU_METHOD
/* Scalar measurable for DDE 'OUT_b_BankB_Enbld'. */
/begin MEASUREMENT OUT_b_BankB_Enbld "Injections will not occur until this is enabled" UBYTE CU_OUT_B_BANKB_ENBLD 1 100 0.0 1.0 ECU_ADDRESS 0x40002f1c BYTE_ORDER MSB_FIRST /end MEASUREMENT
/begin COMPU_METHOD CU_OUT_B_BANKB_ENBLD "Conversion method for OUT_b_BankB_Enbld" RAT_FUNC "%10.0" "b" COEFFS 0.000000 1.000000 0.000000 0.000000 0.000000 1.000000 /end COMPU_METHOD
/* Scalar measurable for DDE 'OUT_b_CombustionAllCyls'. */
/begin MEASUREMENT OUT_b_CombustionAllCyls "Displayable" UBYTE CU_OUT_B_COMBUSTIONALLCYLS 1 100 0.0 1.0 ECU_ADDRESS 0x40002f0b BYTE_ORDER MSB_FIRST /end MEASUREMENT
/begin COMPU_METHOD CU_OUT_B_COMBUSTIONALLCYLS "Conversion method for OUT_b_CombustionAllCyls" RAT_FUNC "%10.0" "b" COEFFS 0.000000 1.000000 0.000000 0.000000 0.000000 1.000000 /end COMPU_METHOD
/* Scalar measurable for DDE 'OUT_b_DM19Request'. */
/begin MEASUREMENT OUT_b_DM19Request "ZF Fan" UBYTE CU_OUT_B_DM19REQUEST 1 100 0.0 1.0 ECU_ADDRESS 0x40002f09 BYTE_ORDER MSB_FIRST /end MEASUREMENT
/begin COMPU_METHOD CU_OUT_B_DM19REQUEST "Conversion method for OUT_b_DM19Request" RAT_FUNC "%10.0" "b" COEFFS 0.000000 1.000000 0.000000 0.000000 0.000000 1.000000 /end COMPU_METHOD
/* Scalar measurable for DDE 'OUT_b_FCV_OC'. */
/begin MEASUREMENT OUT_b_FCV_OC "Output overcurrent trip flag" UBYTE CU_OUT_B_FCV_OC 1 100 0.0 1.0 ECU_ADDRESS 0x40002f50 BYTE_ORDER MSB_FIRST /end MEASUREMENT
/begin COMPU_METHOD CU_OUT_B_FCV_OC "Conversion method for OUT_b_FCV_OC" RAT_FUNC "%10.0" "b" COEFFS 0.000000 1.000000 0.000000 0.000000 0.000000 1.000000 /end COMPU_METHOD
/* Scalar measurable for DDE 'OUT_b_FlashChecksum'. */
/begin MEASUREMENT OUT_b_FlashChecksum "Displayable" UBYTE CU_OUT_B_FLASHCHECKSUM 1 100 0.0 1.0 ECU_ADDRESS 0x40002f23 BYTE_ORDER MSB_FIRST /end MEASUREMENT
/begin COMPU_METHOD CU_OUT_B_FLASHCHECKSUM "Conversion method for OUT_b_FlashChecksum" RAT_FUNC "%10.0" "b" COEFFS 0.000000 1.000000 0.000000 0.000000 0.000000 1.000000 /end COMPU_METHOD
/* Scalar measurable for DDE 'OUT_b_HEGO11_Heater_OC'. */
/begin MEASUREMENT OUT_b_HEGO11_Heater_OC "Output overcurrent trip flag" UBYTE CU_OUT_B_HEGO11_HEATER_OC 1 100 0.0 1.0 ECU_ADDRESS 0x40002f4f BYTE_ORDER MSB_FIRST /end MEASUREMENT
/begin COMPU_METHOD CU_OUT_B_HEGO11_HEATER_OC "Conversion method for OUT_b_HEGO11_Heater_OC" RAT_FUNC "%10.0" "b" COEFFS 0.000000 1.000000 0.000000 0.000000 0.000000 1.000000 /end COMPU_METHOD
/* Scalar measurable for DDE 'OUT_b_HEGO12_Heater_OC'. */
/begin MEASUREMENT OUT_b_HEGO12_Heater_OC "Output overcurrent trip flag" UBYTE CU_OUT_B_HEGO12_HEATER_OC 1 100 0.0 1.0 ECU_ADDRESS 0x40002f4d BYTE_ORDER MSB_FIRST /end MEASUREMENT
/begin COMPU_METHOD CU_OUT_B_HEGO12_HEATER_OC "Conversion method for OUT_b_HEGO12_Heater_OC" RAT_FUNC "%10.0" "b" COEFFS 0.000000 1.000000 0.000000 0.000000 0.000000 1.000000 /end COMPU_METHOD
/* Scalar measurable for DDE 'OUT_b_HEGO21_Heater_OC'. */
/begin MEASUREMENT OUT_b_HEGO21_Heater_OC "Output overcurrent trip flag" UBYTE CU_OUT_B_HEGO21_HEATER_OC 1 100 0.0 1.0 ECU_ADDRESS 0x40002f4e BYTE_ORDER MSB_FIRST /end MEASUREMENT
/begin COMPU_METHOD CU_OUT_B_HEGO21_HEATER_OC "Conversion method for OUT_b_HEGO21_Heater_OC" RAT_FUNC "%10.0" "b" COEFFS 0.000000 1.000000 0.000000 0.000000 0.000000 1.000000 /end COMPU_METHOD
/* Scalar measurable for DDE 'OUT_b_HighsideY1'. */
/begin MEASUREMENT OUT_b_HighsideY1 "Displayable" UBYTE CU_OUT_B_HIGHSIDEY1 1 100 0.0 1.0 ECU_ADDRESS 0x40002f11 BYTE_ORDER MSB_FIRST /end MEASUREMENT
/begin COMPU_METHOD CU_OUT_B_HIGHSIDEY1 "Conversion method for OUT_b_HighsideY1" RAT_FUNC "%10.0" "b" COEFFS 0.000000 1.000000 0.000000 0.000000 0.000000 1.000000 /end COMPU_METHOD
/* Scalar measurable for DDE 'OUT_b_HighsideY5'. */
/begin MEASUREMENT OUT_b_HighsideY5 "Displayable" UBYTE CU_OUT_B_HIGHSIDEY5 1 100 0.0 1.0 ECU_ADDRESS 0x40002f12 BYTE_ORDER MSB_FIRST /end MEASUREMENT
/begin COMPU_METHOD CU_OUT_B_HIGHSIDEY5 "Conversion method for OUT_b_HighsideY5" RAT_FUNC "%10.0" "b" COEFFS 0.000000 1.000000 0.000000 0.000000 0.000000 1.000000 /end COMPU_METHOD
/* Scalar measurable for DDE 'OUT_b_Inj1_LSD_Active'. */
/begin MEASUREMENT OUT_b_Inj1_LSD_Active "Displayable" UBYTE CU_OUT_B_INJ1_LSD_ACTIVE 1 100 0.0 1.0 ECU_ADDRESS 0x40002f17 BYTE_ORDER MSB_FIRST /end MEASUREMENT
/begin COMPU_METHOD CU_OUT_B_INJ1_LSD_ACTIVE "Conversion method for OUT_b_Inj1_LSD_Active" RAT_FUNC "%10.0" "b" COEFFS 0.000000 1.000000 0.000000 0.000000 0.000000 1.000000 /end COMPU_METHOD
/* Scalar measurable for DDE 'OUT_b_Inj2_LSD_Active'. */
/begin MEASUREMENT OUT_b_Inj2_LSD_Active "Displayable" UBYTE CU_OUT_B_INJ2_LSD_ACTIVE 1 100 0.0 1.0 ECU_ADDRESS 0x40002f16 BYTE_ORDER MSB_FIRST /end MEASUREMENT
/begin COMPU_METHOD CU_OUT_B_INJ2_LSD_ACTIVE "Conversion method for OUT_b_Inj2_LSD_Active" RAT_FUNC "%10.0" "b" COEFFS 0.000000 1.000000 0.000000 0.000000 0.000000 1.000000 /end COMPU_METHOD
/* Scalar measurable for DDE 'OUT_b_Inj3_LSD_Active'. */
/begin MEASUREMENT OUT_b_Inj3_LSD_Active "Displayable" UBYTE CU_OUT_B_INJ3_LSD_ACTIVE 1 100 0.0 1.0 ECU_ADDRESS 0x40002f15 BYTE_ORDER MSB_FIRST /end MEASUREMENT
/begin COMPU_METHOD CU_OUT_B_INJ3_LSD_ACTIVE "Conversion method for OUT_b_Inj3_LSD_Active" RAT_FUNC "%10.0" "b" COEFFS 0.000000 1.000000 0.000000 0.000000 0.000000 1.000000 /end COMPU_METHOD
/* Scalar measurable for DDE 'OUT_b_Inj4_LSD_Active'. */
/begin MEASUREMENT OUT_b_Inj4_LSD_Active "Displayable" UBYTE CU_OUT_B_INJ4_LSD_ACTIVE 1 100 0.0 1.0 ECU_ADDRESS 0x40002f14 BYTE_ORDER MSB_FIRST /end MEASUREMENT
/begin COMPU_METHOD CU_OUT_B_INJ4_LSD_ACTIVE "Conversion method for OUT_b_Inj4_LSD_Active" RAT_FUNC "%10.0" "b" COEFFS 0.000000 1.000000 0.000000 0.000000 0.000000 1.000000 /end COMPU_METHOD
/* Scalar measurable for DDE 'OUT_b_InjHighsideOC'. */
/begin MEASUREMENT OUT_b_InjHighsideOC "Injector highside overcurrent trip flag" UBYTE CU_OUT_B_INJHIGHSIDEOC 1 100 0.0 1.0 ECU_ADDRESS 0x40002f51 BYTE_ORDER MSB_FIRST /end MEASUREMENT
/begin COMPU_METHOD CU_OUT_B_INJHIGHSIDEOC "Conversion method for OUT_b_InjHighsideOC" RAT_FUNC "%10.0" "b" COEFFS 0.000000 1.000000 0.000000 0.000000 0.000000 1.000000 /end COMPU_METHOD
/* Scalar measurable for DDE 'OUT_b_MIL_LED'. */
/begin MEASUREMENT OUT_b_MIL_LED "MIL Led" UBYTE CU_OUT_B_MIL_LED 1 100 0.0 1.0 ECU_ADDRESS 0x40002f2c BYTE_ORDER MSB_FIRST /end MEASUREMENT
/begin COMPU_METHOD CU_OUT_B_MIL_LED "Conversion method for OUT_b_MIL_LED" RAT_FUNC "%10.0" "b" COEFFS 0.000000 1.000000 0.000000 0.000000 0.000000 1.000000 /end COMPU_METHOD
/* Scalar measurable for DDE 'OUT_b_PT_Relay'. */
/begin MEASUREMENT OUT_b_PT_Relay "Displayable" UBYTE CU_OUT_B_PT_RELAY 1 100 0.0 1.0 ECU_ADDRESS 0x40002f13 BYTE_ORDER MSB_FIRST /end MEASUREMENT
/begin COMPU_METHOD CU_OUT_B_PT_RELAY "Conversion method for OUT_b_PT_Relay" RAT_FUNC "%10.0" "b" COEFFS 0.000000 1.000000 0.000000 0.000000 0.000000 1.000000 /end COMPU_METHOD
/* Scalar measurable for DDE 'OUT_b_PT_RelayEnergized'. */
/begin MEASUREMENT OUT_b_PT_RelayEnergized "Status reported to the rest of the system" UBYTE CU_OUT_B_PT_RELAYENERGIZED 1 100 0.0 1.0 ECU_ADDRESS 0x40002f0c BYTE_ORDER MSB_FIRST /end MEASUREMENT
/begin COMPU_METHOD CU_OUT_B_PT_RELAYENERGIZED "Conversion method for OUT_b_PT_RelayEnergized" RAT_FUNC "%10.0" "b" COEFFS 0.000000 1.000000 0.000000 0.000000 0.000000 1.000000 /end COMPU_METHOD
/* Scalar measurable for DDE 'OUT_b_RAM_Checksum'. */
/begin MEASUREMENT OUT_b_RAM_Checksum "Displayable" UBYTE CU_OUT_B_RAM_CHECKSUM 1 100 0.0 1.0 ECU_ADDRESS 0x40002f24 BYTE_ORDER MSB_FIRST /end MEASUREMENT
/begin COMPU_METHOD CU_OUT_B_RAM_CHECKSUM "Conversion method for OUT_b_RAM_Checksum" RAT_FUNC "%10.0" "b" COEFFS 0.000000 1.000000 0.000000 0.000000 0.000000 1.000000 /end COMPU_METHOD
/* Scalar measurable for DDE 'OUT_b_Spk1_Active'. */
/begin MEASUREMENT OUT_b_Spk1_Active "Displayable" UBYTE CU_OUT_B_SPK1_ACTIVE 1 100 0.0 1.0 ECU_ADDRESS 0x40002f1b BYTE_ORDER MSB_FIRST /end MEASUREMENT
/begin COMPU_METHOD CU_OUT_B_SPK1_ACTIVE "Conversion method for OUT_b_Spk1_Active" RAT_FUNC "%10.0" "b" COEFFS 0.000000 1.000000 0.000000 0.000000 0.000000 1.000000 /end COMPU_METHOD
/* Scalar measurable for DDE 'OUT_b_Spk2_Active'. */
/begin MEASUREMENT OUT_b_Spk2_Active "Displayable" UBYTE CU_OUT_B_SPK2_ACTIVE 1 100 0.0 1.0 ECU_ADDRESS 0x40002f1a BYTE_ORDER MSB_FIRST /end MEASUREMENT
/begin COMPU_METHOD CU_OUT_B_SPK2_ACTIVE "Conversion method for OUT_b_Spk2_Active" RAT_FUNC "%10.0" "b" COEFFS 0.000000 1.000000 0.000000 0.000000 0.000000 1.000000 /end COMPU_METHOD
/* Scalar measurable for DDE 'OUT_b_Spk3_Active'. */
/begin MEASUREMENT OUT_b_Spk3_Active "Displayable" UBYTE CU_OUT_B_SPK3_ACTIVE 1 100 0.0 1.0 ECU_ADDRESS 0x40002f19 BYTE_ORDER MSB_FIRST /end MEASUREMENT
/begin COMPU_METHOD CU_OUT_B_SPK3_ACTIVE "Conversion method for OUT_b_Spk3_Active" RAT_FUNC "%10.0" "b" COEFFS 0.000000 1.000000 0.000000 0.000000 0.000000 1.000000 /end COMPU_METHOD
/* Scalar measurable for DDE 'OUT_b_Spk4_Active'. */
/begin MEASUREMENT OUT_b_Spk4_Active "Displayable" UBYTE CU_OUT_B_SPK4_ACTIVE 1 100 0.0 1.0 ECU_ADDRESS 0x40002f18 BYTE_ORDER MSB_FIRST /end MEASUREMENT
/begin COMPU_METHOD CU_OUT_B_SPK4_ACTIVE "Conversion method for OUT_b_Spk4_Active" RAT_FUNC "%10.0" "b" COEFFS 0.000000 1.000000 0.000000 0.000000 0.000000 1.000000 /end COMPU_METHOD
/* Scalar measurable for DDE 'OUT_b_Spk5_Active'. */
/begin MEASUREMENT OUT_b_Spk5_Active "Displayable" UBYTE CU_OUT_B_SPK5_ACTIVE 1 100 0.0 1.0 ECU_ADDRESS 0x40002f10 BYTE_ORDER MSB_FIRST /end MEASUREMENT
/begin COMPU_METHOD CU_OUT_B_SPK5_ACTIVE "Conversion method for OUT_b_Spk5_Active" RAT_FUNC "%10.0" "b" COEFFS 0.000000 1.000000 0.000000 0.000000 0.000000 1.000000 /end COMPU_METHOD
/* Scalar measurable for DDE 'OUT_b_Spk6_Active'. */
/begin MEASUREMENT OUT_b_Spk6_Active "Displayable" UBYTE CU_OUT_B_SPK6_ACTIVE 1 100 0.0 1.0 ECU_ADDRESS 0x40002f0f BYTE_ORDER MSB_FIRST /end MEASUREMENT
/begin COMPU_METHOD CU_OUT_B_SPK6_ACTIVE "Conversion method for OUT_b_Spk6_Active" RAT_FUNC "%10.0" "b" COEFFS 0.000000 1.000000 0.000000 0.000000 0.000000 1.000000 /end COMPU_METHOD
/* Scalar measurable for DDE 'OUT_b_Spk7_Active'. */
/begin MEASUREMENT OUT_b_Spk7_Active "Displayable" UBYTE CU_OUT_B_SPK7_ACTIVE 1 100 0.0 1.0 ECU_ADDRESS 0x40002f0e BYTE_ORDER MSB_FIRST /end MEASUREMENT
/begin COMPU_METHOD CU_OUT_B_SPK7_ACTIVE "Conversion method for OUT_b_Spk7_Active" RAT_FUNC "%10.0" "b" COEFFS 0.000000 1.000000 0.000000 0.000000 0.000000 1.000000 /end COMPU_METHOD
/* Scalar measurable for DDE 'OUT_b_Spk8_Active'. */
/begin MEASUREMENT OUT_b_Spk8_Active "Displayable" UBYTE CU_OUT_B_SPK8_ACTIVE 1 100 0.0 1.0 ECU_ADDRESS 0x40002f0d BYTE_ORDER MSB_FIRST /end MEASUREMENT
/begin COMPU_METHOD CU_OUT_B_SPK8_ACTIVE "Conversion method for OUT_b_Spk8_Active" RAT_FUNC "%10.0" "b" COEFFS 0.000000 1.000000 0.000000 0.000000 0.000000 1.000000 /end COMPU_METHOD
/* Scalar measurable for DDE 'OUT_b_TCO_ena'. */
/begin MEASUREMENT OUT_b_TCO_ena "Value of enable TCO" UBYTE CU_OUT_B_TCO_ENA 1 100 0.0 1.0 ECU_ADDRESS 0x40002e87 BYTE_ORDER MSB_FIRST /end MEASUREMENT
/begin COMPU_METHOD CU_OUT_B_TCO_ENA "Conversion method for OUT_b_TCO_ena" RAT_FUNC "%10.0" "NU" COEFFS 0.000000 1.000000 0.000000 0.000000 0.000000 1.000000 /end COMPU_METHOD
/* Scalar measurable for DDE 'OUT_b_UEGOB_Heater_OC'. */
/begin MEASUREMENT OUT_b_UEGOB_Heater_OC "Output overcurrent trip flag" UBYTE CU_OUT_B_UEGOB_HEATER_OC 1 100 0.0 1.0 ECU_ADDRESS 0x40002f40 BYTE_ORDER MSB_FIRST /end MEASUREMENT
/begin COMPU_METHOD CU_OUT_B_UEGOB_HEATER_OC "Conversion method for OUT_b_UEGOB_Heater_OC" RAT_FUNC "%10.0" "b" COEFFS 0.000000 1.000000 0.000000 0.000000 0.000000 1.000000 /end COMPU_METHOD
/* Scalar measurable for DDE 'OUT_b_VISCO_1st'. */
/begin MEASUREMENT OUT_b_VISCO_1st "(not defined)" UBYTE CU_OUT_B_VISCO_1ST 1 100 0.0 1.0 ECU_ADDRESS 0x40002f20 BYTE_ORDER MSB_FIRST /end MEASUREMENT
/begin COMPU_METHOD CU_OUT_B_VISCO_1ST "Conversion method for OUT_b_VISCO_1st" RAT_FUNC "%10.0" "b" COEFFS 0.000000 1.000000 0.000000 0.000000 0.000000 1.000000 /end COMPU_METHOD
/* Scalar measurable for DDE 'OUT_b_VISCO_2nd'. */
/begin MEASUREMENT OUT_b_VISCO_2nd "(not defined)" UBYTE CU_OUT_B_VISCO_2ND 1 100 0.0 1.0 ECU_ADDRESS 0x40002f1f BYTE_ORDER MSB_FIRST /end MEASUREMENT
/begin COMPU_METHOD CU_OUT_B_VISCO_2ND "Conversion method for OUT_b_VISCO_2nd" RAT_FUNC "%10.0" "b" COEFFS 0.000000 1.000000 0.000000 0.000000 0.000000 1.000000 /end COMPU_METHOD
/* Scalar measurable for DDE 'OUT_b_VentiladorZF'. */
/begin MEASUREMENT OUT_b_VentiladorZF "ZF Fan" UBYTE CU_OUT_B_VENTILADORZF 1 100 0.0 1.0 ECU_ADDRESS 0x40002ed3 BYTE_ORDER MSB_FIRST /end MEASUREMENT
/begin COMPU_METHOD CU_OUT_B_VENTILADORZF "Conversion method for OUT_b_VentiladorZF" RAT_FUNC "%10.0" "b" COEFFS 0.000000 1.000000 0.000000 0.000000 0.000000 1.000000 /end COMPU_METHOD
/* Scalar measurable for DDE 'OUT_b_Y1_OC'. */
/begin MEASUREMENT OUT_b_Y1_OC "Highside output overcurrent trip flag" UBYTE CU_OUT_B_Y1_OC 1 100 0.0 1.0 ECU_ADDRESS 0x40002f4c BYTE_ORDER MSB_FIRST /end MEASUREMENT
/begin COMPU_METHOD CU_OUT_B_Y1_OC "Conversion method for OUT_b_Y1_OC" RAT_FUNC "%10.0" "b" COEFFS 0.000000 1.000000 0.000000 0.000000 0.000000 1.000000 /end COMPU_METHOD
/* Scalar measurable for DDE 'OUT_b_Y5_OC'. */
/begin MEASUREMENT OUT_b_Y5_OC "Highside output overcurrent trip flag" UBYTE CU_OUT_B_Y5_OC 1 100 0.0 1.0 ECU_ADDRESS 0x40002f4b BYTE_ORDER MSB_FIRST /end MEASUREMENT
/begin COMPU_METHOD CU_OUT_B_Y5_OC "Conversion method for OUT_b_Y5_OC" RAT_FUNC "%10.0" "b" COEFFS 0.000000 1.000000 0.000000 0.000000 0.000000 1.000000 /end COMPU_METHOD
/* Scalar measurable for DDE 'OUT_cnt_BankA_SPI_Flts'. */
/begin MEASUREMENT OUT_cnt_BankA_SPI_Flts "Displayable" ULONG CU_OUT_CNT_BANKA_SPI_FLTS 1 100 0.0 0.0 ECU_ADDRESS 0x4000306c BYTE_ORDER MSB_FIRST /end MEASUREMENT
/begin COMPU_METHOD CU_OUT_CNT_BANKA_SPI_FLTS "Conversion method for OUT_cnt_BankA_SPI_Flts" RAT_FUNC "%10.0" "cnt" COEFFS 0.000000 1.000000 0.000000 0.000000 0.000000 1.000000 /end COMPU_METHOD
/* Scalar measurable for DDE 'OUT_cnt_BankB_SPI_Flts'. */
/begin MEASUREMENT OUT_cnt_BankB_SPI_Flts "Displayable" ULONG CU_OUT_CNT_BANKB_SPI_FLTS 1 100 0.0 0.0 ECU_ADDRESS 0x40003068 BYTE_ORDER MSB_FIRST /end MEASUREMENT
/begin COMPU_METHOD CU_OUT_CNT_BANKB_SPI_FLTS "Conversion method for OUT_cnt_BankB_SPI_Flts" RAT_FUNC "%10.0" "cnt" COEFFS 0.000000 1.000000 0.000000 0.000000 0.000000 1.000000 /end COMPU_METHOD
/* Scalar measurable for DDE 'OUT_pct_UEGO_HTR_DC_A'. */
/begin MEASUREMENT OUT_pct_UEGO_HTR_DC_A "Displayable signal for UEGO HTR DC" FLOAT32_IEEE CU_OUT_PCT_UEGO_HTR_DC_A 1 100 0.0 1.0 ECU_ADDRESS 0x400038b8 BYTE_ORDER MSB_FIRST /end MEASUREMENT
/begin COMPU_METHOD CU_OUT_PCT_UEGO_HTR_DC_A "Conversion method for OUT_pct_UEGO_HTR_DC_A" RAT_FUNC "%10.2" "pct" COEFFS 0.000000 1.000000 0.000000 0.000000 0.000000 1.000000 /end COMPU_METHOD
/* Scalar measurable for DDE 'PID_NU_DTerm'. */
/begin MEASUREMENT PID_NU_DTerm "Displayable" FLOAT32_IEEE CU_PID_NU_DTERM 1 100 0.0 0.0 ECU_ADDRESS 0x40003184 BYTE_ORDER MSB_FIRST /end MEASUREMENT
/begin COMPU_METHOD CU_PID_NU_DTERM "Conversion method for PID_NU_DTerm" RAT_FUNC "%10.3" "NU" COEFFS 0.000000 1.000000 0.000000 0.000000 0.000000 1.000000 /end COMPU_METHOD
/* Scalar measurable for DDE 'PID_NU_ITerm'. */
/begin MEASUREMENT PID_NU_ITerm "Displayable" FLOAT32_IEEE CU_PID_NU_ITERM 1 100 0.0 0.0 ECU_ADDRESS 0x4000318c BYTE_ORDER MSB_FIRST /end MEASUREMENT
/begin COMPU_METHOD CU_PID_NU_ITERM "Conversion method for PID_NU_ITerm" RAT_FUNC "%10.3" "NU" COEFFS 0.000000 1.000000 0.000000 0.000000 0.000000 1.000000 /end COMPU_METHOD
/* Scalar measurable for DDE 'PID_NU_PTerm'. */
/begin MEASUREMENT PID_NU_PTerm "Displayable" FLOAT32_IEEE CU_PID_NU_PTERM 1 100 0.0 0.0 ECU_ADDRESS 0x40003190 BYTE_ORDER MSB_FIRST /end MEASUREMENT
/begin COMPU_METHOD CU_PID_NU_PTERM "Conversion method for PID_NU_PTerm" RAT_FUNC "%10.3" "NU" COEFFS 0.000000 1.000000 0.000000 0.000000 0.000000 1.000000 /end COMPU_METHOD
/* Scalar measurable for DDE 'REM_Nm_TqLimit'. */
/begin MEASUREMENT REM_Nm_TqLimit "Displayable" FLOAT32_IEEE CU_REM_NM_TQLIMIT 1 100 0.0 0.0 ECU_ADDRESS 0x400036ec BYTE_ORDER MSB_FIRST /end MEASUREMENT
/begin COMPU_METHOD CU_REM_NM_TQLIMIT "Conversion method for REM_Nm_TqLimit" RAT_FUNC "%10.1" "Nm" COEFFS 0.000000 1.000000 0.000000 0.000000 0.000000 1.000000 /end COMPU_METHOD
/* Scalar measurable for DDE 'REM_b_StopCombustion'. */
/begin MEASUREMENT REM_b_StopCombustion "Displayable" UBYTE CU_REM_B_STOPCOMBUSTION 1 100 0.0 1.0 ECU_ADDRESS 0x40002f2a BYTE_ORDER MSB_FIRST /end MEASUREMENT
/begin COMPU_METHOD CU_REM_B_STOPCOMBUSTION "Conversion method for REM_b_StopCombustion" RAT_FUNC "%10.0" "b" COEFFS 0.000000 1.000000 0.000000 0.000000 0.000000 1.000000 /end COMPU_METHOD
/* Scalar measurable for DDE 'REM_e_TurbineState'. */
/begin MEASUREMENT REM_e_TurbineState "Turbo status" UBYTE CU_REM_E_TURBINESTATE 1 100 0.0 2.0 ECU_ADDRESS 0x40003015 BYTE_ORDER MSB_FIRST /end MEASUREMENT
/begin COMPU_METHOD CU_REM_E_TURBINESTATE "Conversion method for REM_e_TurbineState" TAB_VERB "%12.0" "e" COMPU_TAB_REF CT_REM_E_TURBINESTATE /end COMPU_METHOD
/begin COMPU_VTAB CT_REM_E_TURBINESTATE "Conversion method for REM_e_TurbineState" TAB_VERB 3 0 "REMk_e_TurbineNormal" 1 "REMk_e_TurbineTempWarning" 2 "REMk_e_TurbineOvertempShutdown" /end COMPU_VTAB
/* Scalar measurable for DDE 'REM_pct_OvertempThrottleLimit'. */
/begin MEASUREMENT REM_pct_OvertempThrottleLimit "Displayable" FLOAT32_IEEE CU_REM_PCT_OVERTEMPTHROTTLELIM0 1 100 0.0 0.0 ECU_ADDRESS 0x40003690 BYTE_ORDER MSB_FIRST /end MEASUREMENT
/begin COMPU_METHOD CU_REM_PCT_OVERTEMPTHROTTLELIM0 "Conversion method for REM_pct_OvertempThrottleLimit" RAT_FUNC "%10.2" "pct" COEFFS 0.000000 1.000000 0.000000 0.000000 0.000000 1.000000 /end COMPU_METHOD
/* Scalar measurable for DDE 'RFC_b_Active'. */
/begin MEASUREMENT RFC_b_Active "State displayable" UBYTE CU_RFC_B_ACTIVE 1 100 0.0 1.0 ECU_ADDRESS 0x40002e74 BYTE_ORDER MSB_FIRST /end MEASUREMENT
/begin COMPU_METHOD CU_RFC_B_ACTIVE "Conversion method for RFC_b_Active" RAT_FUNC "%10.0" "b" COEFFS 0.000000 1.000000 0.000000 0.000000 0.000000 1.000000 /end COMPU_METHOD
/* Scalar measurable for DDE 'RFC_mg_FuelRqstDelta'. */
/begin MEASUREMENT RFC_mg_FuelRqstDelta "Fuelmass change vs previous injection" FLOAT32_IEEE CU_RFC_MG_FUELRQSTDELTA 1 100 0.0 0.0 ECU_ADDRESS 0x40003030 BYTE_ORDER MSB_FIRST /end MEASUREMENT
/begin COMPU_METHOD CU_RFC_MG_FUELRQSTDELTA "Conversion method for RFC_mg_FuelRqstDelta" RAT_FUNC "%10.2" "mg" COEFFS 0.000000 1.000000 0.000000 0.000000 0.000000 1.000000 /end COMPU_METHOD
/* Scalar measurable for DDE 'RFC_mg_Inj1'. */
/begin MEASUREMENT RFC_mg_Inj1 "Displayable" FLOAT32_IEEE CU_RFC_MG_INJ1 1 100 0.0 0.0 ECU_ADDRESS 0x40003310 BYTE_ORDER MSB_FIRST /end MEASUREMENT
/begin COMPU_METHOD CU_RFC_MG_INJ1 "Conversion method for RFC_mg_Inj1" RAT_FUNC "%10.2" "mg" COEFFS 0.000000 1.000000 0.000000 0.000000 0.000000 1.000000 /end COMPU_METHOD
/* Scalar measurable for DDE 'RFC_mg_Inj2'. */
/begin MEASUREMENT RFC_mg_Inj2 "Displayable" FLOAT32_IEEE CU_RFC_MG_INJ2 1 100 0.0 0.0 ECU_ADDRESS 0x4000330c BYTE_ORDER MSB_FIRST /end MEASUREMENT
/begin COMPU_METHOD CU_RFC_MG_INJ2 "Conversion method for RFC_mg_Inj2" RAT_FUNC "%10.2" "mg" COEFFS 0.000000 1.000000 0.000000 0.000000 0.000000 1.000000 /end COMPU_METHOD
/* Scalar measurable for DDE 'RFC_mg_Inj3'. */
/begin MEASUREMENT RFC_mg_Inj3 "Displayable" FLOAT32_IEEE CU_RFC_MG_INJ3 1 100 0.0 0.0 ECU_ADDRESS 0x40003308 BYTE_ORDER MSB_FIRST /end MEASUREMENT
/begin COMPU_METHOD CU_RFC_MG_INJ3 "Conversion method for RFC_mg_Inj3" RAT_FUNC "%10.2" "mg" COEFFS 0.000000 1.000000 0.000000 0.000000 0.000000 1.000000 /end COMPU_METHOD
/* Scalar measurable for DDE 'RFC_mg_Inj4'. */
/begin MEASUREMENT RFC_mg_Inj4 "Displayable" FLOAT32_IEEE CU_RFC_MG_INJ4 1 100 0.0 0.0 ECU_ADDRESS 0x40003304 BYTE_ORDER MSB_FIRST /end MEASUREMENT
/begin COMPU_METHOD CU_RFC_MG_INJ4 "Conversion method for RFC_mg_Inj4" RAT_FUNC "%10.2" "mg" COEFFS 0.000000 1.000000 0.000000 0.000000 0.000000 1.000000 /end COMPU_METHOD
/* Scalar measurable for DDE 'RFC_pct_PfInvCyl1'. */
/begin MEASUREMENT RFC_pct_PfInvCyl1 "Fuel compensation factor" FLOAT32_IEEE CU_RFC_PCT_PFINVCYL1 1 100 0.0 0.0 ECU_ADDRESS 0x400031c8 BYTE_ORDER MSB_FIRST /end MEASUREMENT
/begin COMPU_METHOD CU_RFC_PCT_PFINVCYL1 "Conversion method for RFC_pct_PfInvCyl1" RAT_FUNC "%10.2" "pct" COEFFS 0.000000 1.000000 0.000000 0.000000 0.000000 1.000000 /end COMPU_METHOD
/* Scalar measurable for DDE 'RFC_pct_PfInvCyl2'. */
/begin MEASUREMENT RFC_pct_PfInvCyl2 "Fuel compensation factor" FLOAT32_IEEE CU_RFC_PCT_PFINVCYL2 1 100 0.0 0.0 ECU_ADDRESS 0x400031c4 BYTE_ORDER MSB_FIRST /end MEASUREMENT
/begin COMPU_METHOD CU_RFC_PCT_PFINVCYL2 "Conversion method for RFC_pct_PfInvCyl2" RAT_FUNC "%10.2" "pct" COEFFS 0.000000 1.000000 0.000000 0.000000 0.000000 1.000000 /end COMPU_METHOD
/* Scalar measurable for DDE 'RFC_pct_PfInvCyl3'. */
/begin MEASUREMENT RFC_pct_PfInvCyl3 "Fuel compensation factor" FLOAT32_IEEE CU_RFC_PCT_PFINVCYL3 1 100 0.0 0.0 ECU_ADDRESS 0x400031c0 BYTE_ORDER MSB_FIRST /end MEASUREMENT
/begin COMPU_METHOD CU_RFC_PCT_PFINVCYL3 "Conversion method for RFC_pct_PfInvCyl3" RAT_FUNC "%10.2" "pct" COEFFS 0.000000 1.000000 0.000000 0.000000 0.000000 1.000000 /end COMPU_METHOD
/* Scalar measurable for DDE 'RFC_pct_PfInvCyl4'. */
/begin MEASUREMENT RFC_pct_PfInvCyl4 "Fuel compensation factor" FLOAT32_IEEE CU_RFC_PCT_PFINVCYL4 1 100 0.0 0.0 ECU_ADDRESS 0x400031bc BYTE_ORDER MSB_FIRST /end MEASUREMENT
/begin COMPU_METHOD CU_RFC_PCT_PFINVCYL4 "Conversion method for RFC_pct_PfInvCyl4" RAT_FUNC "%10.2" "pct" COEFFS 0.000000 1.000000 0.000000 0.000000 0.000000 1.000000 /end COMPU_METHOD
/* Scalar measurable for DDE 'RFC_pct_RelativePfInv'. */
/begin MEASUREMENT RFC_pct_RelativePfInv "PfInv (relative gain) max from all cyls" FLOAT32_IEEE CU_RFC_PCT_RELATIVEPFINV 1 100 0.0 0.0 ECU_ADDRESS 0x40003034 BYTE_ORDER MSB_FIRST /end MEASUREMENT
/begin COMPU_METHOD CU_RFC_PCT_RELATIVEPFINV "Conversion method for RFC_pct_RelativePfInv" RAT_FUNC "%10.2" "pct" COEFFS 0.000000 1.000000 0.000000 0.000000 0.000000 1.000000 /end COMPU_METHOD
/* Scalar measurable for DDE 'RFC_pct_WallWetFraction'. */
/begin MEASUREMENT RFC_pct_WallWetFraction "Map output displayable" FLOAT32_IEEE CU_RFC_PCT_WALLWETFRACTION 1 100 0.0 0.0 ECU_ADDRESS 0x400031b8 BYTE_ORDER MSB_FIRST /end MEASUREMENT
/begin COMPU_METHOD CU_RFC_PCT_WALLWETFRACTION "Conversion method for RFC_pct_WallWetFraction" RAT_FUNC "%10.2" "pct" COEFFS 0.000000 1.000000 0.000000 0.000000 0.000000 1.000000 /end COMPU_METHOD
/* Scalar measurable for DDE 'RFC_s_DbncTimer'. */
/begin MEASUREMENT RFC_s_DbncTimer "Displayable" FLOAT32_IEEE CU_RFC_S_DBNCTIMER 1 100 0.0 0.0 ECU_ADDRESS 0x400031b0 BYTE_ORDER MSB_FIRST /end MEASUREMENT
/begin COMPU_METHOD CU_RFC_S_DBNCTIMER "Conversion method for RFC_s_DbncTimer" RAT_FUNC "%10.2" "s" COEFFS 0.000000 1.000000 0.000000 0.000000 0.000000 1.000000 /end COMPU_METHOD
/* Scalar measurable for DDE 'RFC_s_ExpTimer'. */
/begin MEASUREMENT RFC_s_ExpTimer "Displayable" FLOAT32_IEEE CU_RFC_S_EXPTIMER 1 100 0.0 0.0 ECU_ADDRESS 0x400031b4 BYTE_ORDER MSB_FIRST /end MEASUREMENT
/begin COMPU_METHOD CU_RFC_S_EXPTIMER "Conversion method for RFC_s_ExpTimer" RAT_FUNC "%10.2" "s" COEFFS 0.000000 1.000000 0.000000 0.000000 0.000000 1.000000 /end COMPU_METHOD
/* Scalar measurable for DDE 'RFC_s_PuddleVapTime'. */
/begin MEASUREMENT RFC_s_PuddleVapTime "Map output displayable" FLOAT32_IEEE CU_RFC_S_PUDDLEVAPTIME 1 100 0.0 0.0 ECU_ADDRESS 0x400031cc BYTE_ORDER MSB_FIRST /end MEASUREMENT
/begin COMPU_METHOD CU_RFC_S_PUDDLEVAPTIME "Conversion method for RFC_s_PuddleVapTime" RAT_FUNC "%10.2" "s" COEFFS 0.000000 1.000000 0.000000 0.000000 0.000000 1.000000 /end COMPU_METHOD
/* Scalar measurable for DDE 'SAR_adv_SparkAng'. */
/begin MEASUREMENT SAR_adv_SparkAng "Arbitrated spark advance angle" FLOAT32_IEEE CU_SAR_ADV_SPARKANG 1 100 -40.0 40.0 ECU_ADDRESS 0x40003448 BYTE_ORDER MSB_FIRST /end MEASUREMENT
/begin COMPU_METHOD CU_SAR_ADV_SPARKANG "Conversion method for SAR_adv_SparkAng" RAT_FUNC "%10.1" "adv" COEFFS 0.000000 1.000000 0.000000 0.000000 0.000000 1.000000 /end COMPU_METHOD
/* Scalar measurable for DDE 'SAR_ret_ArbitratedRetardRqst'. */
/begin MEASUREMENT SAR_ret_ArbitratedRetardRqst "Result of all retard modifers" FLOAT32_IEEE CU_SAR_RET_ARBITRATEDRETARDRQST 1 100 0.0 0.0 ECU_ADDRESS 0x4000344c BYTE_ORDER MSB_FIRST /end MEASUREMENT
/begin COMPU_METHOD CU_SAR_RET_ARBITRATEDRETARDRQST "Conversion method for SAR_ret_ArbitratedRetardRqst" RAT_FUNC "%10.1" "ret" COEFFS 0.000000 1.000000 0.000000 0.000000 0.000000 1.000000 /end COMPU_METHOD
/* Scalar measurable for DDE 'SOV_b_OpenValve1'. */
/begin MEASUREMENT SOV_b_OpenValve1 "Displayable" UBYTE CU_SOV_B_OPENVALVE1 1 100 0.0 1.0 ECU_ADDRESS 0x40002f26 BYTE_ORDER MSB_FIRST /end MEASUREMENT
/begin COMPU_METHOD CU_SOV_B_OPENVALVE1 "Conversion method for SOV_b_OpenValve1" RAT_FUNC "%10.0" "b" COEFFS 0.000000 1.000000 0.000000 0.000000 0.000000 1.000000 /end COMPU_METHOD
/* Scalar measurable for DDE 'SOV_b_OpenValve2'. */
/begin MEASUREMENT SOV_b_OpenValve2 "Displayable" UBYTE CU_SOV_B_OPENVALVE2 1 100 0.0 1.0 ECU_ADDRESS 0x40002f25 BYTE_ORDER MSB_FIRST /end MEASUREMENT
/begin COMPU_METHOD CU_SOV_B_OPENVALVE2 "Conversion method for SOV_b_OpenValve2" RAT_FUNC "%10.0" "b" COEFFS 0.000000 1.000000 0.000000 0.000000 0.000000 1.000000 /end COMPU_METHOD
/* Scalar measurable for DDE 'SPT_adv_CoilOffAng'. */
/begin MEASUREMENT SPT_adv_CoilOffAng "Spark coil off angle" FLOAT32_IEEE CU_SPT_ADV_COILOFFANG 1 100 -40.0 40.0 ECU_ADDRESS 0x40003208 BYTE_ORDER MSB_FIRST /end MEASUREMENT
/begin COMPU_METHOD CU_SPT_ADV_COILOFFANG "Conversion method for SPT_adv_CoilOffAng" RAT_FUNC "%10.1" "adv" COEFFS 0.000000 1.000000 0.000000 0.000000 0.000000 1.000000 /end COMPU_METHOD
/* Scalar measurable for DDE 'SPT_adv_CoilOnAng'. */
/begin MEASUREMENT SPT_adv_CoilOnAng "Spark coil on angle" FLOAT32_IEEE CU_SPT_ADV_COILONANG 1 100 -40.0 360.0 ECU_ADDRESS 0x4000320c BYTE_ORDER MSB_FIRST /end MEASUREMENT
/begin COMPU_METHOD CU_SPT_ADV_COILONANG "Conversion method for SPT_adv_CoilOnAng" RAT_FUNC "%10.1" "adv" COEFFS 0.000000 1.000000 0.000000 0.000000 0.000000 1.000000 /end COMPU_METHOD
/* Scalar measurable for DDE 'SPT_deg_DwellTime'. */
/begin MEASUREMENT SPT_deg_DwellTime "Dwell time in degrees of crank rotation" FLOAT32_IEEE CU_SPT_DEG_DWELLTIME 1 100 0.0 360.0 ECU_ADDRESS 0x4000329c BYTE_ORDER MSB_FIRST /end MEASUREMENT
/begin COMPU_METHOD CU_SPT_DEG_DWELLTIME "Conversion method for SPT_deg_DwellTime" RAT_FUNC "%10.2" "deg" COEFFS 0.000000 1.000000 0.000000 0.000000 0.000000 1.000000 /end COMPU_METHOD
/* Scalar measurable for DDE 'SPT_ms_DwellTime'. */
/begin MEASUREMENT SPT_ms_DwellTime "Final dwell time value" FLOAT32_IEEE CU_SPT_MS_DWELLTIME 1 100 0.0 20.0 ECU_ADDRESS 0x400032a0 BYTE_ORDER MSB_FIRST /end MEASUREMENT
/begin COMPU_METHOD CU_SPT_MS_DWELLTIME "Conversion method for SPT_ms_DwellTime" RAT_FUNC "%10.2" "ms" COEFFS 0.000000 1.000000 0.000000 0.000000 0.000000 1.000000 /end COMPU_METHOD
/* Scalar measurable for DDE 'SPT_ms_DwellTimeRaw'. */
/begin MEASUREMENT SPT_ms_DwellTimeRaw "Raw spark dwell time" FLOAT32_IEEE CU_SPT_MS_DWELLTIMERAW 1 100 0.0 10.0 ECU_ADDRESS 0x400032a8 BYTE_ORDER MSB_FIRST /end MEASUREMENT
/begin COMPU_METHOD CU_SPT_MS_DWELLTIMERAW "Conversion method for SPT_ms_DwellTimeRaw" RAT_FUNC "%10.2" "ms" COEFFS 0.000000 1.000000 0.000000 0.000000 0.000000 1.000000 /end COMPU_METHOD
/* Scalar measurable for DDE 'SPT_ms_MaxDwellTime'. */
/begin MEASUREMENT SPT_ms_MaxDwellTime "Calculated dwell limit based on current engine speed" FLOAT32_IEEE CU_SPT_MS_MAXDWELLTIME 1 100 0.0 0.0 ECU_ADDRESS 0x400032a4 BYTE_ORDER MSB_FIRST /end MEASUREMENT
/begin COMPU_METHOD CU_SPT_MS_MAXDWELLTIME "Conversion method for SPT_ms_MaxDwellTime" RAT_FUNC "%10.3" "ms" COEFFS 0.000000 1.000000 0.000000 0.000000 0.000000 1.000000 /end COMPU_METHOD
/* Scalar measurable for DDE 'STR_b_ManualStarter'. */
/begin MEASUREMENT STR_b_ManualStarter "Displayable- global fault management control signal, sent to each FBM" UBYTE CU_STR_B_MANUALSTARTER 1 100 0.0 1.0 ECU_ADDRESS 0x40002f2b BYTE_ORDER MSB_FIRST /end MEASUREMENT
/begin COMPU_METHOD CU_STR_B_MANUALSTARTER "Conversion method for STR_b_ManualStarter" RAT_FUNC "%10.0" "b" COEFFS 0.000000 1.000000 0.000000 0.000000 0.000000 1.000000 /end COMPU_METHOD
/* Scalar measurable for DDE 'SYS_EngSpedDelta1'. */
/begin MEASUREMENT SYS_EngSpedDelta1 "(not defined)" FLOAT32_IEEE CU_SYS_ENGSPEDDELTA1 1 100 -10000.0 10000.0 ECU_ADDRESS 0x400030b0 BYTE_ORDER MSB_FIRST /end MEASUREMENT
/begin COMPU_METHOD CU_SYS_ENGSPEDDELTA1 "Conversion method for SYS_EngSpedDelta1" RAT_FUNC "%10.3" "RPM" COEFFS 0.000000 1.000000 0.000000 0.000000 0.000000 1.000000 /end COMPU_METHOD
/* Scalar measurable for DDE 'SYS_EngSpedDelta1_after'. */
/begin MEASUREMENT SYS_EngSpedDelta1_after "(not defined)" FLOAT32_IEEE CU_SYS_ENGSPEDDELTA1_AFTER 1 100 -10000.0 10000.0 ECU_ADDRESS 0x400030ac BYTE_ORDER MSB_FIRST /end MEASUREMENT
/begin COMPU_METHOD CU_SYS_ENGSPEDDELTA1_AFTER "Conversion method for SYS_EngSpedDelta1_after" RAT_FUNC "%10.3" "RPM" COEFFS 0.000000 1.000000 0.000000 0.000000 0.000000 1.000000 /end COMPU_METHOD
/* Scalar measurable for DDE 'SYS_EngSpedDelta2'. */
/begin MEASUREMENT SYS_EngSpedDelta2 "(not defined)" FLOAT32_IEEE CU_SYS_ENGSPEDDELTA2 1 100 -10000.0 10000.0 ECU_ADDRESS 0x400030a0 BYTE_ORDER MSB_FIRST /end MEASUREMENT
/begin COMPU_METHOD CU_SYS_ENGSPEDDELTA2 "Conversion method for SYS_EngSpedDelta2" RAT_FUNC "%10.3" "RPM" COEFFS 0.000000 1.000000 0.000000 0.000000 0.000000 1.000000 /end COMPU_METHOD
/* Scalar measurable for DDE 'SYS_EngSpedDelta2_after'. */
/begin MEASUREMENT SYS_EngSpedDelta2_after "(not defined)" FLOAT32_IEEE CU_SYS_ENGSPEDDELTA2_AFTER 1 100 -10000.0 10000.0 ECU_ADDRESS 0x4000309c BYTE_ORDER MSB_FIRST /end MEASUREMENT
/begin COMPU_METHOD CU_SYS_ENGSPEDDELTA2_AFTER "Conversion method for SYS_EngSpedDelta2_after" RAT_FUNC "%10.3" "RPM" COEFFS 0.000000 1.000000 0.000000 0.000000 0.000000 1.000000 /end COMPU_METHOD
/* Scalar measurable for DDE 'SYS_EngSpedDelta3'. */
/begin MEASUREMENT SYS_EngSpedDelta3 "(not defined)" FLOAT32_IEEE CU_SYS_ENGSPEDDELTA3 1 100 -10000.0 10000.0 ECU_ADDRESS 0x40003090 BYTE_ORDER MSB_FIRST /end MEASUREMENT
/begin COMPU_METHOD CU_SYS_ENGSPEDDELTA3 "Conversion method for SYS_EngSpedDelta3" RAT_FUNC "%10.3" "RPM" COEFFS 0.000000 1.000000 0.000000 0.000000 0.000000 1.000000 /end COMPU_METHOD
/* Scalar measurable for DDE 'SYS_EngSpedDelta3_after'. */
/begin MEASUREMENT SYS_EngSpedDelta3_after "(not defined)" FLOAT32_IEEE CU_SYS_ENGSPEDDELTA3_AFTER 1 100 -10000.0 10000.0 ECU_ADDRESS 0x4000308c BYTE_ORDER MSB_FIRST /end MEASUREMENT
/begin COMPU_METHOD CU_SYS_ENGSPEDDELTA3_AFTER "Conversion method for SYS_EngSpedDelta3_after" RAT_FUNC "%10.3" "RPM" COEFFS 0.000000 1.000000 0.000000 0.000000 0.000000 1.000000 /end COMPU_METHOD
/* Scalar measurable for DDE 'SYS_EngSpedDelta4'. */
/begin MEASUREMENT SYS_EngSpedDelta4 "(not defined)" FLOAT32_IEEE CU_SYS_ENGSPEDDELTA4 1 100 -10000.0 10000.0 ECU_ADDRESS 0x40003080 BYTE_ORDER MSB_FIRST /end MEASUREMENT
/begin COMPU_METHOD CU_SYS_ENGSPEDDELTA4 "Conversion method for SYS_EngSpedDelta4" RAT_FUNC "%10.3" "RPM" COEFFS 0.000000 1.000000 0.000000 0.000000 0.000000 1.000000 /end COMPU_METHOD
/* Scalar measurable for DDE 'SYS_EngSpedDelta4_after'. */
/begin MEASUREMENT SYS_EngSpedDelta4_after "(not defined)" FLOAT32_IEEE CU_SYS_ENGSPEDDELTA4_AFTER 1 100 -10000.0 10000.0 ECU_ADDRESS 0x4000307c BYTE_ORDER MSB_FIRST /end MEASUREMENT
/begin COMPU_METHOD CU_SYS_ENGSPEDDELTA4_AFTER "Conversion method for SYS_EngSpedDelta4_after" RAT_FUNC "%10.3" "RPM" COEFFS 0.000000 1.000000 0.000000 0.000000 0.000000 1.000000 /end COMPU_METHOD
/* Scalar measurable for DDE 'SYS_NU_CrankWheelDecodeErr'. */
/begin MEASUREMENT SYS_NU_CrankWheelDecodeErr "Crank wheel error status" UWORD CU_SYS_NU_CRANKWHEELDECODEERR 1 100 0.0 65535.0 ECU_ADDRESS 0x4000302c BYTE_ORDER MSB_FIRST /end MEASUREMENT
/begin COMPU_METHOD CU_SYS_NU_CRANKWHEELDECODEERR "Conversion method for SYS_NU_CrankWheelDecodeErr" RAT_FUNC "%10.0" "NU" COEFFS 0.000000 1.000000 0.000000 0.000000 0.000000 1.000000 /end COMPU_METHOD
/* Scalar measurable for DDE 'SYS_NU_CrankWheelDecodeStat'. */
/begin MEASUREMENT SYS_NU_CrankWheelDecodeStat "Crank wheel decode status" UWORD CU_SYS_NU_CRANKWHEELDECODESTAT 1 100 0.0 65535.0 ECU_ADDRESS 0x4000302e BYTE_ORDER MSB_FIRST /end MEASUREMENT
/begin COMPU_METHOD CU_SYS_NU_CRANKWHEELDECODESTAT "Conversion method for SYS_NU_CrankWheelDecodeStat" RAT_FUNC "%10.0" "NU" COEFFS 0.000000 1.000000 0.000000 0.000000 0.000000 1.000000 /end COMPU_METHOD
/* Scalar measurable for DDE 'SYS_NU_CurrCyl'. */
/begin MEASUREMENT SYS_NU_CurrCyl "Current cyclinder" UBYTE CU_SYS_NU_CURRCYL 1 100 0.0 4.0 ECU_ADDRESS 0x40002fd9 BYTE_ORDER MSB_FIRST /end MEASUREMENT
/begin COMPU_METHOD CU_SYS_NU_CURRCYL "Conversion method for SYS_NU_CurrCyl" RAT_FUNC "%10.0" "NU" COEFFS 0.000000 1.000000 0.000000 0.000000 0.000000 1.000000 /end COMPU_METHOD
/* Scalar measurable for DDE 'SYS_NU_EngSyncReq'. */
/begin MEASUREMENT SYS_NU_EngSyncReq "SYSk_e_NoSync,SYSk_e_CrankRegionSync,SYSk_e_HalfEngSync,SYSk_e_FullEngSync" FLOAT32_IEEE CU_SYS_NU_ENGSYNCREQ 1 100 0.0 3.0 ECU_ADDRESS 0x40003025 BYTE_ORDER MSB_FIRST /end MEASUREMENT
/begin COMPU_METHOD CU_SYS_NU_ENGSYNCREQ "Conversion method for SYS_NU_EngSyncReq" RAT_FUNC "%10.0" "NU" COEFFS 0.000000 1.000000 0.000000 0.000000 0.000000 1.000000 /end COMPU_METHOD
/* Scalar measurable for DDE 'SYS_NU_EngToothOfst'. */
/begin MEASUREMENT SYS_NU_EngToothOfst "(not defined)" SWORD CU_SYS_NU_ENGTOOTHOFST 1 100 0.0 10.0 ECU_ADDRESS 0x40003026 BYTE_ORDER MSB_FIRST /end MEASUREMENT
/begin COMPU_METHOD CU_SYS_NU_ENGTOOTHOFST "Conversion method for SYS_NU_EngToothOfst" RAT_FUNC "%10.0" "NU" COEFFS 0.000000 1.000000 0.000000 0.000000 0.000000 1.000000 /end COMPU_METHOD
/* Scalar measurable for DDE 'SYS_NU_ResetType'. */
/begin MEASUREMENT SYS_NU_ResetType "Bit flags for reset status" UBYTE CU_SYS_NU_RESETTYPE 1 100 0.0 128.0 ECU_ADDRESS 0x40003014 BYTE_ORDER MSB_FIRST /end MEASUREMENT
/begin COMPU_METHOD CU_SYS_NU_RESETTYPE "Conversion method for SYS_NU_ResetType" RAT_FUNC "%10.0" "NU" COEFFS 0.000000 1.000000 0.000000 0.000000 0.000000 1.000000 /end COMPU_METHOD
/* Scalar measurable for DDE 'SYS_b_CrankAngValid'. */
/begin MEASUREMENT SYS_b_CrankAngValid "Displayable" UBYTE CU_SYS_B_CRANKANGVALID 1 100 0.0 1.0 ECU_ADDRESS 0x40003828 BYTE_ORDER MSB_FIRST /end MEASUREMENT
/begin COMPU_METHOD CU_SYS_B_CRANKANGVALID "Conversion method for SYS_b_CrankAngValid" RAT_FUNC "%10.0" "b" COEFFS 0.000000 1.000000 0.000000 0.000000 0.000000 1.000000 /end COMPU_METHOD
/* Scalar measurable for DDE 'SYS_b_CrankSync'. */
/begin MEASUREMENT SYS_b_CrankSync "Crank sync flag" UBYTE CU_SYS_B_CRANKSYNC 1 100 0.0 1.0 ECU_ADDRESS 0x40002f73 BYTE_ORDER MSB_FIRST /end MEASUREMENT
/begin COMPU_METHOD CU_SYS_B_CRANKSYNC "Conversion method for SYS_b_CrankSync" RAT_FUNC "%10.0" "b" COEFFS 0.000000 1.000000 0.000000 0.000000 0.000000 1.000000 /end COMPU_METHOD
/* Scalar measurable for DDE 'SYS_b_CurrCylValid'. */
/begin MEASUREMENT SYS_b_CurrCylValid "Current cyclinder valid flag" UBYTE CU_SYS_B_CURRCYLVALID 1 100 0.0 1.0 ECU_ADDRESS 0x40002e2c BYTE_ORDER MSB_FIRST /end MEASUREMENT
/begin COMPU_METHOD CU_SYS_B_CURRCYLVALID "Conversion method for SYS_b_CurrCylValid" RAT_FUNC "%10.0" "b" COEFFS 0.000000 1.000000 0.000000 0.000000 0.000000 1.000000 /end COMPU_METHOD
/* Scalar measurable for DDE 'SYS_b_EngSync'. */
/begin MEASUREMENT SYS_b_EngSync "Engine sync status" UBYTE CU_SYS_B_ENGSYNC 1 100 0.0 1.0 ECU_ADDRESS 0x40002f72 BYTE_ORDER MSB_FIRST /end MEASUREMENT
/begin COMPU_METHOD CU_SYS_B_ENGSYNC "Conversion method for SYS_b_EngSync" RAT_FUNC "%10.0" "b" COEFFS 0.000000 1.000000 0.000000 0.000000 0.000000 1.000000 /end COMPU_METHOD
/* Scalar measurable for DDE 'SYS_b_SyncInPhase'. */
/begin MEASUREMENT SYS_b_SyncInPhase "(not defined)" UBYTE CU_SYS_B_SYNCINPHASE 1 100 0.0 1.0 ECU_ADDRESS 0x40002fd1 BYTE_ORDER MSB_FIRST /end MEASUREMENT
/begin COMPU_METHOD CU_SYS_B_SYNCINPHASE "Conversion method for SYS_b_SyncInPhase" RAT_FUNC "%10.0" "b" COEFFS 0.000000 1.000000 0.000000 0.000000 0.000000 1.000000 /end COMPU_METHOD
/* Scalar measurable for DDE 'SYS_b_SyncOutBy360'. */
/begin MEASUREMENT SYS_b_SyncOutBy360 "(not defined)" UBYTE CU_SYS_B_SYNCOUTBY360 1 100 0.0 1.0 ECU_ADDRESS 0x40002fd0 BYTE_ORDER MSB_FIRST /end MEASUREMENT
/begin COMPU_METHOD CU_SYS_B_SYNCOUTBY360 "Conversion method for SYS_b_SyncOutBy360" RAT_FUNC "%10.0" "b" COEFFS 0.000000 1.000000 0.000000 0.000000 0.000000 1.000000 /end COMPU_METHOD
/* Scalar measurable for DDE 'SYS_b_TwoTeethMeas'. */
/begin MEASUREMENT SYS_b_TwoTeethMeas "(not defined)" UBYTE CU_SYS_B_TWOTEETHMEAS 1 100 0.0 1.0 ECU_ADDRESS 0x40002fd2 BYTE_ORDER MSB_FIRST /end MEASUREMENT
/begin COMPU_METHOD CU_SYS_B_TWOTEETHMEAS "Conversion method for SYS_b_TwoTeethMeas" RAT_FUNC "%10.0" "b" COEFFS 0.000000 1.000000 0.000000 0.000000 0.000000 1.000000 /end COMPU_METHOD
/* Scalar measurable for DDE 'SYS_cnt_LoopCounter'. */
/begin MEASUREMENT SYS_cnt_LoopCounter "Counter increments every loop.  Multiply by loop period to get actual time" ULONG CU_SYS_CNT_LOOPCOUNTER 1 100 0.0 4294967295.0 ECU_ADDRESS 0x40003078 BYTE_ORDER MSB_FIRST /end MEASUREMENT
/begin COMPU_METHOD CU_SYS_CNT_LOOPCOUNTER "Conversion method for SYS_cnt_LoopCounter" RAT_FUNC "%10.0" "cnt" COEFFS 0.000000 1.000000 0.000000 0.000000 0.000000 1.000000 /end COMPU_METHOD
/* Scalar measurable for DDE 'SYS_cnt_NumAngularFuncCalls'. */
/begin MEASUREMENT SYS_cnt_NumAngularFuncCalls "Displayable" ULONG CU_SYS_CNT_NUMANGULARFUNCCALLS 1 100 0.0 4294967295.0 ECU_ADDRESS 0x40003074 BYTE_ORDER MSB_FIRST /end MEASUREMENT
/begin COMPU_METHOD CU_SYS_CNT_NUMANGULARFUNCCALLS "Conversion method for SYS_cnt_NumAngularFuncCalls" RAT_FUNC "%10.0" "cnt" COEFFS 0.000000 1.000000 0.000000 0.000000 0.000000 1.000000 /end COMPU_METHOD
/* Scalar measurable for DDE 'SYS_deg_CamTooth1'. */
/begin MEASUREMENT SYS_deg_CamTooth1 "(not defined)" FLOAT32_IEEE CU_SYS_DEG_CAMTOOTH1 1 100 0.0 720.0 ECU_ADDRESS 0x40003980 BYTE_ORDER MSB_FIRST /end MEASUREMENT
/begin COMPU_METHOD CU_SYS_DEG_CAMTOOTH1 "Conversion method for SYS_deg_CamTooth1" RAT_FUNC "%10.0" "deg" COEFFS 0.000000 1.000000 0.000000 0.000000 0.000000 1.000000 /end COMPU_METHOD
/* Scalar measurable for DDE 'SYS_deg_CamTooth2'. */
/begin MEASUREMENT SYS_deg_CamTooth2 "(not defined)" FLOAT32_IEEE CU_SYS_DEG_CAMTOOTH2 1 100 0.0 720.0 ECU_ADDRESS 0x4000397c BYTE_ORDER MSB_FIRST /end MEASUREMENT
/begin COMPU_METHOD CU_SYS_DEG_CAMTOOTH2 "Conversion method for SYS_deg_CamTooth2" RAT_FUNC "%10.0" "deg" COEFFS 0.000000 1.000000 0.000000 0.000000 0.000000 1.000000 /end COMPU_METHOD
/* Scalar measurable for DDE 'SYS_deg_CamTooth3'. */
/begin MEASUREMENT SYS_deg_CamTooth3 "(not defined)" FLOAT32_IEEE CU_SYS_DEG_CAMTOOTH3 1 100 0.0 720.0 ECU_ADDRESS 0x40003974 BYTE_ORDER MSB_FIRST /end MEASUREMENT
/begin COMPU_METHOD CU_SYS_DEG_CAMTOOTH3 "Conversion method for SYS_deg_CamTooth3" RAT_FUNC "%10.0" "deg" COEFFS 0.000000 1.000000 0.000000 0.000000 0.000000 1.000000 /end COMPU_METHOD
/* Scalar measurable for DDE 'SYS_deg_CamTooth4'. */
/begin MEASUREMENT SYS_deg_CamTooth4 "(not defined)" FLOAT32_IEEE CU_SYS_DEG_CAMTOOTH4 1 100 0.0 720.0 ECU_ADDRESS 0x40003970 BYTE_ORDER MSB_FIRST /end MEASUREMENT
/begin COMPU_METHOD CU_SYS_DEG_CAMTOOTH4 "Conversion method for SYS_deg_CamTooth4" RAT_FUNC "%10.0" "deg" COEFFS 0.000000 1.000000 0.000000 0.000000 0.000000 1.000000 /end COMPU_METHOD
/* Scalar measurable for DDE 'SYS_deg_CrankAng'. */
/begin MEASUREMENT SYS_deg_CrankAng "Crank angle relative to missing tooth region" FLOAT32_IEEE CU_SYS_DEG_CRANKANG 1 100 0.0 0.0 ECU_ADDRESS 0x4000382c BYTE_ORDER MSB_FIRST /end MEASUREMENT
/begin COMPU_METHOD CU_SYS_DEG_CRANKANG "Conversion method for SYS_deg_CrankAng" RAT_FUNC "%10.0" "deg" COEFFS 0.000000 1.000000 0.000000 0.000000 0.000000 1.000000 /end COMPU_METHOD
/* Scalar measurable for DDE 'SYS_deg_EngAngOfst'. */
/begin MEASUREMENT SYS_deg_EngAngOfst "(not defined)" FLOAT32_IEEE CU_SYS_DEG_ENGANGOFST 1 100 0.0 720.0 ECU_ADDRESS 0x40003984 BYTE_ORDER MSB_FIRST /end MEASUREMENT
/begin COMPU_METHOD CU_SYS_DEG_ENGANGOFST "Conversion method for SYS_deg_EngAngOfst" RAT_FUNC "%10.0" "deg" COEFFS 0.000000 1.000000 0.000000 0.000000 0.000000 1.000000 /end COMPU_METHOD
/* Scalar measurable for DDE 'SYS_deg_EngAngOfstReq'. */
/begin MEASUREMENT SYS_deg_EngAngOfstReq "(not defined)" FLOAT32_IEEE CU_SYS_DEG_ENGANGOFSTREQ 1 100 -720.0 720.0 ECU_ADDRESS 0x40003978 BYTE_ORDER MSB_FIRST /end MEASUREMENT
/begin COMPU_METHOD CU_SYS_DEG_ENGANGOFSTREQ "Conversion method for SYS_deg_EngAngOfstReq" RAT_FUNC "%10.3" "deg" COEFFS 0.000000 1.000000 0.000000 0.000000 0.000000 1.000000 /end COMPU_METHOD
/* Scalar measurable for DDE 'SYS_e_CAN0_State'. */
/begin MEASUREMENT SYS_e_CAN0_State "CAN0 bus state" FLOAT32_IEEE CU_SYS_E_CAN0_STATE 1 100 0.0 2.0 ECU_ADDRESS 0x4000369c BYTE_ORDER MSB_FIRST /end MEASUREMENT
/begin COMPU_METHOD CU_SYS_E_CAN0_STATE "Conversion method for SYS_e_CAN0_State" TAB_VERB "%12.0" "e" COMPU_TAB_REF CT_SYS_E_CAN0_STATE /end COMPU_METHOD
/begin COMPU_VTAB CT_SYS_E_CAN0_STATE "Conversion method for SYS_e_CAN0_State" TAB_VERB 3 0 "SYSk_e_CAN_Active" 1 "SYSk_e_CAN_ErrorPassive" 2 "SYSk_e_CAN_BusOff" /end COMPU_VTAB
/* Scalar measurable for DDE 'SYS_e_CAN1_State'. */
/begin MEASUREMENT SYS_e_CAN1_State "CAN1 bus state" FLOAT32_IEEE CU_SYS_E_CAN1_STATE 1 100 0.0 2.0 ECU_ADDRESS 0x40003694 BYTE_ORDER MSB_FIRST /end MEASUREMENT
/begin COMPU_METHOD CU_SYS_E_CAN1_STATE "Conversion method for SYS_e_CAN1_State" TAB_VERB "%12.0" "e" COMPU_TAB_REF CT_SYS_E_CAN1_STATE /end COMPU_METHOD
/begin COMPU_VTAB CT_SYS_E_CAN1_STATE "Conversion method for SYS_e_CAN1_State" TAB_VERB 3 0 "SYSk_e_CAN_Active" 1 "SYSk_e_CAN_ErrorPassive" 2 "SYSk_e_CAN_BusOff" /end COMPU_VTAB
/* Scalar measurable for DDE 'SYS_e_CAN3_State'. */
/begin MEASUREMENT SYS_e_CAN3_State "CAN3 bus state" FLOAT32_IEEE CU_SYS_E_CAN3_STATE 1 100 0.0 2.0 ECU_ADDRESS 0x40003698 BYTE_ORDER MSB_FIRST /end MEASUREMENT
/begin COMPU_METHOD CU_SYS_E_CAN3_STATE "Conversion method for SYS_e_CAN3_State" TAB_VERB "%12.0" "e" COMPU_TAB_REF CT_SYS_E_CAN3_STATE /end COMPU_METHOD
/begin COMPU_VTAB CT_SYS_E_CAN3_STATE "Conversion method for SYS_e_CAN3_State" TAB_VERB 3 0 "SYSk_e_CAN_Active" 1 "SYSk_e_CAN_ErrorPassive" 2 "SYSk_e_CAN_BusOff" /end COMPU_VTAB
/* Scalar measurable for DDE 'SYS_e_EngSync'. */
/begin MEASUREMENT SYS_e_EngSync "(not defined)" FLOAT32_IEEE CU_SYS_E_ENGSYNC 1 100 0.0 3.0 ECU_ADDRESS 0x40003988 BYTE_ORDER MSB_FIRST /end MEASUREMENT
/begin COMPU_METHOD CU_SYS_E_ENGSYNC "Conversion method for SYS_e_EngSync" RAT_FUNC "%10.0" "e" COEFFS 0.000000 1.000000 0.000000 0.000000 0.000000 1.000000 /end COMPU_METHOD
/* Scalar measurable for DDE 'SYS_s_BootDuration'. */
/begin MEASUREMENT SYS_s_BootDuration "Time taken for ECU boot" FLOAT32_IEEE CU_SYS_S_BOOTDURATION 1 100 0.0 100.0 ECU_ADDRESS 0x400036b4 BYTE_ORDER MSB_FIRST /end MEASUREMENT
/begin COMPU_METHOD CU_SYS_S_BOOTDURATION "Conversion method for SYS_s_BootDuration" RAT_FUNC "%10.6" "s" COEFFS 0.000000 1.000000 0.000000 0.000000 0.000000 1.000000 /end COMPU_METHOD
/* Scalar measurable for DDE 'SYS_us_LoopA_Task'. */
/begin MEASUREMENT SYS_us_LoopA_Task "Duration of periodic task (last measured valued)" ULONG CU_SYS_US_LOOPA_TASK 1 100 0.0 0.0 ECU_ADDRESS 0x40003064 BYTE_ORDER MSB_FIRST /end MEASUREMENT
/begin COMPU_METHOD CU_SYS_US_LOOPA_TASK "Conversion method for SYS_us_LoopA_Task" RAT_FUNC "%10.0" "us" COEFFS 0.000000 1.000000 0.000000 0.000000 0.000000 1.000000 /end COMPU_METHOD
/* Scalar measurable for DDE 'SYS_us_LoopA_TaskMax'. */
/begin MEASUREMENT SYS_us_LoopA_TaskMax "Duration of periodic task (maximum since power up)" ULONG CU_SYS_US_LOOPA_TASKMAX 1 100 0.0 0.0 ECU_ADDRESS 0x4000305c BYTE_ORDER MSB_FIRST /end MEASUREMENT
/begin COMPU_METHOD CU_SYS_US_LOOPA_TASKMAX "Conversion method for SYS_us_LoopA_TaskMax" RAT_FUNC "%10.0" "us" COEFFS 0.000000 1.000000 0.000000 0.000000 0.000000 1.000000 /end COMPU_METHOD
/* Scalar measurable for DDE 'TAR_Nm_EEC1Tq'. */
/begin MEASUREMENT TAR_Nm_EEC1Tq "(not defined)" FLOAT32_IEEE CU_TAR_NM_EEC1TQ 1 100 0.0 0.0 ECU_ADDRESS 0x400032b0 BYTE_ORDER MSB_FIRST /end MEASUREMENT
/begin COMPU_METHOD CU_TAR_NM_EEC1TQ "Conversion method for TAR_Nm_EEC1Tq" RAT_FUNC "%10.0" "Nm" COEFFS 0.000000 1.000000 0.000000 0.000000 0.000000 1.000000 /end COMPU_METHOD
/* Scalar measurable for DDE 'TAR_Nm_EEC1Tqt'. */
/begin MEASUREMENT TAR_Nm_EEC1Tqt "(not defined)" FLOAT32_IEEE CU_TAR_NM_EEC1TQT 1 100 0.0 0.0 ECU_ADDRESS 0x400032ac BYTE_ORDER MSB_FIRST /end MEASUREMENT
/begin COMPU_METHOD CU_TAR_NM_EEC1TQT "Conversion method for TAR_Nm_EEC1Tqt" RAT_FUNC "%10.0" "Nm" COEFFS 0.000000 1.000000 0.000000 0.000000 0.000000 1.000000 /end COMPU_METHOD
/* Scalar measurable for DDE 'TAR_Nm_EngDmnd'. */
/begin MEASUREMENT TAR_Nm_EngDmnd "(not defined)" FLOAT32_IEEE CU_TAR_NM_ENGDMND 1 100 0.0 0.0 ECU_ADDRESS 0x4000355c BYTE_ORDER MSB_FIRST /end MEASUREMENT
/begin COMPU_METHOD CU_TAR_NM_ENGDMND "Conversion method for TAR_Nm_EngDmnd" RAT_FUNC "%10.0" "Nm" COEFFS 0.000000 1.000000 0.000000 0.000000 0.000000 1.000000 /end COMPU_METHOD
/* Scalar measurable for DDE 'TAR_Nm_J1939DrvrDmndTq'. */
/begin MEASUREMENT TAR_Nm_J1939DrvrDmndTq "(not defined)" FLOAT32_IEEE CU_TAR_NM_J1939DRVRDMNDTQ 1 100 3.0 3.0 ECU_ADDRESS 0x40003298 BYTE_ORDER MSB_FIRST /end MEASUREMENT
/begin COMPU_METHOD CU_TAR_NM_J1939DRVRDMNDTQ "Conversion method for TAR_Nm_J1939DrvrDmndTq" RAT_FUNC "%10.0" "Nm" COEFFS 0.000000 1.000000 0.000000 0.000000 0.000000 1.000000 /end COMPU_METHOD
/* Scalar measurable for DDE 'TAR_Nm_MaxTqTable'. */
/begin MEASUREMENT TAR_Nm_MaxTqTable "Maximum feasible torque at current RPM" FLOAT32_IEEE CU_TAR_NM_MAXTQTABLE 1 100 0.0 0.0 ECU_ADDRESS 0x40003600 BYTE_ORDER MSB_FIRST /end MEASUREMENT
/begin COMPU_METHOD CU_TAR_NM_MAXTQTABLE "Conversion method for TAR_Nm_MaxTqTable" RAT_FUNC "%10.1" "Nm" COEFFS 0.000000 1.000000 0.000000 0.000000 0.000000 1.000000 /end COMPU_METHOD
/* Scalar measurable for DDE 'TAR_Nm_RawArbTqRqst'. */
/begin MEASUREMENT TAR_Nm_RawArbTqRqst "Raw arbitrated torque request" FLOAT32_IEEE CU_TAR_NM_RAWARBTQRQST 1 100 0.0 0.0 ECU_ADDRESS 0x40003570 BYTE_ORDER MSB_FIRST /end MEASUREMENT
/begin COMPU_METHOD CU_TAR_NM_RAWARBTQRQST "Conversion method for TAR_Nm_RawArbTqRqst" RAT_FUNC "%10.1" "Nm" COEFFS 0.000000 1.000000 0.000000 0.000000 0.000000 1.000000 /end COMPU_METHOD
/* Scalar measurable for DDE 'TAR_Nm_TqFromAir'. */
/begin MEASUREMENT TAR_Nm_TqFromAir "(not defined)" FLOAT32_IEEE CU_TAR_NM_TQFROMAIR 1 100 0.0 0.0 ECU_ADDRESS 0x400032bc BYTE_ORDER MSB_FIRST /end MEASUREMENT
/begin COMPU_METHOD CU_TAR_NM_TQFROMAIR "Conversion method for TAR_Nm_TqFromAir" RAT_FUNC "%10.0" "Nm" COEFFS 0.000000 1.000000 0.000000 0.000000 0.000000 1.000000 /end COMPU_METHOD
/* Scalar measurable for DDE 'TAR_Nm_TqFromMAP'. */
/begin MEASUREMENT TAR_Nm_TqFromMAP "(not defined)" FLOAT32_IEEE CU_TAR_NM_TQFROMMAP 1 100 0.0 0.0 ECU_ADDRESS 0x400032c0 BYTE_ORDER MSB_FIRST /end MEASUREMENT
/begin COMPU_METHOD CU_TAR_NM_TQFROMMAP "Conversion method for TAR_Nm_TqFromMAP" RAT_FUNC "%10.0" "Nm" COEFFS 0.000000 1.000000 0.000000 0.000000 0.000000 1.000000 /end COMPU_METHOD
/* Scalar measurable for DDE 'TAR_Nm_TqFromMAP_Idle'. */
/begin MEASUREMENT TAR_Nm_TqFromMAP_Idle "(not defined)" FLOAT32_IEEE CU_TAR_NM_TQFROMMAP_IDLE 1 100 0.0 0.0 ECU_ADDRESS 0x400032c4 BYTE_ORDER MSB_FIRST /end MEASUREMENT
/begin COMPU_METHOD CU_TAR_NM_TQFROMMAP_IDLE "Conversion method for TAR_Nm_TqFromMAP_Idle" RAT_FUNC "%10.0" "Nm" COEFFS 0.000000 1.000000 0.000000 0.000000 0.000000 1.000000 /end COMPU_METHOD
/* Scalar measurable for DDE 'TAR_Nm_TqRqst'. */
/begin MEASUREMENT TAR_Nm_TqRqst "Arbitrated torque request" FLOAT32_IEEE CU_TAR_NM_TQRQST 1 100 0.0 0.0 ECU_ADDRESS 0x40003550 BYTE_ORDER MSB_FIRST /end MEASUREMENT
/begin COMPU_METHOD CU_TAR_NM_TQRQST "Conversion method for TAR_Nm_TqRqst" RAT_FUNC "%10.2" "Nm" COEFFS 0.000000 1.000000 0.000000 0.000000 0.000000 1.000000 /end COMPU_METHOD
/* Scalar measurable for DDE 'TAR_Nm_TqiFromMAP_Idle'. */
/begin MEASUREMENT TAR_Nm_TqiFromMAP_Idle "(not defined)" FLOAT32_IEEE CU_TAR_NM_TQIFROMMAP_IDLE 1 100 0.0 0.0 ECU_ADDRESS 0x400032b8 BYTE_ORDER MSB_FIRST /end MEASUREMENT
/begin COMPU_METHOD CU_TAR_NM_TQIFROMMAP_IDLE "Conversion method for TAR_Nm_TqiFromMAP_Idle" RAT_FUNC "%10.0" "Nm" COEFFS 0.000000 1.000000 0.000000 0.000000 0.000000 1.000000 /end COMPU_METHOD
/* Scalar measurable for DDE 'TAR_Nm_TqiFromModel'. */
/begin MEASUREMENT TAR_Nm_TqiFromModel "(not defined)" FLOAT32_IEEE CU_TAR_NM_TQIFROMMODEL 1 100 0.0 0.0 ECU_ADDRESS 0x400032b4 BYTE_ORDER MSB_FIRST /end MEASUREMENT
/begin COMPU_METHOD CU_TAR_NM_TQIFROMMODEL "Conversion method for TAR_Nm_TqiFromModel" RAT_FUNC "%10.0" "Nm" COEFFS 0.000000 1.000000 0.000000 0.000000 0.000000 1.000000 /end COMPU_METHOD
/* Scalar measurable for DDE 'TAR_b_DTC_TqLimit'. */
/begin MEASUREMENT TAR_b_DTC_TqLimit "Displayable" UBYTE CU_TAR_B_DTC_TQLIMIT 1 100 0.0 1.0 ECU_ADDRESS 0x40002ed1 BYTE_ORDER MSB_FIRST /end MEASUREMENT
/begin COMPU_METHOD CU_TAR_B_DTC_TQLIMIT "Conversion method for TAR_b_DTC_TqLimit" RAT_FUNC "%10.0" "b" COEFFS 0.000000 1.000000 0.000000 0.000000 0.000000 1.000000 /end COMPU_METHOD
/* Scalar measurable for DDE 'TAR_b_LimpHome'. */
/begin MEASUREMENT TAR_b_LimpHome "Displayable" UBYTE CU_TAR_B_LIMPHOME 1 100 0.0 1.0 ECU_ADDRESS 0x40002ee1 BYTE_ORDER MSB_FIRST /end MEASUREMENT
/begin COMPU_METHOD CU_TAR_B_LIMPHOME "Conversion method for TAR_b_LimpHome" RAT_FUNC "%10.0" "b" COEFFS 0.000000 1.000000 0.000000 0.000000 0.000000 1.000000 /end COMPU_METHOD
/* Scalar measurable for DDE 'TAR_b_TqFromMAP_act'. */
/begin MEASUREMENT TAR_b_TqFromMAP_act "(not defined)" UBYTE CU_TAR_B_TQFROMMAP_ACT 1 100 0.0 1.0 ECU_ADDRESS 0x40002e93 BYTE_ORDER MSB_FIRST /end MEASUREMENT
/begin COMPU_METHOD CU_TAR_B_TQFROMMAP_ACT "Conversion method for TAR_b_TqFromMAP_act" RAT_FUNC "%10.0" "b" COEFFS 0.000000 1.000000 0.000000 0.000000 0.000000 1.000000 /end COMPU_METHOD
/* Scalar measurable for DDE 'TRF_Nm_TqHPF'. */
/begin MEASUREMENT TRF_Nm_TqHPF "Filter result" FLOAT32_IEEE CU_TRF_NM_TQHPF 1 100 0.0 0.0 ECU_ADDRESS 0x400034cc BYTE_ORDER MSB_FIRST /end MEASUREMENT
/begin COMPU_METHOD CU_TRF_NM_TQHPF "Conversion method for TRF_Nm_TqHPF" RAT_FUNC "%10.2" "Nm" COEFFS 0.000000 1.000000 0.000000 0.000000 0.000000 1.000000 /end COMPU_METHOD
/* Scalar measurable for DDE 'TRF_b_Actv'. */
/begin MEASUREMENT TRF_b_Actv "TRF enabled" UBYTE CU_TRF_B_ACTV 1 100 0.0 1.0 ECU_ADDRESS 0x40002ec0 BYTE_ORDER MSB_FIRST /end MEASUREMENT
/begin COMPU_METHOD CU_TRF_B_ACTV "Conversion method for TRF_b_Actv" RAT_FUNC "%10.0" "b" COEFFS 0.000000 1.000000 0.000000 0.000000 0.000000 1.000000 /end COMPU_METHOD
/* Scalar measurable for DDE 'TRF_b_Transient'. */
/begin MEASUREMENT TRF_b_Transient "TRF Rate of change enable criteria passed" UBYTE CU_TRF_B_TRANSIENT 1 100 0.0 1.0 ECU_ADDRESS 0x40002ec1 BYTE_ORDER MSB_FIRST /end MEASUREMENT
/begin COMPU_METHOD CU_TRF_B_TRANSIENT "Conversion method for TRF_b_Transient" RAT_FUNC "%10.0" "b" COEFFS 0.000000 1.000000 0.000000 0.000000 0.000000 1.000000 /end COMPU_METHOD
/* Scalar measurable for DDE 'TRF_lam_EnrichmentRqst'. */
/begin MEASUREMENT TRF_lam_EnrichmentRqst "TRF AFR modifier raw value" FLOAT32_IEEE CU_TRF_LAM_ENRICHMENTRQST 1 100 0.0 0.0 ECU_ADDRESS 0x400034c8 BYTE_ORDER MSB_FIRST /end MEASUREMENT
/begin COMPU_METHOD CU_TRF_LAM_ENRICHMENTRQST "Conversion method for TRF_lam_EnrichmentRqst" RAT_FUNC "%10.3" "lam" COEFFS 0.000000 1.000000 0.000000 0.000000 0.000000 1.000000 /end COMPU_METHOD
/* Scalar measurable for DDE 'TRF_lam_Trim'. */
/begin MEASUREMENT TRF_lam_Trim "Final AFR modifier (lambda adder)" FLOAT32_IEEE CU_TRF_LAM_TRIM 1 100 0.0 0.0 ECU_ADDRESS 0x400034c4 BYTE_ORDER MSB_FIRST /end MEASUREMENT
/begin COMPU_METHOD CU_TRF_LAM_TRIM "Conversion method for TRF_lam_Trim" RAT_FUNC "%10.2" "lam" COEFFS 0.000000 1.000000 0.000000 0.000000 0.000000 1.000000 /end COMPU_METHOD
/* Scalar measurable for DDE 'TRS_Nm_TqHPF'. */
/begin MEASUREMENT TRS_Nm_TqHPF "Filter result" FLOAT32_IEEE CU_TRS_NM_TQHPF 1 100 0.0 0.0 ECU_ADDRESS 0x40003488 BYTE_ORDER MSB_FIRST /end MEASUREMENT
/begin COMPU_METHOD CU_TRS_NM_TQHPF "Conversion method for TRS_Nm_TqHPF" RAT_FUNC "%10.2" "Nm" COEFFS 0.000000 1.000000 0.000000 0.000000 0.000000 1.000000 /end COMPU_METHOD
/* Scalar measurable for DDE 'TRS_Nm_TqHPF_Peak'. */
/begin MEASUREMENT TRS_Nm_TqHPF_Peak "Peak value of the Torque HPF" FLOAT32_IEEE CU_TRS_NM_TQHPF_PEAK 1 100 0.0 0.0 ECU_ADDRESS 0x40003484 BYTE_ORDER MSB_FIRST /end MEASUREMENT
/begin COMPU_METHOD CU_TRS_NM_TQHPF_PEAK "Conversion method for TRS_Nm_TqHPF_Peak" RAT_FUNC "%10.2" "Nm" COEFFS 0.000000 1.000000 0.000000 0.000000 0.000000 1.000000 /end COMPU_METHOD
/* Scalar measurable for DDE 'TRS_b_Transient'. */
/begin MEASUREMENT TRS_b_Transient "TRS transient detected" UBYTE CU_TRS_B_TRANSIENT 1 100 0.0 1.0 ECU_ADDRESS 0x40002ebe BYTE_ORDER MSB_FIRST /end MEASUREMENT
/begin COMPU_METHOD CU_TRS_B_TRANSIENT "Conversion method for TRS_b_Transient" RAT_FUNC "%10.0" "b" COEFFS 0.000000 1.000000 0.000000 0.000000 0.000000 1.000000 /end COMPU_METHOD
/* Scalar measurable for DDE 'TRS_ret_SparkRqst'. */
/begin MEASUREMENT TRS_ret_SparkRqst "Displayable" FLOAT32_IEEE CU_TRS_RET_SPARKRQST 1 100 0.0 0.0 ECU_ADDRESS 0x4000347c BYTE_ORDER MSB_FIRST /end MEASUREMENT
/begin COMPU_METHOD CU_TRS_RET_SPARKRQST "Conversion method for TRS_ret_SparkRqst" RAT_FUNC "%10.1" "ret" COEFFS 0.000000 1.000000 0.000000 0.000000 0.000000 1.000000 /end COMPU_METHOD
/* Scalar measurable for DDE 'TRS_ret_SparkRqstRaw'. */
/begin MEASUREMENT TRS_ret_SparkRqstRaw "Raw transient spark retard" FLOAT32_IEEE CU_TRS_RET_SPARKRQSTRAW 1 100 0.0 0.0 ECU_ADDRESS 0x40003480 BYTE_ORDER MSB_FIRST /end MEASUREMENT
/begin COMPU_METHOD CU_TRS_RET_SPARKRQSTRAW "Conversion method for TRS_ret_SparkRqstRaw" RAT_FUNC "%10.1" "ret" COEFFS 0.000000 1.000000 0.000000 0.000000 0.000000 1.000000 /end COMPU_METHOD
/* Scalar measurable for DDE 'TSS_b_OBDtimeOK'. */
/begin MEASUREMENT TSS_b_OBDtimeOK "Displayable" UBYTE CU_TSS_B_OBDTIMEOK 1 100 0.0 1.0 ECU_ADDRESS 0x40002f36 BYTE_ORDER MSB_FIRST /end MEASUREMENT
/begin COMPU_METHOD CU_TSS_B_OBDTIMEOK "Conversion method for TSS_b_OBDtimeOK" RAT_FUNC "%10.0" "b" COEFFS 0.000000 1.000000 0.000000 0.000000 0.000000 1.000000 /end COMPU_METHOD
/* Scalar measurable for DDE 'TUR_NU_BoostPressErrROC'. */
/begin MEASUREMENT TUR_NU_BoostPressErrROC "Rate of change of manifold pressure error" FLOAT32_IEEE CU_TUR_NU_BOOSTPRESSERRROC 1 100 0.0 0.0 ECU_ADDRESS 0x40003284 BYTE_ORDER MSB_FIRST /end MEASUREMENT
/begin COMPU_METHOD CU_TUR_NU_BOOSTPRESSERRROC "Conversion method for TUR_NU_BoostPressErrROC" RAT_FUNC "%10.2" "NU" COEFFS 0.000000 1.000000 0.000000 0.000000 0.000000 1.000000 /end COMPU_METHOD
/* Scalar measurable for DDE 'TUR_NU_FB_DC'. */
/begin MEASUREMENT TUR_NU_FB_DC "Tubo Feedback DC" FLOAT32_IEEE CU_TUR_NU_FB_DC 1 100 0.0 0.0 ECU_ADDRESS 0x40003264 BYTE_ORDER MSB_FIRST /end MEASUREMENT
/begin COMPU_METHOD CU_TUR_NU_FB_DC "Conversion method for TUR_NU_FB_DC" RAT_FUNC "%10.3" "pct" COEFFS 0.000000 1.000000 0.000000 0.000000 0.000000 1.000000 /end COMPU_METHOD
/* Scalar measurable for DDE 'TUR_NU_FF_DC'. */
/begin MEASUREMENT TUR_NU_FF_DC "Tubo Feedback DC" FLOAT32_IEEE CU_TUR_NU_FF_DC 1 100 0.0 0.0 ECU_ADDRESS 0x40003260 BYTE_ORDER MSB_FIRST /end MEASUREMENT
/begin COMPU_METHOD CU_TUR_NU_FF_DC "Conversion method for TUR_NU_FF_DC" RAT_FUNC "%10.3" "pct" COEFFS 0.000000 1.000000 0.000000 0.000000 0.000000 1.000000 /end COMPU_METHOD
/* Scalar measurable for DDE 'TUR_NU_PressRatioTrgt'. */
/begin MEASUREMENT TUR_NU_PressRatioTrgt "Target boost pressure ratio" FLOAT32_IEEE CU_TUR_NU_PRESSRATIOTRGT 1 100 0.0 0.0 ECU_ADDRESS 0x40003274 BYTE_ORDER MSB_FIRST /end MEASUREMENT
/begin COMPU_METHOD CU_TUR_NU_PRESSRATIOTRGT "Conversion method for TUR_NU_PressRatioTrgt" RAT_FUNC "%10.2" "NU" COEFFS 0.000000 1.000000 0.000000 0.000000 0.000000 1.000000 /end COMPU_METHOD
/* Scalar measurable for DDE 'TUR_b_AtMaxBoost'. */
/begin MEASUREMENT TUR_b_AtMaxBoost "Indicates actuator is at its limit of authority" UBYTE CU_TUR_B_ATMAXBOOST 1 100 0.0 1.0 ECU_ADDRESS 0x40002e82 BYTE_ORDER MSB_FIRST /end MEASUREMENT
/begin COMPU_METHOD CU_TUR_B_ATMAXBOOST "Conversion method for TUR_b_AtMaxBoost" RAT_FUNC "%10.0" "b" COEFFS 0.000000 1.000000 0.000000 0.000000 0.000000 1.000000 /end COMPU_METHOD
/* Scalar measurable for DDE 'TUR_b_AtMinBoost'. */
/begin MEASUREMENT TUR_b_AtMinBoost "Indicates actuator is at its limit of authority" UBYTE CU_TUR_B_ATMINBOOST 1 100 0.0 1.0 ECU_ADDRESS 0x40002e83 BYTE_ORDER MSB_FIRST /end MEASUREMENT
/begin COMPU_METHOD CU_TUR_B_ATMINBOOST "Conversion method for TUR_b_AtMinBoost" RAT_FUNC "%10.0" "b" COEFFS 0.000000 1.000000 0.000000 0.000000 0.000000 1.000000 /end COMPU_METHOD
/* Scalar measurable for DDE 'TUR_b_CompBypassValve'. */
/begin MEASUREMENT TUR_b_CompBypassValve "Compressor bypass valve command" UBYTE CU_TUR_B_COMPBYPASSVALVE 1 100 0.0 1.0 ECU_ADDRESS 0x40002e7f BYTE_ORDER MSB_FIRST /end MEASUREMENT
/begin COMPU_METHOD CU_TUR_B_COMPBYPASSVALVE "Conversion method for TUR_b_CompBypassValve" RAT_FUNC "%10.0" "b" COEFFS 0.000000 1.000000 0.000000 0.000000 0.000000 1.000000 /end COMPU_METHOD
/* Scalar measurable for DDE 'TUR_kPa_BoostPressErr'. */
/begin MEASUREMENT TUR_kPa_BoostPressErr "Manifold pressure error" FLOAT32_IEEE CU_TUR_KPA_BOOSTPRESSERR 1 100 0.0 0.0 ECU_ADDRESS 0x40003290 BYTE_ORDER MSB_FIRST /end MEASUREMENT
/begin COMPU_METHOD CU_TUR_KPA_BOOSTPRESSERR "Conversion method for TUR_kPa_BoostPressErr" RAT_FUNC "%10.2" "kPa" COEFFS 0.000000 1.000000 0.000000 0.000000 0.000000 1.000000 /end COMPU_METHOD
/* Scalar measurable for DDE 'TUR_pct_DTerm'. */
/begin MEASUREMENT TUR_pct_DTerm "Derivative effort term for turbo actuator control" FLOAT32_IEEE CU_TUR_PCT_DTERM 1 100 0.0 0.0 ECU_ADDRESS 0x40003280 BYTE_ORDER MSB_FIRST /end MEASUREMENT
/begin COMPU_METHOD CU_TUR_PCT_DTERM "Conversion method for TUR_pct_DTerm" RAT_FUNC "%10.3" "pct" COEFFS 0.000000 1.000000 0.000000 0.000000 0.000000 1.000000 /end COMPU_METHOD
/* Scalar measurable for DDE 'TUR_pct_FB_Effort'. */
/begin MEASUREMENT TUR_pct_FB_Effort "Final PID effort for turbo boost control" FLOAT32_IEEE CU_TUR_PCT_FB_EFFORT 1 100 0.0 0.0 ECU_ADDRESS 0x40003278 BYTE_ORDER MSB_FIRST /end MEASUREMENT
/begin COMPU_METHOD CU_TUR_PCT_FB_EFFORT "Conversion method for TUR_pct_FB_Effort" RAT_FUNC "%10.3" "pct" COEFFS 0.000000 1.000000 0.000000 0.000000 0.000000 1.000000 /end COMPU_METHOD
/* Scalar measurable for DDE 'TUR_pct_FB_EffortRaw'. */
/begin MEASUREMENT TUR_pct_FB_EffortRaw "Raw PID effort for turbo boost control" FLOAT32_IEEE CU_TUR_PCT_FB_EFFORTRAW 1 100 0.0 0.0 ECU_ADDRESS 0x4000327c BYTE_ORDER MSB_FIRST /end MEASUREMENT
/begin COMPU_METHOD CU_TUR_PCT_FB_EFFORTRAW "Conversion method for TUR_pct_FB_EffortRaw" RAT_FUNC "%10.3" "pct" COEFFS 0.000000 1.000000 0.000000 0.000000 0.000000 1.000000 /end COMPU_METHOD
/* Scalar measurable for DDE 'TUR_pct_FF_Effort'. */
/begin MEASUREMENT TUR_pct_FF_Effort "Turbo feedforward effort" FLOAT32_IEEE CU_TUR_PCT_FF_EFFORT 1 100 0.0 0.0 ECU_ADDRESS 0x40003270 BYTE_ORDER MSB_FIRST /end MEASUREMENT
/begin COMPU_METHOD CU_TUR_PCT_FF_EFFORT "Conversion method for TUR_pct_FF_Effort" RAT_FUNC "%10.3" "pct" COEFFS 0.000000 1.000000 0.000000 0.000000 0.000000 1.000000 /end COMPU_METHOD
/* Scalar measurable for DDE 'TUR_pct_ITerm'. */
/begin MEASUREMENT TUR_pct_ITerm "Integral effort term in turbo actuator control" FLOAT32_IEEE CU_TUR_PCT_ITERM 1 100 0.0 0.0 ECU_ADDRESS 0x40003288 BYTE_ORDER MSB_FIRST /end MEASUREMENT
/begin COMPU_METHOD CU_TUR_PCT_ITERM "Conversion method for TUR_pct_ITerm" RAT_FUNC "%10.4" "pct" COEFFS 0.000000 1.000000 0.000000 0.000000 0.000000 1.000000 /end COMPU_METHOD
/* Scalar measurable for DDE 'TUR_pct_PTerm'. */
/begin MEASUREMENT TUR_pct_PTerm "Proportional effort term in turbo actuator control" FLOAT32_IEEE CU_TUR_PCT_PTERM 1 100 0.0 0.0 ECU_ADDRESS 0x4000328c BYTE_ORDER MSB_FIRST /end MEASUREMENT
/begin COMPU_METHOD CU_TUR_PCT_PTERM "Conversion method for TUR_pct_PTerm" RAT_FUNC "%10.4" "pct" COEFFS 0.000000 1.000000 0.000000 0.000000 0.000000 1.000000 /end COMPU_METHOD
/* Scalar measurable for DDE 'TUR_pct_TotalEffort'. */
/begin MEASUREMENT TUR_pct_TotalEffort "Final total turbo control effort" FLOAT32_IEEE CU_TUR_PCT_TOTALEFFORT 1 100 0.0 0.0 ECU_ADDRESS 0x40003268 BYTE_ORDER MSB_FIRST /end MEASUREMENT
/begin COMPU_METHOD CU_TUR_PCT_TOTALEFFORT "Conversion method for TUR_pct_TotalEffort" RAT_FUNC "%10.3" "pct" COEFFS 0.000000 1.000000 0.000000 0.000000 0.000000 1.000000 /end COMPU_METHOD
/* Scalar measurable for DDE 'TUR_pct_TotalEffortRaw'. */
/begin MEASUREMENT TUR_pct_TotalEffortRaw "Raw total turbo control effort" FLOAT32_IEEE CU_TUR_PCT_TOTALEFFORTRAW 1 100 0.0 0.0 ECU_ADDRESS 0x4000326c BYTE_ORDER MSB_FIRST /end MEASUREMENT
/begin COMPU_METHOD CU_TUR_PCT_TOTALEFFORTRAW "Conversion method for TUR_pct_TotalEffortRaw" RAT_FUNC "%10.3" "pct" COEFFS 0.000000 1.000000 0.000000 0.000000 0.000000 1.000000 /end COMPU_METHOD
/* Scalar measurable for DDE 'TUR_pct_TurCtrlDC'. */
/begin MEASUREMENT TUR_pct_TurCtrlDC "Final value of turbo control actuator duty cycle" FLOAT32_IEEE CU_TUR_PCT_TURCTRLDC 1 100 0.0 0.0 ECU_ADDRESS 0x40003234 BYTE_ORDER MSB_FIRST /end MEASUREMENT
/begin COMPU_METHOD CU_TUR_PCT_TURCTRLDC "Conversion method for TUR_pct_TurCtrlDC" RAT_FUNC "%10.3" "pct" COEFFS 0.000000 1.000000 0.000000 0.000000 0.000000 1.000000 /end COMPU_METHOD
/* Scalar measurable for DDE 'VCP_NU_CamErrROC'. */
/begin MEASUREMENT VCP_NU_CamErrROC "(deg/s) Time derivative of position error" FLOAT32_IEEE CU_VCP_NU_CAMERRROC 1 100 -100.0 100.0 ECU_ADDRESS 0x40003244 BYTE_ORDER MSB_FIRST /end MEASUREMENT
/begin COMPU_METHOD CU_VCP_NU_CAMERRROC "Conversion method for VCP_NU_CamErrROC" RAT_FUNC "%10.3" "NU" COEFFS 0.000000 1.000000 0.000000 0.000000 0.000000 1.000000 /end COMPU_METHOD
/* Scalar measurable for DDE 'VCP_adv_CamTrgt'. */
/begin MEASUREMENT VCP_adv_CamTrgt "Rate limited  cam phasing target" FLOAT32_IEEE CU_VCP_ADV_CAMTRGT 1 100 -5.0 100.0 ECU_ADDRESS 0x40003258 BYTE_ORDER MSB_FIRST /end MEASUREMENT
/begin COMPU_METHOD CU_VCP_ADV_CAMTRGT "Conversion method for VCP_adv_CamTrgt" RAT_FUNC "%10.1" "adv" COEFFS 0.000000 1.000000 0.000000 0.000000 0.000000 1.000000 /end COMPU_METHOD
/* Scalar measurable for DDE 'VCP_deg_CamErr'. */
/begin MEASUREMENT VCP_deg_CamErr "VVT error" FLOAT32_IEEE CU_VCP_DEG_CAMERR 1 100 -100.0 100.0 ECU_ADDRESS 0x40003250 BYTE_ORDER MSB_FIRST /end MEASUREMENT
/begin COMPU_METHOD CU_VCP_DEG_CAMERR "Conversion method for VCP_deg_CamErr" RAT_FUNC "%10.3" "NU" COEFFS 0.000000 1.000000 0.000000 0.000000 0.000000 1.000000 /end COMPU_METHOD
/* Scalar measurable for DDE 'VCP_pct_CamDC'. */
/begin MEASUREMENT VCP_pct_CamDC "PWM Signal percentage for Monitoring" FLOAT32_IEEE CU_VCP_PCT_CAMDC 1 100 0.0 1.0 ECU_ADDRESS 0x40003204 BYTE_ORDER MSB_FIRST /end MEASUREMENT
/begin COMPU_METHOD CU_VCP_PCT_CAMDC "Conversion method for VCP_pct_CamDC" RAT_FUNC "%10.2" "pct" COEFFS 0.000000 1.000000 0.000000 0.000000 0.000000 1.000000 /end COMPU_METHOD
/* Scalar measurable for DDE 'VCP_pct_CamDC_FF'. */
/begin MEASUREMENT VCP_pct_CamDC_FF "Feed-forward control effort for  cam phasing" FLOAT32_IEEE CU_VCP_PCT_CAMDC_FF 1 100 0.0 1.0 ECU_ADDRESS 0x40003254 BYTE_ORDER MSB_FIRST /end MEASUREMENT
/begin COMPU_METHOD CU_VCP_PCT_CAMDC_FF "Conversion method for VCP_pct_CamDC_FF" RAT_FUNC "%10.3" "NU" COEFFS 0.000000 1.000000 0.000000 0.000000 0.000000 1.000000 /end COMPU_METHOD
/* Scalar measurable for DDE 'VCP_pct_CamDC_PID'. */
/begin MEASUREMENT VCP_pct_CamDC_PID "Feedback control effort for  cam phasing" FLOAT32_IEEE CU_VCP_PCT_CAMDC_PID 1 100 0.0 1.0 ECU_ADDRESS 0x40003238 BYTE_ORDER MSB_FIRST /end MEASUREMENT
/begin COMPU_METHOD CU_VCP_PCT_CAMDC_PID "Conversion method for VCP_pct_CamDC_PID" RAT_FUNC "%10.3" "NU" COEFFS 0.000000 1.000000 0.000000 0.000000 0.000000 1.000000 /end COMPU_METHOD
/* Scalar measurable for DDE 'VCP_pct_CamDTerm'. */
/begin MEASUREMENT VCP_pct_CamDTerm "Derivative effort for  cam" FLOAT32_IEEE CU_VCP_PCT_CAMDTERM 1 100 -1.0 1.0 ECU_ADDRESS 0x40003240 BYTE_ORDER MSB_FIRST /end MEASUREMENT
/begin COMPU_METHOD CU_VCP_PCT_CAMDTERM "Conversion method for VCP_pct_CamDTerm" RAT_FUNC "%10.3" "NU" COEFFS 0.000000 1.000000 0.000000 0.000000 0.000000 1.000000 /end COMPU_METHOD
/* Scalar measurable for DDE 'VCP_pct_CamITerm'. */
/begin MEASUREMENT VCP_pct_CamITerm "Integral effort for  cam" FLOAT32_IEEE CU_VCP_PCT_CAMITERM 1 100 -1.0 1.0 ECU_ADDRESS 0x40003248 BYTE_ORDER MSB_FIRST /end MEASUREMENT
/begin COMPU_METHOD CU_VCP_PCT_CAMITERM "Conversion method for VCP_pct_CamITerm" RAT_FUNC "%10.3" "NU" COEFFS 0.000000 1.000000 0.000000 0.000000 0.000000 1.000000 /end COMPU_METHOD
/* Scalar measurable for DDE 'VCP_pct_CamPIDRaw'. */
/begin MEASUREMENT VCP_pct_CamPIDRaw "Cam PID effort raw" FLOAT32_IEEE CU_VCP_PCT_CAMPIDRAW 1 100 -1.0 1.0 ECU_ADDRESS 0x4000323c BYTE_ORDER MSB_FIRST /end MEASUREMENT
/begin COMPU_METHOD CU_VCP_PCT_CAMPIDRAW "Conversion method for VCP_pct_CamPIDRaw" RAT_FUNC "%10.3" "NU" COEFFS 0.000000 1.000000 0.000000 0.000000 0.000000 1.000000 /end COMPU_METHOD
/* Scalar measurable for DDE 'VCP_pct_CamPTerm'. */
/begin MEASUREMENT VCP_pct_CamPTerm "Proportional effort" FLOAT32_IEEE CU_VCP_PCT_CAMPTERM 1 100 0.0 1.0 ECU_ADDRESS 0x4000324c BYTE_ORDER MSB_FIRST /end MEASUREMENT
/begin COMPU_METHOD CU_VCP_PCT_CAMPTERM "Conversion method for VCP_pct_CamPTerm" RAT_FUNC "%10.3" "NU" COEFFS 0.000000 1.000000 0.000000 0.000000 0.000000 1.000000 /end COMPU_METHOD
/* Scalar measurable for DDE 'sys_app_code_day'. */
/begin MEASUREMENT sys_app_code_day "Day the application code was built." UWORD CU_SYS_APP_CODE_DAY 1 100 0.0 0.0 ECU_ADDRESS 0x4000314c BYTE_ORDER MSB_FIRST /end MEASUREMENT
/begin COMPU_METHOD CU_SYS_APP_CODE_DAY "Conversion method for sys_app_code_day" RAT_FUNC "%10.0" "(not defined)" COEFFS 0.000000 1.000000 0.000000 0.000000 0.000000 1.000000 /end COMPU_METHOD
/* Scalar measurable for DDE 'sys_app_code_major_ver'. */
/begin MEASUREMENT sys_app_code_major_ver "Major version of the application code." UWORD CU_SYS_APP_CODE_MAJOR_VER 1 100 0.0 0.0 ECU_ADDRESS 0x40003148 BYTE_ORDER MSB_FIRST /end MEASUREMENT
/begin COMPU_METHOD CU_SYS_APP_CODE_MAJOR_VER "Conversion method for sys_app_code_major_ver" RAT_FUNC "%10.0" "(not defined)" COEFFS 0.000000 1.000000 0.000000 0.000000 0.000000 1.000000 /end COMPU_METHOD
/* Scalar measurable for DDE 'sys_app_code_minor_ver'. */
/begin MEASUREMENT sys_app_code_minor_ver "Minor version of the application code." UWORD CU_SYS_APP_CODE_MINOR_VER 1 100 0.0 0.0 ECU_ADDRESS 0x40003144 BYTE_ORDER MSB_FIRST /end MEASUREMENT
/begin COMPU_METHOD CU_SYS_APP_CODE_MINOR_VER "Conversion method for sys_app_code_minor_ver" RAT_FUNC "%10.0" "(not defined)" COEFFS 0.000000 1.000000 0.000000 0.000000 0.000000 1.000000 /end COMPU_METHOD
/* Scalar measurable for DDE 'sys_app_code_month'. */
/begin MEASUREMENT sys_app_code_month "Month the application code was built." UWORD CU_SYS_APP_CODE_MONTH 1 100 0.0 0.0 ECU_ADDRESS 0x40003150 BYTE_ORDER MSB_FIRST /end MEASUREMENT
/begin COMPU_METHOD CU_SYS_APP_CODE_MONTH "Conversion method for sys_app_code_month" RAT_FUNC "%10.0" "(not defined)" COEFFS 0.000000 1.000000 0.000000 0.000000 0.000000 1.000000 /end COMPU_METHOD
/* Scalar measurable for DDE 'sys_app_code_subminor_ver'. */
/begin MEASUREMENT sys_app_code_subminor_ver "Sub-minor version of the application code." UWORD CU_SYS_APP_CODE_SUBMINOR_VER 1 100 0.0 0.0 ECU_ADDRESS 0x40003140 BYTE_ORDER MSB_FIRST /end MEASUREMENT
/begin COMPU_METHOD CU_SYS_APP_CODE_SUBMINOR_VER "Conversion method for sys_app_code_subminor_ver" RAT_FUNC "%10.0" "(not defined)" COEFFS 0.000000 1.000000 0.000000 0.000000 0.000000 1.000000 /end COMPU_METHOD
/* Scalar measurable for DDE 'sys_app_code_year'. */
/begin MEASUREMENT sys_app_code_year "Year the application code was built." UWORD CU_SYS_APP_CODE_YEAR 1 100 0.0 0.0 ECU_ADDRESS 0x40003154 BYTE_ORDER MSB_FIRST /end MEASUREMENT
/begin COMPU_METHOD CU_SYS_APP_CODE_YEAR "Conversion method for sys_app_code_year" RAT_FUNC "%10.0" "(not defined)" COEFFS 0.000000 1.000000 0.000000 0.000000 0.000000 1.000000 /end COMPU_METHOD
/* Scalar measurable for DDE 'sys_cpu_loading'. */
/begin MEASUREMENT sys_cpu_loading "CPU loading seen in last 50ms" UBYTE CU_SYS_CPU_LOADING 1 100 0.0 0.0 ECU_ADDRESS 0x40003018 BYTE_ORDER MSB_FIRST /end MEASUREMENT
/begin COMPU_METHOD CU_SYS_CPU_LOADING "Conversion method for sys_cpu_loading" RAT_FUNC "%10.0" "%" COEFFS 0.000000 1.000000 0.000000 0.000000 0.000000 1.000000 /end COMPU_METHOD
/* Scalar measurable for DDE 'sys_cpu_loading_max'. */
/begin MEASUREMENT sys_cpu_loading_max "Maximum CPU loading seen in any 50ms period" UBYTE CU_SYS_CPU_LOADING_MAX 1 100 0.0 0.0 ECU_ADDRESS 0x40003017 BYTE_ORDER MSB_FIRST /end MEASUREMENT
/begin COMPU_METHOD CU_SYS_CPU_LOADING_MAX "Conversion method for sys_cpu_loading_max" RAT_FUNC "%10.0" "%" COEFFS 0.000000 1.000000 0.000000 0.000000 0.000000 1.000000 /end COMPU_METHOD
/* Scalar measurable for DDE 'sys_stack_used'. */
/begin MEASUREMENT sys_stack_used "Amount of used stack" ULONG CU_SYS_STACK_USED 1 100 0.0 0.0 ECU_ADDRESS 0x40003060 BYTE_ORDER MSB_FIRST /end MEASUREMENT
/begin COMPU_METHOD CU_SYS_STACK_USED "Conversion method for sys_stack_used" RAT_FUNC "%10.0" "B" COEFFS 0.000000 1.000000 0.000000 0.000000 0.000000 1.000000 /end COMPU_METHOD
/begin FUNCTION inp "Group /ByDataDictionaryPrefix/inp"
 /begin LOC_MEASUREMENT INP_C_AmbientTemp INP_C_CompOutTemp INP_C_CoolantTemp INP_C_ExhaustTemp INP_C_FuelTemp INP_C_ManifoldTemp INP_C_OilTemp INP_L_TotalFuelLevel_L INP_NU_APP1_Raw INP_NU_APP2_Raw INP_NU_SpiCtrlCnts_A INP_NU_SpiCtrlCnts_B INP_NU_TP1_Raw INP_NU_TP2_Raw INP_RPM_CrankSpd INP_RPM_EngSpd INP_V_EGO11 INP_V_EGO21 INP_V_FuelLevel1 INP_V_FuelLevel2 INP_V_VBatt INP_b_AC_PressSw INP_b_AC_Rqst INP_b_CamWheelMvmt INP_b_CrankAngValid INP_b_CrankMvmt INP_b_EngAngValid INP_b_EngSync INP_b_Ign INP_b_OilPrSw INP_b_XG4 INP_bar_FuelPress INP_cnt_IgnCount INP_cnt_count_1 INP_cnt_count_2 INP_cnt_count_3 INP_cnt_count_4 INP_deg_CrankAng INP_deg_EngAng INP_e_TransGear INP_gps_MAF INP_kPa_Baro INP_kPa_CompOutPress INP_kPa_MAP INP_kPa_OilPress INP_kph_VehSpd INP_lam_UEGO1 INP_lam_UEGO2 INP_pct_AltLoad INP_pct_Cylinder1_Knock INP_pct_Cylinder2_Knock INP_pct_Cylinder3_Knock INP_pct_Cylinder4_Knock INP_pct_EstimatedGearRatio INP_pct_GLPLevel1 INP_pct_GLPLevel2 INP_pct_PrefiltTotalFuelLevel INP_pct_TotalFuelLevel INP_ret_VCP_Pos INP_rpm_EngSpdPre_ang_1 INP_rpm_EngSpdPre_ang_2 INP_rpm_EngSpdPre_ang_3 INP_rpm_EngSpdPre_ang_4 INP_rpm_EngSpdPst_ang_1 INP_rpm_EngSpdPst_ang_2 INP_rpm_EngSpdPst_ang_3 INP_rpm_EngSpdPst_ang_4 /end LOC_MEASUREMENT
 /begin REF_CHARACTERISTIC INPc_C_AmbientTemp INPc_C_CompOutTemp INPc_C_CoolantTemp INPc_C_ExhaustTemp INPc_C_FuelTemp INPc_C_ManifoldTemp INPc_C_OilTemp INPc_Hz_UaFiltConst INPc_Hz_UrFiltConst INPc_L_TotalFuelLevel_L INPc_NU_APP1_Raw INPc_NU_APP2_Raw INPc_NU_CrankSensorBias INPc_NU_CrankSensorType INPc_NU_TP1_Raw INPc_NU_TP2_Raw INPc_RPM_EngSpd INPc_V_EGO11 INPc_V_EGO21 INPc_V_FuelLevel1 INPc_V_FuelLevel2 INPc_V_VBatt INPc_b_AC_PressSw INPc_b_AC_Rqst INPc_b_EngSync INPc_b_Ign INPc_b_OilPrSw INPc_bar_FuelPress INPc_cnt_CrankTeethMissing INPc_cnt_TotalCrankTeeth INPc_e_TransGear INPc_gps_MAF INPc_kPa_Baro INPc_kPa_CompOutPress INPc_kPa_MAP INPc_kPa_OilPress INPc_kph_VehSpd INPc_lam_UEGO1 INPc_lam_UEGO2 INPc_nu_EngineSpeedCyl_1 INPc_nu_EngineSpeedCyl_2 INPc_nu_EngineSpeedCyl_3 INPc_nu_EngineSpeedCyl_4 INPc_nu_num_toothpost INPc_nu_num_toothpre INPc_nu_toothmodulo INPc_nu_toothpost INPc_nu_toothpre INPc_o_AC_PressSw INPc_o_AC_Rqst INPc_o_APP1_Raw INPc_o_APP2_Raw INPc_o_AltLoad INPc_o_AmbientTemp INPc_o_Baro INPc_o_CompOutPress INPc_o_CompOutTemp INPc_o_CoolantTemp INPc_o_Cylinder1_Knock INPc_o_Cylinder2_Knock INPc_o_Cylinder3_Knock INPc_o_Cylinder4_Knock INPc_o_EGO11 INPc_o_EGO21 INPc_o_EngSpd INPc_o_EngSync INPc_o_ExhaustTemp INPc_o_FuelLevel1 INPc_o_FuelLevel2 INPc_o_FuelPress INPc_o_FuelTemp INPc_o_GLPLevel1 INPc_o_GLPLevel2 INPc_o_Ign INPc_o_MAF INPc_o_MAP INPc_o_ManifoldTemp INPc_o_OilPrSw INPc_o_OilPress INPc_o_OilTemp INPc_o_PrefiltTotalFuelLevel INPc_o_TP1_Raw INPc_o_TP2_Raw INPc_o_TotalFuelLevel INPc_o_TotalFuelLevel_L INPc_o_TransGear INPc_o_UEGO1 INPc_o_UEGO2 INPc_o_VBatt INPc_o_VCP_Pos INPc_o_VehSpd INPc_pct_AltLoad INPc_pct_Cylinder1_Knock INPc_pct_Cylinder2_Knock INPc_pct_Cylinder3_Knock INPc_pct_Cylinder4_Knock INPc_pct_GLPLevel1 INPc_pct_GLPLevel2 INPc_pct_NeutralRatioHigh INPc_pct_NeutralRatioLow INPc_pct_PrefiltTotalFuelLevel INPc_pct_TotalFuelLevel INPc_ret_VCP_Pos INPc_s_DelayEnableMis INPc_s_MisfireDelay INPv_pct_GearRatios /end REF_CHARACTERISTIC
/end FUNCTION
/begin FUNCTION knk "Group /ByDataDictionaryPrefix/knk"
 /begin LOC_MEASUREMENT KNK_NU_EngSpdCorr KNK_b_EnrichFuel KNK_b_NewKnockEvent KNK_lam_AFR_Lim KNK_ret_SensorBased KNK_ret_SparkMod KNK_ret_TempBased /end LOC_MEASUREMENT
 /begin REF_CHARACTERISTIC KNKc_adv_AdvanceStep KNKc_b_Enbl KNKc_lam_AFR_Lim KNKc_lam_AntiKnock KNKc_o_AFR_Lim KNKc_o_SparkMod KNKc_pct_LoadDetectionThers KNKc_ret_SensorBasedMax KNKc_ret_SparkMod KNKc_ret_SparkModMax KNKc_s_RetardHoldTime KNKm_NU_EngSpdCorr_x KNKm_NU_EngSpdCorr_z KNKm_NU_RetardStep_x KNKm_NU_RetardStep_z KNKm_NU_SparkRetard_x KNKm_NU_SparkRetard_y KNKm_NU_SparkRetard_z KNKm_pct_DetectionThresh_x KNKm_pct_DetectionThresh_z /end REF_CHARACTERISTIC
/end FUNCTION
/begin FUNCTION lam "Group /ByDataDictionaryPrefix/lam"
 /begin LOC_MEASUREMENT LAM_NU_AmpFactor_A LAM_NU_AmpFactor_B LAM_NU_Lambda_A LAM_NU_Lambda_B LAM_b_AmpFactorFlag_A LAM_b_AmpFactorFlag_B LAM_b_LambdaValidFlag_A LAM_b_LambdaValidFlag_B LAM_mA_Ip_A LAM_mA_Ip_B /end LOC_MEASUREMENT
 /begin REF_CHARACTERISTIC LAMc_C_SensorTempValidThresh_A LAMc_C_SensorTempValidThresh_B LAMc_NU_AmpFactorHyst_A LAMc_NU_AmpFactorHyst_B LAMm_NU_LambdaA_x LAMm_NU_LambdaA_z LAMm_NU_LambdaB_x LAMm_NU_LambdaB_z /end REF_CHARACTERISTIC
/end FUNCTION
/begin FUNCTION log "Group /ByDataDictionaryPrefix/log"
 /begin LOC_MEASUREMENT LOG_NU_ManualPump LOG_NU_TqCvLuEngg LOG_NU_TransDrvEngg LOG_NU_TransShftPrcs LOG_PWM_BLOWER LOG_PWM_PUMP LOG_b_EC1_state LOG_b_ENBOBD LOG_b_RelePump1 LOG_b_RelePump2 LOG_b_ZF_Auto LOG_pct_PercentClutchSlip LOG_s_EC1_counter Log_b_TPDT1 Log_b_TPDT2 Log_b_TPDT3 Log_b_TPDT4 Log_b_TPDT5 Log_b_TPDT6 /end LOC_MEASUREMENT
 /begin REF_CHARACTERISTIC LOGc_NU_EEC14_FuelType LOGc_NU_ManualPump LOGc_PWM_BLOWER LOGc_PWM_PUMP LOGc_b_ACC1_gen LOGc_b_AEBS1_gen LOGc_b_EC1_CANA_ena LOGc_b_ENBOBD LOGc_b_EnableCanLog LOGc_b_EnableDM1 LOGc_b_ML_gen LOGc_b_RelePump1 LOGc_b_RelePump2 LOGc_b_VDC1_gen LOGc_b_VDC2_gen LOGc_b_VDHR_gen LOGc_b_ZF_Auto LOGc_b_ZF_auto_ena LOGc_b_ZF_man_ena LOGc_o_BLOWER LOGc_o_ENBOBD LOGc_o_ManualPump LOGc_o_PUMP LOGc_o_RelePump1 LOGc_o_RelePump2 LOGc_o_ZF_Auto LOGc_s_ResMisfCounter LOGc_s_SDG01_Period LOGc_s_TFrames /end REF_CHARACTERISTIC
/end FUNCTION
/begin FUNCTION max "Group /ByDataDictionaryPrefix/max" /begin REF_CHARACTERISTIC MaxCruiseTorque_Nm /end REF_CHARACTERISTIC /end FUNCTION
/begin FUNCTION min "Group /ByDataDictionaryPrefix/min" /begin REF_CHARACTERISTIC MinCruiseTorque_Nm /end REF_CHARACTERISTIC /end FUNCTION
/begin FUNCTION mpl "Group /ByDataDictionaryPrefix/mpl" /begin REF_CHARACTERISTIC mplc_fi_config_din_pin_y21 mplc_fi_count_din_pin_y21 /end REF_CHARACTERISTIC /end FUNCTION
/begin FUNCTION nvm "Group /ByDataDictionaryPrefix/nvm" /begin LOC_MEASUREMENT NVM_NU_EngRunTime /end LOC_MEASUREMENT
 /begin REF_CHARACTERISTIC NVMc_NU_CyclesDflt NVMc_NU_DistanceCounterDflt NVMc_NU_DistanceCounterMILDflt NVMc_NU_EngineRuntimeDflt NVMc_NU_EngineRuntimeDflt2 NVMc_NU_HOURSDflt NVMc_NU_MILcontinousDflt NVMc_NU_WarmCyclesCounterDflt NVMc_b_ResetDataCollected NVMca_NU_CyclesDflt NVMca_NU_DistanceCounterDflt NVMca_NU_DistanceCounterMILDflt NVMca_NU_EngineRuntimeDflt NVMca_NU_EngineRuntimeDflt2 NVMca_NU_HOURSDflt NVMca_NU_MILcontinousDflt NVMca_NU_WarmCyclesCounterDflt /end REF_CHARACTERISTIC
/end FUNCTION
/begin FUNCTION obd "Group /ByDataDictionaryPrefix/obd" /begin REF_CHARACTERISTIC OBDc_b_BegasCVN /end REF_CHARACTERISTIC /end FUNCTION
/begin FUNCTION out "Group /ByDataDictionaryPrefix/out"
 /begin LOC_MEASUREMENT OUT_C_FAN_ZF OUT_Hz_EngSpd OUT_Hz_FreqUEGOA OUT_Hz_VhSpd OUT_NU_BankA_Faults OUT_NU_DM19CVN OUT_NU_FCV_Faults OUT_NU_INJ_A1_Faults OUT_NU_INJ_A2_Faults OUT_NU_INJ_A3_Faults OUT_NU_INJ_A4_Faults OUT_b_18F00000_ena OUT_b_18F0010B_ena OUT_b_18FDC40B_ena OUT_b_18FE6E00_ena OUT_b_18FEE100_ena OUT_b_18FEE600_ena OUT_b_18FEEE00_ena OUT_b_24V_WarmupA OUT_b_BCM_ZF_ena OUT_b_BCM_ena OUT_b_BankA_Enbld OUT_b_BankB_Enbld OUT_b_CombustionAllCyls OUT_b_DM19Request OUT_b_FCV_OC OUT_b_FlashChecksum OUT_b_HEGO11_Heater_OC OUT_b_HEGO12_Heater_OC OUT_b_HEGO21_Heater_OC OUT_b_HighsideY1 OUT_b_HighsideY5 OUT_b_Inj1_LSD_Active OUT_b_Inj2_LSD_Active OUT_b_Inj3_LSD_Active OUT_b_Inj4_LSD_Active OUT_b_InjHighsideOC OUT_b_MIL_LED OUT_b_PT_Relay OUT_b_PT_RelayEnergized OUT_b_RAM_Checksum OUT_b_Spk1_Active OUT_b_Spk2_Active OUT_b_Spk3_Active OUT_b_Spk4_Active OUT_b_Spk5_Active OUT_b_Spk6_Active OUT_b_Spk7_Active OUT_b_Spk8_Active OUT_b_TCO_ena OUT_b_UEGOB_Heater_OC OUT_b_VISCO_1st OUT_b_VISCO_2nd OUT_b_VentiladorZF OUT_b_Y1_OC OUT_b_Y5_OC OUT_cnt_BankA_SPI_Flts OUT_cnt_BankB_SPI_Flts OUT_pct_UEGO_HTR_DC_A /end LOC_MEASUREMENT
 /begin REF_CHARACTERISTIC OUTc_A_InjHoldCurrent OUTc_A_InjPeakCurrent OUTc_C_EFPFuelTemp OUTc_C_FAN_ZF OUTc_C_TempZF_off OUTc_C_TempZF_on OUTc_C_Thres_off OUTc_C_Thres_on OUTc_C_Visco_off_1st OUTc_C_Visco_off_2nd OUTc_C_Visco_on_1st OUTc_C_Visco_on_2nd OUTc_Hz_CompBypassFrq OUTc_Hz_EGO_HeaterFrq OUTc_Hz_ETC_HBridgeFrq OUTc_Hz_EngSpd OUTc_Hz_FreqStepsUEGOA OUTc_Hz_FreqUEGOA OUTc_Hz_FreqUEGO_A OUTc_Hz_LoThrshUEGOA OUTc_Hz_RampFreq_A OUTc_Hz_ShutOffValveFrq OUTc_Hz_TurCtrlFrq OUTc_Hz_VhSpd OUTc_NU_DM19CVN OUTc_NU_EngSpdFq_Type OUTc_NU_VhSpdFq_Type OUTc_V_VoltUEGOThrsh OUTc_b_18F00000 OUTc_b_18F00000_ena OUTc_b_18F0010B OUTc_b_18F0010B_ena OUTc_b_18FDC40B OUTc_b_18FDC40B_ena OUTc_b_18FE6E00 OUTc_b_18FE6E00_ena OUTc_b_18FEE100 OUTc_b_18FEE100_ena OUTc_b_18FEE600 OUTc_b_18FEE600_ena OUTc_b_18FEEE00 OUTc_b_18FEEE00_ena OUTc_b_BCM OUTc_b_BCM_ZF OUTc_b_BCM_ZF_ena OUTc_b_BCM_ena OUTc_b_CombustionAllCyls OUTc_b_DM19Request OUTc_b_EnableBankA_Inj OUTc_b_EnableBankB_Inj OUTc_b_EnableCCO OUTc_b_EnableHighsideY1 OUTc_b_EnableHighsideY5 OUTc_b_EnablePowerHold OUTc_b_EnablePowertrainRly OUTc_b_EnblManualFuelCut OUTc_b_EnblManualSparkCut OUTc_b_FuelEnIgnoreSync OUTc_b_InvertETC OUTc_b_MIL_LED OUTc_b_ManualFuelCut1 OUTc_b_ManualFuelCut2 OUTc_b_ManualFuelCut3 OUTc_b_ManualFuelCut4 OUTc_b_ManualSparkCut1 OUTc_b_ManualSparkCut2 OUTc_b_ManualSparkCut3 OUTc_b_ManualSparkCut4 OUTc_b_ManualSparkCut5 OUTc_b_ManualSparkCut6 OUTc_b_ManualSparkCut7 OUTc_b_ManualSparkCut8 OUTc_b_PT_RelayEnergized OUTc_b_PowerRelayIgnoreSync OUTc_b_ResetFltBankA OUTc_b_ResetFltBankB OUTc_b_ResetHighsideTrip OUTc_b_ResetOC_Trip OUTc_b_SpkEnIgnoreSync OUTc_b_TCO OUTc_b_TCO_ena OUTc_b_VISCO_1st OUTc_b_VISCO_2nd OUTc_b_VRefA_Enbl OUTc_b_VRefB_Enbl OUTc_b_VRefC_Enbl OUTc_b_VRefD_Enbl OUTc_b_VentiladorZF OUTc_km_Totaldistance OUTc_o_18F00000_ena OUTc_o_18F0010B_ena OUTc_o_18FDC40B_ena OUTc_o_18FE6E00_ena OUTc_o_18FEE100_ena OUTc_o_18FEE600_ena OUTc_o_18FEEE00_ena OUTc_o_BCM_ZF_ena OUTc_o_BCM_ena OUTc_o_CombustionAllCyls OUTc_o_DM19CVN OUTc_o_DM19Request OUTc_o_EngSpd OUTc_o_FAN_ZF OUTc_o_FreqUEGOA OUTc_o_MIL_LED OUTc_o_PT_RelayEnergized OUTc_o_TCO_ena OUTc_o_UEGO_HTR_DC_A OUTc_o_VISCO_1st OUTc_o_VISCO_2nd OUTc_o_VentiladorZF OUTc_o_VhSpd OUTc_pct_ActvLoadPumpThrs OUTc_pct_DC_StepsUEGOA OUTc_pct_DC_UEGO_A OUTc_pct_DeactvLoadPumpThrs OUTc_pct_EngSpd_Fq OUTc_pct_FuelMinLevel OUTc_pct_FuelReserve_1Tank OUTc_pct_FuelReserve_2Tank OUTc_pct_HiThrshUEGOA OUTc_pct_RampDC_A OUTc_pct_UEGO_HTR_DC_A OUTc_pct_VhSpd_Fq OUTc_s_ChangeTanksDelay OUTc_s_DbncStepsDC_UEGOA OUTc_s_DbncStepsDC_UEGOA2 OUTc_s_DbncStepsFreqUEGOA OUTc_s_DbncStepsFreqUEGOA2 OUTc_s_DynoMsg1_Period OUTc_s_DynoMsg2_Period OUTc_s_FuelLevelLimDelay OUTc_s_ShutdownDelay OUTc_s_SwichTankHold OUTc_s_ViscoOFFPulse OUTc_s_ViscoPeakPulse OUTc_us_CurrentLimitDither1 OUTc_us_CurrentLimitDither3 OUTc_us_InjPeakDuration OUTm_Hz_FreqUEGO_x OUTm_Hz_FreqUEGO_z OUTm_NU_EngSpd_x OUTm_NU_EngSpd_z OUTm_NU_VhSpd_x OUTm_NU_VhSpd_z /end REF_CHARACTERISTIC
/end FUNCTION
/begin FUNCTION pid "Group /ByDataDictionaryPrefix/pid" /begin LOC_MEASUREMENT PID_NU_DTerm PID_NU_ITerm PID_NU_PTerm /end LOC_MEASUREMENT /end FUNCTION
/begin FUNCTION pio "Group /ByDataDictionaryPrefix/pio"
 /begin REF_CHARACTERISTIC pioc_inj_diag_blank pioc_inj_t6_max pioc_inj_t7 pioc_inj_t7_on_time pioc_rate_pot_max_hz /end REF_CHARACTERISTIC
/end FUNCTION
/begin FUNCTION rem "Group /ByDataDictionaryPrefix/rem"
 /begin LOC_MEASUREMENT REM_Nm_TqLimit REM_b_StopCombustion REM_e_TurbineState REM_pct_OvertempThrottleLimit /end LOC_MEASUREMENT
 /begin REF_CHARACTERISTIC REMc_C_OvertempThrsh REMc_C_TurbineShutdownThrsh REMc_C_TurbineWarningThrsh REMc_Nm_OvertempTqLimit REMc_Nm_TqLimit REMc_b_EnblCombustion REMc_b_PreventRunningReboot REMc_b_ResetTurbineShutdown REMc_b_StopCombustion REMc_e_TurbineState REMc_o_OvertempThrottleLimit REMc_o_StopCombustion REMc_o_TqLimit REMc_o_TurbineState REMc_pct_OvertempThrottleLimit REMc_s_PowerupDelay REMc_s_RunningRebootWindow REMc_s_TurbineTempDbnc /end REF_CHARACTERISTIC
/end FUNCTION
/begin FUNCTION rfc "Group /ByDataDictionaryPrefix/rfc"
 /begin LOC_MEASUREMENT RFC_b_Active RFC_mg_FuelRqstDelta RFC_mg_Inj1 RFC_mg_Inj2 RFC_mg_Inj3 RFC_mg_Inj4 RFC_pct_PfInvCyl1 RFC_pct_PfInvCyl2 RFC_pct_PfInvCyl3 RFC_pct_PfInvCyl4 RFC_pct_RelativePfInv RFC_pct_WallWetFraction RFC_s_DbncTimer RFC_s_ExpTimer RFC_s_PuddleVapTime /end LOC_MEASUREMENT
 /begin REF_CHARACTERISTIC RFCc_b_Enable RFCc_mg_FuelRqstDeltaThrsh RFCc_pct_MaxEnlean RFCc_pct_MaxEnrich RFCc_pct_PfInvThrsh RFCc_s_DbncTimer RFCc_s_ExpTimer RFCm_NU_PuddleVapTime_x RFCm_NU_PuddleVapTime_y RFCm_NU_PuddleVapTime_z RFCm_NU_WallWetFraction_x RFCm_NU_WallWetFraction_y RFCm_NU_WallWetFraction_z /end REF_CHARACTERISTIC
/end FUNCTION
/begin FUNCTION sar "Group /ByDataDictionaryPrefix/sar" /begin LOC_MEASUREMENT SAR_adv_SparkAng SAR_ret_ArbitratedRetardRqst /end LOC_MEASUREMENT
 /begin REF_CHARACTERISTIC SARc_NU_MBT_RiseRate SARc_adv_RunningSparkMax SARc_adv_RunningSparkMin SARc_adv_SparkAng SARc_o_SparkAng /end REF_CHARACTERISTIC
/end FUNCTION
/begin FUNCTION sov "Group /ByDataDictionaryPrefix/sov" /begin LOC_MEASUREMENT SOV_b_OpenValve1 SOV_b_OpenValve2 /end LOC_MEASUREMENT
 /begin REF_CHARACTERISTIC SOVc_b_OpenValve1 SOVc_b_OpenValve2 SOVc_o_OpenValve1 SOVc_o_OpenValve2 /end REF_CHARACTERISTIC
/end FUNCTION
/begin FUNCTION spt "Group /ByDataDictionaryPrefix/spt"
 /begin LOC_MEASUREMENT SPT_adv_CoilOffAng SPT_adv_CoilOnAng SPT_deg_DwellTime SPT_ms_DwellTime SPT_ms_DwellTimeRaw SPT_ms_MaxDwellTime /end LOC_MEASUREMENT
 /begin REF_CHARACTERISTIC SPTc_adv_CoilOffAng SPTc_adv_CoilOnAng SPTc_b_UseHalfVBatt SPTc_ms_MinDwellTime SPTc_ms_MinOffTime SPTc_o_CoilOffAng SPTc_o_CoilOnAng SPTm_NU_DwellTime_x SPTm_NU_DwellTime_z /end REF_CHARACTERISTIC
/end FUNCTION
/begin FUNCTION str "Group /ByDataDictionaryPrefix/str" /begin LOC_MEASUREMENT STR_b_ManualStarter /end LOC_MEASUREMENT /begin REF_CHARACTERISTIC STRc_b_ManualStarter STRc_o_ManualStarter /end REF_CHARACTERISTIC /end FUNCTION
/begin FUNCTION sys "Group /ByDataDictionaryPrefix/sys"
 /begin LOC_MEASUREMENT SYS_EngSpedDelta1 SYS_EngSpedDelta1_after SYS_EngSpedDelta2 SYS_EngSpedDelta2_after SYS_EngSpedDelta3 SYS_EngSpedDelta3_after SYS_EngSpedDelta4 SYS_EngSpedDelta4_after SYS_NU_CrankWheelDecodeErr SYS_NU_CrankWheelDecodeStat SYS_NU_CurrCyl SYS_NU_EngSyncReq SYS_NU_EngToothOfst SYS_NU_ResetType SYS_b_CrankAngValid SYS_b_CrankSync SYS_b_CurrCylValid SYS_b_EngSync SYS_b_SyncInPhase SYS_b_SyncOutBy360 SYS_b_TwoTeethMeas SYS_cnt_LoopCounter SYS_cnt_NumAngularFuncCalls SYS_deg_CamTooth1 SYS_deg_CamTooth2 SYS_deg_CamTooth3 SYS_deg_CamTooth4 SYS_deg_CrankAng SYS_deg_EngAngOfst SYS_deg_EngAngOfstReq SYS_e_CAN0_State SYS_e_CAN1_State SYS_e_CAN3_State SYS_e_EngSync SYS_s_BootDuration SYS_us_LoopA_Task SYS_us_LoopA_TaskMax sys_app_code_day sys_app_code_major_ver sys_app_code_minor_ver sys_app_code_month sys_app_code_subminor_ver sys_app_code_year sys_cpu_loading sys_cpu_loading_max sys_stack_used /end LOC_MEASUREMENT
 /begin REF_CHARACTERISTIC SYSc_NU_CWG_GapRatioLongShort SYSc_NU_CWG_GapRatioShortLong SYSc_NU_CWG_NoiseRejRatioAcross SYSc_NU_CWG_NoiseRejRatioAfter SYSc_NU_CWG_NoiseRejRatioNormal SYSc_NU_CWG_NoiseRejRatioTOTth SYSc_NU_CWG_SkipTeeth SYSc_NU_CWG_StallDetRatioAcross SYSc_NU_CWG_StallDetRatioAfter SYSc_NU_CWG_StallDetRatioNorm SYSc_NU_CWG_StallDetRatioTOTth SYSc_NU_EngSyncReq SYSc_NU_MaxMissfire SYSc_Nm_ManualTqRqst SYSc_adv_ManualSparkOfst SYSc_b_CrankAngValid SYSc_b_ModuleReset SYSc_b_TransmitVIN SYSc_b_TurboPrsnt SYSc_b_UseAND SYSc_b_VCP SYSc_cc_EngDisp SYSc_cnt_NumOfCyls SYSc_deg_AngTaskCalc SYSc_deg_EngAngOfstReq SYSc_deg_SyncEndAngle SYSc_deg_SyncStartAngle SYSc_ms_CWG_FirstToothTimeout SYSc_ms_InjDeadTime SYSc_ms_MinInjTime SYSc_o_CrankAngValid SYSc_o_EngAngOfstReq SYSc_o_EngSyncReq SYSc_pct_ManualFuelTrim SYSc_ret_InjDropDeadAng SYSv_cnt_CylIndex SYSv_deg_TDC_Angles /end REF_CHARACTERISTIC
/end FUNCTION
/begin FUNCTION tar "Group /ByDataDictionaryPrefix/tar"
 /begin LOC_MEASUREMENT TAR_Nm_EEC1Tq TAR_Nm_EEC1Tqt TAR_Nm_EngDmnd TAR_Nm_J1939DrvrDmndTq TAR_Nm_MaxTqTable TAR_Nm_RawArbTqRqst TAR_Nm_TqFromAir TAR_Nm_TqFromMAP TAR_Nm_TqFromMAP_Idle TAR_Nm_TqRqst TAR_Nm_TqiFromMAP_Idle TAR_Nm_TqiFromModel TAR_b_DTC_TqLimit TAR_b_LimpHome TAR_b_TqFromMAP_act /end LOC_MEASUREMENT
 /begin REF_CHARACTERISTIC TARc_Hz_BrakeTqLPF TARc_Hz_IdlAirToTqLPF TARc_NU_ClunkTqFallRate TARc_NU_ClunkTqRiseRate TARc_NU_RearAxleRatio TARc_NU_TqFallRate TARc_NU_TqRiseRate TARc_Nm_ClunkRegionMax TARc_Nm_ClunkRegionMin TARc_Nm_DFCTorque TARc_Nm_DTC_LimitTq TARc_Nm_EngReferenceTorque TARc_Nm_Max TARc_Nm_TqRqst TARc_b_DTC_TqLimit TARc_b_Disable_TQmodel TARc_b_EnableIdl_ELM TARc_b_LimpHome TARc_b_TqModelSelect TARc_kph_ClunkEnblVehSpd TARc_mm_WheelCircumference TARc_o_DTC_TqLimit TARc_o_LimpHome TARc_o_TqRqst TARc_s_DTC_LimitTime TARc_s_EEC1TimeTqSmooth TARm_Nm_AirToTq_x TARm_Nm_AirToTq_y TARm_Nm_AirToTq_z TARm_Nm_IdlMAPToTq_x TARm_Nm_IdlMAPToTq_y TARm_Nm_IdlMAPToTq_z TARm_Nm_MAPToTq_x TARm_Nm_MAPToTq_y TARm_Nm_MAPToTq_z TARm_Nm_MaxTqTable_x TARm_Nm_MaxTqTable_y TARm_Nm_MaxTqTable_z /end REF_CHARACTERISTIC
/end FUNCTION
/begin FUNCTION tco "Group /ByDataDictionaryPrefix/tco" /begin REF_CHARACTERISTIC TCOc_NU_VehSpeed_Gain TCOc_NU_VehSpeed_Ofst /end REF_CHARACTERISTIC /end FUNCTION
/begin FUNCTION trf "Group /ByDataDictionaryPrefix/trf"
 /begin LOC_MEASUREMENT TRF_Nm_TqHPF TRF_b_Actv TRF_b_Transient TRF_lam_EnrichmentRqst TRF_lam_Trim /end LOC_MEASUREMENT
 /begin REF_CHARACTERISTIC TRFc_NU_TqHPF_TC TRFc_Nm_FallingTransientThrsh TRFc_Nm_RisingTransientThrsh TRFc_RPM_CoolantTempEnblThrsh TRFc_RPM_EngSpdEnblThrsh TRFc_b_IdlDisable TRFc_lam_MaxEnrichment TRFc_lam_MinEnrichment TRFc_lam_Trim TRFc_o_Trim TRFm_NU_EnrichmentRqst_x TRFm_NU_EnrichmentRqst_y TRFm_NU_EnrichmentRqst_z /end REF_CHARACTERISTIC
/end FUNCTION
/begin FUNCTION trs "Group /ByDataDictionaryPrefix/trs"
 /begin LOC_MEASUREMENT TRS_Nm_TqHPF TRS_Nm_TqHPF_Peak TRS_b_Transient TRS_ret_SparkRqst TRS_ret_SparkRqstRaw /end LOC_MEASUREMENT
 /begin REF_CHARACTERISTIC TRSc_NU_SparkFallRate TRSc_NU_TqHPF_TC TRSc_Nm_TqHPF_Thrsh TRSc_lam_AFR_EnblThrsh TRSc_o_SparkRqst TRSc_ret_SparkRqst TRSc_s_AFR_EnblDelay TRSm_NU_SparkRqst_x TRSm_NU_SparkRqst_y TRSm_NU_SparkRqst_z /end REF_CHARACTERISTIC
/end FUNCTION
/begin FUNCTION tss "Group /ByDataDictionaryPrefix/tss" /begin LOC_MEASUREMENT TSS_b_OBDtimeOK /end LOC_MEASUREMENT /begin REF_CHARACTERISTIC TSSc_b_OBDtimeOK TSSc_o_OBDtimeOK /end REF_CHARACTERISTIC /end FUNCTION
/begin FUNCTION tst "Group /ByDataDictionaryPrefix/tst" /begin REF_CHARACTERISTIC TSTc_b_StopKnockChanges TSTc_b_UseY14 /end REF_CHARACTERISTIC /end FUNCTION
/begin FUNCTION tur "Group /ByDataDictionaryPrefix/tur"
 /begin LOC_MEASUREMENT TUR_NU_BoostPressErrROC TUR_NU_FB_DC TUR_NU_FF_DC TUR_NU_PressRatioTrgt TUR_b_AtMaxBoost TUR_b_AtMinBoost TUR_b_CompBypassValve TUR_kPa_BoostPressErr TUR_pct_DTerm TUR_pct_FB_Effort TUR_pct_FB_EffortRaw TUR_pct_FF_Effort TUR_pct_ITerm TUR_pct_PTerm TUR_pct_TotalEffort TUR_pct_TotalEffortRaw TUR_pct_TurCtrlDC /end LOC_MEASUREMENT
 /begin REF_CHARACTERISTIC TURc_NU_BoostPressErrROC_Thrsh TURc_NU_DGain TURc_NU_IGain TURc_NU_PGain TURc_b_AtMaxBoost TURc_b_AtMinBoost TURc_b_CompBypassValve TURc_b_FBTableUse TURc_b_ResetITerm TURc_b_UsePrRatioForCtrl TURc_kPa_DbndLatchI TURc_kPa_MechanicalSetpoint TURc_kPa_TurboErroThr TURc_o_AtMaxBoost TURc_o_AtMinBoost TURc_o_CompBypassValve TURc_o_TurCtrlDC TURc_pct_FB_EffortDbndMax TURc_pct_FB_EffortDbndMin TURc_pct_ITermMax TURc_pct_ITermMin TURc_pct_TurCtrlDC TURm_NU_EffortToDuty_x TURm_NU_EffortToDuty_z TURm_NU_FF1_x TURm_NU_FF1_y TURm_NU_FF1_z TURm_NU_FF_x TURm_NU_FF_y TURm_NU_FF_z /end REF_CHARACTERISTIC
/end FUNCTION
/begin FUNCTION vcp "Group /ByDataDictionaryPrefix/vcp"
 /begin LOC_MEASUREMENT VCP_NU_CamErrROC VCP_adv_CamTrgt VCP_deg_CamErr VCP_pct_CamDC VCP_pct_CamDC_FF VCP_pct_CamDC_PID VCP_pct_CamDTerm VCP_pct_CamITerm VCP_pct_CamPIDRaw VCP_pct_CamPTerm /end LOC_MEASUREMENT
 /begin REF_CHARACTERISTIC VCPc_NU_CamDGain VCPc_NU_CamErrROCThrsh VCPc_NU_CamIGain VCPc_NU_CamPGain VCPc_NU_TrgtFallRate VCPc_NU_TrgtRiseRate VCPc_adv_CamHiStop VCPc_adv_CamLoStop VCPc_b_CamResetITerm VCPc_deg_CamDbndLatchI VCPc_deg_CamHiLatchI VCPc_deg_CamLoLatchI VCPc_o_CamDC VCPc_pct_CamDC VCPc_pct_CamITermMax VCPc_pct_CamITermMin VCPc_pct_CamPID_Dbnd VCPc_pct_CamPID_Max VCPc_pct_CamPID_Min VCPm_NU_CamDC_FF_x VCPm_NU_CamDC_FF_y VCPm_NU_CamDC_FF_z VCPm_NU_DutyCycle_x VCPm_NU_DutyCycle_z /end REF_CHARACTERISTIC
/end FUNCTION
/begin FUNCTION ByDataDictionaryPrefix "Group /ByDataDictionaryPrefix"
 /begin SUB_FUNCTION adm afr ain amb ame app baf bar bas cal cin clf cpl cru ctc dfc dia din drl dtc efp elm erl erm etc exd ext fca flt fmg frp hht hrw htr idl ijt inp knk lam log max min mpl nvm obd out pid pio rem rfc sar sov spt str sys tar tco trf trs tss tst tur vcp /end SUB_FUNCTION
/end FUNCTION
/begin FUNCTION OVR_AndExport1 "Group /ByModelHeirarchy/Gasoline/0.Engine_Config/Engine_Sync_Logic/OVR_AndExport1" /begin LOC_MEASUREMENT SYS_deg_EngAngOfstReq /end LOC_MEASUREMENT /begin REF_CHARACTERISTIC SYSc_deg_EngAngOfstReq SYSc_o_EngAngOfstReq /end REF_CHARACTERISTIC /end FUNCTION
/begin FUNCTION OVR_AndExport7 "Group /ByModelHeirarchy/Gasoline/0.Engine_Config/Engine_Sync_Logic/OVR_AndExport7" /begin LOC_MEASUREMENT SYS_NU_EngSyncReq /end LOC_MEASUREMENT /begin REF_CHARACTERISTIC SYSc_NU_EngSyncReq SYSc_o_EngSyncReq /end REF_CHARACTERISTIC /end FUNCTION
/begin FUNCTION Engine_Sync_Logic "Group /ByModelHeirarchy/Gasoline/0.Engine_Config/Engine_Sync_Logic" /begin SUB_FUNCTION OVR_AndExport1 OVR_AndExport7 /end SUB_FUNCTION
 /begin LOC_MEASUREMENT SYS_NU_EngToothOfst SYS_b_SyncInPhase SYS_b_SyncOutBy360 SYS_b_TwoTeethMeas SYS_deg_CamTooth1 SYS_deg_CamTooth2 SYS_deg_CamTooth3 SYS_deg_CamTooth4 SYS_deg_EngAngOfst SYS_e_EngSync /end LOC_MEASUREMENT
 /begin REF_CHARACTERISTIC INPv_deg_CamTeethPositionsRaw SYSc_b_UseAND SYSc_deg_SyncEndAngle SYSc_deg_SyncStartAngle TSTc_b_UseY14 /end REF_CHARACTERISTIC
/end FUNCTION
/begin FUNCTION OVR_AndExport34 "Group /ByModelHeirarchy/Gasoline/0.Engine_Config/OVR_AndExport34" /begin LOC_MEASUREMENT DTC_b_EcuMemFault /end LOC_MEASUREMENT /begin REF_CHARACTERISTIC DTCc_b_EcuMemFault DTCc_o_EcuMemFault /end REF_CHARACTERISTIC /end FUNCTION
/begin FUNCTION _0.Engine_Config "Group /ByModelHeirarchy/Gasoline/0.Engine_Config" /begin SUB_FUNCTION Engine_Sync_Logic OVR_AndExport34 /end SUB_FUNCTION
 /begin LOC_MEASUREMENT INP_b_CamWheelMvmt INP_b_CrankAngValid INP_b_CrankMvmt INP_b_EngAngValid INP_deg_CrankAng INP_deg_EngAng SYS_NU_CrankWheelDecodeErr SYS_NU_CrankWheelDecodeStat SYS_cnt_LoopCounter /end LOC_MEASUREMENT
 /begin REF_CHARACTERISTIC AINc_V_FuelPress_Max AINc_bar_FuelPressOvrd AINc_o_FuelPressOvrd AINm_NU_FuelPress_x AINm_NU_FuelPress_z IJTm_NU_InjectorFlowMapCmp_x IJTm_NU_InjectorFlowMapCmp_y IJTm_NU_InjectorFlowMapCmp_z INPc_NU_CrankSensorBias INPc_NU_CrankSensorType INPc_cnt_CrankTeethMissing INPc_cnt_TotalCrankTeeth OUTc_A_InjHoldCurrent OUTc_A_InjPeakCurrent OUTc_b_EnableBankA_Inj OUTc_b_EnableBankB_Inj OUTc_b_EnableCCO OUTc_b_EnablePowertrainRly OUTc_us_CurrentLimitDither1 OUTc_us_CurrentLimitDither3 OUTc_us_InjPeakDuration SYSc_NU_CWG_GapRatioLongShort SYSc_NU_CWG_GapRatioShortLong SYSc_NU_CWG_NoiseRejRatioAcross SYSc_NU_CWG_NoiseRejRatioAfter SYSc_NU_CWG_NoiseRejRatioNormal SYSc_NU_CWG_NoiseRejRatioTOTth SYSc_NU_CWG_SkipTeeth SYSc_NU_CWG_StallDetRatioAcross SYSc_NU_CWG_StallDetRatioAfter SYSc_NU_CWG_StallDetRatioNorm SYSc_NU_CWG_StallDetRatioTOTth SYSc_deg_AngTaskCalc SYSc_ms_CWG_FirstToothTimeout SYSc_ms_InjDeadTime SYSc_ms_MinInjTime SYSc_ret_InjDropDeadAng SYSv_deg_TDC_Angles /end REF_CHARACTERISTIC
/end FUNCTION
/begin FUNCTION OVR_AndExport11 "Group /ByModelHeirarchy/Gasoline/1.Input_Processing/Analog inputs/AAT1/OVR_AndExport1" /begin LOC_MEASUREMENT DTC_b_Air_TempLV /end LOC_MEASUREMENT /begin REF_CHARACTERISTIC DTCc_b_Air_TempLV DTCc_o_Air_TempLV /end REF_CHARACTERISTIC /end FUNCTION
/begin FUNCTION OVR_AndExport2 "Group /ByModelHeirarchy/Gasoline/1.Input_Processing/Analog inputs/AAT1/OVR_AndExport2" /begin LOC_MEASUREMENT DTC_b_Air_TempHV /end LOC_MEASUREMENT /begin REF_CHARACTERISTIC DTCc_b_Air_TempHV DTCc_o_Air_TempHV /end REF_CHARACTERISTIC /end FUNCTION
/begin FUNCTION OVR_AndExport341 "Group /ByModelHeirarchy/Gasoline/1.Input_Processing/Analog inputs/AAT1/OVR_AndExport34" /begin LOC_MEASUREMENT DTC_b_Air_HTemp /end LOC_MEASUREMENT /begin REF_CHARACTERISTIC DTCc_b_Air_HTemp DTCc_o_Air_HTemp /end REF_CHARACTERISTIC /end FUNCTION
/begin FUNCTION AAT1 "Group /ByModelHeirarchy/Gasoline/1.Input_Processing/Analog inputs/AAT1" /begin SUB_FUNCTION OVR_AndExport11 OVR_AndExport2 OVR_AndExport341 /end SUB_FUNCTION /begin LOC_MEASUREMENT AIN_V_AmbientTemp AIN_b_AmbientTemp_Fault /end LOC_MEASUREMENT
 /begin REF_CHARACTERISTIC AINc_C_AmbientTemp_Dflt AINc_C_AmbientTemp_Max AINc_C_AmbientTemp_Min AINc_Hz_AmbientTemp_BktFR AINc_Hz_AmbientTemp_BktRR AINc_NU_AmbientTemp_BktHys AINc_NU_AmbientTemp_SlewLim AINc_V_AmbientTemp_Max AINc_V_AmbientTemp_Min AINv_C_AmbientTemp_TF AINv_V_AmbientTemp_TF /end REF_CHARACTERISTIC
/end FUNCTION
/begin FUNCTION OVR_AndExport342 "Group /ByModelHeirarchy/Gasoline/1.Input_Processing/Analog inputs/APP1/OVR_AndExport34" /begin LOC_MEASUREMENT DTC_b_APP1_NonValidVoltage /end LOC_MEASUREMENT /begin REF_CHARACTERISTIC DTCc_b_APP1_NonValidVoltage DTCc_o_APP1_NonValidVoltage /end REF_CHARACTERISTIC /end FUNCTION
/begin FUNCTION APP1 "Group /ByModelHeirarchy/Gasoline/1.Input_Processing/Analog inputs/APP1" /begin SUB_FUNCTION OVR_AndExport342 /end SUB_FUNCTION
 /begin REF_CHARACTERISTIC AINc_HZ_pdl1_dat_nok_FR AINc_HZ_pdl1_dat_nok_RR AINc_V_APP1_Max AINc_V_APP1_Min /end REF_CHARACTERISTIC
/end FUNCTION
/begin FUNCTION OVR_AndExport343 "Group /ByModelHeirarchy/Gasoline/1.Input_Processing/Analog inputs/APP2/OVR_AndExport34" /begin LOC_MEASUREMENT DTC_b_APP2_NonValidVoltage /end LOC_MEASUREMENT /begin REF_CHARACTERISTIC DTCc_b_APP2_NonValidVoltage DTCc_o_APP2_NonValidVoltage /end REF_CHARACTERISTIC /end FUNCTION
/begin FUNCTION APP2 "Group /ByModelHeirarchy/Gasoline/1.Input_Processing/Analog inputs/APP2" /begin SUB_FUNCTION OVR_AndExport343 /end SUB_FUNCTION
 /begin REF_CHARACTERISTIC AINc_HZ_acel_pdl2_dat_nok_FR AINc_HZ_acel_pdl2_dat_nok_RR AINc_V_APP2_Max AINc_V_APP2_Min /end REF_CHARACTERISTIC
/end FUNCTION
/begin FUNCTION LogEnable1 "Group /ByModelHeirarchy/Gasoline/1.Input_Processing/Analog inputs/AT1IMG1_FAP/LogEnable1" /begin REF_CHARACTERISTIC LOGc_b_EnableCanLog /end REF_CHARACTERISTIC /end FUNCTION
/begin FUNCTION AT1IMG1_FAP "Group /ByModelHeirarchy/Gasoline/1.Input_Processing/Analog inputs/AT1IMG1_FAP" /begin SUB_FUNCTION LogEnable1 /end SUB_FUNCTION /end FUNCTION
/begin FUNCTION Displayables "Group /ByModelHeirarchy/Gasoline/1.Input_Processing/Analog inputs/Angular MAP input/Angular MAP/Displayables"
 /begin LOC_MEASUREMENT AIN_V_MAP_Sample1 AIN_V_MAP_Sample10 AIN_V_MAP_Sample11 AIN_V_MAP_Sample12 AIN_V_MAP_Sample13 AIN_V_MAP_Sample14 AIN_V_MAP_Sample15 AIN_V_MAP_Sample16 AIN_V_MAP_Sample2 AIN_V_MAP_Sample3 AIN_V_MAP_Sample4 AIN_V_MAP_Sample5 AIN_V_MAP_Sample6 AIN_V_MAP_Sample7 AIN_V_MAP_Sample8 AIN_V_MAP_Sample9 /end LOC_MEASUREMENT
/end FUNCTION
/begin FUNCTION Angular_MAP "Group /ByModelHeirarchy/Gasoline/1.Input_Processing/Analog inputs/Angular MAP input/Angular MAP" /begin SUB_FUNCTION Displayables /end SUB_FUNCTION /begin REF_CHARACTERISTIC AINc_e_MAP_SampleCylinder AINv_deg_MAP_SampleAngles /end REF_CHARACTERISTIC /end FUNCTION
/begin FUNCTION Monitor_Angular_Updates "Group /ByModelHeirarchy/Gasoline/1.Input_Processing/Analog inputs/Angular MAP input/Monitor Angular Updates" /begin LOC_MEASUREMENT AIN_b_UsingPeriodic SYS_cnt_NumAngularFuncCalls /end LOC_MEASUREMENT /begin REF_CHARACTERISTIC AINc_s_NoSyncDelay /end REF_CHARACTERISTIC /end FUNCTION
/begin FUNCTION OVR_AndExport21 "Group /ByModelHeirarchy/Gasoline/1.Input_Processing/Analog inputs/Angular MAP input/OVR_AndExport2" /begin LOC_MEASUREMENT DTC_b_MAPAfterThOverPress /end LOC_MEASUREMENT /begin REF_CHARACTERISTIC DTCc_b_MAPAfterThOverPress DTCc_o_MAPAfterThOverPress /end REF_CHARACTERISTIC /end FUNCTION
/begin FUNCTION OVR_AndExport3 "Group /ByModelHeirarchy/Gasoline/1.Input_Processing/Analog inputs/Angular MAP input/OVR_AndExport3" /begin LOC_MEASUREMENT DTC_b_MAPAfterThInfraPress /end LOC_MEASUREMENT /begin REF_CHARACTERISTIC DTCc_b_MAPAfterThInfraPress DTCc_o_MAPAfterThInfraPress /end REF_CHARACTERISTIC /end FUNCTION
/begin FUNCTION OVR_AndExport4 "Group /ByModelHeirarchy/Gasoline/1.Input_Processing/Analog inputs/Angular MAP input/OVR_AndExport4" /begin LOC_MEASUREMENT DTC_b_MAPAfterThr_LV /end LOC_MEASUREMENT /begin REF_CHARACTERISTIC DTCc_b_MAPAfterThr_LV DTCc_o_MAPAfterThr_LV /end REF_CHARACTERISTIC /end FUNCTION
/begin FUNCTION OVR_AndExport5 "Group /ByModelHeirarchy/Gasoline/1.Input_Processing/Analog inputs/Angular MAP input/OVR_AndExport5" /begin LOC_MEASUREMENT DTC_b_MAPAftrThr_HV /end LOC_MEASUREMENT /begin REF_CHARACTERISTIC DTCc_b_MAPAftrThr_HV DTCc_o_MAPAftrThr_HV /end REF_CHARACTERISTIC /end FUNCTION
/begin FUNCTION Angular_MAP_input "Group /ByModelHeirarchy/Gasoline/1.Input_Processing/Analog inputs/Angular MAP input"
 /begin SUB_FUNCTION Angular_MAP Monitor_Angular_Updates OVR_AndExport21 OVR_AndExport3 OVR_AndExport4 OVR_AndExport5 /end SUB_FUNCTION
 /begin LOC_MEASUREMENT AIN_V_MAP_Raw /end LOC_MEASUREMENT
 /begin REF_CHARACTERISTIC AINc_Hz_map_dath_FR AINc_Hz_map_dath_RR AINc_Hz_map_datl_FR AINc_Hz_map_datl_RR AINc_Hz_map_lh_FR AINc_Hz_map_lh_RR AINc_Hz_map_vh_FR AINc_Hz_map_vh_RR AINc_NU_MAP_Gain AINc_V_MAP_Dft AINc_V_MAP_OV AINc_V_MAP_Ofst AINc_V_MAP_UV AINc_kPa_MAPsThershold AINc_kPa_MAPuThershold /end REF_CHARACTERISTIC
/end FUNCTION
/begin FUNCTION OVR_AndExport12 "Group /ByModelHeirarchy/Gasoline/1.Input_Processing/Analog inputs/BARO/OVR_AndExport1" /begin LOC_MEASUREMENT DTC_b_BARO_PressHVoltage /end LOC_MEASUREMENT /begin REF_CHARACTERISTIC DTCc_b_BARO_PressHVoltage DTCc_o_BARO_PressHVoltage /end REF_CHARACTERISTIC /end FUNCTION
/begin FUNCTION OVR_AndExport22 "Group /ByModelHeirarchy/Gasoline/1.Input_Processing/Analog inputs/BARO/OVR_AndExport2" /begin LOC_MEASUREMENT DTC_b_BARO_ErraticValue /end LOC_MEASUREMENT /begin REF_CHARACTERISTIC DTCc_b_BARO_ErraticValue DTCc_o_BARO_ErraticValue /end REF_CHARACTERISTIC /end FUNCTION
/begin FUNCTION OVR_AndExport344 "Group /ByModelHeirarchy/Gasoline/1.Input_Processing/Analog inputs/BARO/OVR_AndExport34" /begin LOC_MEASUREMENT DTC_b_BARO_PressLVoltage /end LOC_MEASUREMENT /begin REF_CHARACTERISTIC DTCc_b_BARO_PressLVoltage DTCc_o_BARO_PressLVoltage /end REF_CHARACTERISTIC /end FUNCTION
/begin FUNCTION BARO "Group /ByModelHeirarchy/Gasoline/1.Input_Processing/Analog inputs/BARO" /begin SUB_FUNCTION OVR_AndExport12 OVR_AndExport22 OVR_AndExport344 /end SUB_FUNCTION /begin LOC_MEASUREMENT AIN_V_Baro AIN_b_Baro_Fault /end LOC_MEASUREMENT
 /begin REF_CHARACTERISTIC AINc_Hz_Baro_BktFR AINc_Hz_Baro_BktRR AINc_NU_Baro_BktHys AINc_NU_Baro_Gain AINc_NU_Baro_SlewLim AINc_V_Baro_Max AINc_V_Baro_Min AINc_V_Baro_Ofst AINc_kPa_Baro_Dflt AINc_kPa_Baro_Max AINc_kPa_Baro_Min /end REF_CHARACTERISTIC
/end FUNCTION
/begin FUNCTION OVR_AndExport13 "Group /ByModelHeirarchy/Gasoline/1.Input_Processing/Analog inputs/ECT/OVR_AndExport1" /begin LOC_MEASUREMENT DTC_b_ECT_LTemp /end LOC_MEASUREMENT /begin REF_CHARACTERISTIC DTCc_b_ECT_LTemp DTCc_o_ECT_LTemp /end REF_CHARACTERISTIC /end FUNCTION
/begin FUNCTION OVR_AndExport23 "Group /ByModelHeirarchy/Gasoline/1.Input_Processing/Analog inputs/ECT/OVR_AndExport2" /begin LOC_MEASUREMENT DTC_b_ECT_TempHVoltage /end LOC_MEASUREMENT /begin REF_CHARACTERISTIC DTCc_b_ECT_TempHVoltage DTCc_o_ECT_TempHVoltage /end REF_CHARACTERISTIC /end FUNCTION
/begin FUNCTION OVR_AndExport31 "Group /ByModelHeirarchy/Gasoline/1.Input_Processing/Analog inputs/ECT/OVR_AndExport3" /begin LOC_MEASUREMENT DTC_b_ECT_TempLVoltage /end LOC_MEASUREMENT /begin REF_CHARACTERISTIC DTCc_b_ECT_TempLVoltage DTCc_o_ECT_TempLVoltage /end REF_CHARACTERISTIC /end FUNCTION
/begin FUNCTION OVR_AndExport345 "Group /ByModelHeirarchy/Gasoline/1.Input_Processing/Analog inputs/ECT/OVR_AndExport34" /begin LOC_MEASUREMENT DTC_b_ECT_HTemp /end LOC_MEASUREMENT /begin REF_CHARACTERISTIC DTCc_b_ECT_HTemp DTCc_o_ECT_HTemp /end REF_CHARACTERISTIC /end FUNCTION
/begin FUNCTION ECT "Group /ByModelHeirarchy/Gasoline/1.Input_Processing/Analog inputs/ECT"
 /begin SUB_FUNCTION OVR_AndExport13 OVR_AndExport23 OVR_AndExport31 OVR_AndExport345 /end SUB_FUNCTION
 /begin LOC_MEASUREMENT AIN_V_CoolantTemp AIN_b_CoolantTemp_Fault /end LOC_MEASUREMENT
 /begin REF_CHARACTERISTIC AINc_C_CoolantTemp_Dflt AINc_C_CoolantTemp_Max AINc_C_CoolantTemp_Max_Begas AINc_C_CoolantTemp_Min AINc_C_CoolantTemp_Min_Begas AINc_Hz_CoolantTemp_BktFR AINc_Hz_CoolantTemp_BktRR AINc_NU_CoolantTemp_BktHys AINc_NU_CoolantTemp_SlewLim AINc_V_CoolantTemp_Max AINc_V_CoolantTemp_Min AINv_C_CoolantTemp_TF AINv_V_CoolantTemp_TF /end REF_CHARACTERISTIC
/end FUNCTION
/begin FUNCTION OVR_AndExport32 "Group /ByModelHeirarchy/Gasoline/1.Input_Processing/Analog inputs/Exhaust Temp/OVR_AndExport3" /begin LOC_MEASUREMENT DTC_b_Exhaust_HTemp /end LOC_MEASUREMENT /begin REF_CHARACTERISTIC DTCc_b_Exhaust_HTemp DTCc_o_Exhaust_HTemp /end REF_CHARACTERISTIC /end FUNCTION
/begin FUNCTION OVR_AndExport41 "Group /ByModelHeirarchy/Gasoline/1.Input_Processing/Analog inputs/Exhaust Temp/OVR_AndExport4" /begin LOC_MEASUREMENT DTC_b_EGT_TempHV /end LOC_MEASUREMENT /begin REF_CHARACTERISTIC DTCc_b_EGT_TempHV DTCc_o_EGT_TempHV /end REF_CHARACTERISTIC /end FUNCTION
/begin FUNCTION OVR_AndExport51 "Group /ByModelHeirarchy/Gasoline/1.Input_Processing/Analog inputs/Exhaust Temp/OVR_AndExport5" /begin LOC_MEASUREMENT DTC_b_EGT_TempLV /end LOC_MEASUREMENT /begin REF_CHARACTERISTIC DTCc_b_EGT_TempLV DTCc_o_EGT_TempLV /end REF_CHARACTERISTIC /end FUNCTION
/begin FUNCTION Exhaust_Temp "Group /ByModelHeirarchy/Gasoline/1.Input_Processing/Analog inputs/Exhaust Temp" /begin SUB_FUNCTION OVR_AndExport32 OVR_AndExport41 OVR_AndExport51 /end SUB_FUNCTION /begin LOC_MEASUREMENT AIN_V_EGT AIN_b_EGT_Fault /end LOC_MEASUREMENT
 /begin REF_CHARACTERISTIC AINc_C_ExTemp_Dflt AINc_C_ExTemp_Max AINc_C_ExTemp_Min AINc_Hz_ExTemp_BktFR AINc_Hz_ExTemp_BktRR AINc_NU_ExTemp_BktHys AINc_NU_ExTemp_SlewLim AINc_V_ExTemp_Max AINc_V_ExTemp_Min AINv_C_ExTemp_TF AINv_V_ExTemp_TF /end REF_CHARACTERISTIC
/end FUNCTION
/begin FUNCTION OVR_AndExport14 "Group /ByModelHeirarchy/Gasoline/1.Input_Processing/Analog inputs/FAP/OVR_AndExport1" /begin LOC_MEASUREMENT DTC_b_FAP_HPress /end LOC_MEASUREMENT /begin REF_CHARACTERISTIC DTCc_b_FAP_HPress DTCc_o_FAP_HPress /end REF_CHARACTERISTIC /end FUNCTION
/begin FUNCTION OVR_AndExport346 "Group /ByModelHeirarchy/Gasoline/1.Input_Processing/Analog inputs/FAP/OVR_AndExport34" /begin LOC_MEASUREMENT DTC_b_FAP_Disconected /end LOC_MEASUREMENT /begin REF_CHARACTERISTIC DTCc_b_FAP_Disconected DTCc_o_FAP_Disconected /end REF_CHARACTERISTIC /end FUNCTION
/begin FUNCTION FAP "Group /ByModelHeirarchy/Gasoline/1.Input_Processing/Analog inputs/FAP" /begin SUB_FUNCTION OVR_AndExport14 OVR_AndExport346 /end SUB_FUNCTION /begin LOC_MEASUREMENT AIN_V_FAPRaw /end LOC_MEASUREMENT
 /begin REF_CHARACTERISTIC AINc_Hz_FAPPress_BktFR AINc_Hz_FAPPress_BktRR AINc_NU_FAPPress_BktHys AINc_NU_FAPPress_Gain AINc_NU_FAPPress_SlewLim AINc_V_FAPPress_Max AINc_V_FAPPress_Min AINc_V_FAPPress_Ofst AINc_kPa_FAPPress_Dflt AINc_kPa_FAPPress_Max AINc_kPa_FAPPress_Min /end REF_CHARACTERISTIC
/end FUNCTION
/begin FUNCTION OVR_AndExport15 "Group /ByModelHeirarchy/Gasoline/1.Input_Processing/Analog inputs/Fuel Press/OVR_AndExport1" /begin LOC_MEASUREMENT DTC_b_GLP_LPress /end LOC_MEASUREMENT /begin REF_CHARACTERISTIC DTCc_b_GLP_LPress DTCc_o_GLP_LPress /end REF_CHARACTERISTIC /end FUNCTION
/begin FUNCTION OVR_AndExport24 "Group /ByModelHeirarchy/Gasoline/1.Input_Processing/Analog inputs/Fuel Press/OVR_AndExport2" /begin LOC_MEASUREMENT DTC_b_GLP_OL /end LOC_MEASUREMENT /begin REF_CHARACTERISTIC DTCc_b_GLP_OL DTCc_o_GLP_OL /end REF_CHARACTERISTIC /end FUNCTION
/begin FUNCTION OVR_AndExport347 "Group /ByModelHeirarchy/Gasoline/1.Input_Processing/Analog inputs/Fuel Press/OVR_AndExport34" /begin LOC_MEASUREMENT DTC_b_GLP_HPress /end LOC_MEASUREMENT /begin REF_CHARACTERISTIC DTCc_b_GLP_HPress DTCc_o_GLP_HPress /end REF_CHARACTERISTIC /end FUNCTION
/begin FUNCTION Fuel_Press "Group /ByModelHeirarchy/Gasoline/1.Input_Processing/Analog inputs/Fuel Press" /begin SUB_FUNCTION OVR_AndExport15 OVR_AndExport24 OVR_AndExport347 /end SUB_FUNCTION /begin LOC_MEASUREMENT AIN_V_FuelPressRaw AIN_b_FuelPress_Fault /end LOC_MEASUREMENT
 /begin REF_CHARACTERISTIC AINc_Hz_FuelPress_BktFR AINc_Hz_FuelPress_BktRR AINc_Hz_FuelPress_LPF AINc_NU_FuelPress_BktHys AINc_NU_FuelPress_SlewLim AINc_V_FuelPress_Max AINc_V_FuelPress_Min AINc_bar_FuelPress_Dflt AINc_bar_FuelPress_Max AINc_bar_FuelPress_Min AINc_kPa_FuelPressDefault AINv_V_FuelPress_TF AINv_bar_FuelPress_TF /end REF_CHARACTERISTIC
/end FUNCTION
/begin FUNCTION OVR_AndExport16 "Group /ByModelHeirarchy/Gasoline/1.Input_Processing/Analog inputs/Fuel Temp/OVR_AndExport1" /begin LOC_MEASUREMENT DTC_b_GLP_LTemp /end LOC_MEASUREMENT /begin REF_CHARACTERISTIC DTCc_b_GLP_LTemp DTCc_o_GLP_LTemp /end REF_CHARACTERISTIC /end FUNCTION
/begin FUNCTION OVR_AndExport25 "Group /ByModelHeirarchy/Gasoline/1.Input_Processing/Analog inputs/Fuel Temp/OVR_AndExport2" /begin LOC_MEASUREMENT DTC_b_GLP_HTemp /end LOC_MEASUREMENT /begin REF_CHARACTERISTIC DTCc_b_GLP_HTemp DTCc_o_GLP_HTemp /end REF_CHARACTERISTIC /end FUNCTION
/begin FUNCTION OVR_AndExport33 "Group /ByModelHeirarchy/Gasoline/1.Input_Processing/Analog inputs/Fuel Temp/OVR_AndExport3" /begin LOC_MEASUREMENT DTC_b_GLP_TempLVoltage /end LOC_MEASUREMENT /begin REF_CHARACTERISTIC DTCc_b_GLP_TempLVoltage DTCc_o_GLP_TempLVoltage /end REF_CHARACTERISTIC /end FUNCTION
/begin FUNCTION OVR_AndExport348 "Group /ByModelHeirarchy/Gasoline/1.Input_Processing/Analog inputs/Fuel Temp/OVR_AndExport34" /begin LOC_MEASUREMENT DTC_b_GLP_TempHVoltage /end LOC_MEASUREMENT /begin REF_CHARACTERISTIC DTCc_b_GLP_TempHVoltage DTCc_o_GLP_TempHVoltage /end REF_CHARACTERISTIC /end FUNCTION
/begin FUNCTION Fuel_Temp "Group /ByModelHeirarchy/Gasoline/1.Input_Processing/Analog inputs/Fuel Temp"
 /begin SUB_FUNCTION OVR_AndExport16 OVR_AndExport25 OVR_AndExport33 OVR_AndExport348 /end SUB_FUNCTION
 /begin LOC_MEASUREMENT AIN_V_FuelTempRaw AIN_b_FuelTemp_Fault /end LOC_MEASUREMENT
 /begin REF_CHARACTERISTIC AINc_C_FuelTemp_Dflt AINc_C_FuelTemp_Max AINc_C_FuelTemp_Min AINc_C_GLPTemp_Dflt AINc_Hz_FuelTemp_BktFR AINc_Hz_FuelTemp_BktRR AINc_NU_FuelTemp_BktHys AINc_NU_FuelTemp_SlewLim AINc_V_FuelTemp_Max AINc_V_FuelTemp_Min AINv_C_FuelTemp_TF AINv_V_FuelTemp_TF /end REF_CHARACTERISTIC
/end FUNCTION
/begin FUNCTION OVR_AndExport349 "Group /ByModelHeirarchy/Gasoline/1.Input_Processing/Analog inputs/FuelLevel1/DTC157/OVR_AndExport34" /begin LOC_MEASUREMENT DTC_b_GLP1_HVoltage /end LOC_MEASUREMENT /begin REF_CHARACTERISTIC DTCc_b_GLP1_HVoltage DTCc_o_GLP1_HVoltage /end REF_CHARACTERISTIC /end FUNCTION
/begin FUNCTION DTC157 "Group /ByModelHeirarchy/Gasoline/1.Input_Processing/Analog inputs/FuelLevel1/DTC157" /begin SUB_FUNCTION OVR_AndExport349 /end SUB_FUNCTION /begin REF_CHARACTERISTIC AINc_Hz_fuel_lvl_dat_FR AINc_Hz_fuel_lvl_dat_RR /end REF_CHARACTERISTIC /end FUNCTION
/begin FUNCTION OVR_AndExport304 "Group /ByModelHeirarchy/Gasoline/1.Input_Processing/Analog inputs/FuelLevel1/DTC159/OVR_AndExport34" /begin LOC_MEASUREMENT DTC_b_GLP2_HVoltage /end LOC_MEASUREMENT /begin REF_CHARACTERISTIC DTCc_b_GLP2_HVoltage DTCc_o_GLP2_HVoltage /end REF_CHARACTERISTIC /end FUNCTION
/begin FUNCTION DTC159 "Group /ByModelHeirarchy/Gasoline/1.Input_Processing/Analog inputs/FuelLevel1/DTC159" /begin SUB_FUNCTION OVR_AndExport304 /end SUB_FUNCTION /begin REF_CHARACTERISTIC AINc_Hz_fuel_lvl_dat_FR AINc_Hz_fuel_lvl_dat_RR /end REF_CHARACTERISTIC /end FUNCTION
/begin FUNCTION OVR_AndExport17 "Group /ByModelHeirarchy/Gasoline/1.Input_Processing/Analog inputs/FuelLevel1/OVR_AndExport1" /begin LOC_MEASUREMENT INP_pct_GLPLevel2 /end LOC_MEASUREMENT /begin REF_CHARACTERISTIC INPc_o_GLPLevel2 INPc_pct_GLPLevel2 /end REF_CHARACTERISTIC /end FUNCTION
/begin FUNCTION OVR_AndExport26 "Group /ByModelHeirarchy/Gasoline/1.Input_Processing/Analog inputs/FuelLevel1/OVR_AndExport2" /begin LOC_MEASUREMENT INP_V_FuelLevel1 /end LOC_MEASUREMENT /begin REF_CHARACTERISTIC INPc_V_FuelLevel1 INPc_o_FuelLevel1 /end REF_CHARACTERISTIC /end FUNCTION
/begin FUNCTION OVR_AndExport35 "Group /ByModelHeirarchy/Gasoline/1.Input_Processing/Analog inputs/FuelLevel1/OVR_AndExport3" /begin LOC_MEASUREMENT INP_V_FuelLevel2 /end LOC_MEASUREMENT /begin REF_CHARACTERISTIC INPc_V_FuelLevel2 INPc_o_FuelLevel2 /end REF_CHARACTERISTIC /end FUNCTION
/begin FUNCTION OVR_AndExport42 "Group /ByModelHeirarchy/Gasoline/1.Input_Processing/Analog inputs/FuelLevel1/OVR_AndExport4" /begin LOC_MEASUREMENT INP_pct_TotalFuelLevel /end LOC_MEASUREMENT /begin REF_CHARACTERISTIC INPc_o_TotalFuelLevel INPc_pct_TotalFuelLevel /end REF_CHARACTERISTIC /end FUNCTION
/begin FUNCTION OVR_AndExport41 "Group /ByModelHeirarchy/Gasoline/1.Input_Processing/Analog inputs/FuelLevel1/OVR_AndExport41" /begin LOC_MEASUREMENT INP_pct_GLPLevel1 /end LOC_MEASUREMENT /begin REF_CHARACTERISTIC INPc_o_GLPLevel1 INPc_pct_GLPLevel1 /end REF_CHARACTERISTIC /end FUNCTION
/begin FUNCTION OVR_AndExport52 "Group /ByModelHeirarchy/Gasoline/1.Input_Processing/Analog inputs/FuelLevel1/OVR_AndExport5" /begin LOC_MEASUREMENT INP_L_TotalFuelLevel_L /end LOC_MEASUREMENT /begin REF_CHARACTERISTIC INPc_L_TotalFuelLevel_L INPc_o_TotalFuelLevel_L /end REF_CHARACTERISTIC /end FUNCTION
/begin FUNCTION OVR_AndExport6 "Group /ByModelHeirarchy/Gasoline/1.Input_Processing/Analog inputs/FuelLevel1/OVR_AndExport6" /begin LOC_MEASUREMENT INP_pct_PrefiltTotalFuelLevel /end LOC_MEASUREMENT
 /begin REF_CHARACTERISTIC INPc_o_PrefiltTotalFuelLevel INPc_pct_PrefiltTotalFuelLevel /end REF_CHARACTERISTIC
/end FUNCTION
/begin FUNCTION V_to_pct "Group /ByModelHeirarchy/Gasoline/1.Input_Processing/Analog inputs/FuelLevel1/V_to_pct"
 /begin REF_CHARACTERISTIC AINc_Hz_FuelLevel1_LPF AINc_Hz_FuelLevel2_LPF AINc_NU_FuelLevel1_Gain_PctToL AINc_NU_FuelLevel1_Gain_VToPct AINc_NU_FuelLevel2_Gain_PctToL AINc_NU_FuelLevel2_Gain_VToPct AINc_V_FuelLevel1_Ofst_PctToL AINc_V_FuelLevel1_Ofst_VToPct AINc_V_FuelLevel2_Ofst_PctToL AINc_V_FuelLevel2_Ofst_VToPct AINc_V_GLPHV /end REF_CHARACTERISTIC
/end FUNCTION
/begin FUNCTION FuelLevel1 "Group /ByModelHeirarchy/Gasoline/1.Input_Processing/Analog inputs/FuelLevel1"
 /begin SUB_FUNCTION DTC157 DTC159 OVR_AndExport17 OVR_AndExport26 OVR_AndExport35 OVR_AndExport42 OVR_AndExport41 OVR_AndExport52 OVR_AndExport6 V_to_pct /end SUB_FUNCTION
 /begin REF_CHARACTERISTIC AINc_b_Tank2_Available AINc_s_TimeFuelLevel /end REF_CHARACTERISTIC
/end FUNCTION
/begin FUNCTION OVR_AndExport18 "Group /ByModelHeirarchy/Gasoline/1.Input_Processing/Analog inputs/IAT1/OVR_AndExport1" /begin LOC_MEASUREMENT DTC_b_CompIAT_TempLV /end LOC_MEASUREMENT /begin REF_CHARACTERISTIC DTCc_b_CompIAT_TempLV DTCc_o_CompIAT_TempLV /end REF_CHARACTERISTIC /end FUNCTION
/begin FUNCTION OVR_AndExport36 "Group /ByModelHeirarchy/Gasoline/1.Input_Processing/Analog inputs/IAT1/OVR_AndExport3" /begin LOC_MEASUREMENT DTC_b_CompIAT_HTemp /end LOC_MEASUREMENT /begin REF_CHARACTERISTIC DTCc_b_CompIAT_HTemp DTCc_o_CompIAT_HTemp /end REF_CHARACTERISTIC /end FUNCTION
/begin FUNCTION OVR_AndExport43 "Group /ByModelHeirarchy/Gasoline/1.Input_Processing/Analog inputs/IAT1/OVR_AndExport4" /begin LOC_MEASUREMENT DTC_b_CompIAT_TempHV /end LOC_MEASUREMENT /begin REF_CHARACTERISTIC DTCc_b_CompIAT_TempHV DTCc_o_CompIAT_TempHV /end REF_CHARACTERISTIC /end FUNCTION
/begin FUNCTION IAT1 "Group /ByModelHeirarchy/Gasoline/1.Input_Processing/Analog inputs/IAT1" /begin SUB_FUNCTION OVR_AndExport18 OVR_AndExport36 OVR_AndExport43 /end SUB_FUNCTION /begin LOC_MEASUREMENT AIN_V_ManifoldTemp AIN_b_ManifoldTemp_Fault /end LOC_MEASUREMENT
 /begin REF_CHARACTERISTIC AINc_C_ManifoldTemp_Dflt AINc_C_ManifoldTemp_Max AINc_C_ManifoldTemp_Min AINc_Hz_ManifoldTemp_BktFR AINc_Hz_ManifoldTemp_BktRR AINc_NU_ManifoldTemp_BktHys AINc_NU_ManifoldTemp_SlewLim AINc_V_ManifoldTemp_Max AINc_V_ManifoldTemp_Min AINv_C_ManifoldTemp_TF AINv_V_ManifoldTemp_TF /end REF_CHARACTERISTIC
/end FUNCTION
/begin FUNCTION Inicio_Reinicio_Temporizaci__n "Group /ByModelHeirarchy/Gasoline/1.Input_Processing/Analog inputs/Inicio-Reinicio-Temporización" /begin LOC_MEASUREMENT DTC_b_DiagCata_Reset /end LOC_MEASUREMENT /begin REF_CHARACTERISTIC DTCc_s_DiagCata_RstDelay /end REF_CHARACTERISTIC /end FUNCTION
/begin FUNCTION OVR_AndExport19 "Group /ByModelHeirarchy/Gasoline/1.Input_Processing/Analog inputs/Knock/Knock/Cylinder up-counter/OVR_AndExport1" /begin LOC_MEASUREMENT AIN_cnt_CylIdxB /end LOC_MEASUREMENT /begin REF_CHARACTERISTIC AINc_cnt_CylIdxB AINc_o_CylIdxB /end REF_CHARACTERISTIC /end FUNCTION
/begin FUNCTION OVR_AndExport8 "Group /ByModelHeirarchy/Gasoline/1.Input_Processing/Analog inputs/Knock/Knock/Cylinder up-counter/OVR_AndExport8" /begin LOC_MEASUREMENT AIN_cnt_CylIdxA /end LOC_MEASUREMENT /begin REF_CHARACTERISTIC AINc_cnt_CylIdxA AINc_o_CylIdxA /end REF_CHARACTERISTIC /end FUNCTION
/begin FUNCTION Cylinder_up_counter "Group /ByModelHeirarchy/Gasoline/1.Input_Processing/Analog inputs/Knock/Knock/Cylinder up-counter" /begin SUB_FUNCTION OVR_AndExport19 OVR_AndExport8 /end SUB_FUNCTION /end FUNCTION
/begin FUNCTION Knock_sensor_A_settings "Group /ByModelHeirarchy/Gasoline/1.Input_Processing/Analog inputs/Knock/Knock/Knock sensor A settings"
 /begin REF_CHARACTERISTIC AINv_NU_KnockFilterGain AINv_kHz_KnockFilterFrq AINv_us_KnockFilterIntegrator /end REF_CHARACTERISTIC
/end FUNCTION
/begin FUNCTION Knock_sensor_B_settings "Group /ByModelHeirarchy/Gasoline/1.Input_Processing/Analog inputs/Knock/Knock/Knock sensor B settings"
 /begin REF_CHARACTERISTIC AINv_NU_KnockFilterGain AINv_kHz_KnockFilterFrq AINv_us_KnockFilterIntegrator /end REF_CHARACTERISTIC
/end FUNCTION
/end MODULE
/end PROJECT
