ASAP2_VERSION 1 31
/begin PROJECT M670_Engine_Control_1.2.0_M670_000 "BeGas B430LG Turbocharged engine"
/begin HEADER "Begas Motor 2017-2022 (c)" VERSION "1_2_0" /end HEADER
/begin MODULE OpenECU_M670_000 ""
/* Map (1d) calibration for DDE 'IDLm_NU_AirDGainPos_z'. */
/begin CHARACTERISTIC IDLm_NU_AirDGainPos_z "Derivative Gain for Air output" CURVE 0x8513c RL_IDLM_NU_AIRDGAINPOS_Z 1000.000000 CU_IDLM_NU_AIRDGAINPOS_Z 0.000000 1000.000000
 /begin AXIS_DESCR COM_AXIS IDL_RPM_Error CU_IDLM_NU_AIRDGAINPOS_X 8 -1000.000000 1000.000000 AXIS_PTS_REF APD_IDLM_NU_AIRDGAINPOS_X /end AXIS_DESCR
 BYTE_ORDER MSB_FIRST /end CHARACTERISTIC
/begin RECORD_LAYOUT RL_IDLM_NU_AIRDGAINPOS_Z FNC_VALUES 1 FLOAT32_IEEE COLUMN_DIR DIRECT /end RECORD_LAYOUT
/begin COMPU_METHOD CU_IDLM_NU_AIRDGAINPOS_Z "Conversion method for IDLm_NU_AirDGainPos_z" RAT_FUNC "%10.2" "NU" COEFFS 0.000000 1.000000 0.000000 0.000000 0.000000 1.000000 /end COMPU_METHOD
/begin AXIS_PTS APD_IDLM_NU_AIRDGAINPOS_X "(pct load) Map index" 0x8511c IDL_RPM_Error RL_IDLM_NU_AIRDGAINPOS_X 2000.000000 CU_IDLM_NU_AIRDGAINPOS_X 8 -1000.0 1000.0 BYTE_ORDER MSB_FIRST /end AXIS_PTS
/begin RECORD_LAYOUT RL_IDLM_NU_AIRDGAINPOS_X AXIS_PTS_X 1 FLOAT32_IEEE INDEX_INCR DIRECT /end RECORD_LAYOUT
/begin COMPU_METHOD CU_IDLM_NU_AIRDGAINPOS_X "Conversion method for IDLm_NU_AirDGainPos_x" RAT_FUNC "%10.2" "pct" COEFFS 0.000000 1.000000 0.000000 0.000000 0.000000 1.000000 /end COMPU_METHOD
/* Map (1d) calibration for DDE 'IDLm_NU_AirIGainNeg_z'. */
/begin CHARACTERISTIC IDLm_NU_AirIGainNeg_z "Integral Gain for Air output" CURVE 0x851bc RL_IDLM_NU_AIRIGAINNEG_Z 1000.000000 CU_IDLM_NU_AIRIGAINNEG_Z 0.000000 1000.000000
 /begin AXIS_DESCR COM_AXIS IDL_RPM_Error CU_IDLM_NU_AIRIGAINNEG_X 8 -1000.000000 1000.000000 AXIS_PTS_REF APD_IDLM_NU_AIRIGAINNEG_X /end AXIS_DESCR
 BYTE_ORDER MSB_FIRST /end CHARACTERISTIC
/begin RECORD_LAYOUT RL_IDLM_NU_AIRIGAINNEG_Z FNC_VALUES 1 FLOAT32_IEEE COLUMN_DIR DIRECT /end RECORD_LAYOUT
/begin COMPU_METHOD CU_IDLM_NU_AIRIGAINNEG_Z "Conversion method for IDLm_NU_AirIGainNeg_z" RAT_FUNC "%10.2" "NU" COEFFS 0.000000 1.000000 0.000000 0.000000 0.000000 1.000000 /end COMPU_METHOD
/begin AXIS_PTS APD_IDLM_NU_AIRIGAINNEG_X "(pct load) Map index" 0x8519c IDL_RPM_Error RL_IDLM_NU_AIRIGAINNEG_X 2000.000000 CU_IDLM_NU_AIRIGAINNEG_X 8 -1000.0 1000.0 BYTE_ORDER MSB_FIRST /end AXIS_PTS
/begin RECORD_LAYOUT RL_IDLM_NU_AIRIGAINNEG_X AXIS_PTS_X 1 FLOAT32_IEEE INDEX_INCR DIRECT /end RECORD_LAYOUT
/begin COMPU_METHOD CU_IDLM_NU_AIRIGAINNEG_X "Conversion method for IDLm_NU_AirIGainNeg_x" RAT_FUNC "%10.2" "pct" COEFFS 0.000000 1.000000 0.000000 0.000000 0.000000 1.000000 /end COMPU_METHOD
/* Map (1d) calibration for DDE 'IDLm_NU_AirIGainPos_z'. */
/begin CHARACTERISTIC IDLm_NU_AirIGainPos_z "Integral Gain for Air output" CURVE 0x850fc RL_IDLM_NU_AIRIGAINPOS_Z 1000.000000 CU_IDLM_NU_AIRIGAINPOS_Z 0.000000 1000.000000
 /begin AXIS_DESCR COM_AXIS IDL_RPM_Error CU_IDLM_NU_AIRIGAINPOS_X 8 -1000.000000 1000.000000 AXIS_PTS_REF APD_IDLM_NU_AIRIGAINPOS_X /end AXIS_DESCR
 BYTE_ORDER MSB_FIRST /end CHARACTERISTIC
/begin RECORD_LAYOUT RL_IDLM_NU_AIRIGAINPOS_Z FNC_VALUES 1 FLOAT32_IEEE COLUMN_DIR DIRECT /end RECORD_LAYOUT
/begin COMPU_METHOD CU_IDLM_NU_AIRIGAINPOS_Z "Conversion method for IDLm_NU_AirIGainPos_z" RAT_FUNC "%10.2" "NU" COEFFS 0.000000 1.000000 0.000000 0.000000 0.000000 1.000000 /end COMPU_METHOD
/begin AXIS_PTS APD_IDLM_NU_AIRIGAINPOS_X "(pct load) Map index" 0x850dc IDL_RPM_Error RL_IDLM_NU_AIRIGAINPOS_X 2000.000000 CU_IDLM_NU_AIRIGAINPOS_X 8 -1000.0 1000.0 BYTE_ORDER MSB_FIRST /end AXIS_PTS
/begin RECORD_LAYOUT RL_IDLM_NU_AIRIGAINPOS_X AXIS_PTS_X 1 FLOAT32_IEEE INDEX_INCR DIRECT /end RECORD_LAYOUT
/begin COMPU_METHOD CU_IDLM_NU_AIRIGAINPOS_X "Conversion method for IDLm_NU_AirIGainPos_x" RAT_FUNC "%10.2" "pct" COEFFS 0.000000 1.000000 0.000000 0.000000 0.000000 1.000000 /end COMPU_METHOD
/* Map (1d) calibration for DDE 'IDLm_NU_AirPGainNeg_z'. */
/begin CHARACTERISTIC IDLm_NU_AirPGainNeg_z "Proportional Gain for PID Controller for Air output" CURVE 0x8517c RL_IDLM_NU_AIRPGAINNEG_Z 1000.000000 CU_IDLM_NU_AIRPGAINNEG_Z 0.000000 1000.000000
 /begin AXIS_DESCR COM_AXIS IDL_RPM_Error CU_IDLM_NU_AIRPGAINNEG_X 8 -1000.000000 1000.000000 AXIS_PTS_REF APD_IDLM_NU_AIRPGAINNEG_X /end AXIS_DESCR
 BYTE_ORDER MSB_FIRST /end CHARACTERISTIC
/begin RECORD_LAYOUT RL_IDLM_NU_AIRPGAINNEG_Z FNC_VALUES 1 FLOAT32_IEEE COLUMN_DIR DIRECT /end RECORD_LAYOUT
/begin COMPU_METHOD CU_IDLM_NU_AIRPGAINNEG_Z "Conversion method for IDLm_NU_AirPGainNeg_z" RAT_FUNC "%10.2" "NU" COEFFS 0.000000 1.000000 0.000000 0.000000 0.000000 1.000000 /end COMPU_METHOD
/begin AXIS_PTS APD_IDLM_NU_AIRPGAINNEG_X "(pct load) Map index" 0x8515c IDL_RPM_Error RL_IDLM_NU_AIRPGAINNEG_X 2000.000000 CU_IDLM_NU_AIRPGAINNEG_X 8 -1000.0 1000.0 BYTE_ORDER MSB_FIRST /end AXIS_PTS
/begin RECORD_LAYOUT RL_IDLM_NU_AIRPGAINNEG_X AXIS_PTS_X 1 FLOAT32_IEEE INDEX_INCR DIRECT /end RECORD_LAYOUT
/begin COMPU_METHOD CU_IDLM_NU_AIRPGAINNEG_X "Conversion method for IDLm_NU_AirPGainNeg_x" RAT_FUNC "%10.2" "pct" COEFFS 0.000000 1.000000 0.000000 0.000000 0.000000 1.000000 /end COMPU_METHOD
/* Map (1d) calibration for DDE 'IDLm_NU_AirPGainPos_z'. */
/begin CHARACTERISTIC IDLm_NU_AirPGainPos_z "Proportional Gain for PID Controller for Air output" CURVE 0x850bc RL_IDLM_NU_AIRPGAINPOS_Z 1000.000000 CU_IDLM_NU_AIRPGAINPOS_Z 0.000000 1000.000000
 /begin AXIS_DESCR COM_AXIS IDL_RPM_Error CU_IDLM_NU_AIRPGAINPOS_X 8 -1000.000000 1000.000000 AXIS_PTS_REF APD_IDLM_NU_AIRPGAINPOS_X /end AXIS_DESCR
 BYTE_ORDER MSB_FIRST /end CHARACTERISTIC
/begin RECORD_LAYOUT RL_IDLM_NU_AIRPGAINPOS_Z FNC_VALUES 1 FLOAT32_IEEE COLUMN_DIR DIRECT /end RECORD_LAYOUT
/begin COMPU_METHOD CU_IDLM_NU_AIRPGAINPOS_Z "Conversion method for IDLm_NU_AirPGainPos_z" RAT_FUNC "%10.2" "NU" COEFFS 0.000000 1.000000 0.000000 0.000000 0.000000 1.000000 /end COMPU_METHOD
/begin AXIS_PTS APD_IDLM_NU_AIRPGAINPOS_X "(pct load) Map index" 0x8509c IDL_RPM_Error RL_IDLM_NU_AIRPGAINPOS_X 2000.000000 CU_IDLM_NU_AIRPGAINPOS_X 8 -1000.0 1000.0 BYTE_ORDER MSB_FIRST /end AXIS_PTS
/begin RECORD_LAYOUT RL_IDLM_NU_AIRPGAINPOS_X AXIS_PTS_X 1 FLOAT32_IEEE INDEX_INCR DIRECT /end RECORD_LAYOUT
/begin COMPU_METHOD CU_IDLM_NU_AIRPGAINPOS_X "Conversion method for IDLm_NU_AirPGainPos_x" RAT_FUNC "%10.2" "pct" COEFFS 0.000000 1.000000 0.000000 0.000000 0.000000 1.000000 /end COMPU_METHOD
/* Map (1d) calibration for DDE 'IDLm_NU_Alternator_z'. */
/begin CHARACTERISTIC IDLm_NU_Alternator_z "Transfer function for alternator load to idle RPM adder" CURVE 0x82554 RL_IDLM_NU_ALTERNATOR_Z 1000.000000 CU_IDLM_NU_ALTERNATOR_Z 0.000000 1000.000000
 /begin AXIS_DESCR COM_AXIS ELM_Nm_AlternatorTq CU_IDLM_NU_ALTERNATOR_X 8 -1000.000000 1000.000000 AXIS_PTS_REF APD_IDLM_NU_ALTERNATOR_X /end AXIS_DESCR
 BYTE_ORDER MSB_FIRST /end CHARACTERISTIC
/begin RECORD_LAYOUT RL_IDLM_NU_ALTERNATOR_Z FNC_VALUES 1 FLOAT32_IEEE COLUMN_DIR DIRECT /end RECORD_LAYOUT
/begin COMPU_METHOD CU_IDLM_NU_ALTERNATOR_Z "Conversion method for IDLm_NU_Alternator_z" RAT_FUNC "%10.0" "RPM" COEFFS 0.000000 1.000000 0.000000 0.000000 0.000000 1.000000 /end COMPU_METHOD
/begin AXIS_PTS APD_IDLM_NU_ALTERNATOR_X "Transfer function for alternator load to idle RPM adder" 0x82534 ELM_Nm_AlternatorTq RL_IDLM_NU_ALTERNATOR_X 2000.000000 CU_IDLM_NU_ALTERNATOR_X 8 -1000.0 1000.0 BYTE_ORDER MSB_FIRST /end AXIS_PTS
/begin RECORD_LAYOUT RL_IDLM_NU_ALTERNATOR_X AXIS_PTS_X 1 FLOAT32_IEEE INDEX_INCR DIRECT /end RECORD_LAYOUT
/begin COMPU_METHOD CU_IDLM_NU_ALTERNATOR_X "Conversion method for IDLm_NU_Alternator_x" RAT_FUNC "%10.2" "A" COEFFS 0.000000 1.000000 0.000000 0.000000 0.000000 1.000000 /end COMPU_METHOD
/* Map (1d) calibration for DDE 'IDLm_NU_EffortToAir_z'. */
/begin CHARACTERISTIC IDLm_NU_EffortToAir_z "LUT for conversion of PID Effort to Air z-axis" CURVE 0x8526c RL_IDLM_NU_EFFORTTOAIR_Z 2000.000000 CU_IDLM_NU_EFFORTTOAIR_Z -1000.000000 1000.000000
 /begin AXIS_DESCR COM_AXIS IDL_NU_AirPIDEffort CU_IDLM_NU_EFFORTTOAIR_X 9 -2.000000 2.000000 AXIS_PTS_REF APD_IDLM_NU_EFFORTTOAIR_X /end AXIS_DESCR
 BYTE_ORDER MSB_FIRST /end CHARACTERISTIC
/begin RECORD_LAYOUT RL_IDLM_NU_EFFORTTOAIR_Z FNC_VALUES 1 FLOAT32_IEEE COLUMN_DIR DIRECT /end RECORD_LAYOUT
/begin COMPU_METHOD CU_IDLM_NU_EFFORTTOAIR_Z "Conversion method for IDLm_NU_EffortToAir_z" RAT_FUNC "%10.3" "gps" COEFFS 0.000000 1.000000 0.000000 0.000000 0.000000 1.000000 /end COMPU_METHOD
/begin AXIS_PTS APD_IDLM_NU_EFFORTTOAIR_X "LUT for conversion of PID Effort to Air x-axis" 0x85248 IDL_NU_AirPIDEffort RL_IDLM_NU_EFFORTTOAIR_X 4.000000 CU_IDLM_NU_EFFORTTOAIR_X 9 -2.0 2.0 BYTE_ORDER MSB_FIRST /end AXIS_PTS
/begin RECORD_LAYOUT RL_IDLM_NU_EFFORTTOAIR_X AXIS_PTS_X 1 FLOAT32_IEEE INDEX_INCR DIRECT /end RECORD_LAYOUT
/begin COMPU_METHOD CU_IDLM_NU_EFFORTTOAIR_X "Conversion method for IDLm_NU_EffortToAir_x" RAT_FUNC "%10.2" "NU" COEFFS 0.000000 1.000000 0.000000 0.000000 0.000000 1.000000 /end COMPU_METHOD
/* Map (1d) calibration for DDE 'IDLm_NU_EffortToSpark_z'. */
/begin CHARACTERISTIC IDLm_NU_EffortToSpark_z "LUT for conversion of PID Effort to Ignition Timing z-axis" CURVE 0x84ec4 RL_IDLM_NU_EFFORTTOSPARK_Z 40.000000 CU_IDLM_NU_EFFORTTOSPARK_Z 0.000000 40.000000
 /begin AXIS_DESCR COM_AXIS IDL_NU_SparkPID_Effort CU_IDLM_NU_EFFORTTOSPARK_X 9 -2.000000 2.000000 AXIS_PTS_REF APD_IDLM_NU_EFFORTTOSPARK_X /end AXIS_DESCR
 BYTE_ORDER MSB_FIRST /end CHARACTERISTIC
/begin RECORD_LAYOUT RL_IDLM_NU_EFFORTTOSPARK_Z FNC_VALUES 1 FLOAT32_IEEE COLUMN_DIR DIRECT /end RECORD_LAYOUT
/begin COMPU_METHOD CU_IDLM_NU_EFFORTTOSPARK_Z "Conversion method for IDLm_NU_EffortToSpark_z" RAT_FUNC "%10.1" "ret" COEFFS 0.000000 1.000000 0.000000 0.000000 0.000000 1.000000 /end COMPU_METHOD
/begin AXIS_PTS APD_IDLM_NU_EFFORTTOSPARK_X "LUT for conversion of PID Effort to Ignition Timing x-axis" 0x84ea0 IDL_NU_SparkPID_Effort RL_IDLM_NU_EFFORTTOSPARK_X 4.000000 CU_IDLM_NU_EFFORTTOSPARK_X 9 -2.0 2.0 BYTE_ORDER MSB_FIRST /end AXIS_PTS
/begin RECORD_LAYOUT RL_IDLM_NU_EFFORTTOSPARK_X AXIS_PTS_X 1 FLOAT32_IEEE INDEX_INCR DIRECT /end RECORD_LAYOUT
/begin COMPU_METHOD CU_IDLM_NU_EFFORTTOSPARK_X "Conversion method for IDLm_NU_EffortToSpark_x" RAT_FUNC "%10.2" "pct" COEFFS 0.000000 1.000000 0.000000 0.000000 0.000000 1.000000 /end COMPU_METHOD
/* Map (1d) calibration for DDE 'IDLm_NU_EngineTemp_z'. */
/begin CHARACTERISTIC IDLm_NU_EngineTemp_z "Idle Spd based on ECT z-axis" CURVE 0x82484 RL_IDLM_NU_ENGINETEMP_Z 10000.000000 CU_IDLM_NU_ENGINETEMP_Z 0.000000 10000.000000
 /begin AXIS_DESCR COM_AXIS NO_INPUT_QUANTITY CU_IDLM_NU_ENGINETEMP_X 9 -100.000000 200.000000 AXIS_PTS_REF APD_IDLM_NU_ENGINETEMP_X /end AXIS_DESCR
 BYTE_ORDER MSB_FIRST /end CHARACTERISTIC
/begin RECORD_LAYOUT RL_IDLM_NU_ENGINETEMP_Z FNC_VALUES 1 FLOAT32_IEEE COLUMN_DIR DIRECT /end RECORD_LAYOUT
/begin COMPU_METHOD CU_IDLM_NU_ENGINETEMP_Z "Conversion method for IDLm_NU_EngineTemp_z" RAT_FUNC "%10.0" "RPM" COEFFS 0.000000 1.000000 0.000000 0.000000 0.000000 1.000000 /end COMPU_METHOD
/begin AXIS_PTS APD_IDLM_NU_ENGINETEMP_X "Idle Spd based on ECT x-axis" 0x82460 NO_INPUT_QUANTITY RL_IDLM_NU_ENGINETEMP_X 300.000000 CU_IDLM_NU_ENGINETEMP_X 9 -100.0 200.0 BYTE_ORDER MSB_FIRST /end AXIS_PTS
/begin RECORD_LAYOUT RL_IDLM_NU_ENGINETEMP_X AXIS_PTS_X 1 FLOAT32_IEEE INDEX_INCR DIRECT /end RECORD_LAYOUT
/begin COMPU_METHOD CU_IDLM_NU_ENGINETEMP_X "Conversion method for IDLm_NU_EngineTemp_x" RAT_FUNC "%10.0" "C" COEFFS 0.000000 1.000000 0.000000 0.000000 0.000000 1.000000 /end COMPU_METHOD
/* Map (1d) calibration for DDE 'IDLm_NU_IdlAC_FF_z'. */
/begin CHARACTERISTIC IDLm_NU_IdlAC_FF_z "LUT for AC compensation" CURVE 0x85574 RL_IDLM_NU_IDLAC_FF_Z 2000.000000 CU_IDLM_NU_IDLAC_FF_Z -1000.000000 1000.000000
 /begin AXIS_DESCR COM_AXIS IDL_RPM_Trgt_trt CU_IDLM_NU_IDLAC_FF_X 10 0.000000 2000.000000 AXIS_PTS_REF APD_IDLM_NU_IDLAC_FF_X /end AXIS_DESCR
 BYTE_ORDER MSB_FIRST /end CHARACTERISTIC
/begin RECORD_LAYOUT RL_IDLM_NU_IDLAC_FF_Z FNC_VALUES 1 FLOAT32_IEEE COLUMN_DIR DIRECT /end RECORD_LAYOUT
/begin COMPU_METHOD CU_IDLM_NU_IDLAC_FF_Z "Conversion method for IDLm_NU_IdlAC_FF_z" RAT_FUNC "%10.3" "gps" COEFFS 0.000000 1.000000 0.000000 0.000000 0.000000 1.000000 /end COMPU_METHOD
/begin AXIS_PTS APD_IDLM_NU_IDLAC_FF_X "(not defined)" 0x8554c IDL_RPM_Trgt_trt RL_IDLM_NU_IDLAC_FF_X 2000.000000 CU_IDLM_NU_IDLAC_FF_X 10 0.0 2000.0 BYTE_ORDER MSB_FIRST /end AXIS_PTS
/begin RECORD_LAYOUT RL_IDLM_NU_IDLAC_FF_X AXIS_PTS_X 1 FLOAT32_IEEE INDEX_INCR DIRECT /end RECORD_LAYOUT
/begin COMPU_METHOD CU_IDLM_NU_IDLAC_FF_X "Conversion method for IDLm_NU_IdlAC_FF_x" RAT_FUNC "%10.0" "RPM" COEFFS 0.000000 1.000000 0.000000 0.000000 0.000000 1.000000 /end COMPU_METHOD
/* Map (2d) calibration for DDE 'IDLm_NU_IdlAir_FF_z'. */
/begin CHARACTERISTIC IDLm_NU_IdlAir_FF_z "Feedforward idle Air table data" MAP 0x852d8 RL_IDLM_NU_IDLAIR_FF_Z 1000.000000 CU_IDLM_NU_IDLAIR_FF_Z 0.000000 1000.000000
 /begin AXIS_DESCR COM_AXIS NO_INPUT_QUANTITY CU_IDLM_NU_IDLAIR_FF_X 7 0.000000 2000.000000 AXIS_PTS_REF APD_IDLM_NU_IDLAIR_FF_X /end AXIS_DESCR
 /begin AXIS_DESCR COM_AXIS NO_INPUT_QUANTITY CU_IDLM_NU_IDLAIR_FF_Y 11 -40.000000 150.000000 AXIS_PTS_REF APD_IDLM_NU_IDLAIR_FF_Y /end AXIS_DESCR
 BYTE_ORDER MSB_FIRST /end CHARACTERISTIC
/begin RECORD_LAYOUT RL_IDLM_NU_IDLAIR_FF_Z FNC_VALUES 1 FLOAT32_IEEE COLUMN_DIR DIRECT /end RECORD_LAYOUT
/begin COMPU_METHOD CU_IDLM_NU_IDLAIR_FF_Z "Conversion method for IDLm_NU_IdlAir_FF_z" RAT_FUNC "%10.3" "gps" COEFFS 0.000000 1.000000 0.000000 0.000000 0.000000 1.000000 /end COMPU_METHOD
/begin AXIS_PTS APD_IDLM_NU_IDLAIR_FF_X "Feedforward idle Air table engine speed axis" 0x85290 NO_INPUT_QUANTITY RL_IDLM_NU_IDLAIR_FF_X 2000.000000 CU_IDLM_NU_IDLAIR_FF_X 7 0.0 2000.0 BYTE_ORDER MSB_FIRST /end AXIS_PTS
/begin RECORD_LAYOUT RL_IDLM_NU_IDLAIR_FF_X AXIS_PTS_X 1 FLOAT32_IEEE INDEX_INCR DIRECT /end RECORD_LAYOUT
/begin COMPU_METHOD CU_IDLM_NU_IDLAIR_FF_X "Conversion method for IDLm_NU_IdlAir_FF_x" RAT_FUNC "%10.0" "RPM" COEFFS 0.000000 1.000000 0.000000 0.000000 0.000000 1.000000 /end COMPU_METHOD
/begin AXIS_PTS APD_IDLM_NU_IDLAIR_FF_Y "Feedforward idle Air table data" 0x852ac NO_INPUT_QUANTITY RL_IDLM_NU_IDLAIR_FF_Y 190.000000 CU_IDLM_NU_IDLAIR_FF_Y 11 -40.0 150.0 BYTE_ORDER MSB_FIRST /end AXIS_PTS
/begin RECORD_LAYOUT RL_IDLM_NU_IDLAIR_FF_Y AXIS_PTS_X 1 FLOAT32_IEEE INDEX_INCR DIRECT /end RECORD_LAYOUT
/begin COMPU_METHOD CU_IDLM_NU_IDLAIR_FF_Y "Conversion method for IDLm_NU_IdlAir_FF_y" RAT_FUNC "%10.2" "C" COEFFS 0.000000 1.000000 0.000000 0.000000 0.000000 1.000000 /end COMPU_METHOD
/* Map (1d) calibration for DDE 'IDLm_NU_SparkDGainNeg_z'. */
/begin CHARACTERISTIC IDLm_NU_SparkDGainNeg_z "Derivative Gain for spark output" CURVE 0x8bf4c RL_IDLM_NU_SPARKDGAINNEG_Z 1000.000000 CU_IDLM_NU_SPARKDGAINNEG_Z 0.000000 1000.000000
 /begin AXIS_DESCR COM_AXIS IDL_RPM_Error CU_IDLM_NU_SPARKDGAINNEG_X 8 -1000.000000 1000.000000 AXIS_PTS_REF APD_IDLM_NU_SPARKDGAINNEG_X /end AXIS_DESCR
 BYTE_ORDER MSB_FIRST /end CHARACTERISTIC
/begin RECORD_LAYOUT RL_IDLM_NU_SPARKDGAINNEG_Z FNC_VALUES 1 FLOAT32_IEEE COLUMN_DIR DIRECT /end RECORD_LAYOUT
/begin COMPU_METHOD CU_IDLM_NU_SPARKDGAINNEG_Z "Conversion method for IDLm_NU_SparkDGainNeg_z" RAT_FUNC "%10.2" "NU" COEFFS 0.000000 1.000000 0.000000 0.000000 0.000000 1.000000 /end COMPU_METHOD
/begin AXIS_PTS APD_IDLM_NU_SPARKDGAINNEG_X "(pct load) Map index" 0x8bf2c IDL_RPM_Error RL_IDLM_NU_SPARKDGAINNEG_X 2000.000000 CU_IDLM_NU_SPARKDGAINNEG_X 8 -1000.0 1000.0 BYTE_ORDER MSB_FIRST /end AXIS_PTS
/begin RECORD_LAYOUT RL_IDLM_NU_SPARKDGAINNEG_X AXIS_PTS_X 1 FLOAT32_IEEE INDEX_INCR DIRECT /end RECORD_LAYOUT
/begin COMPU_METHOD CU_IDLM_NU_SPARKDGAINNEG_X "Conversion method for IDLm_NU_SparkDGainNeg_x" RAT_FUNC "%10.2" "pct" COEFFS 0.000000 1.000000 0.000000 0.000000 0.000000 1.000000 /end COMPU_METHOD
/* Map (1d) calibration for DDE 'IDLm_NU_SparkDGainPos_z'. */
/begin CHARACTERISTIC IDLm_NU_SparkDGainPos_z "Derivative Gain for spark output" CURVE 0x84e50 RL_IDLM_NU_SPARKDGAINPOS_Z 1000.000000 CU_IDLM_NU_SPARKDGAINPOS_Z 0.000000 1000.000000
 /begin AXIS_DESCR COM_AXIS IDL_RPM_Error CU_IDLM_NU_SPARKDGAINPOS_X 8 -1000.000000 1000.000000 AXIS_PTS_REF APD_IDLM_NU_SPARKDGAINPOS_X /end AXIS_DESCR
 BYTE_ORDER MSB_FIRST /end CHARACTERISTIC
/begin RECORD_LAYOUT RL_IDLM_NU_SPARKDGAINPOS_Z FNC_VALUES 1 FLOAT32_IEEE COLUMN_DIR DIRECT /end RECORD_LAYOUT
/begin COMPU_METHOD CU_IDLM_NU_SPARKDGAINPOS_Z "Conversion method for IDLm_NU_SparkDGainPos_z" RAT_FUNC "%10.2" "NU" COEFFS 0.000000 1.000000 0.000000 0.000000 0.000000 1.000000 /end COMPU_METHOD
/begin AXIS_PTS APD_IDLM_NU_SPARKDGAINPOS_X "(pct load) Map index" 0x84e30 IDL_RPM_Error RL_IDLM_NU_SPARKDGAINPOS_X 2000.000000 CU_IDLM_NU_SPARKDGAINPOS_X 8 -1000.0 1000.0 BYTE_ORDER MSB_FIRST /end AXIS_PTS
/begin RECORD_LAYOUT RL_IDLM_NU_SPARKDGAINPOS_X AXIS_PTS_X 1 FLOAT32_IEEE INDEX_INCR DIRECT /end RECORD_LAYOUT
/begin COMPU_METHOD CU_IDLM_NU_SPARKDGAINPOS_X "Conversion method for IDLm_NU_SparkDGainPos_x" RAT_FUNC "%10.2" "pct" COEFFS 0.000000 1.000000 0.000000 0.000000 0.000000 1.000000 /end COMPU_METHOD
/* Map (1d) calibration for DDE 'IDLm_NU_SparkIGainNeg_z'. */
/begin CHARACTERISTIC IDLm_NU_SparkIGainNeg_z "Integral Gain for spark output" CURVE 0x8bf0c RL_IDLM_NU_SPARKIGAINNEG_Z 1000.000000 CU_IDLM_NU_SPARKIGAINNEG_Z 0.000000 1000.000000
 /begin AXIS_DESCR COM_AXIS IDL_RPM_Error CU_IDLM_NU_SPARKIGAINNEG_X 8 -1000.000000 1000.000000 AXIS_PTS_REF APD_IDLM_NU_SPARKIGAINNEG_X /end AXIS_DESCR
 BYTE_ORDER MSB_FIRST /end CHARACTERISTIC
/begin RECORD_LAYOUT RL_IDLM_NU_SPARKIGAINNEG_Z FNC_VALUES 1 FLOAT32_IEEE COLUMN_DIR DIRECT /end RECORD_LAYOUT
/begin COMPU_METHOD CU_IDLM_NU_SPARKIGAINNEG_Z "Conversion method for IDLm_NU_SparkIGainNeg_z" RAT_FUNC "%10.2" "NU" COEFFS 0.000000 1.000000 0.000000 0.000000 0.000000 1.000000 /end COMPU_METHOD
/begin AXIS_PTS APD_IDLM_NU_SPARKIGAINNEG_X "(pct load) Map index" 0x8beec IDL_RPM_Error RL_IDLM_NU_SPARKIGAINNEG_X 2000.000000 CU_IDLM_NU_SPARKIGAINNEG_X 8 -1000.0 1000.0 BYTE_ORDER MSB_FIRST /end AXIS_PTS
/begin RECORD_LAYOUT RL_IDLM_NU_SPARKIGAINNEG_X AXIS_PTS_X 1 FLOAT32_IEEE INDEX_INCR DIRECT /end RECORD_LAYOUT
/begin COMPU_METHOD CU_IDLM_NU_SPARKIGAINNEG_X "Conversion method for IDLm_NU_SparkIGainNeg_x" RAT_FUNC "%10.2" "pct" COEFFS 0.000000 1.000000 0.000000 0.000000 0.000000 1.000000 /end COMPU_METHOD
/* Map (1d) calibration for DDE 'IDLm_NU_SparkIGainPos_z'. */
/begin CHARACTERISTIC IDLm_NU_SparkIGainPos_z "Integral Gain for spark output" CURVE 0x84e10 RL_IDLM_NU_SPARKIGAINPOS_Z 1000.000000 CU_IDLM_NU_SPARKIGAINPOS_Z 0.000000 1000.000000
 /begin AXIS_DESCR COM_AXIS IDL_RPM_Error CU_IDLM_NU_SPARKIGAINPOS_X 8 -1000.000000 1000.000000 AXIS_PTS_REF APD_IDLM_NU_SPARKIGAINPOS_X /end AXIS_DESCR
 BYTE_ORDER MSB_FIRST /end CHARACTERISTIC
/begin RECORD_LAYOUT RL_IDLM_NU_SPARKIGAINPOS_Z FNC_VALUES 1 FLOAT32_IEEE COLUMN_DIR DIRECT /end RECORD_LAYOUT
/begin COMPU_METHOD CU_IDLM_NU_SPARKIGAINPOS_Z "Conversion method for IDLm_NU_SparkIGainPos_z" RAT_FUNC "%10.2" "NU" COEFFS 0.000000 1.000000 0.000000 0.000000 0.000000 1.000000 /end COMPU_METHOD
/begin AXIS_PTS APD_IDLM_NU_SPARKIGAINPOS_X "(pct load) Map index" 0x84df0 IDL_RPM_Error RL_IDLM_NU_SPARKIGAINPOS_X 2000.000000 CU_IDLM_NU_SPARKIGAINPOS_X 8 -1000.0 1000.0 BYTE_ORDER MSB_FIRST /end AXIS_PTS
/begin RECORD_LAYOUT RL_IDLM_NU_SPARKIGAINPOS_X AXIS_PTS_X 1 FLOAT32_IEEE INDEX_INCR DIRECT /end RECORD_LAYOUT
/begin COMPU_METHOD CU_IDLM_NU_SPARKIGAINPOS_X "Conversion method for IDLm_NU_SparkIGainPos_x" RAT_FUNC "%10.2" "pct" COEFFS 0.000000 1.000000 0.000000 0.000000 0.000000 1.000000 /end COMPU_METHOD
/* Map (1d) calibration for DDE 'IDLm_NU_SparkPGainNeg_z'. */
/begin CHARACTERISTIC IDLm_NU_SparkPGainNeg_z "Proportional Gain for PID Controller for spark output" CURVE 0x8becc RL_IDLM_NU_SPARKPGAINNEG_Z 1000.000000 CU_IDLM_NU_SPARKPGAINNEG_Z 0.000000 1000.000000
 /begin AXIS_DESCR COM_AXIS IDL_RPM_Error CU_IDLM_NU_SPARKPGAINNEG_X 8 -1000.000000 1000.000000 AXIS_PTS_REF APD_IDLM_NU_SPARKPGAINNEG_X /end AXIS_DESCR
 BYTE_ORDER MSB_FIRST /end CHARACTERISTIC
/begin RECORD_LAYOUT RL_IDLM_NU_SPARKPGAINNEG_Z FNC_VALUES 1 FLOAT32_IEEE COLUMN_DIR DIRECT /end RECORD_LAYOUT
/begin COMPU_METHOD CU_IDLM_NU_SPARKPGAINNEG_Z "Conversion method for IDLm_NU_SparkPGainNeg_z" RAT_FUNC "%10.2" "NU" COEFFS 0.000000 1.000000 0.000000 0.000000 0.000000 1.000000 /end COMPU_METHOD
/begin AXIS_PTS APD_IDLM_NU_SPARKPGAINNEG_X "(pct load) Map index" 0x8beac IDL_RPM_Error RL_IDLM_NU_SPARKPGAINNEG_X 2000.000000 CU_IDLM_NU_SPARKPGAINNEG_X 8 -1000.0 1000.0 BYTE_ORDER MSB_FIRST /end AXIS_PTS
/begin RECORD_LAYOUT RL_IDLM_NU_SPARKPGAINNEG_X AXIS_PTS_X 1 FLOAT32_IEEE INDEX_INCR DIRECT /end RECORD_LAYOUT
/begin COMPU_METHOD CU_IDLM_NU_SPARKPGAINNEG_X "Conversion method for IDLm_NU_SparkPGainNeg_x" RAT_FUNC "%10.2" "pct" COEFFS 0.000000 1.000000 0.000000 0.000000 0.000000 1.000000 /end COMPU_METHOD
/* Map (1d) calibration for DDE 'IDLm_NU_SparkPGainPos_z'. */
/begin CHARACTERISTIC IDLm_NU_SparkPGainPos_z "Proportional Gain for PID Controller for spark output" CURVE 0x84dd0 RL_IDLM_NU_SPARKPGAINPOS_Z 1000.000000 CU_IDLM_NU_SPARKPGAINPOS_Z 0.000000 1000.000000
 /begin AXIS_DESCR COM_AXIS IDL_RPM_Error CU_IDLM_NU_SPARKPGAINPOS_X 8 -1000.000000 1000.000000 AXIS_PTS_REF APD_IDLM_NU_SPARKPGAINPOS_X /end AXIS_DESCR
 BYTE_ORDER MSB_FIRST /end CHARACTERISTIC
/begin RECORD_LAYOUT RL_IDLM_NU_SPARKPGAINPOS_Z FNC_VALUES 1 FLOAT32_IEEE COLUMN_DIR DIRECT /end RECORD_LAYOUT
/begin COMPU_METHOD CU_IDLM_NU_SPARKPGAINPOS_Z "Conversion method for IDLm_NU_SparkPGainPos_z" RAT_FUNC "%10.2" "NU" COEFFS 0.000000 1.000000 0.000000 0.000000 0.000000 1.000000 /end COMPU_METHOD
/begin AXIS_PTS APD_IDLM_NU_SPARKPGAINPOS_X "(pct load) Map index" 0x84db0 IDL_RPM_Error RL_IDLM_NU_SPARKPGAINPOS_X 2000.000000 CU_IDLM_NU_SPARKPGAINPOS_X 8 -1000.0 1000.0 BYTE_ORDER MSB_FIRST /end AXIS_PTS
/begin RECORD_LAYOUT RL_IDLM_NU_SPARKPGAINPOS_X AXIS_PTS_X 1 FLOAT32_IEEE INDEX_INCR DIRECT /end RECORD_LAYOUT
/begin COMPU_METHOD CU_IDLM_NU_SPARKPGAINPOS_X "Conversion method for IDLm_NU_SparkPGainPos_x" RAT_FUNC "%10.2" "pct" COEFFS 0.000000 1.000000 0.000000 0.000000 0.000000 1.000000 /end COMPU_METHOD
/* Map (1d) calibration for DDE 'IDLm_NU_TimeSinceStart_z'. */
/begin CHARACTERISTIC IDLm_NU_TimeSinceStart_z "Idle Spd based on Time Since Eng Start z-axis" CURVE 0x824dc RL_IDLM_NU_TIMESINCESTART_Z 10000.000000 CU_IDLM_NU_TIMESINCESTART_Z 0.000000 10000.000000
 /begin AXIS_DESCR COM_AXIS NO_INPUT_QUANTITY CU_IDLM_NU_TIMESINCESTART_X 10 0.000000 600.000000 AXIS_PTS_REF APD_IDLM_NU_TIMESINCESTART_X /end AXIS_DESCR
 BYTE_ORDER MSB_FIRST /end CHARACTERISTIC
/begin RECORD_LAYOUT RL_IDLM_NU_TIMESINCESTART_Z FNC_VALUES 1 FLOAT32_IEEE COLUMN_DIR DIRECT /end RECORD_LAYOUT
/begin COMPU_METHOD CU_IDLM_NU_TIMESINCESTART_Z "Conversion method for IDLm_NU_TimeSinceStart_z" RAT_FUNC "%10.0" "RPM" COEFFS 0.000000 1.000000 0.000000 0.000000 0.000000 1.000000 /end COMPU_METHOD
/begin AXIS_PTS APD_IDLM_NU_TIMESINCESTART_X "Idle Spd based on Time Since Eng Start x-axis" 0x824b4 NO_INPUT_QUANTITY RL_IDLM_NU_TIMESINCESTART_X 600.000000 CU_IDLM_NU_TIMESINCESTART_X 10 0.0 600.0 BYTE_ORDER MSB_FIRST /end AXIS_PTS
/begin RECORD_LAYOUT RL_IDLM_NU_TIMESINCESTART_X AXIS_PTS_X 1 FLOAT32_IEEE INDEX_INCR DIRECT /end RECORD_LAYOUT
/begin COMPU_METHOD CU_IDLM_NU_TIMESINCESTART_X "Conversion method for IDLm_NU_TimeSinceStart_x" RAT_FUNC "%10.0" "s" COEFFS 0.000000 1.000000 0.000000 0.000000 0.000000 1.000000 /end COMPU_METHOD
/* Map (2d) calibration for DDE 'IDLm_gps_IdlAirGEAR_FF_z'. */
/begin CHARACTERISTIC IDLm_gps_IdlAirGEAR_FF_z "(not defined)" MAP 0x8544c RL_IDLM_GPS_IDLAIRGEAR_FF_Z 2000.000000 CU_IDLM_GPS_IDLAIRGEAR_FF_Z -1000.000000 1000.000000
 /begin AXIS_DESCR COM_AXIS NO_INPUT_QUANTITY CU_IDLM_GPS_IDLAIRGEAR_FF_X 8 0.000000 2000.000000 AXIS_PTS_REF APD_IDLM_GPS_IDLAIRGEAR_FF_X /end AXIS_DESCR
 /begin AXIS_DESCR COM_AXIS NO_INPUT_QUANTITY CU_IDLM_GPS_IDLAIRGEAR_FF_Y 8 -1.000000 6.000000 AXIS_PTS_REF APD_IDLM_GPS_IDLAIRGEAR_FF_Y /end AXIS_DESCR
 BYTE_ORDER MSB_FIRST /end CHARACTERISTIC
/begin RECORD_LAYOUT RL_IDLM_GPS_IDLAIRGEAR_FF_Z FNC_VALUES 1 FLOAT32_IEEE COLUMN_DIR DIRECT /end RECORD_LAYOUT
/begin COMPU_METHOD CU_IDLM_GPS_IDLAIRGEAR_FF_Z "Conversion method for IDLm_gps_IdlAirGEAR_FF_z" RAT_FUNC "%10.2" "gps" COEFFS 0.000000 1.000000 0.000000 0.000000 0.000000 1.000000 /end COMPU_METHOD
/begin AXIS_PTS APD_IDLM_GPS_IDLAIRGEAR_FF_X "(not defined)" 0x8540c NO_INPUT_QUANTITY RL_IDLM_GPS_IDLAIRGEAR_FF_X 2000.000000 CU_IDLM_GPS_IDLAIRGEAR_FF_X 8 0.0 2000.0 BYTE_ORDER MSB_FIRST /end AXIS_PTS
/begin RECORD_LAYOUT RL_IDLM_GPS_IDLAIRGEAR_FF_X AXIS_PTS_X 1 FLOAT32_IEEE INDEX_INCR DIRECT /end RECORD_LAYOUT
/begin COMPU_METHOD CU_IDLM_GPS_IDLAIRGEAR_FF_X "Conversion method for IDLm_gps_IdlAirGEAR_FF_x" RAT_FUNC "%10.0" "RPM" COEFFS 0.000000 1.000000 0.000000 0.000000 0.000000 1.000000 /end COMPU_METHOD
/begin AXIS_PTS APD_IDLM_GPS_IDLAIRGEAR_FF_Y "Drvr Air demand map vehicle speed axis for gear compensation" 0x8542c NO_INPUT_QUANTITY RL_IDLM_GPS_IDLAIRGEAR_FF_Y 7.000000 CU_IDLM_GPS_IDLAIRGEAR_FF_Y 8 -1.0 6.0 BYTE_ORDER MSB_FIRST /end AXIS_PTS
/begin RECORD_LAYOUT RL_IDLM_GPS_IDLAIRGEAR_FF_Y AXIS_PTS_X 1 FLOAT32_IEEE INDEX_INCR DIRECT /end RECORD_LAYOUT
/begin COMPU_METHOD CU_IDLM_GPS_IDLAIRGEAR_FF_Y "Conversion method for IDLm_gps_IdlAirGEAR_FF_y" RAT_FUNC "%10.0" "NU" COEFFS 0.000000 1.000000 0.000000 0.000000 0.000000 1.000000 /end COMPU_METHOD
/* Scalar calibration for DDE 'IJTc_NU_FlowRateConstant'. */
/begin CHARACTERISTIC IJTc_NU_FlowRateConstant "Flow rate constant" VALUE 0x8ad4c RL_IJTC_NU_FLOWRATECONSTANT 5000.000000 CU_IJTC_NU_FLOWRATECONSTANT 0.000000 5000.000000 BYTE_ORDER MSB_FIRST /end CHARACTERISTIC
/begin RECORD_LAYOUT RL_IJTC_NU_FLOWRATECONSTANT FNC_VALUES 1 FLOAT32_IEEE COLUMN_DIR DIRECT /end RECORD_LAYOUT
/begin COMPU_METHOD CU_IJTC_NU_FLOWRATECONSTANT "Conversion method for IJTc_NU_FlowRateConstant" RAT_FUNC "%10.2" "NU" COEFFS 0.000000 1.000000 0.000000 0.000000 0.000000 1.000000 /end COMPU_METHOD
/* Scalar calibration for DDE 'IJTc_adv_SOC_Inj1'. */
/begin CHARACTERISTIC IJTc_adv_SOC_Inj1 "Override cal for injector 1" VALUE 0x8a6f0 RL_IJTC_ADV_SOC_INJ1 1440.000000 CU_IJTC_ADV_SOC_INJ1 -720.000000 720.000000 BYTE_ORDER MSB_FIRST /end CHARACTERISTIC
/begin RECORD_LAYOUT RL_IJTC_ADV_SOC_INJ1 FNC_VALUES 1 FLOAT32_IEEE COLUMN_DIR DIRECT /end RECORD_LAYOUT
/begin COMPU_METHOD CU_IJTC_ADV_SOC_INJ1 "Conversion method for IJTc_adv_SOC_Inj1" RAT_FUNC "%10.2" "adv" COEFFS 0.000000 1.000000 0.000000 0.000000 0.000000 1.000000 /end COMPU_METHOD
/* Scalar calibration for DDE 'IJTc_adv_SOC_Inj2'. */
/begin CHARACTERISTIC IJTc_adv_SOC_Inj2 "Override cal for injector 2" VALUE 0x8a6f8 RL_IJTC_ADV_SOC_INJ2 1440.000000 CU_IJTC_ADV_SOC_INJ2 -720.000000 720.000000 BYTE_ORDER MSB_FIRST /end CHARACTERISTIC
/begin RECORD_LAYOUT RL_IJTC_ADV_SOC_INJ2 FNC_VALUES 1 FLOAT32_IEEE COLUMN_DIR DIRECT /end RECORD_LAYOUT
/begin COMPU_METHOD CU_IJTC_ADV_SOC_INJ2 "Conversion method for IJTc_adv_SOC_Inj2" RAT_FUNC "%10.2" "adv" COEFFS 0.000000 1.000000 0.000000 0.000000 0.000000 1.000000 /end COMPU_METHOD
/* Scalar calibration for DDE 'IJTc_adv_SOC_Inj3'. */
/begin CHARACTERISTIC IJTc_adv_SOC_Inj3 "Override cal for injector 3" VALUE 0x8a700 RL_IJTC_ADV_SOC_INJ3 1440.000000 CU_IJTC_ADV_SOC_INJ3 -720.000000 720.000000 BYTE_ORDER MSB_FIRST /end CHARACTERISTIC
/begin RECORD_LAYOUT RL_IJTC_ADV_SOC_INJ3 FNC_VALUES 1 FLOAT32_IEEE COLUMN_DIR DIRECT /end RECORD_LAYOUT
/begin COMPU_METHOD CU_IJTC_ADV_SOC_INJ3 "Conversion method for IJTc_adv_SOC_Inj3" RAT_FUNC "%10.2" "adv" COEFFS 0.000000 1.000000 0.000000 0.000000 0.000000 1.000000 /end COMPU_METHOD
/* Scalar calibration for DDE 'IJTc_adv_SOC_Inj4'. */
/begin CHARACTERISTIC IJTc_adv_SOC_Inj4 "Override cal for injector 4" VALUE 0x8a708 RL_IJTC_ADV_SOC_INJ4 1440.000000 CU_IJTC_ADV_SOC_INJ4 -720.000000 720.000000 BYTE_ORDER MSB_FIRST /end CHARACTERISTIC
/begin RECORD_LAYOUT RL_IJTC_ADV_SOC_INJ4 FNC_VALUES 1 FLOAT32_IEEE COLUMN_DIR DIRECT /end RECORD_LAYOUT
/begin COMPU_METHOD CU_IJTC_ADV_SOC_INJ4 "Conversion method for IJTc_adv_SOC_Inj4" RAT_FUNC "%10.2" "adv" COEFFS 0.000000 1.000000 0.000000 0.000000 0.000000 1.000000 /end COMPU_METHOD
/* Scalar calibration for DDE 'IJTc_adv_SOC_Max'. */
/begin CHARACTERISTIC IJTc_adv_SOC_Max "Maximum injection advance angle" VALUE 0x8a6e4 RL_IJTC_ADV_SOC_MAX 720.000000 CU_IJTC_ADV_SOC_MAX 0.000000 720.000000 BYTE_ORDER MSB_FIRST /end CHARACTERISTIC
/begin RECORD_LAYOUT RL_IJTC_ADV_SOC_MAX FNC_VALUES 1 FLOAT32_IEEE COLUMN_DIR DIRECT /end RECORD_LAYOUT
/begin COMPU_METHOD CU_IJTC_ADV_SOC_MAX "Conversion method for IJTc_adv_SOC_Max" RAT_FUNC "%10.0" "adv" COEFFS 0.000000 1.000000 0.000000 0.000000 0.000000 1.000000 /end COMPU_METHOD
/* Scalar calibration for DDE 'IJTc_adv_SOC_Min'. */
/begin CHARACTERISTIC IJTc_adv_SOC_Min "Minimum injection advance angle" VALUE 0x8a6e8 RL_IJTC_ADV_SOC_MIN 720.000000 CU_IJTC_ADV_SOC_MIN -720.000000 0.000000 BYTE_ORDER MSB_FIRST /end CHARACTERISTIC
/begin RECORD_LAYOUT RL_IJTC_ADV_SOC_MIN FNC_VALUES 1 FLOAT32_IEEE COLUMN_DIR DIRECT /end RECORD_LAYOUT
/begin COMPU_METHOD CU_IJTC_ADV_SOC_MIN "Conversion method for IJTc_adv_SOC_Min" RAT_FUNC "%10.0" "adv" COEFFS 0.000000 1.000000 0.000000 0.000000 0.000000 1.000000 /end COMPU_METHOD
/* Scalar calibration for DDE 'IJTc_b_Inj1_InjectionSent'. */
/begin CHARACTERISTIC IJTc_b_Inj1_InjectionSent "Override cal for injector 1" VALUE 0x8a721 RL_IJTC_B_INJ1_INJECTIONSENT 1.000000 CU_IJTC_B_INJ1_INJECTIONSENT 0.000000 1.000000 BYTE_ORDER MSB_FIRST /end CHARACTERISTIC
/begin RECORD_LAYOUT RL_IJTC_B_INJ1_INJECTIONSENT FNC_VALUES 1 UBYTE COLUMN_DIR DIRECT /end RECORD_LAYOUT
/begin COMPU_METHOD CU_IJTC_B_INJ1_INJECTIONSENT "Conversion method for IJTc_b_Inj1_InjectionSent" RAT_FUNC "%10.0" "b" COEFFS 0.000000 1.000000 0.000000 0.000000 0.000000 1.000000 /end COMPU_METHOD
/* Scalar calibration for DDE 'IJTc_b_Inj2_InjectionSent'. */
/begin CHARACTERISTIC IJTc_b_Inj2_InjectionSent "Override cal for injector 2" VALUE 0x8a723 RL_IJTC_B_INJ2_INJECTIONSENT 1.000000 CU_IJTC_B_INJ2_INJECTIONSENT 0.000000 1.000000 BYTE_ORDER MSB_FIRST /end CHARACTERISTIC
/begin RECORD_LAYOUT RL_IJTC_B_INJ2_INJECTIONSENT FNC_VALUES 1 UBYTE COLUMN_DIR DIRECT /end RECORD_LAYOUT
/begin COMPU_METHOD CU_IJTC_B_INJ2_INJECTIONSENT "Conversion method for IJTc_b_Inj2_InjectionSent" RAT_FUNC "%10.0" "b" COEFFS 0.000000 1.000000 0.000000 0.000000 0.000000 1.000000 /end COMPU_METHOD
/* Scalar calibration for DDE 'IJTc_b_Inj3_InjectionSent'. */
/begin CHARACTERISTIC IJTc_b_Inj3_InjectionSent "Override cal for injector 3" VALUE 0x8a725 RL_IJTC_B_INJ3_INJECTIONSENT 1.000000 CU_IJTC_B_INJ3_INJECTIONSENT 0.000000 1.000000 BYTE_ORDER MSB_FIRST /end CHARACTERISTIC
/begin RECORD_LAYOUT RL_IJTC_B_INJ3_INJECTIONSENT FNC_VALUES 1 UBYTE COLUMN_DIR DIRECT /end RECORD_LAYOUT
/begin COMPU_METHOD CU_IJTC_B_INJ3_INJECTIONSENT "Conversion method for IJTc_b_Inj3_InjectionSent" RAT_FUNC "%10.0" "b" COEFFS 0.000000 1.000000 0.000000 0.000000 0.000000 1.000000 /end COMPU_METHOD
/* Scalar calibration for DDE 'IJTc_b_Inj4_InjectionSent'. */
/begin CHARACTERISTIC IJTc_b_Inj4_InjectionSent "Override cal for injector 4" VALUE 0x8a727 RL_IJTC_B_INJ4_INJECTIONSENT 1.000000 CU_IJTC_B_INJ4_INJECTIONSENT 0.000000 1.000000 BYTE_ORDER MSB_FIRST /end CHARACTERISTIC
/begin RECORD_LAYOUT RL_IJTC_B_INJ4_INJECTIONSENT FNC_VALUES 1 UBYTE COLUMN_DIR DIRECT /end RECORD_LAYOUT
/begin COMPU_METHOD CU_IJTC_B_INJ4_INJECTIONSENT "Conversion method for IJTc_b_Inj4_InjectionSent" RAT_FUNC "%10.0" "b" COEFFS 0.000000 1.000000 0.000000 0.000000 0.000000 1.000000 /end COMPU_METHOD
/* Scalar calibration for DDE 'IJTc_b_PrimingPulseEnable'. */
/begin CHARACTERISTIC IJTc_b_PrimingPulseEnable "Enable priming pulse during cranking" VALUE 0x8a8c8 RL_IJTC_B_PRIMINGPULSEENABLE 1.000000 CU_IJTC_B_PRIMINGPULSEENABLE 0.000000 1.000000 BYTE_ORDER MSB_FIRST /end CHARACTERISTIC
/begin RECORD_LAYOUT RL_IJTC_B_PRIMINGPULSEENABLE FNC_VALUES 1 UBYTE COLUMN_DIR DIRECT /end RECORD_LAYOUT
/begin COMPU_METHOD CU_IJTC_B_PRIMINGPULSEENABLE "Conversion method for IJTc_b_PrimingPulseEnable" RAT_FUNC "%10.0" "b" COEFFS 0.000000 1.000000 0.000000 0.000000 0.000000 1.000000 /end COMPU_METHOD
/* Scalar calibration for DDE 'IJTc_b_UseFlowRateTable'. */
/begin CHARACTERISTIC IJTc_b_UseFlowRateTable "Boolean to indicate use of flow rate equation or flow map" VALUE 0x8ad48 RL_IJTC_B_USEFLOWRATETABLE 1.000000 CU_IJTC_B_USEFLOWRATETABLE 0.000000 1.000000 BYTE_ORDER MSB_FIRST /end CHARACTERISTIC
/begin RECORD_LAYOUT RL_IJTC_B_USEFLOWRATETABLE FNC_VALUES 1 UBYTE COLUMN_DIR DIRECT /end RECORD_LAYOUT
/begin COMPU_METHOD CU_IJTC_B_USEFLOWRATETABLE "Conversion method for IJTc_b_UseFlowRateTable" RAT_FUNC "%10.0" "b" COEFFS 0.000000 1.000000 0.000000 0.000000 0.000000 1.000000 /end COMPU_METHOD
/* Scalar calibration for DDE 'IJTc_cnt_PrimingPulses'. */
/begin CHARACTERISTIC IJTc_cnt_PrimingPulses "Number of firings the injector should send the fixed pulse" VALUE 0x8a8d0 RL_IJTC_CNT_PRIMINGPULSES 4.000000 CU_IJTC_CNT_PRIMINGPULSES 1.000000 5.000000 BYTE_ORDER MSB_FIRST /end CHARACTERISTIC
/begin RECORD_LAYOUT RL_IJTC_CNT_PRIMINGPULSES FNC_VALUES 1 UBYTE COLUMN_DIR DIRECT /end RECORD_LAYOUT
/begin COMPU_METHOD CU_IJTC_CNT_PRIMINGPULSES "Conversion method for IJTc_cnt_PrimingPulses" RAT_FUNC "%10.0" "cnt" COEFFS 0.000000 1.000000 0.000000 0.000000 0.000000 1.000000 /end COMPU_METHOD
/* Scalar calibration for DDE 'IJTc_mg_MaxInj'. */
/begin CHARACTERISTIC IJTc_mg_MaxInj "Maximum injection quantity" VALUE 0x8a914 RL_IJTC_MG_MAXINJ 700.000000 CU_IJTC_MG_MAXINJ 0.000000 700.000000 BYTE_ORDER MSB_FIRST /end CHARACTERISTIC
/begin RECORD_LAYOUT RL_IJTC_MG_MAXINJ FNC_VALUES 1 FLOAT32_IEEE COLUMN_DIR DIRECT /end RECORD_LAYOUT
/begin COMPU_METHOD CU_IJTC_MG_MAXINJ "Conversion method for IJTc_mg_MaxInj" RAT_FUNC "%10.2" "mg" COEFFS 0.000000 1.000000 0.000000 0.000000 0.000000 1.000000 /end COMPU_METHOD
/* Scalar calibration for DDE 'IJTc_mg_MinInj'. */
/begin CHARACTERISTIC IJTc_mg_MinInj "Minimum injection quantity" VALUE 0x8a918 RL_IJTC_MG_MININJ 5.000000 CU_IJTC_MG_MININJ 0.000000 5.000000 BYTE_ORDER MSB_FIRST /end CHARACTERISTIC
/begin RECORD_LAYOUT RL_IJTC_MG_MININJ FNC_VALUES 1 FLOAT32_IEEE COLUMN_DIR DIRECT /end RECORD_LAYOUT
/begin COMPU_METHOD CU_IJTC_MG_MININJ "Conversion method for IJTc_mg_MinInj" RAT_FUNC "%10.2" "mg" COEFFS 0.000000 1.000000 0.000000 0.000000 0.000000 1.000000 /end COMPU_METHOD
/* Scalar calibration for DDE 'IJTc_ms_ClosingDelayNoOverlap'. */
/begin CHARACTERISTIC IJTc_ms_ClosingDelayNoOverlap "Injector closing time" VALUE 0x8ad54 RL_IJTC_MS_CLOSINGDELAYNOOVERL0 2.000000 CU_IJTC_MS_CLOSINGDELAYNOOVERL0 0.000000 2.000000 BYTE_ORDER MSB_FIRST /end CHARACTERISTIC
/begin RECORD_LAYOUT RL_IJTC_MS_CLOSINGDELAYNOOVERL0 FNC_VALUES 1 FLOAT32_IEEE COLUMN_DIR DIRECT /end RECORD_LAYOUT
/begin COMPU_METHOD CU_IJTC_MS_CLOSINGDELAYNOOVERL0 "Conversion method for IJTc_ms_ClosingDelayNoOverlap" RAT_FUNC "%10.2" "ms" COEFFS 0.000000 1.000000 0.000000 0.000000 0.000000 1.000000 /end COMPU_METHOD
/* Scalar calibration for DDE 'IJTc_ms_ClosingDelayWithOverlap'. */
/begin CHARACTERISTIC IJTc_ms_ClosingDelayWithOverlap "Injector closing time" VALUE 0x8ad50 RL_IJTC_MS_CLOSINGDELAYWITHOVE0 2.000000 CU_IJTC_MS_CLOSINGDELAYWITHOVE0 0.000000 2.000000 BYTE_ORDER MSB_FIRST /end CHARACTERISTIC
/begin RECORD_LAYOUT RL_IJTC_MS_CLOSINGDELAYWITHOVE0 FNC_VALUES 1 FLOAT32_IEEE COLUMN_DIR DIRECT /end RECORD_LAYOUT
/begin COMPU_METHOD CU_IJTC_MS_CLOSINGDELAYWITHOVE0 "Conversion method for IJTc_ms_ClosingDelayWithOverlap" RAT_FUNC "%10.2" "ms" COEFFS 0.000000 1.000000 0.000000 0.000000 0.000000 1.000000 /end COMPU_METHOD
/* Scalar calibration for DDE 'IJTc_ms_Inj1'. */
/begin CHARACTERISTIC IJTc_ms_Inj1 "Override cal for injector 1 ms" VALUE 0x8ad60 RL_IJTC_MS_INJ1 10.000000 CU_IJTC_MS_INJ1 0.000000 10.000000 BYTE_ORDER MSB_FIRST /end CHARACTERISTIC
/begin RECORD_LAYOUT RL_IJTC_MS_INJ1 FNC_VALUES 1 FLOAT32_IEEE COLUMN_DIR DIRECT /end RECORD_LAYOUT
/begin COMPU_METHOD CU_IJTC_MS_INJ1 "Conversion method for IJTc_ms_Inj1" RAT_FUNC "%10.2" "ms" COEFFS 0.000000 1.000000 0.000000 0.000000 0.000000 1.000000 /end COMPU_METHOD
/* Scalar calibration for DDE 'IJTc_ms_Inj2'. */
/begin CHARACTERISTIC IJTc_ms_Inj2 "Override cal for injector 2 ms" VALUE 0x8ad68 RL_IJTC_MS_INJ2 10.000000 CU_IJTC_MS_INJ2 0.000000 10.000000 BYTE_ORDER MSB_FIRST /end CHARACTERISTIC
/begin RECORD_LAYOUT RL_IJTC_MS_INJ2 FNC_VALUES 1 FLOAT32_IEEE COLUMN_DIR DIRECT /end RECORD_LAYOUT
/begin COMPU_METHOD CU_IJTC_MS_INJ2 "Conversion method for IJTc_ms_Inj2" RAT_FUNC "%10.2" "ms" COEFFS 0.000000 1.000000 0.000000 0.000000 0.000000 1.000000 /end COMPU_METHOD
/* Scalar calibration for DDE 'IJTc_ms_Inj3'. */
/begin CHARACTERISTIC IJTc_ms_Inj3 "Override cal for injector 3 ms" VALUE 0x8ad70 RL_IJTC_MS_INJ3 10.000000 CU_IJTC_MS_INJ3 0.000000 10.000000 BYTE_ORDER MSB_FIRST /end CHARACTERISTIC
/begin RECORD_LAYOUT RL_IJTC_MS_INJ3 FNC_VALUES 1 FLOAT32_IEEE COLUMN_DIR DIRECT /end RECORD_LAYOUT
/begin COMPU_METHOD CU_IJTC_MS_INJ3 "Conversion method for IJTc_ms_Inj3" RAT_FUNC "%10.2" "ms" COEFFS 0.000000 1.000000 0.000000 0.000000 0.000000 1.000000 /end COMPU_METHOD
/* Scalar calibration for DDE 'IJTc_ms_Inj4'. */
/begin CHARACTERISTIC IJTc_ms_Inj4 "Override cal for injector 4 ms" VALUE 0x8ad78 RL_IJTC_MS_INJ4 10.000000 CU_IJTC_MS_INJ4 0.000000 10.000000 BYTE_ORDER MSB_FIRST /end CHARACTERISTIC
/begin RECORD_LAYOUT RL_IJTC_MS_INJ4 FNC_VALUES 1 FLOAT32_IEEE COLUMN_DIR DIRECT /end RECORD_LAYOUT
/begin COMPU_METHOD CU_IJTC_MS_INJ4 "Conversion method for IJTc_ms_Inj4" RAT_FUNC "%10.2" "ms" COEFFS 0.000000 1.000000 0.000000 0.000000 0.000000 1.000000 /end COMPU_METHOD
/* Scalar calibration for DDE 'IJTc_ms_OpeningDelayInj1'. */
/begin CHARACTERISTIC IJTc_ms_OpeningDelayInj1 "Override cal for injector 1" VALUE 0x8be04 RL_IJTC_MS_OPENINGDELAYINJ1 10.000000 CU_IJTC_MS_OPENINGDELAYINJ1 0.000000 10.000000 BYTE_ORDER MSB_FIRST /end CHARACTERISTIC
/begin RECORD_LAYOUT RL_IJTC_MS_OPENINGDELAYINJ1 FNC_VALUES 1 FLOAT32_IEEE COLUMN_DIR DIRECT /end RECORD_LAYOUT
/begin COMPU_METHOD CU_IJTC_MS_OPENINGDELAYINJ1 "Conversion method for IJTc_ms_OpeningDelayInj1" RAT_FUNC "%10.3" "ms" COEFFS 0.000000 1.000000 0.000000 0.000000 0.000000 1.000000 /end COMPU_METHOD
/* Scalar calibration for DDE 'IJTc_ms_OpeningDelayInj2'. */
/begin CHARACTERISTIC IJTc_ms_OpeningDelayInj2 "Override cal for injector 2" VALUE 0x8be0c RL_IJTC_MS_OPENINGDELAYINJ2 10.000000 CU_IJTC_MS_OPENINGDELAYINJ2 0.000000 10.000000 BYTE_ORDER MSB_FIRST /end CHARACTERISTIC
/begin RECORD_LAYOUT RL_IJTC_MS_OPENINGDELAYINJ2 FNC_VALUES 1 FLOAT32_IEEE COLUMN_DIR DIRECT /end RECORD_LAYOUT
/begin COMPU_METHOD CU_IJTC_MS_OPENINGDELAYINJ2 "Conversion method for IJTc_ms_OpeningDelayInj2" RAT_FUNC "%10.3" "ms" COEFFS 0.000000 1.000000 0.000000 0.000000 0.000000 1.000000 /end COMPU_METHOD
/* Scalar calibration for DDE 'IJTc_ms_OpeningDelayInj3'. */
/begin CHARACTERISTIC IJTc_ms_OpeningDelayInj3 "Override cal for injector 3" VALUE 0x8be14 RL_IJTC_MS_OPENINGDELAYINJ3 10.000000 CU_IJTC_MS_OPENINGDELAYINJ3 0.000000 10.000000 BYTE_ORDER MSB_FIRST /end CHARACTERISTIC
/begin RECORD_LAYOUT RL_IJTC_MS_OPENINGDELAYINJ3 FNC_VALUES 1 FLOAT32_IEEE COLUMN_DIR DIRECT /end RECORD_LAYOUT
/begin COMPU_METHOD CU_IJTC_MS_OPENINGDELAYINJ3 "Conversion method for IJTc_ms_OpeningDelayInj3" RAT_FUNC "%10.3" "ms" COEFFS 0.000000 1.000000 0.000000 0.000000 0.000000 1.000000 /end COMPU_METHOD
/* Scalar calibration for DDE 'IJTc_ms_OpeningDelayInj4'. */
/begin CHARACTERISTIC IJTc_ms_OpeningDelayInj4 "Override cal for injector 4" VALUE 0x8be1c RL_IJTC_MS_OPENINGDELAYINJ4 10.000000 CU_IJTC_MS_OPENINGDELAYINJ4 0.000000 10.000000 BYTE_ORDER MSB_FIRST /end CHARACTERISTIC
/begin RECORD_LAYOUT RL_IJTC_MS_OPENINGDELAYINJ4 FNC_VALUES 1 FLOAT32_IEEE COLUMN_DIR DIRECT /end RECORD_LAYOUT
/begin COMPU_METHOD CU_IJTC_MS_OPENINGDELAYINJ4 "Conversion method for IJTc_ms_OpeningDelayInj4" RAT_FUNC "%10.3" "ms" COEFFS 0.000000 1.000000 0.000000 0.000000 0.000000 1.000000 /end COMPU_METHOD
/* Scalar calibration for DDE 'IJTc_ms_OverlapOfst'. */
/begin CHARACTERISTIC IJTc_ms_OverlapOfst "If pulses for each injector are this close to eachother consider it overlap" VALUE 0x8ad44 RL_IJTC_MS_OVERLAPOFST 20.000000 CU_IJTC_MS_OVERLAPOFST -10.000000 10.000000 BYTE_ORDER MSB_FIRST /end CHARACTERISTIC
/begin RECORD_LAYOUT RL_IJTC_MS_OVERLAPOFST FNC_VALUES 1 FLOAT32_IEEE COLUMN_DIR DIRECT /end RECORD_LAYOUT
/begin COMPU_METHOD CU_IJTC_MS_OVERLAPOFST "Conversion method for IJTc_ms_OverlapOfst" RAT_FUNC "%10.2" "ms" COEFFS 0.000000 1.000000 0.000000 0.000000 0.000000 1.000000 /end COMPU_METHOD
/* Scalar calibration for DDE 'IJTc_ms_PrimingPulseFlowTime'. */
/begin CHARACTERISTIC IJTc_ms_PrimingPulseFlowTime "Priming pulse injection duration" VALUE 0x8ad58 RL_IJTC_MS_PRIMINGPULSEFLOWTIME 100.000000 CU_IJTC_MS_PRIMINGPULSEFLOWTIME 0.000000 100.000000 BYTE_ORDER MSB_FIRST /end CHARACTERISTIC
/begin RECORD_LAYOUT RL_IJTC_MS_PRIMINGPULSEFLOWTIME FNC_VALUES 1 FLOAT32_IEEE COLUMN_DIR DIRECT /end RECORD_LAYOUT
/begin COMPU_METHOD CU_IJTC_MS_PRIMINGPULSEFLOWTIME "Conversion method for IJTc_ms_PrimingPulseFlowTime" RAT_FUNC "%10.1" "ms" COEFFS 0.000000 1.000000 0.000000 0.000000 0.000000 1.000000 /end COMPU_METHOD
/* Scalar calibration for DDE 'IJTc_o_Inj1_InjectionSent'. */
/begin CHARACTERISTIC IJTc_o_Inj1_InjectionSent "Override flag for injector 1" VALUE 0x8a720 RL_IJTC_O_INJ1_INJECTIONSENT 1.000000 CU_IJTC_O_INJ1_INJECTIONSENT 0.000000 1.000000 BYTE_ORDER MSB_FIRST /end CHARACTERISTIC
/begin RECORD_LAYOUT RL_IJTC_O_INJ1_INJECTIONSENT FNC_VALUES 1 UBYTE COLUMN_DIR DIRECT /end RECORD_LAYOUT
/begin COMPU_METHOD CU_IJTC_O_INJ1_INJECTIONSENT "Conversion method for IJTc_o_Inj1_InjectionSent" RAT_FUNC "%10.0" "o" COEFFS 0.000000 1.000000 0.000000 0.000000 0.000000 1.000000 /end COMPU_METHOD
/* Scalar calibration for DDE 'IJTc_o_Inj1_PulseDur'. */
/begin CHARACTERISTIC IJTc_o_Inj1_PulseDur "Override flag for injector 1 ms" VALUE 0x8ad5c RL_IJTC_O_INJ1_PULSEDUR 1.000000 CU_IJTC_O_INJ1_PULSEDUR 0.000000 1.000000 BYTE_ORDER MSB_FIRST /end CHARACTERISTIC
/begin RECORD_LAYOUT RL_IJTC_O_INJ1_PULSEDUR FNC_VALUES 1 UBYTE COLUMN_DIR DIRECT /end RECORD_LAYOUT
/begin COMPU_METHOD CU_IJTC_O_INJ1_PULSEDUR "Conversion method for IJTc_o_Inj1_PulseDur" RAT_FUNC "%10.0" "o" COEFFS 0.000000 1.000000 0.000000 0.000000 0.000000 1.000000 /end COMPU_METHOD
/* Scalar calibration for DDE 'IJTc_o_Inj2_InjectionSent'. */
/begin CHARACTERISTIC IJTc_o_Inj2_InjectionSent "Override flag for injector 2" VALUE 0x8a722 RL_IJTC_O_INJ2_INJECTIONSENT 1.000000 CU_IJTC_O_INJ2_INJECTIONSENT 0.000000 1.000000 BYTE_ORDER MSB_FIRST /end CHARACTERISTIC
/begin RECORD_LAYOUT RL_IJTC_O_INJ2_INJECTIONSENT FNC_VALUES 1 UBYTE COLUMN_DIR DIRECT /end RECORD_LAYOUT
/begin COMPU_METHOD CU_IJTC_O_INJ2_INJECTIONSENT "Conversion method for IJTc_o_Inj2_InjectionSent" RAT_FUNC "%10.0" "o" COEFFS 0.000000 1.000000 0.000000 0.000000 0.000000 1.000000 /end COMPU_METHOD
/* Scalar calibration for DDE 'IJTc_o_Inj2_PulseDur'. */
/begin CHARACTERISTIC IJTc_o_Inj2_PulseDur "Override flag for injector 2 ms" VALUE 0x8ad64 RL_IJTC_O_INJ2_PULSEDUR 1.000000 CU_IJTC_O_INJ2_PULSEDUR 0.000000 1.000000 BYTE_ORDER MSB_FIRST /end CHARACTERISTIC
/begin RECORD_LAYOUT RL_IJTC_O_INJ2_PULSEDUR FNC_VALUES 1 UBYTE COLUMN_DIR DIRECT /end RECORD_LAYOUT
/begin COMPU_METHOD CU_IJTC_O_INJ2_PULSEDUR "Conversion method for IJTc_o_Inj2_PulseDur" RAT_FUNC "%10.0" "o" COEFFS 0.000000 1.000000 0.000000 0.000000 0.000000 1.000000 /end COMPU_METHOD
/* Scalar calibration for DDE 'IJTc_o_Inj3_InjectionSent'. */
/begin CHARACTERISTIC IJTc_o_Inj3_InjectionSent "Override flag for injector 3" VALUE 0x8a724 RL_IJTC_O_INJ3_INJECTIONSENT 1.000000 CU_IJTC_O_INJ3_INJECTIONSENT 0.000000 1.000000 BYTE_ORDER MSB_FIRST /end CHARACTERISTIC
/begin RECORD_LAYOUT RL_IJTC_O_INJ3_INJECTIONSENT FNC_VALUES 1 UBYTE COLUMN_DIR DIRECT /end RECORD_LAYOUT
/begin COMPU_METHOD CU_IJTC_O_INJ3_INJECTIONSENT "Conversion method for IJTc_o_Inj3_InjectionSent" RAT_FUNC "%10.0" "o" COEFFS 0.000000 1.000000 0.000000 0.000000 0.000000 1.000000 /end COMPU_METHOD
/* Scalar calibration for DDE 'IJTc_o_Inj3_PulseDur'. */
/begin CHARACTERISTIC IJTc_o_Inj3_PulseDur "Override flag for injector 3 ms" VALUE 0x8ad6c RL_IJTC_O_INJ3_PULSEDUR 1.000000 CU_IJTC_O_INJ3_PULSEDUR 0.000000 1.000000 BYTE_ORDER MSB_FIRST /end CHARACTERISTIC
/begin RECORD_LAYOUT RL_IJTC_O_INJ3_PULSEDUR FNC_VALUES 1 UBYTE COLUMN_DIR DIRECT /end RECORD_LAYOUT
/begin COMPU_METHOD CU_IJTC_O_INJ3_PULSEDUR "Conversion method for IJTc_o_Inj3_PulseDur" RAT_FUNC "%10.0" "o" COEFFS 0.000000 1.000000 0.000000 0.000000 0.000000 1.000000 /end COMPU_METHOD
/* Scalar calibration for DDE 'IJTc_o_Inj4_InjectionSent'. */
/begin CHARACTERISTIC IJTc_o_Inj4_InjectionSent "Override flag for injector 4" VALUE 0x8a726 RL_IJTC_O_INJ4_INJECTIONSENT 1.000000 CU_IJTC_O_INJ4_INJECTIONSENT 0.000000 1.000000 BYTE_ORDER MSB_FIRST /end CHARACTERISTIC
/begin RECORD_LAYOUT RL_IJTC_O_INJ4_INJECTIONSENT FNC_VALUES 1 UBYTE COLUMN_DIR DIRECT /end RECORD_LAYOUT
/begin COMPU_METHOD CU_IJTC_O_INJ4_INJECTIONSENT "Conversion method for IJTc_o_Inj4_InjectionSent" RAT_FUNC "%10.0" "o" COEFFS 0.000000 1.000000 0.000000 0.000000 0.000000 1.000000 /end COMPU_METHOD
/* Scalar calibration for DDE 'IJTc_o_Inj4_PulseDur'. */
/begin CHARACTERISTIC IJTc_o_Inj4_PulseDur "Override flag for injector 4 ms" VALUE 0x8ad74 RL_IJTC_O_INJ4_PULSEDUR 1.000000 CU_IJTC_O_INJ4_PULSEDUR 0.000000 1.000000 BYTE_ORDER MSB_FIRST /end CHARACTERISTIC
/begin RECORD_LAYOUT RL_IJTC_O_INJ4_PULSEDUR FNC_VALUES 1 UBYTE COLUMN_DIR DIRECT /end RECORD_LAYOUT
/begin COMPU_METHOD CU_IJTC_O_INJ4_PULSEDUR "Conversion method for IJTc_o_Inj4_PulseDur" RAT_FUNC "%10.0" "o" COEFFS 0.000000 1.000000 0.000000 0.000000 0.000000 1.000000 /end COMPU_METHOD
/* Scalar calibration for DDE 'IJTc_o_OpeningDelayInj1'. */
/begin CHARACTERISTIC IJTc_o_OpeningDelayInj1 "Override flag for injector 1" VALUE 0x8be00 RL_IJTC_O_OPENINGDELAYINJ1 1.000000 CU_IJTC_O_OPENINGDELAYINJ1 0.000000 1.000000 BYTE_ORDER MSB_FIRST /end CHARACTERISTIC
/begin RECORD_LAYOUT RL_IJTC_O_OPENINGDELAYINJ1 FNC_VALUES 1 UBYTE COLUMN_DIR DIRECT /end RECORD_LAYOUT
/begin COMPU_METHOD CU_IJTC_O_OPENINGDELAYINJ1 "Conversion method for IJTc_o_OpeningDelayInj1" RAT_FUNC "%10.0" "o" COEFFS 0.000000 1.000000 0.000000 0.000000 0.000000 1.000000 /end COMPU_METHOD
/* Scalar calibration for DDE 'IJTc_o_OpeningDelayInj2'. */
/begin CHARACTERISTIC IJTc_o_OpeningDelayInj2 "Override flag for injector 2" VALUE 0x8be08 RL_IJTC_O_OPENINGDELAYINJ2 1.000000 CU_IJTC_O_OPENINGDELAYINJ2 0.000000 1.000000 BYTE_ORDER MSB_FIRST /end CHARACTERISTIC
/begin RECORD_LAYOUT RL_IJTC_O_OPENINGDELAYINJ2 FNC_VALUES 1 UBYTE COLUMN_DIR DIRECT /end RECORD_LAYOUT
/begin COMPU_METHOD CU_IJTC_O_OPENINGDELAYINJ2 "Conversion method for IJTc_o_OpeningDelayInj2" RAT_FUNC "%10.0" "o" COEFFS 0.000000 1.000000 0.000000 0.000000 0.000000 1.000000 /end COMPU_METHOD
/* Scalar calibration for DDE 'IJTc_o_OpeningDelayInj3'. */
/begin CHARACTERISTIC IJTc_o_OpeningDelayInj3 "Override flag for injector 3" VALUE 0x8be10 RL_IJTC_O_OPENINGDELAYINJ3 1.000000 CU_IJTC_O_OPENINGDELAYINJ3 0.000000 1.000000 BYTE_ORDER MSB_FIRST /end CHARACTERISTIC
/begin RECORD_LAYOUT RL_IJTC_O_OPENINGDELAYINJ3 FNC_VALUES 1 UBYTE COLUMN_DIR DIRECT /end RECORD_LAYOUT
/begin COMPU_METHOD CU_IJTC_O_OPENINGDELAYINJ3 "Conversion method for IJTc_o_OpeningDelayInj3" RAT_FUNC "%10.0" "o" COEFFS 0.000000 1.000000 0.000000 0.000000 0.000000 1.000000 /end COMPU_METHOD
/* Scalar calibration for DDE 'IJTc_o_OpeningDelayInj4'. */
/begin CHARACTERISTIC IJTc_o_OpeningDelayInj4 "Override flag for injector 4" VALUE 0x8be18 RL_IJTC_O_OPENINGDELAYINJ4 1.000000 CU_IJTC_O_OPENINGDELAYINJ4 0.000000 1.000000 BYTE_ORDER MSB_FIRST /end CHARACTERISTIC
/begin RECORD_LAYOUT RL_IJTC_O_OPENINGDELAYINJ4 FNC_VALUES 1 UBYTE COLUMN_DIR DIRECT /end RECORD_LAYOUT
/begin COMPU_METHOD CU_IJTC_O_OPENINGDELAYINJ4 "Conversion method for IJTc_o_OpeningDelayInj4" RAT_FUNC "%10.0" "o" COEFFS 0.000000 1.000000 0.000000 0.000000 0.000000 1.000000 /end COMPU_METHOD
/* Scalar calibration for DDE 'IJTc_o_SOC_Inj1'. */
/begin CHARACTERISTIC IJTc_o_SOC_Inj1 "Override flag for injector 1" VALUE 0x8a6ec RL_IJTC_O_SOC_INJ1 1.000000 CU_IJTC_O_SOC_INJ1 0.000000 1.000000 BYTE_ORDER MSB_FIRST /end CHARACTERISTIC
/begin RECORD_LAYOUT RL_IJTC_O_SOC_INJ1 FNC_VALUES 1 UBYTE COLUMN_DIR DIRECT /end RECORD_LAYOUT
/begin COMPU_METHOD CU_IJTC_O_SOC_INJ1 "Conversion method for IJTc_o_SOC_Inj1" RAT_FUNC "%10.0" "o" COEFFS 0.000000 1.000000 0.000000 0.000000 0.000000 1.000000 /end COMPU_METHOD
/* Scalar calibration for DDE 'IJTc_o_SOC_Inj2'. */
/begin CHARACTERISTIC IJTc_o_SOC_Inj2 "Override flag for injector 2" VALUE 0x8a6f4 RL_IJTC_O_SOC_INJ2 1.000000 CU_IJTC_O_SOC_INJ2 0.000000 1.000000 BYTE_ORDER MSB_FIRST /end CHARACTERISTIC
/begin RECORD_LAYOUT RL_IJTC_O_SOC_INJ2 FNC_VALUES 1 UBYTE COLUMN_DIR DIRECT /end RECORD_LAYOUT
/begin COMPU_METHOD CU_IJTC_O_SOC_INJ2 "Conversion method for IJTc_o_SOC_Inj2" RAT_FUNC "%10.0" "o" COEFFS 0.000000 1.000000 0.000000 0.000000 0.000000 1.000000 /end COMPU_METHOD
/* Scalar calibration for DDE 'IJTc_o_SOC_Inj3'. */
/begin CHARACTERISTIC IJTc_o_SOC_Inj3 "Override flag for injector 3" VALUE 0x8a6fc RL_IJTC_O_SOC_INJ3 1.000000 CU_IJTC_O_SOC_INJ3 0.000000 1.000000 BYTE_ORDER MSB_FIRST /end CHARACTERISTIC
/begin RECORD_LAYOUT RL_IJTC_O_SOC_INJ3 FNC_VALUES 1 UBYTE COLUMN_DIR DIRECT /end RECORD_LAYOUT
/begin COMPU_METHOD CU_IJTC_O_SOC_INJ3 "Conversion method for IJTc_o_SOC_Inj3" RAT_FUNC "%10.0" "o" COEFFS 0.000000 1.000000 0.000000 0.000000 0.000000 1.000000 /end COMPU_METHOD
/* Scalar calibration for DDE 'IJTc_o_SOC_Inj4'. */
/begin CHARACTERISTIC IJTc_o_SOC_Inj4 "Override flag for injector 4" VALUE 0x8a704 RL_IJTC_O_SOC_INJ4 1.000000 CU_IJTC_O_SOC_INJ4 0.000000 1.000000 BYTE_ORDER MSB_FIRST /end CHARACTERISTIC
/begin RECORD_LAYOUT RL_IJTC_O_SOC_INJ4 FNC_VALUES 1 UBYTE COLUMN_DIR DIRECT /end RECORD_LAYOUT
/begin COMPU_METHOD CU_IJTC_O_SOC_INJ4 "Conversion method for IJTc_o_SOC_Inj4" RAT_FUNC "%10.0" "o" COEFFS 0.000000 1.000000 0.000000 0.000000 0.000000 1.000000 /end COMPU_METHOD
/* Scalar calibration for DDE 'IJTc_pct_Inj1_Balancing'. */
/begin CHARACTERISTIC IJTc_pct_Inj1_Balancing "Injector-specific fuel volume compensation factor" VALUE 0x8a904 RL_IJTC_PCT_INJ1_BALANCING 2.000000 CU_IJTC_PCT_INJ1_BALANCING 0.000000 2.000000 BYTE_ORDER MSB_FIRST /end CHARACTERISTIC
/begin RECORD_LAYOUT RL_IJTC_PCT_INJ1_BALANCING FNC_VALUES 1 FLOAT32_IEEE COLUMN_DIR DIRECT /end RECORD_LAYOUT
/begin COMPU_METHOD CU_IJTC_PCT_INJ1_BALANCING "Conversion method for IJTc_pct_Inj1_Balancing" RAT_FUNC "%10.2" "pct" COEFFS 0.000000 1.000000 0.000000 0.000000 0.000000 1.000000 /end COMPU_METHOD
/* Scalar calibration for DDE 'IJTc_pct_Inj2_Balancing'. */
/begin CHARACTERISTIC IJTc_pct_Inj2_Balancing "Injector-specific fuel volume compensation factor" VALUE 0x8a908 RL_IJTC_PCT_INJ2_BALANCING 2.000000 CU_IJTC_PCT_INJ2_BALANCING 0.000000 2.000000 BYTE_ORDER MSB_FIRST /end CHARACTERISTIC
/begin RECORD_LAYOUT RL_IJTC_PCT_INJ2_BALANCING FNC_VALUES 1 FLOAT32_IEEE COLUMN_DIR DIRECT /end RECORD_LAYOUT
/begin COMPU_METHOD CU_IJTC_PCT_INJ2_BALANCING "Conversion method for IJTc_pct_Inj2_Balancing" RAT_FUNC "%10.2" "pct" COEFFS 0.000000 1.000000 0.000000 0.000000 0.000000 1.000000 /end COMPU_METHOD
/* Scalar calibration for DDE 'IJTc_pct_Inj3_Balancing'. */
/begin CHARACTERISTIC IJTc_pct_Inj3_Balancing "Injector-specific fuel volume compensation factor" VALUE 0x8a90c RL_IJTC_PCT_INJ3_BALANCING 2.000000 CU_IJTC_PCT_INJ3_BALANCING 0.000000 2.000000 BYTE_ORDER MSB_FIRST /end CHARACTERISTIC
/begin RECORD_LAYOUT RL_IJTC_PCT_INJ3_BALANCING FNC_VALUES 1 FLOAT32_IEEE COLUMN_DIR DIRECT /end RECORD_LAYOUT
/begin COMPU_METHOD CU_IJTC_PCT_INJ3_BALANCING "Conversion method for IJTc_pct_Inj3_Balancing" RAT_FUNC "%10.2" "pct" COEFFS 0.000000 1.000000 0.000000 0.000000 0.000000 1.000000 /end COMPU_METHOD
/* Scalar calibration for DDE 'IJTc_pct_Inj4_Balancing'. */
/begin CHARACTERISTIC IJTc_pct_Inj4_Balancing "Injector-specific fuel volume compensation factor" VALUE 0x8a910 RL_IJTC_PCT_INJ4_BALANCING 2.000000 CU_IJTC_PCT_INJ4_BALANCING 0.000000 2.000000 BYTE_ORDER MSB_FIRST /end CHARACTERISTIC
/begin RECORD_LAYOUT RL_IJTC_PCT_INJ4_BALANCING FNC_VALUES 1 FLOAT32_IEEE COLUMN_DIR DIRECT /end RECORD_LAYOUT
/begin COMPU_METHOD CU_IJTC_PCT_INJ4_BALANCING "Conversion method for IJTc_pct_Inj4_Balancing" RAT_FUNC "%10.2" "pct" COEFFS 0.000000 1.000000 0.000000 0.000000 0.000000 1.000000 /end COMPU_METHOD
/* Scalar calibration for DDE 'IJTc_s_MinCalculationSlack'. */
/begin CHARACTERISTIC IJTc_s_MinCalculationSlack "If the slack falls below this threshold InjectionSent will become constantly set" VALUE 0x8a70c RL_IJTC_S_MINCALCULATIONSLACK 0.020000 CU_IJTC_S_MINCALCULATIONSLACK 0.000000 0.020000 BYTE_ORDER MSB_FIRST /end CHARACTERISTIC
/begin RECORD_LAYOUT RL_IJTC_S_MINCALCULATIONSLACK FNC_VALUES 1 FLOAT32_IEEE COLUMN_DIR DIRECT /end RECORD_LAYOUT
/begin COMPU_METHOD CU_IJTC_S_MINCALCULATIONSLACK "Conversion method for IJTc_s_MinCalculationSlack" RAT_FUNC "%10.4" "s" COEFFS 0.000000 1.000000 0.000000 0.000000 0.000000 1.000000 /end COMPU_METHOD
/* Scalar calibration for DDE 'IJTc_s_PrimingPulseTimeout'. */
/begin CHARACTERISTIC IJTc_s_PrimingPulseTimeout "Force priming pulse to stop if it is still running after this duration" VALUE 0x8a8cc RL_IJTC_S_PRIMINGPULSETIMEOUT 5.000000 CU_IJTC_S_PRIMINGPULSETIMEOUT 0.000000 5.000000 BYTE_ORDER MSB_FIRST /end CHARACTERISTIC
/begin RECORD_LAYOUT RL_IJTC_S_PRIMINGPULSETIMEOUT FNC_VALUES 1 FLOAT32_IEEE COLUMN_DIR DIRECT /end RECORD_LAYOUT
/begin COMPU_METHOD CU_IJTC_S_PRIMINGPULSETIMEOUT "Conversion method for IJTc_s_PrimingPulseTimeout" RAT_FUNC "%10.2" "s" COEFFS 0.000000 1.000000 0.000000 0.000000 0.000000 1.000000 /end COMPU_METHOD
/* Map (2d) calibration for DDE 'IJTm_NU_CrankingSOI_Pulse1_z'. */
/begin CHARACTERISTIC IJTm_NU_CrankingSOI_Pulse1_z "SOI map data for crank pulse 1" MAP 0x8a1a8 RL_IJTM_NU_CRANKINGSOI_PULSE1_Z 1440.000000 CU_IJTM_NU_CRANKINGSOI_PULSE1_Z -720.000000 720.000000
 /begin AXIS_DESCR COM_AXIS NO_INPUT_QUANTITY CU_IJTM_NU_CRANKINGSOI_PULSE1_X 5 0.000000 10000.000000 AXIS_PTS_REF APD_IJTM_NU_CRANKINGSOI_PULSE11 /end AXIS_DESCR
 /begin AXIS_DESCR COM_AXIS NO_INPUT_QUANTITY CU_IJTM_NU_CRANKINGSOI_PULSE1_Y 5 -50.000000 200.000000 AXIS_PTS_REF APD_IJTM_NU_CRANKINGSOI_PULSE10 /end AXIS_DESCR
 BYTE_ORDER MSB_FIRST /end CHARACTERISTIC
/begin RECORD_LAYOUT RL_IJTM_NU_CRANKINGSOI_PULSE1_Z FNC_VALUES 1 FLOAT32_IEEE COLUMN_DIR DIRECT /end RECORD_LAYOUT
/begin COMPU_METHOD CU_IJTM_NU_CRANKINGSOI_PULSE1_Z "Conversion method for IJTm_NU_CrankingSOI_Pulse1_z" RAT_FUNC "%10.0" "adv" COEFFS 0.000000 1.000000 0.000000 0.000000 0.000000 1.000000 /end COMPU_METHOD
/begin AXIS_PTS APD_IJTM_NU_CRANKINGSOI_PULSE11 "SOI map for crank pulse 1 engine speed axis" 0x8a180 NO_INPUT_QUANTITY RL_IJTM_NU_CRANKINGSOI_PULSE1_X 10000.000000 CU_IJTM_NU_CRANKINGSOI_PULSE1_X 5 0.0 10000.0 BYTE_ORDER MSB_FIRST /end AXIS_PTS
/begin RECORD_LAYOUT RL_IJTM_NU_CRANKINGSOI_PULSE1_X AXIS_PTS_X 1 FLOAT32_IEEE INDEX_INCR DIRECT /end RECORD_LAYOUT
/begin COMPU_METHOD CU_IJTM_NU_CRANKINGSOI_PULSE1_X "Conversion method for IJTm_NU_CrankingSOI_Pulse1_x" RAT_FUNC "%10.0" "RPM" COEFFS 0.000000 1.000000 0.000000 0.000000 0.000000 1.000000 /end COMPU_METHOD
/begin AXIS_PTS APD_IJTM_NU_CRANKINGSOI_PULSE10 "SOI map for crank pulse 1 ECT axis" 0x8a194 NO_INPUT_QUANTITY RL_IJTM_NU_CRANKINGSOI_PULSE1_Y 250.000000 CU_IJTM_NU_CRANKINGSOI_PULSE1_Y 5 -50.0 200.0 BYTE_ORDER MSB_FIRST /end AXIS_PTS
/begin RECORD_LAYOUT RL_IJTM_NU_CRANKINGSOI_PULSE1_Y AXIS_PTS_X 1 FLOAT32_IEEE INDEX_INCR DIRECT /end RECORD_LAYOUT
/begin COMPU_METHOD CU_IJTM_NU_CRANKINGSOI_PULSE1_Y "Conversion method for IJTm_NU_CrankingSOI_Pulse1_y" RAT_FUNC "%10.0" "C" COEFFS 0.000000 1.000000 0.000000 0.000000 0.000000 1.000000 /end COMPU_METHOD
/* Map (2d) calibration for DDE 'IJTm_NU_FuelFlowOffset_z'. */
/begin CHARACTERISTIC IJTm_NU_FuelFlowOffset_z "Fuel flow offset (pct) acts as a gain to change the injector flow time (ms)" MAP 0x8ac00 RL_IJTM_NU_FUELFLOWOFFSET_Z 2.000000 CU_IJTM_NU_FUELFLOWOFFSET_Z -1.000000 1.000000
 /begin AXIS_DESCR COM_AXIS NO_INPUT_QUANTITY CU_IJTM_NU_FUELFLOWOFFSET_X 9 0.000000 8000.000000 AXIS_PTS_REF APD_IJTM_NU_FUELFLOWOFFSET_X /end AXIS_DESCR
 /begin AXIS_DESCR COM_AXIS NO_INPUT_QUANTITY CU_IJTM_NU_FUELFLOWOFFSET_Y 9 0.000000 500.000000 AXIS_PTS_REF APD_IJTM_NU_FUELFLOWOFFSET_Y /end AXIS_DESCR
 BYTE_ORDER MSB_FIRST /end CHARACTERISTIC
/begin RECORD_LAYOUT RL_IJTM_NU_FUELFLOWOFFSET_Z FNC_VALUES 1 FLOAT32_IEEE COLUMN_DIR DIRECT /end RECORD_LAYOUT
/begin COMPU_METHOD CU_IJTM_NU_FUELFLOWOFFSET_Z "Conversion method for IJTm_NU_FuelFlowOffset_z" RAT_FUNC "%10.3" "pct" COEFFS 0.000000 1.000000 0.000000 0.000000 0.000000 1.000000 /end COMPU_METHOD
/begin AXIS_PTS APD_IJTM_NU_FUELFLOWOFFSET_X "Engine Speed (RPM) x-axis for Fuel offset lookup table" 0x8abb8 NO_INPUT_QUANTITY RL_IJTM_NU_FUELFLOWOFFSET_X 8000.000000 CU_IJTM_NU_FUELFLOWOFFSET_X 9 0.0 8000.0 BYTE_ORDER MSB_FIRST /end AXIS_PTS
/begin RECORD_LAYOUT RL_IJTM_NU_FUELFLOWOFFSET_X AXIS_PTS_X 1 FLOAT32_IEEE INDEX_INCR DIRECT /end RECORD_LAYOUT
/begin COMPU_METHOD CU_IJTM_NU_FUELFLOWOFFSET_X "Conversion method for IJTm_NU_FuelFlowOffset_x" RAT_FUNC "%10.2" "RPM" COEFFS 0.000000 1.000000 0.000000 0.000000 0.000000 1.000000 /end COMPU_METHOD
/begin AXIS_PTS APD_IJTM_NU_FUELFLOWOFFSET_Y "Requested fuel (mg) y-axis for Fuel offset table" 0x8abdc NO_INPUT_QUANTITY RL_IJTM_NU_FUELFLOWOFFSET_Y 500.000000 CU_IJTM_NU_FUELFLOWOFFSET_Y 9 0.0 500.0 BYTE_ORDER MSB_FIRST /end AXIS_PTS
/begin RECORD_LAYOUT RL_IJTM_NU_FUELFLOWOFFSET_Y AXIS_PTS_X 1 FLOAT32_IEEE INDEX_INCR DIRECT /end RECORD_LAYOUT
/begin COMPU_METHOD CU_IJTM_NU_FUELFLOWOFFSET_Y "Conversion method for IJTm_NU_FuelFlowOffset_y" RAT_FUNC "%10.3" "mg" COEFFS 0.000000 1.000000 0.000000 0.000000 0.000000 1.000000 /end COMPU_METHOD
/* Map (1d) calibration for DDE 'IJTm_NU_FuelTempCF_z'. */
/begin CHARACTERISTIC IJTm_NU_FuelTempCF_z "Injection quantity fuel rail temperature compensation map data" CURVE 0x8a8ec RL_IJTM_NU_FUELTEMPCF_Z 2.000000 CU_IJTM_NU_FUELTEMPCF_Z 0.000000 2.000000
 /begin AXIS_DESCR COM_AXIS NO_INPUT_QUANTITY CU_IJTM_NU_FUELTEMPCF_X 6 -50.000000 200.000000 AXIS_PTS_REF APD_IJTM_NU_FUELTEMPCF_X /end AXIS_DESCR
 BYTE_ORDER MSB_FIRST /end CHARACTERISTIC
/begin RECORD_LAYOUT RL_IJTM_NU_FUELTEMPCF_Z FNC_VALUES 1 FLOAT32_IEEE COLUMN_DIR DIRECT /end RECORD_LAYOUT
/begin COMPU_METHOD CU_IJTM_NU_FUELTEMPCF_Z "Conversion method for IJTm_NU_FuelTempCF_z" RAT_FUNC "%10.2" "pct" COEFFS 0.000000 1.000000 0.000000 0.000000 0.000000 1.000000 /end COMPU_METHOD
/begin AXIS_PTS APD_IJTM_NU_FUELTEMPCF_X "Injection quantity fuel rail temperature compensation map temp axis" 0x8a8d4 NO_INPUT_QUANTITY RL_IJTM_NU_FUELTEMPCF_X 250.000000 CU_IJTM_NU_FUELTEMPCF_X 6 -50.0 200.0 BYTE_ORDER MSB_FIRST /end AXIS_PTS
/begin RECORD_LAYOUT RL_IJTM_NU_FUELTEMPCF_X AXIS_PTS_X 1 FLOAT32_IEEE INDEX_INCR DIRECT /end RECORD_LAYOUT
/begin COMPU_METHOD CU_IJTM_NU_FUELTEMPCF_X "Conversion method for IJTm_NU_FuelTempCF_x" RAT_FUNC "%10.0" "C" COEFFS 0.000000 1.000000 0.000000 0.000000 0.000000 1.000000 /end COMPU_METHOD
/* Map (2d) calibration for DDE 'IJTm_NU_InjectorFlowMapCmp_z'. */
/begin CHARACTERISTIC IJTm_NU_InjectorFlowMapCmp_z "Compressed Injector flow map data. Note that opening delay is captured separately (this is flow-time ms)" MAP 0x8d33c RL_IJTM_NU_INJECTORFLOWMAPCMP_Z 50.000000 CU_IJTM_NU_INJECTORFLOWMAPCMP_Z 0.000000 50.000000
 /begin AXIS_DESCR COM_AXIS NO_INPUT_QUANTITY CU_IJTM_NU_INJECTORFLOWMAPCMP_X 10 0.000000 150.000000 AXIS_PTS_REF APD_IJTM_NU_INJECTORFLOWMAPCMP1 /end AXIS_DESCR
 /begin AXIS_DESCR COM_AXIS NO_INPUT_QUANTITY CU_IJTM_NU_INJECTORFLOWMAPCMP_Y 10 0.000000 10000.000000 AXIS_PTS_REF APD_IJTM_NU_INJECTORFLOWMAPCMP0 /end AXIS_DESCR
 BYTE_ORDER MSB_FIRST /end CHARACTERISTIC
/begin RECORD_LAYOUT RL_IJTM_NU_INJECTORFLOWMAPCMP_Z FNC_VALUES 1 FLOAT32_IEEE COLUMN_DIR DIRECT /end RECORD_LAYOUT
/begin COMPU_METHOD CU_IJTM_NU_INJECTORFLOWMAPCMP_Z "Conversion method for IJTm_NU_InjectorFlowMapCmp_z" RAT_FUNC "%10.2" "ms" COEFFS 0.000000 1.000000 0.000000 0.000000 0.000000 1.000000 /end COMPU_METHOD
/begin AXIS_PTS APD_IJTM_NU_INJECTORFLOWMAPCMP1 "Compressed Injector flow map volume axis" 0x8d2ec NO_INPUT_QUANTITY RL_IJTM_NU_INJECTORFLOWMAPCMP_X 150.000000 CU_IJTM_NU_INJECTORFLOWMAPCMP_X 10 0.0 150.0 BYTE_ORDER MSB_FIRST /end AXIS_PTS
/begin RECORD_LAYOUT RL_IJTM_NU_INJECTORFLOWMAPCMP_X AXIS_PTS_X 1 FLOAT32_IEEE INDEX_INCR DIRECT /end RECORD_LAYOUT
/begin COMPU_METHOD CU_IJTM_NU_INJECTORFLOWMAPCMP_X "Conversion method for IJTm_NU_InjectorFlowMapCmp_x" RAT_FUNC "%10.3" "mm3" COEFFS 0.000000 1.000000 0.000000 0.000000 0.000000 1.000000 /end COMPU_METHOD
/begin AXIS_PTS APD_IJTM_NU_INJECTORFLOWMAPCMP0 "Compressed Injector flow map FRP axis (MPa for compatibility w/ TPU volume-mode injection)" 0x8d314 NO_INPUT_QUANTITY RL_IJTM_NU_INJECTORFLOWMAPCMP_Y 10000.000000 CU_IJTM_NU_INJECTORFLOWMAPCMP_Y 10 0.0 10000.0 BYTE_ORDER MSB_FIRST /end AXIS_PTS
/begin RECORD_LAYOUT RL_IJTM_NU_INJECTORFLOWMAPCMP_Y AXIS_PTS_X 1 FLOAT32_IEEE INDEX_INCR DIRECT /end RECORD_LAYOUT
/begin COMPU_METHOD CU_IJTM_NU_INJECTORFLOWMAPCMP_Y "Conversion method for IJTm_NU_InjectorFlowMapCmp_y" RAT_FUNC "%10.0" "MPa" COEFFS 0.000000 1.000000 0.000000 0.000000 0.000000 1.000000 /end COMPU_METHOD
/* Map (2d) calibration for DDE 'IJTm_NU_InjectorFlowMapPFI_z'. */
/begin CHARACTERISTIC IJTm_NU_InjectorFlowMapPFI_z "PFI Injector flow map" MAP 0x8a988 RL_IJTM_NU_INJECTORFLOWMAPPFI_Z 100.000000 CU_IJTM_NU_INJECTORFLOWMAPPFI_Z 0.000000 100.000000
 /begin AXIS_DESCR COM_AXIS NO_INPUT_QUANTITY CU_IJTM_NU_INJECTORFLOWMAPPFI_X 20 0.000000 200.000000 AXIS_PTS_REF APD_IJTM_NU_INJECTORFLOWMAPPFI1 /end AXIS_DESCR
 /begin AXIS_DESCR COM_AXIS NO_INPUT_QUANTITY CU_IJTM_NU_INJECTORFLOWMAPPFI_Y 7 -20.000000 100.000000 AXIS_PTS_REF APD_IJTM_NU_INJECTORFLOWMAPPFI0 /end AXIS_DESCR
 BYTE_ORDER MSB_FIRST /end CHARACTERISTIC
/begin RECORD_LAYOUT RL_IJTM_NU_INJECTORFLOWMAPPFI_Z FNC_VALUES 1 FLOAT32_IEEE COLUMN_DIR DIRECT /end RECORD_LAYOUT
/begin COMPU_METHOD CU_IJTM_NU_INJECTORFLOWMAPPFI_Z "Conversion method for IJTm_NU_InjectorFlowMapPFI_z" RAT_FUNC "%10.4" "gps" COEFFS 0.000000 1.000000 0.000000 0.000000 0.000000 1.000000 /end COMPU_METHOD
/begin AXIS_PTS APD_IJTM_NU_INJECTORFLOWMAPPFI1 "PFI Injector flow map effective pressure (x-axis)" 0x8a91c NO_INPUT_QUANTITY RL_IJTM_NU_INJECTORFLOWMAPPFI_X 200.000000 CU_IJTM_NU_INJECTORFLOWMAPPFI_X 20 0.0 200.0 BYTE_ORDER MSB_FIRST /end AXIS_PTS
/begin RECORD_LAYOUT RL_IJTM_NU_INJECTORFLOWMAPPFI_X AXIS_PTS_X 1 FLOAT32_IEEE INDEX_INCR DIRECT /end RECORD_LAYOUT
/begin COMPU_METHOD CU_IJTM_NU_INJECTORFLOWMAPPFI_X "Conversion method for IJTm_NU_InjectorFlowMapPFI_x" RAT_FUNC "%10.1" "bar" COEFFS 0.000000 1.000000 0.000000 0.000000 0.000000 1.000000 /end COMPU_METHOD
/begin AXIS_PTS APD_IJTM_NU_INJECTORFLOWMAPPFI0 "GLP Temperature" 0x8a96c NO_INPUT_QUANTITY RL_IJTM_NU_INJECTORFLOWMAPPFI_Y 120.000000 CU_IJTM_NU_INJECTORFLOWMAPPFI_Y 7 -20.0 100.0 BYTE_ORDER MSB_FIRST /end AXIS_PTS
/begin RECORD_LAYOUT RL_IJTM_NU_INJECTORFLOWMAPPFI_Y AXIS_PTS_X 1 FLOAT32_IEEE INDEX_INCR DIRECT /end RECORD_LAYOUT
/begin COMPU_METHOD CU_IJTM_NU_INJECTORFLOWMAPPFI_Y "Conversion method for IJTm_NU_InjectorFlowMapPFI_y" RAT_FUNC "%10.0" "C" COEFFS 0.000000 1.000000 0.000000 0.000000 0.000000 1.000000 /end COMPU_METHOD
/* Map (1d) calibration for DDE 'IJTm_NU_OpeningDelayPFI_z'. */
/begin CHARACTERISTIC IJTm_NU_OpeningDelayPFI_z "Displayable" CURVE 0x8a6b8 RL_IJTM_NU_OPENINGDELAYPFI_Z 3.000000 CU_IJTM_NU_OPENINGDELAYPFI_Z 0.000000 3.000000
 /begin AXIS_DESCR COM_AXIS NO_INPUT_QUANTITY CU_IJTM_NU_OPENINGDELAYPFI_X 11 6.000000 30.000000 AXIS_PTS_REF APD_IJTM_NU_OPENINGDELAYPFI_X /end AXIS_DESCR
 BYTE_ORDER MSB_FIRST /end CHARACTERISTIC
/begin RECORD_LAYOUT RL_IJTM_NU_OPENINGDELAYPFI_Z FNC_VALUES 1 FLOAT32_IEEE COLUMN_DIR DIRECT /end RECORD_LAYOUT
/begin COMPU_METHOD CU_IJTM_NU_OPENINGDELAYPFI_Z "Conversion method for IJTm_NU_OpeningDelayPFI_z" RAT_FUNC "%10.3" "ms" COEFFS 0.000000 1.000000 0.000000 0.000000 0.000000 1.000000 /end COMPU_METHOD
/begin AXIS_PTS APD_IJTM_NU_OPENINGDELAYPFI_X "Displayable" 0x8a68c NO_INPUT_QUANTITY RL_IJTM_NU_OPENINGDELAYPFI_X 24.000000 CU_IJTM_NU_OPENINGDELAYPFI_X 11 6.0 30.0 BYTE_ORDER MSB_FIRST /end AXIS_PTS
/begin RECORD_LAYOUT RL_IJTM_NU_OPENINGDELAYPFI_X AXIS_PTS_X 1 FLOAT32_IEEE INDEX_INCR DIRECT /end RECORD_LAYOUT
/begin COMPU_METHOD CU_IJTM_NU_OPENINGDELAYPFI_X "Conversion method for IJTm_NU_OpeningDelayPFI_x" RAT_FUNC "%10.1" "V" COEFFS 0.000000 1.000000 0.000000 0.000000 0.000000 1.000000 /end COMPU_METHOD
/* Map (2d) calibration for DDE 'IJTm_NU_RunningSOI_Pulse1_z'. */
/begin CHARACTERISTIC IJTm_NU_RunningSOI_Pulse1_z "SOI map data for Run pulse 1" MAP 0x8a28c RL_IJTM_NU_RUNNINGSOI_PULSE1_Z 1440.000000 CU_IJTM_NU_RUNNINGSOI_PULSE1_Z -720.000000 720.000000
 /begin AXIS_DESCR COM_AXIS NO_INPUT_QUANTITY CU_IJTM_NU_RUNNINGSOI_PULSE1_X 16 0.000000 10000.000000 AXIS_PTS_REF APD_IJTM_NU_RUNNINGSOI_PULSE1_X /end AXIS_DESCR
 /begin AXIS_DESCR COM_AXIS NO_INPUT_QUANTITY CU_IJTM_NU_RUNNINGSOI_PULSE1_Y 16 0.000000 200.000000 AXIS_PTS_REF APD_IJTM_NU_RUNNINGSOI_PULSE1_Y /end AXIS_DESCR
 BYTE_ORDER MSB_FIRST /end CHARACTERISTIC
/begin RECORD_LAYOUT RL_IJTM_NU_RUNNINGSOI_PULSE1_Z FNC_VALUES 1 FLOAT32_IEEE COLUMN_DIR DIRECT /end RECORD_LAYOUT
/begin COMPU_METHOD CU_IJTM_NU_RUNNINGSOI_PULSE1_Z "Conversion method for IJTm_NU_RunningSOI_Pulse1_z" RAT_FUNC "%10.0" "adv" COEFFS 0.000000 1.000000 0.000000 0.000000 0.000000 1.000000 /end COMPU_METHOD
/begin AXIS_PTS APD_IJTM_NU_RUNNINGSOI_PULSE1_X "SOI map for Run pulse 1 engine speed axis" 0x8a20c NO_INPUT_QUANTITY RL_IJTM_NU_RUNNINGSOI_PULSE1_X 10000.000000 CU_IJTM_NU_RUNNINGSOI_PULSE1_X 16 0.0 10000.0 BYTE_ORDER MSB_FIRST /end AXIS_PTS
/begin RECORD_LAYOUT RL_IJTM_NU_RUNNINGSOI_PULSE1_X AXIS_PTS_X 1 FLOAT32_IEEE INDEX_INCR DIRECT /end RECORD_LAYOUT
/begin COMPU_METHOD CU_IJTM_NU_RUNNINGSOI_PULSE1_X "Conversion method for IJTm_NU_RunningSOI_Pulse1_x" RAT_FUNC "%10.0" "RPM" COEFFS 0.000000 1.000000 0.000000 0.000000 0.000000 1.000000 /end COMPU_METHOD
/begin AXIS_PTS APD_IJTM_NU_RUNNINGSOI_PULSE1_Y "SOI map for Run pulse 1 torque demand axis" 0x8a24c NO_INPUT_QUANTITY RL_IJTM_NU_RUNNINGSOI_PULSE1_Y 200.000000 CU_IJTM_NU_RUNNINGSOI_PULSE1_Y 16 0.0 200.0 BYTE_ORDER MSB_FIRST /end AXIS_PTS
/begin RECORD_LAYOUT RL_IJTM_NU_RUNNINGSOI_PULSE1_Y AXIS_PTS_X 1 FLOAT32_IEEE INDEX_INCR DIRECT /end RECORD_LAYOUT
/begin COMPU_METHOD CU_IJTM_NU_RUNNINGSOI_PULSE1_Y "Conversion method for IJTm_NU_RunningSOI_Pulse1_y" RAT_FUNC "%10.1" "Nm" COEFFS 0.000000 1.000000 0.000000 0.000000 0.000000 1.000000 /end COMPU_METHOD
/* Scalar calibration for DDE 'INPc_C_AmbientTemp'. */
/begin CHARACTERISTIC INPc_C_AmbientTemp "Override value" VALUE 0x8cd9c RL_INPC_C_AMBIENTTEMP 100.000000 CU_INPC_C_AMBIENTTEMP -40.000000 60.000000 BYTE_ORDER MSB_FIRST /end CHARACTERISTIC
/begin RECORD_LAYOUT RL_INPC_C_AMBIENTTEMP FNC_VALUES 1 FLOAT32_IEEE COLUMN_DIR DIRECT /end RECORD_LAYOUT
/begin COMPU_METHOD CU_INPC_C_AMBIENTTEMP "Conversion method for INPc_C_AmbientTemp" RAT_FUNC "%10.2" "C" COEFFS 0.000000 1.000000 0.000000 0.000000 0.000000 1.000000 /end COMPU_METHOD
/* Scalar calibration for DDE 'INPc_C_CompOutTemp'. */
/begin CHARACTERISTIC INPc_C_CompOutTemp "Override value" VALUE 0x8cdbc RL_INPC_C_COMPOUTTEMP 190.000000 CU_INPC_C_COMPOUTTEMP -40.000000 150.000000 BYTE_ORDER MSB_FIRST /end CHARACTERISTIC
/begin RECORD_LAYOUT RL_INPC_C_COMPOUTTEMP FNC_VALUES 1 FLOAT32_IEEE COLUMN_DIR DIRECT /end RECORD_LAYOUT
/begin COMPU_METHOD CU_INPC_C_COMPOUTTEMP "Conversion method for INPc_C_CompOutTemp" RAT_FUNC "%10.2" "C" COEFFS 0.000000 1.000000 0.000000 0.000000 0.000000 1.000000 /end COMPU_METHOD
/* Scalar calibration for DDE 'INPc_C_CoolantTemp'. */
/begin CHARACTERISTIC INPc_C_CoolantTemp "Override value" VALUE 0x8ce40 RL_INPC_C_COOLANTTEMP 145.000000 CU_INPC_C_COOLANTTEMP -40.000000 105.000000 BYTE_ORDER MSB_FIRST /end CHARACTERISTIC
/begin RECORD_LAYOUT RL_INPC_C_COOLANTTEMP FNC_VALUES 1 FLOAT32_IEEE COLUMN_DIR DIRECT /end RECORD_LAYOUT
/begin COMPU_METHOD CU_INPC_C_COOLANTTEMP "Conversion method for INPc_C_CoolantTemp" RAT_FUNC "%10.0" "C" COEFFS 0.000000 1.000000 0.000000 0.000000 0.000000 1.000000 /end COMPU_METHOD
/* Scalar calibration for DDE 'INPc_C_ExhaustTemp'. */
/begin CHARACTERISTIC INPc_C_ExhaustTemp "Override" VALUE 0x8cdc4 RL_INPC_C_EXHAUSTTEMP 1040.000000 CU_INPC_C_EXHAUSTTEMP -40.000000 1000.000000 BYTE_ORDER MSB_FIRST /end CHARACTERISTIC
/begin RECORD_LAYOUT RL_INPC_C_EXHAUSTTEMP FNC_VALUES 1 FLOAT32_IEEE COLUMN_DIR DIRECT /end RECORD_LAYOUT
/begin COMPU_METHOD CU_INPC_C_EXHAUSTTEMP "Conversion method for INPc_C_ExhaustTemp" RAT_FUNC "%10.1" "C" COEFFS 0.000000 1.000000 0.000000 0.000000 0.000000 1.000000 /end COMPU_METHOD
/* Scalar calibration for DDE 'INPc_C_FuelTemp'. */
/begin CHARACTERISTIC INPc_C_FuelTemp "Override value" VALUE 0x8ce28 RL_INPC_C_FUELTEMP 145.000000 CU_INPC_C_FUELTEMP -40.000000 105.000000 BYTE_ORDER MSB_FIRST /end CHARACTERISTIC
/begin RECORD_LAYOUT RL_INPC_C_FUELTEMP FNC_VALUES 1 FLOAT32_IEEE COLUMN_DIR DIRECT /end RECORD_LAYOUT
/begin COMPU_METHOD CU_INPC_C_FUELTEMP "Conversion method for INPc_C_FuelTemp" RAT_FUNC "%10.0" "C" COEFFS 0.000000 1.000000 0.000000 0.000000 0.000000 1.000000 /end COMPU_METHOD
/* Scalar calibration for DDE 'INPc_C_ManifoldTemp'. */
/begin CHARACTERISTIC INPc_C_ManifoldTemp "Override value" VALUE 0x8ce38 RL_INPC_C_MANIFOLDTEMP 145.000000 CU_INPC_C_MANIFOLDTEMP -40.000000 105.000000 BYTE_ORDER MSB_FIRST /end CHARACTERISTIC
/begin RECORD_LAYOUT RL_INPC_C_MANIFOLDTEMP FNC_VALUES 1 FLOAT32_IEEE COLUMN_DIR DIRECT /end RECORD_LAYOUT
/begin COMPU_METHOD CU_INPC_C_MANIFOLDTEMP "Conversion method for INPc_C_ManifoldTemp" RAT_FUNC "%10.2" "C" COEFFS 0.000000 1.000000 0.000000 0.000000 0.000000 1.000000 /end COMPU_METHOD
/* Scalar calibration for DDE 'INPc_C_OilTemp'. */
/begin CHARACTERISTIC INPc_C_OilTemp "Override value" VALUE 0x8cde8 RL_INPC_C_OILTEMP 190.000000 CU_INPC_C_OILTEMP -40.000000 150.000000 BYTE_ORDER MSB_FIRST /end CHARACTERISTIC
/begin RECORD_LAYOUT RL_INPC_C_OILTEMP FNC_VALUES 1 FLOAT32_IEEE COLUMN_DIR DIRECT /end RECORD_LAYOUT
/begin COMPU_METHOD CU_INPC_C_OILTEMP "Conversion method for INPc_C_OilTemp" RAT_FUNC "%10.2" "C" COEFFS 0.000000 1.000000 0.000000 0.000000 0.000000 1.000000 /end COMPU_METHOD
/* Scalar calibration for DDE 'INPc_Hz_UaFiltConst'. */
/begin CHARACTERISTIC INPc_Hz_UaFiltConst "low pass filter constant for AIN_Ua" VALUE 0x8d78c RL_INPC_HZ_UAFILTCONST 100.000000 CU_INPC_HZ_UAFILTCONST 0.000000 100.000000 BYTE_ORDER MSB_FIRST /end CHARACTERISTIC
/begin RECORD_LAYOUT RL_INPC_HZ_UAFILTCONST FNC_VALUES 1 FLOAT32_IEEE COLUMN_DIR DIRECT /end RECORD_LAYOUT
/begin COMPU_METHOD CU_INPC_HZ_UAFILTCONST "Conversion method for INPc_Hz_UaFiltConst" RAT_FUNC "%10.2" "Hz" COEFFS 0.000000 1.000000 0.000000 0.000000 0.000000 1.000000 /end COMPU_METHOD
/* Scalar calibration for DDE 'INPc_Hz_UrFiltConst'. */
/begin CHARACTERISTIC INPc_Hz_UrFiltConst "low pass filter constant for AIN_Ur" VALUE 0x8d788 RL_INPC_HZ_URFILTCONST 100.000000 CU_INPC_HZ_URFILTCONST 0.000000 100.000000 BYTE_ORDER MSB_FIRST /end CHARACTERISTIC
/begin RECORD_LAYOUT RL_INPC_HZ_URFILTCONST FNC_VALUES 1 FLOAT32_IEEE COLUMN_DIR DIRECT /end RECORD_LAYOUT
/begin COMPU_METHOD CU_INPC_HZ_URFILTCONST "Conversion method for INPc_Hz_UrFiltConst" RAT_FUNC "%10.2" "Hz" COEFFS 0.000000 1.000000 0.000000 0.000000 0.000000 1.000000 /end COMPU_METHOD
/* Scalar calibration for DDE 'INPc_L_TotalFuelLevel_L'. */
/begin CHARACTERISTIC INPc_L_TotalFuelLevel_L "Override value" VALUE 0x8c1ac RL_INPC_L_TOTALFUELLEVEL_L 150.000000 CU_INPC_L_TOTALFUELLEVEL_L 0.000000 150.000000 BYTE_ORDER MSB_FIRST /end CHARACTERISTIC
/begin RECORD_LAYOUT RL_INPC_L_TOTALFUELLEVEL_L FNC_VALUES 1 FLOAT32_IEEE COLUMN_DIR DIRECT /end RECORD_LAYOUT
/begin COMPU_METHOD CU_INPC_L_TOTALFUELLEVEL_L "Conversion method for INPc_L_TotalFuelLevel_L" RAT_FUNC "%10.2" "L" COEFFS 0.000000 1.000000 0.000000 0.000000 0.000000 1.000000 /end COMPU_METHOD
/* Scalar calibration for DDE 'INPc_NU_APP1_Raw'. */
/begin CHARACTERISTIC INPc_NU_APP1_Raw "Override value" VALUE 0x8cd54 RL_INPC_NU_APP1_RAW 5.000000 CU_INPC_NU_APP1_RAW 0.000000 5.000000 BYTE_ORDER MSB_FIRST /end CHARACTERISTIC
/begin RECORD_LAYOUT RL_INPC_NU_APP1_RAW FNC_VALUES 1 FLOAT32_IEEE COLUMN_DIR DIRECT /end RECORD_LAYOUT
/begin COMPU_METHOD CU_INPC_NU_APP1_RAW "Conversion method for INPc_NU_APP1_Raw" RAT_FUNC "%10.3" "NU" COEFFS 0.000000 1.000000 0.000000 0.000000 0.000000 1.000000 /end COMPU_METHOD
/* Scalar calibration for DDE 'INPc_NU_APP2_Raw'. */
/begin CHARACTERISTIC INPc_NU_APP2_Raw "Override value" VALUE 0x8cd5c RL_INPC_NU_APP2_RAW 5.000000 CU_INPC_NU_APP2_RAW 0.000000 5.000000 BYTE_ORDER MSB_FIRST /end CHARACTERISTIC
/begin RECORD_LAYOUT RL_INPC_NU_APP2_RAW FNC_VALUES 1 FLOAT32_IEEE COLUMN_DIR DIRECT /end RECORD_LAYOUT
/begin COMPU_METHOD CU_INPC_NU_APP2_RAW "Conversion method for INPc_NU_APP2_Raw" RAT_FUNC "%10.3" "NU" COEFFS 0.000000 1.000000 0.000000 0.000000 0.000000 1.000000 /end COMPU_METHOD
/* Scalar calibration for DDE 'INPc_NU_CrankSensorBias'. */
/begin CHARACTERISTIC INPc_NU_CrankSensorBias "Set to 1 for bias" VALUE 0x8bf84 RL_INPC_NU_CRANKSENSORBIAS 1.000000 CU_INPC_NU_CRANKSENSORBIAS 0.000000 1.000000 BYTE_ORDER MSB_FIRST /end CHARACTERISTIC
/begin RECORD_LAYOUT RL_INPC_NU_CRANKSENSORBIAS FNC_VALUES 1 UBYTE COLUMN_DIR DIRECT /end RECORD_LAYOUT
/begin COMPU_METHOD CU_INPC_NU_CRANKSENSORBIAS "Conversion method for INPc_NU_CrankSensorBias" RAT_FUNC "%10.0" "b" COEFFS 0.000000 1.000000 0.000000 0.000000 0.000000 1.000000 /end COMPU_METHOD
/* Scalar calibration for DDE 'INPc_NU_CrankSensorType'. */
/begin CHARACTERISTIC INPc_NU_CrankSensorType "Set to 1 for hall-effect" VALUE 0x8bf85 RL_INPC_NU_CRANKSENSORTYPE 1.000000 CU_INPC_NU_CRANKSENSORTYPE 0.000000 1.000000 BYTE_ORDER MSB_FIRST /end CHARACTERISTIC
/begin RECORD_LAYOUT RL_INPC_NU_CRANKSENSORTYPE FNC_VALUES 1 UBYTE COLUMN_DIR DIRECT /end RECORD_LAYOUT
/begin COMPU_METHOD CU_INPC_NU_CRANKSENSORTYPE "Conversion method for INPc_NU_CrankSensorType" RAT_FUNC "%10.0" "b" COEFFS 0.000000 1.000000 0.000000 0.000000 0.000000 1.000000 /end COMPU_METHOD
/* Scalar calibration for DDE 'INPc_NU_TP1_Raw'. */
/begin CHARACTERISTIC INPc_NU_TP1_Raw "Override value" VALUE 0x8ce48 RL_INPC_NU_TP1_RAW 90.000000 CU_INPC_NU_TP1_RAW 0.000000 90.000000 BYTE_ORDER MSB_FIRST /end CHARACTERISTIC
/begin RECORD_LAYOUT RL_INPC_NU_TP1_RAW FNC_VALUES 1 FLOAT32_IEEE COLUMN_DIR DIRECT /end RECORD_LAYOUT
/begin COMPU_METHOD CU_INPC_NU_TP1_RAW "Conversion method for INPc_NU_TP1_Raw" RAT_FUNC "%10.1" "NU" COEFFS 0.000000 1.000000 0.000000 0.000000 0.000000 1.000000 /end COMPU_METHOD
/* Scalar calibration for DDE 'INPc_NU_TP2_Raw'. */
/begin CHARACTERISTIC INPc_NU_TP2_Raw "Override value" VALUE 0x8cd64 RL_INPC_NU_TP2_RAW 90.000000 CU_INPC_NU_TP2_RAW 0.000000 90.000000 BYTE_ORDER MSB_FIRST /end CHARACTERISTIC
/begin RECORD_LAYOUT RL_INPC_NU_TP2_RAW FNC_VALUES 1 FLOAT32_IEEE COLUMN_DIR DIRECT /end RECORD_LAYOUT
/begin COMPU_METHOD CU_INPC_NU_TP2_RAW "Conversion method for INPc_NU_TP2_Raw" RAT_FUNC "%10.1" "NU" COEFFS 0.000000 1.000000 0.000000 0.000000 0.000000 1.000000 /end COMPU_METHOD
/* Scalar calibration for DDE 'INPc_RPM_EngSpd'. */
/begin CHARACTERISTIC INPc_RPM_EngSpd "Override value" VALUE 0x8cddc RL_INPC_RPM_ENGSPD 10000.000000 CU_INPC_RPM_ENGSPD 0.000000 10000.000000 BYTE_ORDER MSB_FIRST /end CHARACTERISTIC
/begin RECORD_LAYOUT RL_INPC_RPM_ENGSPD FNC_VALUES 1 FLOAT32_IEEE COLUMN_DIR DIRECT /end RECORD_LAYOUT
/begin COMPU_METHOD CU_INPC_RPM_ENGSPD "Conversion method for INPc_RPM_EngSpd" RAT_FUNC "%10.0" "RPM" COEFFS 0.000000 1.000000 0.000000 0.000000 0.000000 1.000000 /end COMPU_METHOD
/* Scalar calibration for DDE 'INPc_V_EGO11'. */
/begin CHARACTERISTIC INPc_V_EGO11 "Override value" VALUE 0x8cd44 RL_INPC_V_EGO11 5.000000 CU_INPC_V_EGO11 0.000000 5.000000 BYTE_ORDER MSB_FIRST /end CHARACTERISTIC
/begin RECORD_LAYOUT RL_INPC_V_EGO11 FNC_VALUES 1 FLOAT32_IEEE COLUMN_DIR DIRECT /end RECORD_LAYOUT
/begin COMPU_METHOD CU_INPC_V_EGO11 "Conversion method for INPc_V_EGO11" RAT_FUNC "%10.2" "V" COEFFS 0.000000 1.000000 0.000000 0.000000 0.000000 1.000000 /end COMPU_METHOD
/* Scalar calibration for DDE 'INPc_V_EGO21'. */
/begin CHARACTERISTIC INPc_V_EGO21 "Override value" VALUE 0x8cd84 RL_INPC_V_EGO21 5.000000 CU_INPC_V_EGO21 0.000000 5.000000 BYTE_ORDER MSB_FIRST /end CHARACTERISTIC
/begin RECORD_LAYOUT RL_INPC_V_EGO21 FNC_VALUES 1 FLOAT32_IEEE COLUMN_DIR DIRECT /end RECORD_LAYOUT
/begin COMPU_METHOD CU_INPC_V_EGO21 "Conversion method for INPc_V_EGO21" RAT_FUNC "%10.2" "V" COEFFS 0.000000 1.000000 0.000000 0.000000 0.000000 1.000000 /end COMPU_METHOD
/* Scalar calibration for DDE 'INPc_V_FuelLevel1'. */
/begin CHARACTERISTIC INPc_V_FuelLevel1 "Override value" VALUE 0x8c13c RL_INPC_V_FUELLEVEL1 10.000000 CU_INPC_V_FUELLEVEL1 0.000000 10.000000 BYTE_ORDER MSB_FIRST /end CHARACTERISTIC
/begin RECORD_LAYOUT RL_INPC_V_FUELLEVEL1 FNC_VALUES 1 FLOAT32_IEEE COLUMN_DIR DIRECT /end RECORD_LAYOUT
/begin COMPU_METHOD CU_INPC_V_FUELLEVEL1 "Conversion method for INPc_V_FuelLevel1" RAT_FUNC "%10.2" "V" COEFFS 0.000000 1.000000 0.000000 0.000000 0.000000 1.000000 /end COMPU_METHOD
/* Scalar calibration for DDE 'INPc_V_FuelLevel2'. */
/begin CHARACTERISTIC INPc_V_FuelLevel2 "Override value" VALUE 0x8c144 RL_INPC_V_FUELLEVEL2 10.000000 CU_INPC_V_FUELLEVEL2 0.000000 10.000000 BYTE_ORDER MSB_FIRST /end CHARACTERISTIC
/begin RECORD_LAYOUT RL_INPC_V_FUELLEVEL2 FNC_VALUES 1 FLOAT32_IEEE COLUMN_DIR DIRECT /end RECORD_LAYOUT
/begin COMPU_METHOD CU_INPC_V_FUELLEVEL2 "Conversion method for INPc_V_FuelLevel2" RAT_FUNC "%10.2" "V" COEFFS 0.000000 1.000000 0.000000 0.000000 0.000000 1.000000 /end COMPU_METHOD
/* Scalar calibration for DDE 'INPc_V_VBatt'. */
/begin CHARACTERISTIC INPc_V_VBatt "Override value" VALUE 0x8cd4c RL_INPC_V_VBATT 30.000000 CU_INPC_V_VBATT 0.000000 30.000000 BYTE_ORDER MSB_FIRST /end CHARACTERISTIC
/begin RECORD_LAYOUT RL_INPC_V_VBATT FNC_VALUES 1 FLOAT32_IEEE COLUMN_DIR DIRECT /end RECORD_LAYOUT
/begin COMPU_METHOD CU_INPC_V_VBATT "Conversion method for INPc_V_VBatt" RAT_FUNC "%10.1" "V" COEFFS 0.000000 1.000000 0.000000 0.000000 0.000000 1.000000 /end COMPU_METHOD
/* Scalar calibration for DDE 'INPc_b_AC_PressSw'. */
/begin CHARACTERISTIC INPc_b_AC_PressSw "Override value" VALUE 0x8cde1 RL_INPC_B_AC_PRESSSW 1.000000 CU_INPC_B_AC_PRESSSW 0.000000 1.000000 BYTE_ORDER MSB_FIRST /end CHARACTERISTIC
/begin RECORD_LAYOUT RL_INPC_B_AC_PRESSSW FNC_VALUES 1 UBYTE COLUMN_DIR DIRECT /end RECORD_LAYOUT
/begin COMPU_METHOD CU_INPC_B_AC_PRESSSW "Conversion method for INPc_b_AC_PressSw" RAT_FUNC "%10.0" "b" COEFFS 0.000000 1.000000 0.000000 0.000000 0.000000 1.000000 /end COMPU_METHOD
/* Scalar calibration for DDE 'INPc_b_AC_Rqst'. */
/begin CHARACTERISTIC INPc_b_AC_Rqst "Override value" VALUE 0x8cde3 RL_INPC_B_AC_RQST 1.000000 CU_INPC_B_AC_RQST 0.000000 1.000000 BYTE_ORDER MSB_FIRST /end CHARACTERISTIC
/begin RECORD_LAYOUT RL_INPC_B_AC_RQST FNC_VALUES 1 UBYTE COLUMN_DIR DIRECT /end RECORD_LAYOUT
/begin COMPU_METHOD CU_INPC_B_AC_RQST "Conversion method for INPc_b_AC_Rqst" RAT_FUNC "%10.0" "b" COEFFS 0.000000 1.000000 0.000000 0.000000 0.000000 1.000000 /end COMPU_METHOD
/* Scalar calibration for DDE 'INPc_b_EngSync'. */
/begin CHARACTERISTIC INPc_b_EngSync "Override value" VALUE 0x8cdc9 RL_INPC_B_ENGSYNC 1.000000 CU_INPC_B_ENGSYNC 0.000000 1.000000 BYTE_ORDER MSB_FIRST /end CHARACTERISTIC
/begin RECORD_LAYOUT RL_INPC_B_ENGSYNC FNC_VALUES 1 UBYTE COLUMN_DIR DIRECT /end RECORD_LAYOUT
/begin COMPU_METHOD CU_INPC_B_ENGSYNC "Conversion method for INPc_b_EngSync" RAT_FUNC "%10.0" "b" COEFFS 0.000000 1.000000 0.000000 0.000000 0.000000 1.000000 /end COMPU_METHOD
/* Scalar calibration for DDE 'INPc_b_Ign'. */
/begin CHARACTERISTIC INPc_b_Ign "Override value" VALUE 0x8ce3d RL_INPC_B_IGN 1.000000 CU_INPC_B_IGN 0.000000 1.000000 BYTE_ORDER MSB_FIRST /end CHARACTERISTIC
/begin RECORD_LAYOUT RL_INPC_B_IGN FNC_VALUES 1 UBYTE COLUMN_DIR DIRECT /end RECORD_LAYOUT
/begin COMPU_METHOD CU_INPC_B_IGN "Conversion method for INPc_b_Ign" RAT_FUNC "%10.0" "b" COEFFS 0.000000 1.000000 0.000000 0.000000 0.000000 1.000000 /end COMPU_METHOD
/* Scalar calibration for DDE 'INPc_b_OilPrSw'. */
/begin CHARACTERISTIC INPc_b_OilPrSw "Override" VALUE 0x8cdd9 RL_INPC_B_OILPRSW 1.000000 CU_INPC_B_OILPRSW 0.000000 1.000000 BYTE_ORDER MSB_FIRST /end CHARACTERISTIC
/begin RECORD_LAYOUT RL_INPC_B_OILPRSW FNC_VALUES 1 UBYTE COLUMN_DIR DIRECT /end RECORD_LAYOUT
/begin COMPU_METHOD CU_INPC_B_OILPRSW "Conversion method for INPc_b_OilPrSw" RAT_FUNC "%10.0" "b" COEFFS 0.000000 1.000000 0.000000 0.000000 0.000000 1.000000 /end COMPU_METHOD
/* Scalar calibration for DDE 'INPc_bar_FuelPress'. */
/begin CHARACTERISTIC INPc_bar_FuelPress "Override value" VALUE 0x8cd94 RL_INPC_BAR_FUELPRESS 250.000000 CU_INPC_BAR_FUELPRESS 0.000000 250.000000 BYTE_ORDER MSB_FIRST /end CHARACTERISTIC
/begin RECORD_LAYOUT RL_INPC_BAR_FUELPRESS FNC_VALUES 1 FLOAT32_IEEE COLUMN_DIR DIRECT /end RECORD_LAYOUT
/begin COMPU_METHOD CU_INPC_BAR_FUELPRESS "Conversion method for INPc_bar_FuelPress" RAT_FUNC "%10.1" "bar" COEFFS 0.000000 1.000000 0.000000 0.000000 0.000000 1.000000 /end COMPU_METHOD
/* Scalar calibration for DDE 'INPc_cnt_CrankTeethMissing'. */
/begin CHARACTERISTIC INPc_cnt_CrankTeethMissing "(not defined)" VALUE 0x8d2b4 RL_INPC_CNT_CRANKTEETHMISSING 20.000000 CU_INPC_CNT_CRANKTEETHMISSING -10.000000 10.000000 BYTE_ORDER MSB_FIRST /end CHARACTERISTIC
/begin RECORD_LAYOUT RL_INPC_CNT_CRANKTEETHMISSING FNC_VALUES 1 FLOAT32_IEEE COLUMN_DIR DIRECT /end RECORD_LAYOUT
/begin COMPU_METHOD CU_INPC_CNT_CRANKTEETHMISSING "Conversion method for INPc_cnt_CrankTeethMissing" RAT_FUNC "%10.3" "cnt" COEFFS 0.000000 1.000000 0.000000 0.000000 0.000000 1.000000 /end COMPU_METHOD
/* Scalar calibration for DDE 'INPc_cnt_TotalCrankTeeth'. */
/begin CHARACTERISTIC INPc_cnt_TotalCrankTeeth "(not defined)" VALUE 0x8d2b0 RL_INPC_CNT_TOTALCRANKTEETH 100.000000 CU_INPC_CNT_TOTALCRANKTEETH 0.000000 100.000000 BYTE_ORDER MSB_FIRST /end CHARACTERISTIC
/begin RECORD_LAYOUT RL_INPC_CNT_TOTALCRANKTEETH FNC_VALUES 1 FLOAT32_IEEE COLUMN_DIR DIRECT /end RECORD_LAYOUT
/begin COMPU_METHOD CU_INPC_CNT_TOTALCRANKTEETH "Conversion method for INPc_cnt_TotalCrankTeeth" RAT_FUNC "%10.3" "cnt" COEFFS 0.000000 1.000000 0.000000 0.000000 0.000000 1.000000 /end COMPU_METHOD
/* Scalar calibration for DDE 'INPc_e_TransGear'. */
/begin CHARACTERISTIC INPc_e_TransGear "Override value" VALUE 0x8cded RL_INPC_E_TRANSGEAR 6.000000 CU_INPC_E_TRANSGEAR -1.000000 5.000000 BYTE_ORDER MSB_FIRST /end CHARACTERISTIC
/begin RECORD_LAYOUT RL_INPC_E_TRANSGEAR FNC_VALUES 1 SBYTE COLUMN_DIR DIRECT /end RECORD_LAYOUT
/begin COMPU_METHOD CU_INPC_E_TRANSGEAR "Conversion method for INPc_e_TransGear" RAT_FUNC "%10.0" "e" COEFFS 0.000000 1.000000 0.000000 0.000000 0.000000 1.000000 /end COMPU_METHOD
/* Scalar calibration for DDE 'INPc_gps_MAF'. */
/begin CHARACTERISTIC INPc_gps_MAF "Override value" VALUE 0x8cd3c RL_INPC_GPS_MAF 1000.000000 CU_INPC_GPS_MAF 0.000000 1000.000000 BYTE_ORDER MSB_FIRST /end CHARACTERISTIC
/begin RECORD_LAYOUT RL_INPC_GPS_MAF FNC_VALUES 1 FLOAT32_IEEE COLUMN_DIR DIRECT /end RECORD_LAYOUT
/begin COMPU_METHOD CU_INPC_GPS_MAF "Conversion method for INPc_gps_MAF" RAT_FUNC "%10.0" "gps" COEFFS 0.000000 1.000000 0.000000 0.000000 0.000000 1.000000 /end COMPU_METHOD
/* Scalar calibration for DDE 'INPc_kPa_Baro'. */
/begin CHARACTERISTIC INPc_kPa_Baro "Override value" VALUE 0x8cdac RL_INPC_KPA_BARO 115.000000 CU_INPC_KPA_BARO 0.000000 115.000000 BYTE_ORDER MSB_FIRST /end CHARACTERISTIC
/begin RECORD_LAYOUT RL_INPC_KPA_BARO FNC_VALUES 1 FLOAT32_IEEE COLUMN_DIR DIRECT /end RECORD_LAYOUT
/begin COMPU_METHOD CU_INPC_KPA_BARO "Conversion method for INPc_kPa_Baro" RAT_FUNC "%10.2" "kPa" COEFFS 0.000000 1.000000 0.000000 0.000000 0.000000 1.000000 /end COMPU_METHOD
/* Scalar calibration for DDE 'INPc_kPa_CompOutPress'. */
/begin CHARACTERISTIC INPc_kPa_CompOutPress "Override value" VALUE 0x8cda4 RL_INPC_KPA_COMPOUTPRESS 300.000000 CU_INPC_KPA_COMPOUTPRESS 0.000000 300.000000 BYTE_ORDER MSB_FIRST /end CHARACTERISTIC
/begin RECORD_LAYOUT RL_INPC_KPA_COMPOUTPRESS FNC_VALUES 1 FLOAT32_IEEE COLUMN_DIR DIRECT /end RECORD_LAYOUT
/begin COMPU_METHOD CU_INPC_KPA_COMPOUTPRESS "Conversion method for INPc_kPa_CompOutPress" RAT_FUNC "%10.2" "kPa" COEFFS 0.000000 1.000000 0.000000 0.000000 0.000000 1.000000 /end COMPU_METHOD
/* Scalar calibration for DDE 'INPc_kPa_MAP'. */
/begin CHARACTERISTIC INPc_kPa_MAP "Override value" VALUE 0x8ce20 RL_INPC_KPA_MAP 300.000000 CU_INPC_KPA_MAP 0.000000 300.000000 BYTE_ORDER MSB_FIRST /end CHARACTERISTIC
/begin RECORD_LAYOUT RL_INPC_KPA_MAP FNC_VALUES 1 FLOAT32_IEEE COLUMN_DIR DIRECT /end RECORD_LAYOUT
/begin COMPU_METHOD CU_INPC_KPA_MAP "Conversion method for INPc_kPa_MAP" RAT_FUNC "%10.0" "kPa" COEFFS 0.000000 1.000000 0.000000 0.000000 0.000000 1.000000 /end COMPU_METHOD
/* Scalar calibration for DDE 'INPc_kPa_OilPress'. */
/begin CHARACTERISTIC INPc_kPa_OilPress "Override value" VALUE 0x8cd8c RL_INPC_KPA_OILPRESS 500.000000 CU_INPC_KPA_OILPRESS 0.000000 500.000000 BYTE_ORDER MSB_FIRST /end CHARACTERISTIC
/begin RECORD_LAYOUT RL_INPC_KPA_OILPRESS FNC_VALUES 1 FLOAT32_IEEE COLUMN_DIR DIRECT /end RECORD_LAYOUT
/begin COMPU_METHOD CU_INPC_KPA_OILPRESS "Conversion method for INPc_kPa_OilPress" RAT_FUNC "%10.2" "kPa" COEFFS 0.000000 1.000000 0.000000 0.000000 0.000000 1.000000 /end COMPU_METHOD
/* Scalar calibration for DDE 'INPc_kph_VehSpd'. */
/begin CHARACTERISTIC INPc_kph_VehSpd "Override value" VALUE 0x8cdd4 RL_INPC_KPH_VEHSPD 200.000000 CU_INPC_KPH_VEHSPD 0.000000 200.000000 BYTE_ORDER MSB_FIRST /end CHARACTERISTIC
/begin RECORD_LAYOUT RL_INPC_KPH_VEHSPD FNC_VALUES 1 FLOAT32_IEEE COLUMN_DIR DIRECT /end RECORD_LAYOUT
/begin COMPU_METHOD CU_INPC_KPH_VEHSPD "Conversion method for INPc_kph_VehSpd" RAT_FUNC "%10.2" "kph" COEFFS 0.000000 1.000000 0.000000 0.000000 0.000000 1.000000 /end COMPU_METHOD
/* Scalar calibration for DDE 'INPc_lam_UEGO1'. */
/begin CHARACTERISTIC INPc_lam_UEGO1 "Override value" VALUE 0x8ce10 RL_INPC_LAM_UEGO1 5.000000 CU_INPC_LAM_UEGO1 0.000000 5.000000 BYTE_ORDER MSB_FIRST /end CHARACTERISTIC
/begin RECORD_LAYOUT RL_INPC_LAM_UEGO1 FNC_VALUES 1 FLOAT32_IEEE COLUMN_DIR DIRECT /end RECORD_LAYOUT
/begin COMPU_METHOD CU_INPC_LAM_UEGO1 "Conversion method for INPc_lam_UEGO1" RAT_FUNC "%10.2" "lam" COEFFS 0.000000 1.000000 0.000000 0.000000 0.000000 1.000000 /end COMPU_METHOD
/* Scalar calibration for DDE 'INPc_lam_UEGO2'. */
/begin CHARACTERISTIC INPc_lam_UEGO2 "Override value" VALUE 0x8ce18 RL_INPC_LAM_UEGO2 5.000000 CU_INPC_LAM_UEGO2 0.000000 5.000000 BYTE_ORDER MSB_FIRST /end CHARACTERISTIC
/begin RECORD_LAYOUT RL_INPC_LAM_UEGO2 FNC_VALUES 1 FLOAT32_IEEE COLUMN_DIR DIRECT /end RECORD_LAYOUT
/begin COMPU_METHOD CU_INPC_LAM_UEGO2 "Conversion method for INPc_lam_UEGO2" RAT_FUNC "%10.2" "lam" COEFFS 0.000000 1.000000 0.000000 0.000000 0.000000 1.000000 /end COMPU_METHOD
/* Scalar calibration for DDE 'INPc_nu_EngineSpeedCyl_1'. */
/begin CHARACTERISTIC INPc_nu_EngineSpeedCyl_1 "Cylinder to use for speed measurement." VALUE 0x80424 RL_INPC_NU_ENGINESPEEDCYL_1 255.000000 CU_INPC_NU_ENGINESPEEDCYL_1 0.000000 255.000000 BYTE_ORDER MSB_FIRST /end CHARACTERISTIC
/begin RECORD_LAYOUT RL_INPC_NU_ENGINESPEEDCYL_1 FNC_VALUES 1 FLOAT32_IEEE COLUMN_DIR DIRECT /end RECORD_LAYOUT
/begin COMPU_METHOD CU_INPC_NU_ENGINESPEEDCYL_1 "Conversion method for INPc_nu_EngineSpeedCyl_1" RAT_FUNC "%10.0" "NU" COEFFS 0.000000 1.000000 0.000000 0.000000 0.000000 1.000000 /end COMPU_METHOD
/* Scalar calibration for DDE 'INPc_nu_EngineSpeedCyl_2'. */
/begin CHARACTERISTIC INPc_nu_EngineSpeedCyl_2 "Cylinder to use for speed measurement." VALUE 0x80430 RL_INPC_NU_ENGINESPEEDCYL_2 255.000000 CU_INPC_NU_ENGINESPEEDCYL_2 0.000000 255.000000 BYTE_ORDER MSB_FIRST /end CHARACTERISTIC
/begin RECORD_LAYOUT RL_INPC_NU_ENGINESPEEDCYL_2 FNC_VALUES 1 FLOAT32_IEEE COLUMN_DIR DIRECT /end RECORD_LAYOUT
/begin COMPU_METHOD CU_INPC_NU_ENGINESPEEDCYL_2 "Conversion method for INPc_nu_EngineSpeedCyl_2" RAT_FUNC "%10.0" "NU" COEFFS 0.000000 1.000000 0.000000 0.000000 0.000000 1.000000 /end COMPU_METHOD
/* Scalar calibration for DDE 'INPc_nu_EngineSpeedCyl_3'. */
/begin CHARACTERISTIC INPc_nu_EngineSpeedCyl_3 "Cylinder to use for speed measurement." VALUE 0x80434 RL_INPC_NU_ENGINESPEEDCYL_3 255.000000 CU_INPC_NU_ENGINESPEEDCYL_3 0.000000 255.000000 BYTE_ORDER MSB_FIRST /end CHARACTERISTIC
/begin RECORD_LAYOUT RL_INPC_NU_ENGINESPEEDCYL_3 FNC_VALUES 1 FLOAT32_IEEE COLUMN_DIR DIRECT /end RECORD_LAYOUT
/begin COMPU_METHOD CU_INPC_NU_ENGINESPEEDCYL_3 "Conversion method for INPc_nu_EngineSpeedCyl_3" RAT_FUNC "%10.0" "NU" COEFFS 0.000000 1.000000 0.000000 0.000000 0.000000 1.000000 /end COMPU_METHOD
/* Scalar calibration for DDE 'INPc_nu_EngineSpeedCyl_4'. */
/begin CHARACTERISTIC INPc_nu_EngineSpeedCyl_4 "Cylinder to use for speed measurement." VALUE 0x80438 RL_INPC_NU_ENGINESPEEDCYL_4 255.000000 CU_INPC_NU_ENGINESPEEDCYL_4 0.000000 255.000000 BYTE_ORDER MSB_FIRST /end CHARACTERISTIC
/begin RECORD_LAYOUT RL_INPC_NU_ENGINESPEEDCYL_4 FNC_VALUES 1 FLOAT32_IEEE COLUMN_DIR DIRECT /end RECORD_LAYOUT
/begin COMPU_METHOD CU_INPC_NU_ENGINESPEEDCYL_4 "Conversion method for INPc_nu_EngineSpeedCyl_4" RAT_FUNC "%10.0" "NU" COEFFS 0.000000 1.000000 0.000000 0.000000 0.000000 1.000000 /end COMPU_METHOD
/* Scalar calibration for DDE 'INPc_nu_num_toothpost'. */
/begin CHARACTERISTIC INPc_nu_num_toothpost "Number of teeth to use for speed measurement" VALUE 0x8042c RL_INPC_NU_NUM_TOOTHPOST 254.000000 CU_INPC_NU_NUM_TOOTHPOST -127.000000 127.000000 BYTE_ORDER MSB_FIRST /end CHARACTERISTIC
/begin RECORD_LAYOUT RL_INPC_NU_NUM_TOOTHPOST FNC_VALUES 1 FLOAT32_IEEE COLUMN_DIR DIRECT /end RECORD_LAYOUT
/begin COMPU_METHOD CU_INPC_NU_NUM_TOOTHPOST "Conversion method for INPc_nu_num_toothpost" RAT_FUNC "%10.0" "NU" COEFFS 0.000000 1.000000 0.000000 0.000000 0.000000 1.000000 /end COMPU_METHOD
/* Scalar calibration for DDE 'INPc_nu_num_toothpre'. */
/begin CHARACTERISTIC INPc_nu_num_toothpre "Number of teeth to use for speed measurement" VALUE 0x80428 RL_INPC_NU_NUM_TOOTHPRE 254.000000 CU_INPC_NU_NUM_TOOTHPRE -127.000000 127.000000 BYTE_ORDER MSB_FIRST /end CHARACTERISTIC
/begin RECORD_LAYOUT RL_INPC_NU_NUM_TOOTHPRE FNC_VALUES 1 FLOAT32_IEEE COLUMN_DIR DIRECT /end RECORD_LAYOUT
/begin COMPU_METHOD CU_INPC_NU_NUM_TOOTHPRE "Conversion method for INPc_nu_num_toothpre" RAT_FUNC "%10.0" "NU" COEFFS 0.000000 1.000000 0.000000 0.000000 0.000000 1.000000 /end COMPU_METHOD
/* Scalar calibration for DDE 'INPc_nu_toothmodulo'. */
/begin CHARACTERISTIC INPc_nu_toothmodulo "When the sync offset is applied, this is the modulo to the number of teeth." VALUE 0x8041c RL_INPC_NU_TOOTHMODULO 0.000000 CU_INPC_NU_TOOTHMODULO 60.000000 60.000000 BYTE_ORDER MSB_FIRST /end CHARACTERISTIC
/begin RECORD_LAYOUT RL_INPC_NU_TOOTHMODULO FNC_VALUES 1 FLOAT32_IEEE COLUMN_DIR DIRECT /end RECORD_LAYOUT
/begin COMPU_METHOD CU_INPC_NU_TOOTHMODULO "Conversion method for INPc_nu_toothmodulo" RAT_FUNC "%10.0" "NU" COEFFS 0.000000 1.000000 0.000000 0.000000 0.000000 1.000000 /end COMPU_METHOD
/* Scalar calibration for DDE 'INPc_nu_toothpost'. */
/begin CHARACTERISTIC INPc_nu_toothpost "Tooth to start a tooth by tooth speed measurement" VALUE 0x80420 RL_INPC_NU_TOOTHPOST 254.000000 CU_INPC_NU_TOOTHPOST -127.000000 127.000000 BYTE_ORDER MSB_FIRST /end CHARACTERISTIC
/begin RECORD_LAYOUT RL_INPC_NU_TOOTHPOST FNC_VALUES 1 FLOAT32_IEEE COLUMN_DIR DIRECT /end RECORD_LAYOUT
/begin COMPU_METHOD CU_INPC_NU_TOOTHPOST "Conversion method for INPc_nu_toothpost" RAT_FUNC "%10.0" "NU" COEFFS 0.000000 1.000000 0.000000 0.000000 0.000000 1.000000 /end COMPU_METHOD
/* Scalar calibration for DDE 'INPc_nu_toothpre'. */
/begin CHARACTERISTIC INPc_nu_toothpre "Tooth to start a tooth by tooth speed measurement" VALUE 0x80418 RL_INPC_NU_TOOTHPRE 254.000000 CU_INPC_NU_TOOTHPRE -127.000000 127.000000 BYTE_ORDER MSB_FIRST /end CHARACTERISTIC
/begin RECORD_LAYOUT RL_INPC_NU_TOOTHPRE FNC_VALUES 1 FLOAT32_IEEE COLUMN_DIR DIRECT /end RECORD_LAYOUT
/begin COMPU_METHOD CU_INPC_NU_TOOTHPRE "Conversion method for INPc_nu_toothpre" RAT_FUNC "%10.0" "NU" COEFFS 0.000000 1.000000 0.000000 0.000000 0.000000 1.000000 /end COMPU_METHOD
/* Scalar calibration for DDE 'INPc_o_AC_PressSw'. */
/begin CHARACTERISTIC INPc_o_AC_PressSw "Override flag" VALUE 0x8cde0 RL_INPC_O_AC_PRESSSW 1.000000 CU_INPC_O_AC_PRESSSW 0.000000 1.000000 BYTE_ORDER MSB_FIRST /end CHARACTERISTIC
/begin RECORD_LAYOUT RL_INPC_O_AC_PRESSSW FNC_VALUES 1 UBYTE COLUMN_DIR DIRECT /end RECORD_LAYOUT
/begin COMPU_METHOD CU_INPC_O_AC_PRESSSW "Conversion method for INPc_o_AC_PressSw" RAT_FUNC "%10.0" "o" COEFFS 0.000000 1.000000 0.000000 0.000000 0.000000 1.000000 /end COMPU_METHOD
/* Scalar calibration for DDE 'INPc_o_AC_Rqst'. */
/begin CHARACTERISTIC INPc_o_AC_Rqst "Override flag" VALUE 0x8cde2 RL_INPC_O_AC_RQST 1.000000 CU_INPC_O_AC_RQST 0.000000 1.000000 BYTE_ORDER MSB_FIRST /end CHARACTERISTIC
/begin RECORD_LAYOUT RL_INPC_O_AC_RQST FNC_VALUES 1 UBYTE COLUMN_DIR DIRECT /end RECORD_LAYOUT
/begin COMPU_METHOD CU_INPC_O_AC_RQST "Conversion method for INPc_o_AC_Rqst" RAT_FUNC "%10.0" "o" COEFFS 0.000000 1.000000 0.000000 0.000000 0.000000 1.000000 /end COMPU_METHOD
/* Scalar calibration for DDE 'INPc_o_APP1_Raw'. */
/begin CHARACTERISTIC INPc_o_APP1_Raw "Override flag" VALUE 0x8cd50 RL_INPC_O_APP1_RAW 1.000000 CU_INPC_O_APP1_RAW 0.000000 1.000000 BYTE_ORDER MSB_FIRST /end CHARACTERISTIC
/begin RECORD_LAYOUT RL_INPC_O_APP1_RAW FNC_VALUES 1 UBYTE COLUMN_DIR DIRECT /end RECORD_LAYOUT
/begin COMPU_METHOD CU_INPC_O_APP1_RAW "Conversion method for INPc_o_APP1_Raw" RAT_FUNC "%10.0" "o" COEFFS 0.000000 1.000000 0.000000 0.000000 0.000000 1.000000 /end COMPU_METHOD
/* Scalar calibration for DDE 'INPc_o_APP2_Raw'. */
/begin CHARACTERISTIC INPc_o_APP2_Raw "Override flag" VALUE 0x8cd58 RL_INPC_O_APP2_RAW 1.000000 CU_INPC_O_APP2_RAW 0.000000 1.000000 BYTE_ORDER MSB_FIRST /end CHARACTERISTIC
/begin RECORD_LAYOUT RL_INPC_O_APP2_RAW FNC_VALUES 1 UBYTE COLUMN_DIR DIRECT /end RECORD_LAYOUT
/begin COMPU_METHOD CU_INPC_O_APP2_RAW "Conversion method for INPc_o_APP2_Raw" RAT_FUNC "%10.0" "o" COEFFS 0.000000 1.000000 0.000000 0.000000 0.000000 1.000000 /end COMPU_METHOD
/* Scalar calibration for DDE 'INPc_o_AltLoad'. */
/begin CHARACTERISTIC INPc_o_AltLoad "Override flag" VALUE 0x8cdca RL_INPC_O_ALTLOAD 1.000000 CU_INPC_O_ALTLOAD 0.000000 1.000000 BYTE_ORDER MSB_FIRST /end CHARACTERISTIC
/begin RECORD_LAYOUT RL_INPC_O_ALTLOAD FNC_VALUES 1 UBYTE COLUMN_DIR DIRECT /end RECORD_LAYOUT
/begin COMPU_METHOD CU_INPC_O_ALTLOAD "Conversion method for INPc_o_AltLoad" RAT_FUNC "%10.0" "o" COEFFS 0.000000 1.000000 0.000000 0.000000 0.000000 1.000000 /end COMPU_METHOD
/* Scalar calibration for DDE 'INPc_o_AmbientTemp'. */
/begin CHARACTERISTIC INPc_o_AmbientTemp "Override flag" VALUE 0x8cd98 RL_INPC_O_AMBIENTTEMP 1.000000 CU_INPC_O_AMBIENTTEMP 0.000000 1.000000 BYTE_ORDER MSB_FIRST /end CHARACTERISTIC
/begin RECORD_LAYOUT RL_INPC_O_AMBIENTTEMP FNC_VALUES 1 UBYTE COLUMN_DIR DIRECT /end RECORD_LAYOUT
/begin COMPU_METHOD CU_INPC_O_AMBIENTTEMP "Conversion method for INPc_o_AmbientTemp" RAT_FUNC "%10.0" "o" COEFFS 0.000000 1.000000 0.000000 0.000000 0.000000 1.000000 /end COMPU_METHOD
/* Scalar calibration for DDE 'INPc_o_Baro'. */
/begin CHARACTERISTIC INPc_o_Baro "Override flag" VALUE 0x8cda8 RL_INPC_O_BARO 1.000000 CU_INPC_O_BARO 0.000000 1.000000 BYTE_ORDER MSB_FIRST /end CHARACTERISTIC
/begin RECORD_LAYOUT RL_INPC_O_BARO FNC_VALUES 1 UBYTE COLUMN_DIR DIRECT /end RECORD_LAYOUT
/begin COMPU_METHOD CU_INPC_O_BARO "Conversion method for INPc_o_Baro" RAT_FUNC "%10.0" "o" COEFFS 0.000000 1.000000 0.000000 0.000000 0.000000 1.000000 /end COMPU_METHOD
/* Scalar calibration for DDE 'INPc_o_CompOutPress'. */
/begin CHARACTERISTIC INPc_o_CompOutPress "Override flag" VALUE 0x8cda0 RL_INPC_O_COMPOUTPRESS 1.000000 CU_INPC_O_COMPOUTPRESS 0.000000 1.000000 BYTE_ORDER MSB_FIRST /end CHARACTERISTIC
/begin RECORD_LAYOUT RL_INPC_O_COMPOUTPRESS FNC_VALUES 1 UBYTE COLUMN_DIR DIRECT /end RECORD_LAYOUT
/begin COMPU_METHOD CU_INPC_O_COMPOUTPRESS "Conversion method for INPc_o_CompOutPress" RAT_FUNC "%10.0" "o" COEFFS 0.000000 1.000000 0.000000 0.000000 0.000000 1.000000 /end COMPU_METHOD
/* Scalar calibration for DDE 'INPc_o_CompOutTemp'. */
/begin CHARACTERISTIC INPc_o_CompOutTemp "Override flag" VALUE 0x8cdb8 RL_INPC_O_COMPOUTTEMP 1.000000 CU_INPC_O_COMPOUTTEMP 0.000000 1.000000 BYTE_ORDER MSB_FIRST /end CHARACTERISTIC
/begin RECORD_LAYOUT RL_INPC_O_COMPOUTTEMP FNC_VALUES 1 UBYTE COLUMN_DIR DIRECT /end RECORD_LAYOUT
/begin COMPU_METHOD CU_INPC_O_COMPOUTTEMP "Conversion method for INPc_o_CompOutTemp" RAT_FUNC "%10.0" "o" COEFFS 0.000000 1.000000 0.000000 0.000000 0.000000 1.000000 /end COMPU_METHOD
/* Scalar calibration for DDE 'INPc_o_CoolantTemp'. */
/begin CHARACTERISTIC INPc_o_CoolantTemp "Override flag" VALUE 0x8ce3e RL_INPC_O_COOLANTTEMP 1.000000 CU_INPC_O_COOLANTTEMP 0.000000 1.000000 BYTE_ORDER MSB_FIRST /end CHARACTERISTIC
/begin RECORD_LAYOUT RL_INPC_O_COOLANTTEMP FNC_VALUES 1 UBYTE COLUMN_DIR DIRECT /end RECORD_LAYOUT
/begin COMPU_METHOD CU_INPC_O_COOLANTTEMP "Conversion method for INPc_o_CoolantTemp" RAT_FUNC "%10.0" "o" COEFFS 0.000000 1.000000 0.000000 0.000000 0.000000 1.000000 /end COMPU_METHOD
/* Scalar calibration for DDE 'INPc_o_Cylinder1_Knock'. */
/begin CHARACTERISTIC INPc_o_Cylinder1_Knock "Override flag" VALUE 0x8ce2c RL_INPC_O_CYLINDER1_KNOCK 1.000000 CU_INPC_O_CYLINDER1_KNOCK 0.000000 1.000000 BYTE_ORDER MSB_FIRST /end CHARACTERISTIC
/begin RECORD_LAYOUT RL_INPC_O_CYLINDER1_KNOCK FNC_VALUES 1 UBYTE COLUMN_DIR DIRECT /end RECORD_LAYOUT
/begin COMPU_METHOD CU_INPC_O_CYLINDER1_KNOCK "Conversion method for INPc_o_Cylinder1_Knock" RAT_FUNC "%10.0" "o" COEFFS 0.000000 1.000000 0.000000 0.000000 0.000000 1.000000 /end COMPU_METHOD
/* Scalar calibration for DDE 'INPc_o_Cylinder2_Knock'. */
/begin CHARACTERISTIC INPc_o_Cylinder2_Knock "Override flag" VALUE 0x8cd68 RL_INPC_O_CYLINDER2_KNOCK 1.000000 CU_INPC_O_CYLINDER2_KNOCK 0.000000 1.000000 BYTE_ORDER MSB_FIRST /end CHARACTERISTIC
/begin RECORD_LAYOUT RL_INPC_O_CYLINDER2_KNOCK FNC_VALUES 1 UBYTE COLUMN_DIR DIRECT /end RECORD_LAYOUT
/begin COMPU_METHOD CU_INPC_O_CYLINDER2_KNOCK "Conversion method for INPc_o_Cylinder2_Knock" RAT_FUNC "%10.0" "o" COEFFS 0.000000 1.000000 0.000000 0.000000 0.000000 1.000000 /end COMPU_METHOD
/* Scalar calibration for DDE 'INPc_o_Cylinder3_Knock'. */
/begin CHARACTERISTIC INPc_o_Cylinder3_Knock "Override flag" VALUE 0x8cd70 RL_INPC_O_CYLINDER3_KNOCK 1.000000 CU_INPC_O_CYLINDER3_KNOCK 0.000000 1.000000 BYTE_ORDER MSB_FIRST /end CHARACTERISTIC
/begin RECORD_LAYOUT RL_INPC_O_CYLINDER3_KNOCK FNC_VALUES 1 UBYTE COLUMN_DIR DIRECT /end RECORD_LAYOUT
/begin COMPU_METHOD CU_INPC_O_CYLINDER3_KNOCK "Conversion method for INPc_o_Cylinder3_Knock" RAT_FUNC "%10.0" "o" COEFFS 0.000000 1.000000 0.000000 0.000000 0.000000 1.000000 /end COMPU_METHOD
/* Scalar calibration for DDE 'INPc_o_Cylinder4_Knock'. */
/begin CHARACTERISTIC INPc_o_Cylinder4_Knock "Override flag" VALUE 0x8cd78 RL_INPC_O_CYLINDER4_KNOCK 1.000000 CU_INPC_O_CYLINDER4_KNOCK 0.000000 1.000000 BYTE_ORDER MSB_FIRST /end CHARACTERISTIC
/begin RECORD_LAYOUT RL_INPC_O_CYLINDER4_KNOCK FNC_VALUES 1 UBYTE COLUMN_DIR DIRECT /end RECORD_LAYOUT
/begin COMPU_METHOD CU_INPC_O_CYLINDER4_KNOCK "Conversion method for INPc_o_Cylinder4_Knock" RAT_FUNC "%10.0" "o" COEFFS 0.000000 1.000000 0.000000 0.000000 0.000000 1.000000 /end COMPU_METHOD
/* Scalar calibration for DDE 'INPc_o_EGO11'. */
/begin CHARACTERISTIC INPc_o_EGO11 "Override flag" VALUE 0x8cd40 RL_INPC_O_EGO11 1.000000 CU_INPC_O_EGO11 0.000000 1.000000 BYTE_ORDER MSB_FIRST /end CHARACTERISTIC
/begin RECORD_LAYOUT RL_INPC_O_EGO11 FNC_VALUES 1 UBYTE COLUMN_DIR DIRECT /end RECORD_LAYOUT
/begin COMPU_METHOD CU_INPC_O_EGO11 "Conversion method for INPc_o_EGO11" RAT_FUNC "%10.0" "o" COEFFS 0.000000 1.000000 0.000000 0.000000 0.000000 1.000000 /end COMPU_METHOD
/* Scalar calibration for DDE 'INPc_o_EGO21'. */
/begin CHARACTERISTIC INPc_o_EGO21 "Override flag" VALUE 0x8cd80 RL_INPC_O_EGO21 1.000000 CU_INPC_O_EGO21 0.000000 1.000000 BYTE_ORDER MSB_FIRST /end CHARACTERISTIC
/begin RECORD_LAYOUT RL_INPC_O_EGO21 FNC_VALUES 1 UBYTE COLUMN_DIR DIRECT /end RECORD_LAYOUT
/begin COMPU_METHOD CU_INPC_O_EGO21 "Conversion method for INPc_o_EGO21" RAT_FUNC "%10.0" "o" COEFFS 0.000000 1.000000 0.000000 0.000000 0.000000 1.000000 /end COMPU_METHOD
/* Scalar calibration for DDE 'INPc_o_EngSpd'. */
/begin CHARACTERISTIC INPc_o_EngSpd "Override flag" VALUE 0x8cdda RL_INPC_O_ENGSPD 1.000000 CU_INPC_O_ENGSPD 0.000000 1.000000 BYTE_ORDER MSB_FIRST /end CHARACTERISTIC
/begin RECORD_LAYOUT RL_INPC_O_ENGSPD FNC_VALUES 1 UBYTE COLUMN_DIR DIRECT /end RECORD_LAYOUT
/begin COMPU_METHOD CU_INPC_O_ENGSPD "Conversion method for INPc_o_EngSpd" RAT_FUNC "%10.0" "o" COEFFS 0.000000 1.000000 0.000000 0.000000 0.000000 1.000000 /end COMPU_METHOD
/* Scalar calibration for DDE 'INPc_o_EngSync'. */
/begin CHARACTERISTIC INPc_o_EngSync "Override flag" VALUE 0x8cdc8 RL_INPC_O_ENGSYNC 1.000000 CU_INPC_O_ENGSYNC 0.000000 1.000000 BYTE_ORDER MSB_FIRST /end CHARACTERISTIC
/begin RECORD_LAYOUT RL_INPC_O_ENGSYNC FNC_VALUES 1 UBYTE COLUMN_DIR DIRECT /end RECORD_LAYOUT
/begin COMPU_METHOD CU_INPC_O_ENGSYNC "Conversion method for INPc_o_EngSync" RAT_FUNC "%10.0" "o" COEFFS 0.000000 1.000000 0.000000 0.000000 0.000000 1.000000 /end COMPU_METHOD
/* Scalar calibration for DDE 'INPc_o_ExhaustTemp'. */
/begin CHARACTERISTIC INPc_o_ExhaustTemp "Override" VALUE 0x8cdc0 RL_INPC_O_EXHAUSTTEMP 1.000000 CU_INPC_O_EXHAUSTTEMP 0.000000 1.000000 BYTE_ORDER MSB_FIRST /end CHARACTERISTIC
/begin RECORD_LAYOUT RL_INPC_O_EXHAUSTTEMP FNC_VALUES 1 UBYTE COLUMN_DIR DIRECT /end RECORD_LAYOUT
/begin COMPU_METHOD CU_INPC_O_EXHAUSTTEMP "Conversion method for INPc_o_ExhaustTemp" RAT_FUNC "%10.0" "b" COEFFS 0.000000 1.000000 0.000000 0.000000 0.000000 1.000000 /end COMPU_METHOD
/* Scalar calibration for DDE 'INPc_o_FuelLevel1'. */
/begin CHARACTERISTIC INPc_o_FuelLevel1 "Override flag" VALUE 0x8c138 RL_INPC_O_FUELLEVEL1 1.000000 CU_INPC_O_FUELLEVEL1 0.000000 1.000000 BYTE_ORDER MSB_FIRST /end CHARACTERISTIC
/begin RECORD_LAYOUT RL_INPC_O_FUELLEVEL1 FNC_VALUES 1 UBYTE COLUMN_DIR DIRECT /end RECORD_LAYOUT
/begin COMPU_METHOD CU_INPC_O_FUELLEVEL1 "Conversion method for INPc_o_FuelLevel1" RAT_FUNC "%10.0" "o" COEFFS 0.000000 1.000000 0.000000 0.000000 0.000000 1.000000 /end COMPU_METHOD
/* Scalar calibration for DDE 'INPc_o_FuelLevel2'. */
/begin CHARACTERISTIC INPc_o_FuelLevel2 "Override flag" VALUE 0x8c140 RL_INPC_O_FUELLEVEL2 1.000000 CU_INPC_O_FUELLEVEL2 0.000000 1.000000 BYTE_ORDER MSB_FIRST /end CHARACTERISTIC
/begin RECORD_LAYOUT RL_INPC_O_FUELLEVEL2 FNC_VALUES 1 UBYTE COLUMN_DIR DIRECT /end RECORD_LAYOUT
/begin COMPU_METHOD CU_INPC_O_FUELLEVEL2 "Conversion method for INPc_o_FuelLevel2" RAT_FUNC "%10.0" "o" COEFFS 0.000000 1.000000 0.000000 0.000000 0.000000 1.000000 /end COMPU_METHOD
/* Scalar calibration for DDE 'INPc_o_FuelPress'. */
/begin CHARACTERISTIC INPc_o_FuelPress "Override flag" VALUE 0x8cd90 RL_INPC_O_FUELPRESS 1.000000 CU_INPC_O_FUELPRESS 0.000000 1.000000 BYTE_ORDER MSB_FIRST /end CHARACTERISTIC
/begin RECORD_LAYOUT RL_INPC_O_FUELPRESS FNC_VALUES 1 UBYTE COLUMN_DIR DIRECT /end RECORD_LAYOUT
/begin COMPU_METHOD CU_INPC_O_FUELPRESS "Conversion method for INPc_o_FuelPress" RAT_FUNC "%10.0" "o" COEFFS 0.000000 1.000000 0.000000 0.000000 0.000000 1.000000 /end COMPU_METHOD
/* Scalar calibration for DDE 'INPc_o_FuelTemp'. */
/begin CHARACTERISTIC INPc_o_FuelTemp "Override flag" VALUE 0x8ce24 RL_INPC_O_FUELTEMP 1.000000 CU_INPC_O_FUELTEMP 0.000000 1.000000 BYTE_ORDER MSB_FIRST /end CHARACTERISTIC
/begin RECORD_LAYOUT RL_INPC_O_FUELTEMP FNC_VALUES 1 UBYTE COLUMN_DIR DIRECT /end RECORD_LAYOUT
/begin COMPU_METHOD CU_INPC_O_FUELTEMP "Conversion method for INPc_o_FuelTemp" RAT_FUNC "%10.0" "o" COEFFS 0.000000 1.000000 0.000000 0.000000 0.000000 1.000000 /end COMPU_METHOD
/* Scalar calibration for DDE 'INPc_o_GLPLevel1'. */
/begin CHARACTERISTIC INPc_o_GLPLevel1 "Override flag" VALUE 0x8c1a0 RL_INPC_O_GLPLEVEL1 1.000000 CU_INPC_O_GLPLEVEL1 0.000000 1.000000 BYTE_ORDER MSB_FIRST /end CHARACTERISTIC
/begin RECORD_LAYOUT RL_INPC_O_GLPLEVEL1 FNC_VALUES 1 UBYTE COLUMN_DIR DIRECT /end RECORD_LAYOUT
/begin COMPU_METHOD CU_INPC_O_GLPLEVEL1 "Conversion method for INPc_o_GLPLevel1" RAT_FUNC "%10.0" "o" COEFFS 0.000000 1.000000 0.000000 0.000000 0.000000 1.000000 /end COMPU_METHOD
/* Scalar calibration for DDE 'INPc_o_GLPLevel2'. */
/begin CHARACTERISTIC INPc_o_GLPLevel2 "Override flag" VALUE 0x8c16c RL_INPC_O_GLPLEVEL2 1.000000 CU_INPC_O_GLPLEVEL2 0.000000 1.000000 BYTE_ORDER MSB_FIRST /end CHARACTERISTIC
/begin RECORD_LAYOUT RL_INPC_O_GLPLEVEL2 FNC_VALUES 1 UBYTE COLUMN_DIR DIRECT /end RECORD_LAYOUT
/begin COMPU_METHOD CU_INPC_O_GLPLEVEL2 "Conversion method for INPc_o_GLPLevel2" RAT_FUNC "%10.0" "o" COEFFS 0.000000 1.000000 0.000000 0.000000 0.000000 1.000000 /end COMPU_METHOD
/* Scalar calibration for DDE 'INPc_o_Ign'. */
/begin CHARACTERISTIC INPc_o_Ign "Override flag" VALUE 0x8ce3c RL_INPC_O_IGN 1.000000 CU_INPC_O_IGN 0.000000 1.000000 BYTE_ORDER MSB_FIRST /end CHARACTERISTIC
/begin RECORD_LAYOUT RL_INPC_O_IGN FNC_VALUES 1 UBYTE COLUMN_DIR DIRECT /end RECORD_LAYOUT
/begin COMPU_METHOD CU_INPC_O_IGN "Conversion method for INPc_o_Ign" RAT_FUNC "%10.0" "o" COEFFS 0.000000 1.000000 0.000000 0.000000 0.000000 1.000000 /end COMPU_METHOD
/* Scalar calibration for DDE 'INPc_o_MAF'. */
/begin CHARACTERISTIC INPc_o_MAF "Override flag" VALUE 0x8cd38 RL_INPC_O_MAF 1.000000 CU_INPC_O_MAF 0.000000 1.000000 BYTE_ORDER MSB_FIRST /end CHARACTERISTIC
/begin RECORD_LAYOUT RL_INPC_O_MAF FNC_VALUES 1 UBYTE COLUMN_DIR DIRECT /end RECORD_LAYOUT
/begin COMPU_METHOD CU_INPC_O_MAF "Conversion method for INPc_o_MAF" RAT_FUNC "%10.0" "o" COEFFS 0.000000 1.000000 0.000000 0.000000 0.000000 1.000000 /end COMPU_METHOD
/* Scalar calibration for DDE 'INPc_o_MAP'. */
/begin CHARACTERISTIC INPc_o_MAP "Override flag" VALUE 0x8ce1c RL_INPC_O_MAP 1.000000 CU_INPC_O_MAP 0.000000 1.000000 BYTE_ORDER MSB_FIRST /end CHARACTERISTIC
/begin RECORD_LAYOUT RL_INPC_O_MAP FNC_VALUES 1 UBYTE COLUMN_DIR DIRECT /end RECORD_LAYOUT
/begin COMPU_METHOD CU_INPC_O_MAP "Conversion method for INPc_o_MAP" RAT_FUNC "%10.0" "o" COEFFS 0.000000 1.000000 0.000000 0.000000 0.000000 1.000000 /end COMPU_METHOD
/* Scalar calibration for DDE 'INPc_o_ManifoldTemp'. */
/begin CHARACTERISTIC INPc_o_ManifoldTemp "Override flag" VALUE 0x8ce34 RL_INPC_O_MANIFOLDTEMP 1.000000 CU_INPC_O_MANIFOLDTEMP 0.000000 1.000000 BYTE_ORDER MSB_FIRST /end CHARACTERISTIC
/begin RECORD_LAYOUT RL_INPC_O_MANIFOLDTEMP FNC_VALUES 1 UBYTE COLUMN_DIR DIRECT /end RECORD_LAYOUT
/begin COMPU_METHOD CU_INPC_O_MANIFOLDTEMP "Conversion method for INPc_o_ManifoldTemp" RAT_FUNC "%10.0" "o" COEFFS 0.000000 1.000000 0.000000 0.000000 0.000000 1.000000 /end COMPU_METHOD
/* Scalar calibration for DDE 'INPc_o_OilPrSw'. */
/begin CHARACTERISTIC INPc_o_OilPrSw "Override" VALUE 0x8cdd8 RL_INPC_O_OILPRSW 1.000000 CU_INPC_O_OILPRSW 0.000000 1.000000 BYTE_ORDER MSB_FIRST /end CHARACTERISTIC
/begin RECORD_LAYOUT RL_INPC_O_OILPRSW FNC_VALUES 1 UBYTE COLUMN_DIR DIRECT /end RECORD_LAYOUT
/begin COMPU_METHOD CU_INPC_O_OILPRSW "Conversion method for INPc_o_OilPrSw" RAT_FUNC "%10.0" "o" COEFFS 0.000000 1.000000 0.000000 0.000000 0.000000 1.000000 /end COMPU_METHOD
/* Scalar calibration for DDE 'INPc_o_OilPress'. */
/begin CHARACTERISTIC INPc_o_OilPress "Override flag" VALUE 0x8cd88 RL_INPC_O_OILPRESS 1.000000 CU_INPC_O_OILPRESS 0.000000 1.000000 BYTE_ORDER MSB_FIRST /end CHARACTERISTIC
/begin RECORD_LAYOUT RL_INPC_O_OILPRESS FNC_VALUES 1 UBYTE COLUMN_DIR DIRECT /end RECORD_LAYOUT
/begin COMPU_METHOD CU_INPC_O_OILPRESS "Conversion method for INPc_o_OilPress" RAT_FUNC "%10.0" "o" COEFFS 0.000000 1.000000 0.000000 0.000000 0.000000 1.000000 /end COMPU_METHOD
/* Scalar calibration for DDE 'INPc_o_OilTemp'. */
/begin CHARACTERISTIC INPc_o_OilTemp "Override flag" VALUE 0x8cde4 RL_INPC_O_OILTEMP 1.000000 CU_INPC_O_OILTEMP 0.000000 1.000000 BYTE_ORDER MSB_FIRST /end CHARACTERISTIC
/begin RECORD_LAYOUT RL_INPC_O_OILTEMP FNC_VALUES 1 UBYTE COLUMN_DIR DIRECT /end RECORD_LAYOUT
/begin COMPU_METHOD CU_INPC_O_OILTEMP "Conversion method for INPc_o_OilTemp" RAT_FUNC "%10.0" "o" COEFFS 0.000000 1.000000 0.000000 0.000000 0.000000 1.000000 /end COMPU_METHOD
/* Scalar calibration for DDE 'INPc_o_PrefiltTotalFuelLevel'. */
/begin CHARACTERISTIC INPc_o_PrefiltTotalFuelLevel "Override flag" VALUE 0x8c190 RL_INPC_O_PREFILTTOTALFUELLEVEL 1.000000 CU_INPC_O_PREFILTTOTALFUELLEVEL 0.000000 1.000000 BYTE_ORDER MSB_FIRST /end CHARACTERISTIC
/begin RECORD_LAYOUT RL_INPC_O_PREFILTTOTALFUELLEVEL FNC_VALUES 1 UBYTE COLUMN_DIR DIRECT /end RECORD_LAYOUT
/begin COMPU_METHOD CU_INPC_O_PREFILTTOTALFUELLEVEL "Conversion method for INPc_o_PrefiltTotalFuelLevel" RAT_FUNC "%10.0" "o" COEFFS 0.000000 1.000000 0.000000 0.000000 0.000000 1.000000 /end COMPU_METHOD
/* Scalar calibration for DDE 'INPc_o_TP1_Raw'. */
/begin CHARACTERISTIC INPc_o_TP1_Raw "Override flag" VALUE 0x8ce44 RL_INPC_O_TP1_RAW 1.000000 CU_INPC_O_TP1_RAW 0.000000 1.000000 BYTE_ORDER MSB_FIRST /end CHARACTERISTIC
/begin RECORD_LAYOUT RL_INPC_O_TP1_RAW FNC_VALUES 1 UBYTE COLUMN_DIR DIRECT /end RECORD_LAYOUT
/begin COMPU_METHOD CU_INPC_O_TP1_RAW "Conversion method for INPc_o_TP1_Raw" RAT_FUNC "%10.0" "o" COEFFS 0.000000 1.000000 0.000000 0.000000 0.000000 1.000000 /end COMPU_METHOD
/* Scalar calibration for DDE 'INPc_o_TP2_Raw'. */
/begin CHARACTERISTIC INPc_o_TP2_Raw "Override flag" VALUE 0x8cd60 RL_INPC_O_TP2_RAW 1.000000 CU_INPC_O_TP2_RAW 0.000000 1.000000 BYTE_ORDER MSB_FIRST /end CHARACTERISTIC
/begin RECORD_LAYOUT RL_INPC_O_TP2_RAW FNC_VALUES 1 UBYTE COLUMN_DIR DIRECT /end RECORD_LAYOUT
/begin COMPU_METHOD CU_INPC_O_TP2_RAW "Conversion method for INPc_o_TP2_Raw" RAT_FUNC "%10.0" "o" COEFFS 0.000000 1.000000 0.000000 0.000000 0.000000 1.000000 /end COMPU_METHOD
/* Scalar calibration for DDE 'INPc_o_TotalFuelLevel'. */
/begin CHARACTERISTIC INPc_o_TotalFuelLevel "Override flag" VALUE 0x8c198 RL_INPC_O_TOTALFUELLEVEL 1.000000 CU_INPC_O_TOTALFUELLEVEL 0.000000 1.000000 BYTE_ORDER MSB_FIRST /end CHARACTERISTIC
/begin RECORD_LAYOUT RL_INPC_O_TOTALFUELLEVEL FNC_VALUES 1 UBYTE COLUMN_DIR DIRECT /end RECORD_LAYOUT
/begin COMPU_METHOD CU_INPC_O_TOTALFUELLEVEL "Conversion method for INPc_o_TotalFuelLevel" RAT_FUNC "%10.0" "o" COEFFS 0.000000 1.000000 0.000000 0.000000 0.000000 1.000000 /end COMPU_METHOD
/* Scalar calibration for DDE 'INPc_o_TotalFuelLevel_L'. */
/begin CHARACTERISTIC INPc_o_TotalFuelLevel_L "Override flag" VALUE 0x8c1a8 RL_INPC_O_TOTALFUELLEVEL_L 1.000000 CU_INPC_O_TOTALFUELLEVEL_L 0.000000 1.000000 BYTE_ORDER MSB_FIRST /end CHARACTERISTIC
/begin RECORD_LAYOUT RL_INPC_O_TOTALFUELLEVEL_L FNC_VALUES 1 UBYTE COLUMN_DIR DIRECT /end RECORD_LAYOUT
/begin COMPU_METHOD CU_INPC_O_TOTALFUELLEVEL_L "Conversion method for INPc_o_TotalFuelLevel_L" RAT_FUNC "%10.0" "o" COEFFS 0.000000 1.000000 0.000000 0.000000 0.000000 1.000000 /end COMPU_METHOD
/* Scalar calibration for DDE 'INPc_o_TransGear'. */
/begin CHARACTERISTIC INPc_o_TransGear "Override flag" VALUE 0x8cdec RL_INPC_O_TRANSGEAR 1.000000 CU_INPC_O_TRANSGEAR 0.000000 1.000000 BYTE_ORDER MSB_FIRST /end CHARACTERISTIC
/begin RECORD_LAYOUT RL_INPC_O_TRANSGEAR FNC_VALUES 1 UBYTE COLUMN_DIR DIRECT /end RECORD_LAYOUT
/begin COMPU_METHOD CU_INPC_O_TRANSGEAR "Conversion method for INPc_o_TransGear" RAT_FUNC "%10.0" "o" COEFFS 0.000000 1.000000 0.000000 0.000000 0.000000 1.000000 /end COMPU_METHOD
/* Scalar calibration for DDE 'INPc_o_UEGO1'. */
/begin CHARACTERISTIC INPc_o_UEGO1 "Override flag" VALUE 0x8ce0c RL_INPC_O_UEGO1 1.000000 CU_INPC_O_UEGO1 0.000000 1.000000 BYTE_ORDER MSB_FIRST /end CHARACTERISTIC
/begin RECORD_LAYOUT RL_INPC_O_UEGO1 FNC_VALUES 1 UBYTE COLUMN_DIR DIRECT /end RECORD_LAYOUT
/begin COMPU_METHOD CU_INPC_O_UEGO1 "Conversion method for INPc_o_UEGO1" RAT_FUNC "%10.0" "o" COEFFS 0.000000 1.000000 0.000000 0.000000 0.000000 1.000000 /end COMPU_METHOD
/* Scalar calibration for DDE 'INPc_o_UEGO2'. */
/begin CHARACTERISTIC INPc_o_UEGO2 "Override flag" VALUE 0x8ce14 RL_INPC_O_UEGO2 1.000000 CU_INPC_O_UEGO2 0.000000 1.000000 BYTE_ORDER MSB_FIRST /end CHARACTERISTIC
/begin RECORD_LAYOUT RL_INPC_O_UEGO2 FNC_VALUES 1 UBYTE COLUMN_DIR DIRECT /end RECORD_LAYOUT
/begin COMPU_METHOD CU_INPC_O_UEGO2 "Conversion method for INPc_o_UEGO2" RAT_FUNC "%10.0" "o" COEFFS 0.000000 1.000000 0.000000 0.000000 0.000000 1.000000 /end COMPU_METHOD
/* Scalar calibration for DDE 'INPc_o_VBatt'. */
/begin CHARACTERISTIC INPc_o_VBatt "Override flag" VALUE 0x8cd48 RL_INPC_O_VBATT 1.000000 CU_INPC_O_VBATT 0.000000 1.000000 BYTE_ORDER MSB_FIRST /end CHARACTERISTIC
/begin RECORD_LAYOUT RL_INPC_O_VBATT FNC_VALUES 1 UBYTE COLUMN_DIR DIRECT /end RECORD_LAYOUT
/begin COMPU_METHOD CU_INPC_O_VBATT "Conversion method for INPc_o_VBatt" RAT_FUNC "%10.0" "o" COEFFS 0.000000 1.000000 0.000000 0.000000 0.000000 1.000000 /end COMPU_METHOD
/* Scalar calibration for DDE 'INPc_o_VCP_Pos'. */
/begin CHARACTERISTIC INPc_o_VCP_Pos "Override flag" VALUE 0x8cdb0 RL_INPC_O_VCP_POS 1.000000 CU_INPC_O_VCP_POS 0.000000 1.000000 BYTE_ORDER MSB_FIRST /end CHARACTERISTIC
/begin RECORD_LAYOUT RL_INPC_O_VCP_POS FNC_VALUES 1 UBYTE COLUMN_DIR DIRECT /end RECORD_LAYOUT
/begin COMPU_METHOD CU_INPC_O_VCP_POS "Conversion method for INPc_o_VCP_Pos" RAT_FUNC "%10.0" "o" COEFFS 0.000000 1.000000 0.000000 0.000000 0.000000 1.000000 /end COMPU_METHOD
/* Scalar calibration for DDE 'INPc_o_VehSpd'. */
/begin CHARACTERISTIC INPc_o_VehSpd "Override flag" VALUE 0x8cdd0 RL_INPC_O_VEHSPD 1.000000 CU_INPC_O_VEHSPD 0.000000 1.000000 BYTE_ORDER MSB_FIRST /end CHARACTERISTIC
/begin RECORD_LAYOUT RL_INPC_O_VEHSPD FNC_VALUES 1 UBYTE COLUMN_DIR DIRECT /end RECORD_LAYOUT
/begin COMPU_METHOD CU_INPC_O_VEHSPD "Conversion method for INPc_o_VehSpd" RAT_FUNC "%10.0" "o" COEFFS 0.000000 1.000000 0.000000 0.000000 0.000000 1.000000 /end COMPU_METHOD
/* Scalar calibration for DDE 'INPc_pct_AltLoad'. */
/begin CHARACTERISTIC INPc_pct_AltLoad "Override value" VALUE 0x8cdcc RL_INPC_PCT_ALTLOAD 1.000000 CU_INPC_PCT_ALTLOAD 0.000000 1.000000 BYTE_ORDER MSB_FIRST /end CHARACTERISTIC
/begin RECORD_LAYOUT RL_INPC_PCT_ALTLOAD FNC_VALUES 1 FLOAT32_IEEE COLUMN_DIR DIRECT /end RECORD_LAYOUT
/begin COMPU_METHOD CU_INPC_PCT_ALTLOAD "Conversion method for INPc_pct_AltLoad" RAT_FUNC "%10.3" "pct" COEFFS 0.000000 1.000000 0.000000 0.000000 0.000000 1.000000 /end COMPU_METHOD
/* Scalar calibration for DDE 'INPc_pct_Cylinder1_Knock'. */
/begin CHARACTERISTIC INPc_pct_Cylinder1_Knock "Override value" VALUE 0x8ce30 RL_INPC_PCT_CYLINDER1_KNOCK 2.000000 CU_INPC_PCT_CYLINDER1_KNOCK 0.000000 2.000000 BYTE_ORDER MSB_FIRST /end CHARACTERISTIC
/begin RECORD_LAYOUT RL_INPC_PCT_CYLINDER1_KNOCK FNC_VALUES 1 FLOAT32_IEEE COLUMN_DIR DIRECT /end RECORD_LAYOUT
/begin COMPU_METHOD CU_INPC_PCT_CYLINDER1_KNOCK "Conversion method for INPc_pct_Cylinder1_Knock" RAT_FUNC "%10.2" "pct" COEFFS 0.000000 1.000000 0.000000 0.000000 0.000000 1.000000 /end COMPU_METHOD
/* Scalar calibration for DDE 'INPc_pct_Cylinder2_Knock'. */
/begin CHARACTERISTIC INPc_pct_Cylinder2_Knock "Override value" VALUE 0x8cd6c RL_INPC_PCT_CYLINDER2_KNOCK 2.000000 CU_INPC_PCT_CYLINDER2_KNOCK 0.000000 2.000000 BYTE_ORDER MSB_FIRST /end CHARACTERISTIC
/begin RECORD_LAYOUT RL_INPC_PCT_CYLINDER2_KNOCK FNC_VALUES 1 FLOAT32_IEEE COLUMN_DIR DIRECT /end RECORD_LAYOUT
/begin COMPU_METHOD CU_INPC_PCT_CYLINDER2_KNOCK "Conversion method for INPc_pct_Cylinder2_Knock" RAT_FUNC "%10.2" "pct" COEFFS 0.000000 1.000000 0.000000 0.000000 0.000000 1.000000 /end COMPU_METHOD
/* Scalar calibration for DDE 'INPc_pct_Cylinder3_Knock'. */
/begin CHARACTERISTIC INPc_pct_Cylinder3_Knock "Override value" VALUE 0x8cd74 RL_INPC_PCT_CYLINDER3_KNOCK 2.000000 CU_INPC_PCT_CYLINDER3_KNOCK 0.000000 2.000000 BYTE_ORDER MSB_FIRST /end CHARACTERISTIC
/begin RECORD_LAYOUT RL_INPC_PCT_CYLINDER3_KNOCK FNC_VALUES 1 FLOAT32_IEEE COLUMN_DIR DIRECT /end RECORD_LAYOUT
/begin COMPU_METHOD CU_INPC_PCT_CYLINDER3_KNOCK "Conversion method for INPc_pct_Cylinder3_Knock" RAT_FUNC "%10.2" "pct" COEFFS 0.000000 1.000000 0.000000 0.000000 0.000000 1.000000 /end COMPU_METHOD
/* Scalar calibration for DDE 'INPc_pct_Cylinder4_Knock'. */
/begin CHARACTERISTIC INPc_pct_Cylinder4_Knock "Override value" VALUE 0x8cd7c RL_INPC_PCT_CYLINDER4_KNOCK 2.000000 CU_INPC_PCT_CYLINDER4_KNOCK 0.000000 2.000000 BYTE_ORDER MSB_FIRST /end CHARACTERISTIC
/begin RECORD_LAYOUT RL_INPC_PCT_CYLINDER4_KNOCK FNC_VALUES 1 FLOAT32_IEEE COLUMN_DIR DIRECT /end RECORD_LAYOUT
/begin COMPU_METHOD CU_INPC_PCT_CYLINDER4_KNOCK "Conversion method for INPc_pct_Cylinder4_Knock" RAT_FUNC "%10.2" "pct" COEFFS 0.000000 1.000000 0.000000 0.000000 0.000000 1.000000 /end COMPU_METHOD
/* Scalar calibration for DDE 'INPc_pct_GLPLevel1'. */
/begin CHARACTERISTIC INPc_pct_GLPLevel1 "Override value" VALUE 0x8c1a4 RL_INPC_PCT_GLPLEVEL1 200.000000 CU_INPC_PCT_GLPLEVEL1 0.000000 200.000000 BYTE_ORDER MSB_FIRST /end CHARACTERISTIC
/begin RECORD_LAYOUT RL_INPC_PCT_GLPLEVEL1 FNC_VALUES 1 FLOAT32_IEEE COLUMN_DIR DIRECT /end RECORD_LAYOUT
/begin COMPU_METHOD CU_INPC_PCT_GLPLEVEL1 "Conversion method for INPc_pct_GLPLevel1" RAT_FUNC "%10.2" "V" COEFFS 0.000000 1.000000 0.000000 0.000000 0.000000 1.000000 /end COMPU_METHOD
/* Scalar calibration for DDE 'INPc_pct_GLPLevel2'. */
/begin CHARACTERISTIC INPc_pct_GLPLevel2 "Override value" VALUE 0x8c170 RL_INPC_PCT_GLPLEVEL2 200.000000 CU_INPC_PCT_GLPLEVEL2 0.000000 200.000000 BYTE_ORDER MSB_FIRST /end CHARACTERISTIC
/begin RECORD_LAYOUT RL_INPC_PCT_GLPLEVEL2 FNC_VALUES 1 FLOAT32_IEEE COLUMN_DIR DIRECT /end RECORD_LAYOUT
/begin COMPU_METHOD CU_INPC_PCT_GLPLEVEL2 "Conversion method for INPc_pct_GLPLevel2" RAT_FUNC "%10.2" "V" COEFFS 0.000000 1.000000 0.000000 0.000000 0.000000 1.000000 /end COMPU_METHOD
/* Scalar calibration for DDE 'INPc_pct_NeutralRatioHigh'. */
/begin CHARACTERISTIC INPc_pct_NeutralRatioHigh "Ratio to treat as neutral for gear estimation thresholds" VALUE 0x8cdf4 RL_INPC_PCT_NEUTRALRATIOHIGH 0.000000 CU_INPC_PCT_NEUTRALRATIOHIGH 5.000000 5.000000 BYTE_ORDER MSB_FIRST /end CHARACTERISTIC
/begin RECORD_LAYOUT RL_INPC_PCT_NEUTRALRATIOHIGH FNC_VALUES 1 FLOAT32_IEEE COLUMN_DIR DIRECT /end RECORD_LAYOUT
/begin COMPU_METHOD CU_INPC_PCT_NEUTRALRATIOHIGH "Conversion method for INPc_pct_NeutralRatioHigh" RAT_FUNC "%10.0" "pct" COEFFS 0.000000 1.000000 0.000000 0.000000 0.000000 1.000000 /end COMPU_METHOD
/* Scalar calibration for DDE 'INPc_pct_NeutralRatioLow'. */
/begin CHARACTERISTIC INPc_pct_NeutralRatioLow "Ratio to treat as neutral for gear estimation thresholds" VALUE 0x8cdf0 RL_INPC_PCT_NEUTRALRATIOLOW 0.000000 CU_INPC_PCT_NEUTRALRATIOLOW 0.600000 0.600000 BYTE_ORDER MSB_FIRST /end CHARACTERISTIC
/begin RECORD_LAYOUT RL_INPC_PCT_NEUTRALRATIOLOW FNC_VALUES 1 FLOAT32_IEEE COLUMN_DIR DIRECT /end RECORD_LAYOUT
/begin COMPU_METHOD CU_INPC_PCT_NEUTRALRATIOLOW "Conversion method for INPc_pct_NeutralRatioLow" RAT_FUNC "%10.0" "pct" COEFFS 0.000000 1.000000 0.000000 0.000000 0.000000 1.000000 /end COMPU_METHOD
/* Scalar calibration for DDE 'INPc_pct_PrefiltTotalFuelLevel'. */
/begin CHARACTERISTIC INPc_pct_PrefiltTotalFuelLevel "Override value" VALUE 0x8c194 RL_INPC_PCT_PREFILTTOTALFUELLE0 150.000000 CU_INPC_PCT_PREFILTTOTALFUELLE0 0.000000 150.000000 BYTE_ORDER MSB_FIRST /end CHARACTERISTIC
/begin RECORD_LAYOUT RL_INPC_PCT_PREFILTTOTALFUELLE0 FNC_VALUES 1 FLOAT32_IEEE COLUMN_DIR DIRECT /end RECORD_LAYOUT
/begin COMPU_METHOD CU_INPC_PCT_PREFILTTOTALFUELLE0 "Conversion method for INPc_pct_PrefiltTotalFuelLevel" RAT_FUNC "%10.2" "pct" COEFFS 0.000000 1.000000 0.000000 0.000000 0.000000 1.000000 /end COMPU_METHOD
/* Scalar calibration for DDE 'INPc_pct_TotalFuelLevel'. */
/begin CHARACTERISTIC INPc_pct_TotalFuelLevel "Override value" VALUE 0x8c19c RL_INPC_PCT_TOTALFUELLEVEL 150.000000 CU_INPC_PCT_TOTALFUELLEVEL 0.000000 150.000000 BYTE_ORDER MSB_FIRST /end CHARACTERISTIC
/begin RECORD_LAYOUT RL_INPC_PCT_TOTALFUELLEVEL FNC_VALUES 1 FLOAT32_IEEE COLUMN_DIR DIRECT /end RECORD_LAYOUT
/begin COMPU_METHOD CU_INPC_PCT_TOTALFUELLEVEL "Conversion method for INPc_pct_TotalFuelLevel" RAT_FUNC "%10.2" "pct" COEFFS 0.000000 1.000000 0.000000 0.000000 0.000000 1.000000 /end COMPU_METHOD
/* Scalar calibration for DDE 'INPc_ret_VCP_Pos'. */
/begin CHARACTERISTIC INPc_ret_VCP_Pos "Override value" VALUE 0x8cdb4 RL_INPC_RET_VCP_POS 240.000000 CU_INPC_RET_VCP_POS -120.000000 120.000000 BYTE_ORDER MSB_FIRST /end CHARACTERISTIC
/begin RECORD_LAYOUT RL_INPC_RET_VCP_POS FNC_VALUES 1 FLOAT32_IEEE COLUMN_DIR DIRECT /end RECORD_LAYOUT
/begin COMPU_METHOD CU_INPC_RET_VCP_POS "Conversion method for INPc_ret_VCP_Pos" RAT_FUNC "%10.2" "ret" COEFFS 0.000000 1.000000 0.000000 0.000000 0.000000 1.000000 /end COMPU_METHOD
/* Scalar calibration for DDE 'INPc_s_DelayEnableMis'. */
/begin CHARACTERISTIC INPc_s_DelayEnableMis "Retardo mínimo activación DTC enable missfire" VALUE 0x8c4b0 RL_INPC_S_DELAYENABLEMIS 1000.000000 CU_INPC_S_DELAYENABLEMIS 0.000000 1000.000000 BYTE_ORDER MSB_FIRST /end CHARACTERISTIC
/begin RECORD_LAYOUT RL_INPC_S_DELAYENABLEMIS FNC_VALUES 1 FLOAT32_IEEE COLUMN_DIR DIRECT /end RECORD_LAYOUT
/begin COMPU_METHOD CU_INPC_S_DELAYENABLEMIS "Conversion method for INPc_s_DelayEnableMis" RAT_FUNC "%10.0" "s" COEFFS 0.000000 1.000000 0.000000 0.000000 0.000000 1.000000 /end COMPU_METHOD
/* Scalar calibration for DDE 'INPc_s_MisfireDelay'. */
/begin CHARACTERISTIC INPc_s_MisfireDelay "Retardo mínimo activación DTC errores missfire" VALUE 0x8c4b8 RL_INPC_S_MISFIREDELAY 1000.000000 CU_INPC_S_MISFIREDELAY 0.000000 1000.000000 BYTE_ORDER MSB_FIRST /end CHARACTERISTIC
/begin RECORD_LAYOUT RL_INPC_S_MISFIREDELAY FNC_VALUES 1 FLOAT32_IEEE COLUMN_DIR DIRECT /end RECORD_LAYOUT
/begin COMPU_METHOD CU_INPC_S_MISFIREDELAY "Conversion method for INPc_s_MisfireDelay" RAT_FUNC "%10.2" "s" COEFFS 0.000000 1.000000 0.000000 0.000000 0.000000 1.000000 /end COMPU_METHOD
/* Vector/array calibration for DDE 'INPv_deg_CamTeethPositionsRaw'. */
/begin CHARACTERISTIC INPv_deg_CamTeethPositionsRaw "Measured cam edge position" VAL_BLK 0x40008d7c RL_INPV_DEG_CAMTEETHPOSITIONSR0 2880.000000 CU_INPV_DEG_CAMTEETHPOSITIONSR0 -1440.000000 1440.000000 NUMBER 5 BYTE_ORDER MSB_FIRST /end CHARACTERISTIC
/begin RECORD_LAYOUT RL_INPV_DEG_CAMTEETHPOSITIONSR0 FNC_VALUES 1 FLOAT32_IEEE COLUMN_DIR DIRECT /end RECORD_LAYOUT
/begin COMPU_METHOD CU_INPV_DEG_CAMTEETHPOSITIONSR0 "Conversion method for INPv_deg_CamTeethPositionsRaw" RAT_FUNC "%10.1" "deg" COEFFS 0.000000 1.000000 0.000000 0.000000 0.000000 1.000000 /end COMPU_METHOD
/* Vector/array calibration for DDE 'INPv_pct_GearRatios'. */
/begin CHARACTERISTIC INPv_pct_GearRatios "Theoretical transmission gear ratios" VAL_BLK 0x8cdf8 RL_INPV_PCT_GEARRATIOS 10.000000 CU_INPV_PCT_GEARRATIOS 0.000000 10.000000 NUMBER 5 BYTE_ORDER MSB_FIRST /end CHARACTERISTIC
/begin RECORD_LAYOUT RL_INPV_PCT_GEARRATIOS FNC_VALUES 1 FLOAT32_IEEE COLUMN_DIR DIRECT /end RECORD_LAYOUT
/begin COMPU_METHOD CU_INPV_PCT_GEARRATIOS "Conversion method for INPv_pct_GearRatios" RAT_FUNC "%10.2" "pct" COEFFS 0.000000 1.000000 0.000000 0.000000 0.000000 1.000000 /end COMPU_METHOD
/* Scalar calibration for DDE 'KNKc_adv_AdvanceStep'. */
/begin CHARACTERISTIC KNKc_adv_AdvanceStep "Spark advance step after knock stops" VALUE 0x819f4 RL_KNKC_ADV_ADVANCESTEP 5.000000 CU_KNKC_ADV_ADVANCESTEP 0.000000 5.000000 BYTE_ORDER MSB_FIRST /end CHARACTERISTIC
/begin RECORD_LAYOUT RL_KNKC_ADV_ADVANCESTEP FNC_VALUES 1 FLOAT32_IEEE COLUMN_DIR DIRECT /end RECORD_LAYOUT
/begin COMPU_METHOD CU_KNKC_ADV_ADVANCESTEP "Conversion method for KNKc_adv_AdvanceStep" RAT_FUNC "%10.2" "adv" COEFFS 0.000000 1.000000 0.000000 0.000000 0.000000 1.000000 /end COMPU_METHOD
/* Scalar calibration for DDE 'KNKc_b_Enbl'. */
/begin CHARACTERISTIC KNKc_b_Enbl "Feature enable flag" VALUE 0x84c00 RL_KNKC_B_ENBL 1.000000 CU_KNKC_B_ENBL 0.000000 1.000000 BYTE_ORDER MSB_FIRST /end CHARACTERISTIC
/begin RECORD_LAYOUT RL_KNKC_B_ENBL FNC_VALUES 1 UBYTE COLUMN_DIR DIRECT /end RECORD_LAYOUT
/begin COMPU_METHOD CU_KNKC_B_ENBL "Conversion method for KNKc_b_Enbl" RAT_FUNC "%10.0" "b" COEFFS 0.000000 1.000000 0.000000 0.000000 0.000000 1.000000 /end COMPU_METHOD
/* Scalar calibration for DDE 'KNKc_lam_AFR_Lim'. */
/begin CHARACTERISTIC KNKc_lam_AFR_Lim "AFR limit override value" VALUE 0x8be58 RL_KNKC_LAM_AFR_LIM 1.200000 CU_KNKC_LAM_AFR_LIM 0.800000 2.000000 BYTE_ORDER MSB_FIRST /end CHARACTERISTIC
/begin RECORD_LAYOUT RL_KNKC_LAM_AFR_LIM FNC_VALUES 1 FLOAT32_IEEE COLUMN_DIR DIRECT /end RECORD_LAYOUT
/begin COMPU_METHOD CU_KNKC_LAM_AFR_LIM "Conversion method for KNKc_lam_AFR_Lim" RAT_FUNC "%10.2" "lam" COEFFS 0.000000 1.000000 0.000000 0.000000 0.000000 1.000000 /end COMPU_METHOD
/* Scalar calibration for DDE 'KNKc_lam_AntiKnock'. */
/begin CHARACTERISTIC KNKc_lam_AntiKnock "Lambda-maximum applied when KNK enrichment is active" VALUE 0x8be5c RL_KNKC_LAM_ANTIKNOCK 0.400000 CU_KNKC_LAM_ANTIKNOCK 0.400000 0.800000 BYTE_ORDER MSB_FIRST /end CHARACTERISTIC
/begin RECORD_LAYOUT RL_KNKC_LAM_ANTIKNOCK FNC_VALUES 1 FLOAT32_IEEE COLUMN_DIR DIRECT /end RECORD_LAYOUT
/begin COMPU_METHOD CU_KNKC_LAM_ANTIKNOCK "Conversion method for KNKc_lam_AntiKnock" RAT_FUNC "%10.2" "lam" COEFFS 0.000000 1.000000 0.000000 0.000000 0.000000 1.000000 /end COMPU_METHOD
/* Scalar calibration for DDE 'KNKc_o_AFR_Lim'. */
/begin CHARACTERISTIC KNKc_o_AFR_Lim "AFR limit override flag" VALUE 0x8be54 RL_KNKC_O_AFR_LIM 1.000000 CU_KNKC_O_AFR_LIM 0.000000 1.000000 BYTE_ORDER MSB_FIRST /end CHARACTERISTIC
/begin RECORD_LAYOUT RL_KNKC_O_AFR_LIM FNC_VALUES 1 UBYTE COLUMN_DIR DIRECT /end RECORD_LAYOUT
/begin COMPU_METHOD CU_KNKC_O_AFR_LIM "Conversion method for KNKc_o_AFR_Lim" RAT_FUNC "%10.0" "b" COEFFS 0.000000 1.000000 0.000000 0.000000 0.000000 1.000000 /end COMPU_METHOD
/* Scalar calibration for DDE 'KNKc_o_SparkMod'. */
/begin CHARACTERISTIC KNKc_o_SparkMod "Knock spark modifier override flag" VALUE 0x84bf8 RL_KNKC_O_SPARKMOD 1.000000 CU_KNKC_O_SPARKMOD 0.000000 1.000000 BYTE_ORDER MSB_FIRST /end CHARACTERISTIC
/begin RECORD_LAYOUT RL_KNKC_O_SPARKMOD FNC_VALUES 1 UBYTE COLUMN_DIR DIRECT /end RECORD_LAYOUT
/begin COMPU_METHOD CU_KNKC_O_SPARKMOD "Conversion method for KNKc_o_SparkMod" RAT_FUNC "%10.0" "b" COEFFS 0.000000 1.000000 0.000000 0.000000 0.000000 1.000000 /end COMPU_METHOD
/* Scalar calibration for DDE 'KNKc_pct_LoadDetectionThers'. */
/begin CHARACTERISTIC KNKc_pct_LoadDetectionThers "Thershold Knocking detection on" VALUE 0x819b8 RL_KNKC_PCT_LOADDETECTIONTHERS 1.000000 CU_KNKC_PCT_LOADDETECTIONTHERS 0.000000 1.000000 BYTE_ORDER MSB_FIRST /end CHARACTERISTIC
/begin RECORD_LAYOUT RL_KNKC_PCT_LOADDETECTIONTHERS FNC_VALUES 1 FLOAT32_IEEE COLUMN_DIR DIRECT /end RECORD_LAYOUT
/begin COMPU_METHOD CU_KNKC_PCT_LOADDETECTIONTHERS "Conversion method for KNKc_pct_LoadDetectionThers" RAT_FUNC "%10.3" "pct" COEFFS 0.000000 1.000000 0.000000 0.000000 0.000000 1.000000 /end COMPU_METHOD
/* Scalar calibration for DDE 'KNKc_ret_SensorBasedMax'. */
/begin CHARACTERISTIC KNKc_ret_SensorBasedMax "Max sensor based spark retard" VALUE 0x819ec RL_KNKC_RET_SENSORBASEDMAX 15.000000 CU_KNKC_RET_SENSORBASEDMAX 0.000000 15.000000 BYTE_ORDER MSB_FIRST /end CHARACTERISTIC
/begin RECORD_LAYOUT RL_KNKC_RET_SENSORBASEDMAX FNC_VALUES 1 FLOAT32_IEEE COLUMN_DIR DIRECT /end RECORD_LAYOUT
/begin COMPU_METHOD CU_KNKC_RET_SENSORBASEDMAX "Conversion method for KNKc_ret_SensorBasedMax" RAT_FUNC "%10.2" "ret" COEFFS 0.000000 1.000000 0.000000 0.000000 0.000000 1.000000 /end COMPU_METHOD
/* Scalar calibration for DDE 'KNKc_ret_SparkMod'. */
/begin CHARACTERISTIC KNKc_ret_SparkMod "Knock spark modifier override value" VALUE 0x84bfc RL_KNKC_RET_SPARKMOD 40.000000 CU_KNKC_RET_SPARKMOD -40.000000 0.000000 BYTE_ORDER MSB_FIRST /end CHARACTERISTIC
/begin RECORD_LAYOUT RL_KNKC_RET_SPARKMOD FNC_VALUES 1 FLOAT32_IEEE COLUMN_DIR DIRECT /end RECORD_LAYOUT
/begin COMPU_METHOD CU_KNKC_RET_SPARKMOD "Conversion method for KNKc_ret_SparkMod" RAT_FUNC "%10.2" "ret" COEFFS 0.000000 1.000000 0.000000 0.000000 0.000000 1.000000 /end COMPU_METHOD
/* Scalar calibration for DDE 'KNKc_ret_SparkModMax'. */
/begin CHARACTERISTIC KNKc_ret_SparkModMax "Maximum amount of KNK spark offset" VALUE 0x84c04 RL_KNKC_RET_SPARKMODMAX 15.000000 CU_KNKC_RET_SPARKMODMAX 0.000000 15.000000 BYTE_ORDER MSB_FIRST /end CHARACTERISTIC
/begin RECORD_LAYOUT RL_KNKC_RET_SPARKMODMAX FNC_VALUES 1 FLOAT32_IEEE COLUMN_DIR DIRECT /end RECORD_LAYOUT
/begin COMPU_METHOD CU_KNKC_RET_SPARKMODMAX "Conversion method for KNKc_ret_SparkModMax" RAT_FUNC "%10.1" "ret" COEFFS 0.000000 1.000000 0.000000 0.000000 0.000000 1.000000 /end COMPU_METHOD
/* Scalar calibration for DDE 'KNKc_s_RetardHoldTime'. */
/begin CHARACTERISTIC KNKc_s_RetardHoldTime "Hold spark retard after knock stops" VALUE 0x819f0 RL_KNKC_S_RETARDHOLDTIME 2.000000 CU_KNKC_S_RETARDHOLDTIME 0.000000 2.000000 BYTE_ORDER MSB_FIRST /end CHARACTERISTIC
/begin RECORD_LAYOUT RL_KNKC_S_RETARDHOLDTIME FNC_VALUES 1 FLOAT32_IEEE COLUMN_DIR DIRECT /end RECORD_LAYOUT
/begin COMPU_METHOD CU_KNKC_S_RETARDHOLDTIME "Conversion method for KNKc_s_RetardHoldTime" RAT_FUNC "%10.3" "s" COEFFS 0.000000 1.000000 0.000000 0.000000 0.000000 1.000000 /end COMPU_METHOD
/* Map (1d) calibration for DDE 'KNKm_NU_EngSpdCorr_z'. */
/begin CHARACTERISTIC KNKm_NU_EngSpdCorr_z "Engine Speed correction gain for Ignition Retard Angle z-axis" CURVE 0x84be0 RL_KNKM_NU_ENGSPDCORR_Z 4.900000 CU_KNKM_NU_ENGSPDCORR_Z 0.100000 5.000000
 /begin AXIS_DESCR COM_AXIS NO_INPUT_QUANTITY CU_KNKM_NU_ENGSPDCORR_X 6 -10000.000000 10000.000000 AXIS_PTS_REF APD_KNKM_NU_ENGSPDCORR_X /end AXIS_DESCR
 BYTE_ORDER MSB_FIRST /end CHARACTERISTIC
/begin RECORD_LAYOUT RL_KNKM_NU_ENGSPDCORR_Z FNC_VALUES 1 FLOAT32_IEEE COLUMN_DIR DIRECT /end RECORD_LAYOUT
/begin COMPU_METHOD CU_KNKM_NU_ENGSPDCORR_Z "Conversion method for KNKm_NU_EngSpdCorr_z" RAT_FUNC "%10.2" "pct" COEFFS 0.000000 1.000000 0.000000 0.000000 0.000000 1.000000 /end COMPU_METHOD
/begin AXIS_PTS APD_KNKM_NU_ENGSPDCORR_X "Engine Speed correction gain for Ignition Retard Angle x-axis  (EngSpd)" 0x84bc8 NO_INPUT_QUANTITY RL_KNKM_NU_ENGSPDCORR_X 20000.000000 CU_KNKM_NU_ENGSPDCORR_X 6 -10000.0 10000.0 BYTE_ORDER MSB_FIRST /end AXIS_PTS
/begin RECORD_LAYOUT RL_KNKM_NU_ENGSPDCORR_X AXIS_PTS_X 1 FLOAT32_IEEE INDEX_INCR DIRECT /end RECORD_LAYOUT
/begin COMPU_METHOD CU_KNKM_NU_ENGSPDCORR_X "Conversion method for KNKm_NU_EngSpdCorr_x" RAT_FUNC "%10.2" "RPM" COEFFS 0.000000 1.000000 0.000000 0.000000 0.000000 1.000000 /end COMPU_METHOD
/* Map (1d) calibration for DDE 'KNKm_NU_RetardStep_z'. */
/begin CHARACTERISTIC KNKm_NU_RetardStep_z "Table for initial KNK retard step" CURVE 0x819d4 RL_KNKM_NU_RETARDSTEP_Z 15.000000 CU_KNKM_NU_RETARDSTEP_Z 0.000000 15.000000
 /begin AXIS_DESCR COM_AXIS NO_INPUT_QUANTITY CU_KNKM_NU_RETARDSTEP_X 6 0.000000 10000.000000 AXIS_PTS_REF APD_KNKM_NU_RETARDSTEP_X /end AXIS_DESCR
 BYTE_ORDER MSB_FIRST /end CHARACTERISTIC
/begin RECORD_LAYOUT RL_KNKM_NU_RETARDSTEP_Z FNC_VALUES 1 FLOAT32_IEEE COLUMN_DIR DIRECT /end RECORD_LAYOUT
/begin COMPU_METHOD CU_KNKM_NU_RETARDSTEP_Z "Conversion method for KNKm_NU_RetardStep_z" RAT_FUNC "%10.2" "ret" COEFFS 0.000000 1.000000 0.000000 0.000000 0.000000 1.000000 /end COMPU_METHOD
/begin AXIS_PTS APD_KNKM_NU_RETARDSTEP_X "Table for initial KNK retard step" 0x819bc NO_INPUT_QUANTITY RL_KNKM_NU_RETARDSTEP_X 10000.000000 CU_KNKM_NU_RETARDSTEP_X 6 0.0 10000.0 BYTE_ORDER MSB_FIRST /end AXIS_PTS
/begin RECORD_LAYOUT RL_KNKM_NU_RETARDSTEP_X AXIS_PTS_X 1 FLOAT32_IEEE INDEX_INCR DIRECT /end RECORD_LAYOUT
/begin COMPU_METHOD CU_KNKM_NU_RETARDSTEP_X "Conversion method for KNKm_NU_RetardStep_x" RAT_FUNC "%10.0" "RPM" COEFFS 0.000000 1.000000 0.000000 0.000000 0.000000 1.000000 /end COMPU_METHOD
/* Map (2d) calibration for DDE 'KNKm_NU_SparkRetard_z'. */
/begin CHARACTERISTIC KNKm_NU_SparkRetard_z "Ignition Retard Angle z-axis" MAP 0x84b38 RL_KNKM_NU_SPARKRETARD_Z 50.000000 CU_KNKM_NU_SPARKRETARD_Z 0.000000 50.000000
 /begin AXIS_DESCR COM_AXIS AME_C_ChargeTemp CU_KNKM_NU_SPARKRETARD_X 6 -100.000000 500.000000 AXIS_PTS_REF APD_KNKM_NU_SPARKRETARD_X /end AXIS_DESCR
 /begin AXIS_DESCR COM_AXIS BAF_mg_FuelRqst1 CU_KNKM_NU_SPARKRETARD_Y 6 0.000000 100.000000 AXIS_PTS_REF APD_KNKM_NU_SPARKRETARD_Y /end AXIS_DESCR
 BYTE_ORDER MSB_FIRST /end CHARACTERISTIC
/begin RECORD_LAYOUT RL_KNKM_NU_SPARKRETARD_Z FNC_VALUES 1 FLOAT32_IEEE COLUMN_DIR DIRECT /end RECORD_LAYOUT
/begin COMPU_METHOD CU_KNKM_NU_SPARKRETARD_Z "Conversion method for KNKm_NU_SparkRetard_z" RAT_FUNC "%10.1" "ret" COEFFS 0.000000 1.000000 0.000000 0.000000 0.000000 1.000000 /end COMPU_METHOD
/begin AXIS_PTS APD_KNKM_NU_SPARKRETARD_X "Ignition Retard Angle x-axis Charge Temp" 0x84b08 AME_C_ChargeTemp RL_KNKM_NU_SPARKRETARD_X 600.000000 CU_KNKM_NU_SPARKRETARD_X 6 -100.0 500.0 BYTE_ORDER MSB_FIRST /end AXIS_PTS
/begin RECORD_LAYOUT RL_KNKM_NU_SPARKRETARD_X AXIS_PTS_X 1 FLOAT32_IEEE INDEX_INCR DIRECT /end RECORD_LAYOUT
/begin COMPU_METHOD CU_KNKM_NU_SPARKRETARD_X "Conversion method for KNKm_NU_SparkRetard_x" RAT_FUNC "%10.0" "C" COEFFS 0.000000 1.000000 0.000000 0.000000 0.000000 1.000000 /end COMPU_METHOD
/begin AXIS_PTS APD_KNKM_NU_SPARKRETARD_Y "Ignition Retard Angle y-axis Fuel Mass from TRF" 0x84b20 BAF_mg_FuelRqst1 RL_KNKM_NU_SPARKRETARD_Y 100.000000 CU_KNKM_NU_SPARKRETARD_Y 6 0.0 100.0 BYTE_ORDER MSB_FIRST /end AXIS_PTS
/begin RECORD_LAYOUT RL_KNKM_NU_SPARKRETARD_Y AXIS_PTS_X 1 FLOAT32_IEEE INDEX_INCR DIRECT /end RECORD_LAYOUT
/begin COMPU_METHOD CU_KNKM_NU_SPARKRETARD_Y "Conversion method for KNKm_NU_SparkRetard_y" RAT_FUNC "%10.0" "mg" COEFFS 0.000000 1.000000 0.000000 0.000000 0.000000 1.000000 /end COMPU_METHOD
/* Map (1d) calibration for DDE 'KNKm_pct_DetectionThresh_z'. */
/begin CHARACTERISTIC KNKm_pct_DetectionThresh_z "Knock signal threshold for knock detection" CURVE 0x819a0 RL_KNKM_PCT_DETECTIONTHRESH_Z 5.000000 CU_KNKM_PCT_DETECTIONTHRESH_Z 0.000000 5.000000
 /begin AXIS_DESCR COM_AXIS NO_INPUT_QUANTITY CU_KNKM_PCT_DETECTIONTHRESH_X 6 0.000000 10000.000000 AXIS_PTS_REF APD_KNKM_PCT_DETECTIONTHRESH_X /end AXIS_DESCR
 BYTE_ORDER MSB_FIRST /end CHARACTERISTIC
/begin RECORD_LAYOUT RL_KNKM_PCT_DETECTIONTHRESH_Z FNC_VALUES 1 FLOAT32_IEEE COLUMN_DIR DIRECT /end RECORD_LAYOUT
/begin COMPU_METHOD CU_KNKM_PCT_DETECTIONTHRESH_Z "Conversion method for KNKm_pct_DetectionThresh_z" RAT_FUNC "%10.2" "pct" COEFFS 0.000000 1.000000 0.000000 0.000000 0.000000 1.000000 /end COMPU_METHOD
/begin AXIS_PTS APD_KNKM_PCT_DETECTIONTHRESH_X "(Eng Spd) Knock signal threshold for knock detection x-axis" 0x81988 NO_INPUT_QUANTITY RL_KNKM_PCT_DETECTIONTHRESH_X 10000.000000 CU_KNKM_PCT_DETECTIONTHRESH_X 6 0.0 10000.0 BYTE_ORDER MSB_FIRST /end AXIS_PTS
/begin RECORD_LAYOUT RL_KNKM_PCT_DETECTIONTHRESH_X AXIS_PTS_X 1 FLOAT32_IEEE INDEX_INCR DIRECT /end RECORD_LAYOUT
/begin COMPU_METHOD CU_KNKM_PCT_DETECTIONTHRESH_X "Conversion method for KNKm_pct_DetectionThresh_x" RAT_FUNC "%10.2" "RPM" COEFFS 0.000000 1.000000 0.000000 0.000000 0.000000 1.000000 /end COMPU_METHOD
/* Scalar calibration for DDE 'LAMc_C_SensorTempValidThresh_A'. */
/begin CHARACTERISTIC LAMc_C_SensorTempValidThresh_A "Sensor temperature threshold that Lambda calculation is considered valid" VALUE 0x8d784 RL_LAMC_C_SENSORTEMPVALIDTHRES0 1000.000000 CU_LAMC_C_SENSORTEMPVALIDTHRES0 0.000000 1000.000000 BYTE_ORDER MSB_FIRST /end CHARACTERISTIC
/begin RECORD_LAYOUT RL_LAMC_C_SENSORTEMPVALIDTHRES0 FNC_VALUES 1 FLOAT32_IEEE COLUMN_DIR DIRECT /end RECORD_LAYOUT
/begin COMPU_METHOD CU_LAMC_C_SENSORTEMPVALIDTHRES0 "Conversion method for LAMc_C_SensorTempValidThresh_A" RAT_FUNC "%10.1" "C" COEFFS 0.000000 1.000000 0.000000 0.000000 0.000000 1.000000 /end COMPU_METHOD
/* Scalar calibration for DDE 'LAMc_C_SensorTempValidThresh_B'. */
/begin CHARACTERISTIC LAMc_C_SensorTempValidThresh_B "Sensor temperature threshold that Lambda calculation is considered valid" VALUE 0x8d780 RL_LAMC_C_SENSORTEMPVALIDTHRES1 1000.000000 CU_LAMC_C_SENSORTEMPVALIDTHRES1 0.000000 1000.000000 BYTE_ORDER MSB_FIRST /end CHARACTERISTIC
/begin RECORD_LAYOUT RL_LAMC_C_SENSORTEMPVALIDTHRES1 FNC_VALUES 1 FLOAT32_IEEE COLUMN_DIR DIRECT /end RECORD_LAYOUT
/begin COMPU_METHOD CU_LAMC_C_SENSORTEMPVALIDTHRES1 "Conversion method for LAMc_C_SensorTempValidThresh_B" RAT_FUNC "%10.1" "C" COEFFS 0.000000 1.000000 0.000000 0.000000 0.000000 1.000000 /end COMPU_METHOD
/* Scalar calibration for DDE 'LAMc_NU_AmpFactorHyst_A'. */
/begin CHARACTERISTIC LAMc_NU_AmpFactorHyst_A "Lambda hysteresis value used for switching the amplification factor" VALUE 0x8d77c RL_LAMC_NU_AMPFACTORHYST_A 1.000000 CU_LAMC_NU_AMPFACTORHYST_A 0.000000 1.000000 BYTE_ORDER MSB_FIRST /end CHARACTERISTIC
/begin RECORD_LAYOUT RL_LAMC_NU_AMPFACTORHYST_A FNC_VALUES 1 FLOAT32_IEEE COLUMN_DIR DIRECT /end RECORD_LAYOUT
/begin COMPU_METHOD CU_LAMC_NU_AMPFACTORHYST_A "Conversion method for LAMc_NU_AmpFactorHyst_A" RAT_FUNC "%10.3" "NU" COEFFS 0.000000 1.000000 0.000000 0.000000 0.000000 1.000000 /end COMPU_METHOD
/* Scalar calibration for DDE 'LAMc_NU_AmpFactorHyst_B'. */
/begin CHARACTERISTIC LAMc_NU_AmpFactorHyst_B "Lambda hysteresis value used for switching the amplification factor" VALUE 0x8d778 RL_LAMC_NU_AMPFACTORHYST_B 1.000000 CU_LAMC_NU_AMPFACTORHYST_B 0.000000 1.000000 BYTE_ORDER MSB_FIRST /end CHARACTERISTIC
/begin RECORD_LAYOUT RL_LAMC_NU_AMPFACTORHYST_B FNC_VALUES 1 FLOAT32_IEEE COLUMN_DIR DIRECT /end RECORD_LAYOUT
/begin COMPU_METHOD CU_LAMC_NU_AMPFACTORHYST_B "Conversion method for LAMc_NU_AmpFactorHyst_B" RAT_FUNC "%10.3" "NU" COEFFS 0.000000 1.000000 0.000000 0.000000 0.000000 1.000000 /end COMPU_METHOD
/* Map (1d) calibration for DDE 'LAMm_NU_LambdaA_z'. */
/begin CHARACTERISTIC LAMm_NU_LambdaA_z "Calculated Lambda value" CURVE 0x8d6b8 RL_LAMM_NU_LAMBDAA_Z 100.000000 CU_LAMM_NU_LAMBDAA_Z 0.000000 100.000000
 /begin AXIS_DESCR COM_AXIS LAM_mA_Ip_A CU_LAMM_NU_LAMBDAA_X 24 -5.000000 5.000000 AXIS_PTS_REF APD_LAMM_NU_LAMBDAA_X /end AXIS_DESCR
 BYTE_ORDER MSB_FIRST /end CHARACTERISTIC
/begin RECORD_LAYOUT RL_LAMM_NU_LAMBDAA_Z FNC_VALUES 1 FLOAT32_IEEE COLUMN_DIR DIRECT /end RECORD_LAYOUT
/begin COMPU_METHOD CU_LAMM_NU_LAMBDAA_Z "Conversion method for LAMm_NU_LambdaA_z" RAT_FUNC "%10.3" "NU" COEFFS 0.000000 1.000000 0.000000 0.000000 0.000000 1.000000 /end COMPU_METHOD
/begin AXIS_PTS APD_LAMM_NU_LAMBDAA_X "Ip, Current in Nerse cell index for Lambda value" 0x8d718 LAM_mA_Ip_A RL_LAMM_NU_LAMBDAA_X 10.000000 CU_LAMM_NU_LAMBDAA_X 24 -5.0 5.0 BYTE_ORDER MSB_FIRST /end AXIS_PTS
/begin RECORD_LAYOUT RL_LAMM_NU_LAMBDAA_X AXIS_PTS_X 1 FLOAT32_IEEE INDEX_INCR DIRECT /end RECORD_LAYOUT
/begin COMPU_METHOD CU_LAMM_NU_LAMBDAA_X "Conversion method for LAMm_NU_LambdaA_x" RAT_FUNC "%10.3" "NU" COEFFS 0.000000 1.000000 0.000000 0.000000 0.000000 1.000000 /end COMPU_METHOD
/* Map (1d) calibration for DDE 'LAMm_NU_LambdaB_z'. */
/begin CHARACTERISTIC LAMm_NU_LambdaB_z "Calculated Lambda value" CURVE 0x8d5f8 RL_LAMM_NU_LAMBDAB_Z 100.000000 CU_LAMM_NU_LAMBDAB_Z 0.000000 100.000000
 /begin AXIS_DESCR COM_AXIS LAM_mA_Ip_B CU_LAMM_NU_LAMBDAB_X 24 -5.000000 5.000000 AXIS_PTS_REF APD_LAMM_NU_LAMBDAB_X /end AXIS_DESCR
 BYTE_ORDER MSB_FIRST /end CHARACTERISTIC
/begin RECORD_LAYOUT RL_LAMM_NU_LAMBDAB_Z FNC_VALUES 1 FLOAT32_IEEE COLUMN_DIR DIRECT /end RECORD_LAYOUT
/begin COMPU_METHOD CU_LAMM_NU_LAMBDAB_Z "Conversion method for LAMm_NU_LambdaB_z" RAT_FUNC "%10.3" "NU" COEFFS 0.000000 1.000000 0.000000 0.000000 0.000000 1.000000 /end COMPU_METHOD
/begin AXIS_PTS APD_LAMM_NU_LAMBDAB_X "Ip, Current in Nerse cell index for Lambda value" 0x8d658 LAM_mA_Ip_B RL_LAMM_NU_LAMBDAB_X 10.000000 CU_LAMM_NU_LAMBDAB_X 24 -5.0 5.0 BYTE_ORDER MSB_FIRST /end AXIS_PTS
/begin RECORD_LAYOUT RL_LAMM_NU_LAMBDAB_X AXIS_PTS_X 1 FLOAT32_IEEE INDEX_INCR DIRECT /end RECORD_LAYOUT
/begin COMPU_METHOD CU_LAMM_NU_LAMBDAB_X "Conversion method for LAMm_NU_LambdaB_x" RAT_FUNC "%10.3" "NU" COEFFS 0.000000 1.000000 0.000000 0.000000 0.000000 1.000000 /end COMPU_METHOD
/* Scalar calibration for DDE 'LOGc_NU_EEC14_FuelType'. */
/begin CHARACTERISTIC LOGc_NU_EEC14_FuelType "(not defined)" VALUE 0x8be94 RL_LOGC_NU_EEC14_FUELTYPE 255.000000 CU_LOGC_NU_EEC14_FUELTYPE 0.000000 255.000000 BYTE_ORDER MSB_FIRST /end CHARACTERISTIC
/begin RECORD_LAYOUT RL_LOGC_NU_EEC14_FUELTYPE FNC_VALUES 1 FLOAT32_IEEE COLUMN_DIR DIRECT /end RECORD_LAYOUT
/begin COMPU_METHOD CU_LOGC_NU_EEC14_FUELTYPE "Conversion method for LOGc_NU_EEC14_FuelType" RAT_FUNC "%10.0" "NU" COEFFS 0.000000 1.000000 0.000000 0.000000 0.000000 1.000000 /end COMPU_METHOD
/* Scalar calibration for DDE 'LOGc_NU_ManualPump'. */
/begin CHARACTERISTIC LOGc_NU_ManualPump "Manual Value of Throttle Angle Correction" VALUE 0x8d0c8 RL_LOGC_NU_MANUALPUMP 2.000000 CU_LOGC_NU_MANUALPUMP 0.000000 2.000000 BYTE_ORDER MSB_FIRST /end CHARACTERISTIC
/begin RECORD_LAYOUT RL_LOGC_NU_MANUALPUMP FNC_VALUES 1 ULONG COLUMN_DIR DIRECT /end RECORD_LAYOUT
/begin COMPU_METHOD CU_LOGC_NU_MANUALPUMP "Conversion method for LOGc_NU_ManualPump" RAT_FUNC "%10.0" "NU" COEFFS 0.000000 1.000000 0.000000 0.000000 0.000000 1.000000 /end COMPU_METHOD
/* Scalar calibration for DDE 'LOGc_PWM_BLOWER'. */
/begin CHARACTERISTIC LOGc_PWM_BLOWER "Duty Cycle blower" VALUE 0x8d278 RL_LOGC_PWM_BLOWER 1.000000 CU_LOGC_PWM_BLOWER 0.000000 1.000000 BYTE_ORDER MSB_FIRST /end CHARACTERISTIC
/begin RECORD_LAYOUT RL_LOGC_PWM_BLOWER FNC_VALUES 1 FLOAT32_IEEE COLUMN_DIR DIRECT /end RECORD_LAYOUT
/begin COMPU_METHOD CU_LOGC_PWM_BLOWER "Conversion method for LOGc_PWM_BLOWER" RAT_FUNC "%10.2" "V" COEFFS 0.000000 1.000000 0.000000 0.000000 0.000000 1.000000 /end COMPU_METHOD
/* Scalar calibration for DDE 'LOGc_PWM_PUMP'. */
/begin CHARACTERISTIC LOGc_PWM_PUMP "Duty Cycle blower" VALUE 0x8d264 RL_LOGC_PWM_PUMP 1.000000 CU_LOGC_PWM_PUMP 0.000000 1.000000 BYTE_ORDER MSB_FIRST /end CHARACTERISTIC
/begin RECORD_LAYOUT RL_LOGC_PWM_PUMP FNC_VALUES 1 FLOAT32_IEEE COLUMN_DIR DIRECT /end RECORD_LAYOUT
/begin COMPU_METHOD CU_LOGC_PWM_PUMP "Conversion method for LOGc_PWM_PUMP" RAT_FUNC "%10.2" "V" COEFFS 0.000000 1.000000 0.000000 0.000000 0.000000 1.000000 /end COMPU_METHOD
/* Scalar calibration for DDE 'LOGc_b_ACC1_gen'. */
/begin CHARACTERISTIC LOGc_b_ACC1_gen "Allow generated ACC1 menssage for gearbox performance" VALUE 0x8bdf4 RL_LOGC_B_ACC1_GEN 1.000000 CU_LOGC_B_ACC1_GEN 0.000000 1.000000 BYTE_ORDER MSB_FIRST /end CHARACTERISTIC
/begin RECORD_LAYOUT RL_LOGC_B_ACC1_GEN FNC_VALUES 1 UBYTE COLUMN_DIR DIRECT /end RECORD_LAYOUT
/begin COMPU_METHOD CU_LOGC_B_ACC1_GEN "Conversion method for LOGc_b_ACC1_gen" RAT_FUNC "%10.0" "b" COEFFS 0.000000 1.000000 0.000000 0.000000 0.000000 1.000000 /end COMPU_METHOD
/* Scalar calibration for DDE 'LOGc_b_AEBS1_gen'. */
/begin CHARACTERISTIC LOGc_b_AEBS1_gen "Allow generated AEBS1 menssage for gearbox performance" VALUE 0x8bdf5 RL_LOGC_B_AEBS1_GEN 1.000000 CU_LOGC_B_AEBS1_GEN 0.000000 1.000000 BYTE_ORDER MSB_FIRST /end CHARACTERISTIC
/begin RECORD_LAYOUT RL_LOGC_B_AEBS1_GEN FNC_VALUES 1 UBYTE COLUMN_DIR DIRECT /end RECORD_LAYOUT
/begin COMPU_METHOD CU_LOGC_B_AEBS1_GEN "Conversion method for LOGc_b_AEBS1_gen" RAT_FUNC "%10.0" "b" COEFFS 0.000000 1.000000 0.000000 0.000000 0.000000 1.000000 /end COMPU_METHOD
/* Scalar calibration for DDE 'LOGc_b_EC1_CANA_ena'. */
/begin CHARACTERISTIC LOGc_b_EC1_CANA_ena "(not defined)" VALUE 0x8be88 RL_LOGC_B_EC1_CANA_ENA 1.000000 CU_LOGC_B_EC1_CANA_ENA 0.000000 1.000000 BYTE_ORDER MSB_FIRST /end CHARACTERISTIC
/begin RECORD_LAYOUT RL_LOGC_B_EC1_CANA_ENA FNC_VALUES 1 UBYTE COLUMN_DIR DIRECT /end RECORD_LAYOUT
/begin COMPU_METHOD CU_LOGC_B_EC1_CANA_ENA "Conversion method for LOGc_b_EC1_CANA_ena" RAT_FUNC "%10.0" "b" COEFFS 0.000000 1.000000 0.000000 0.000000 0.000000 1.000000 /end COMPU_METHOD
/* Scalar calibration for DDE 'LOGc_b_ENBOBD'. */
/begin CHARACTERISTIC LOGc_b_ENBOBD "Duty Cycle blower" VALUE 0x8ce63 RL_LOGC_B_ENBOBD 1.000000 CU_LOGC_B_ENBOBD 0.000000 1.000000 BYTE_ORDER MSB_FIRST /end CHARACTERISTIC
/begin RECORD_LAYOUT RL_LOGC_B_ENBOBD FNC_VALUES 1 UBYTE COLUMN_DIR DIRECT /end RECORD_LAYOUT
/begin COMPU_METHOD CU_LOGC_B_ENBOBD "Conversion method for LOGc_b_ENBOBD" RAT_FUNC "%10.0" "b" COEFFS 0.000000 1.000000 0.000000 0.000000 0.000000 1.000000 /end COMPU_METHOD
/* Scalar calibration for DDE 'LOGc_b_EnableCanLog'. */
/begin CHARACTERISTIC LOGc_b_EnableCanLog "Enable Log data to be transmitted on 1000K bus" VALUE 0x878e4 RL_LOGC_B_ENABLECANLOG 1.000000 CU_LOGC_B_ENABLECANLOG 0.000000 1.000000 BYTE_ORDER MSB_FIRST /end CHARACTERISTIC
/begin RECORD_LAYOUT RL_LOGC_B_ENABLECANLOG FNC_VALUES 1 UBYTE COLUMN_DIR DIRECT /end RECORD_LAYOUT
/begin COMPU_METHOD CU_LOGC_B_ENABLECANLOG "Conversion method for LOGc_b_EnableCanLog" RAT_FUNC "%10.0" "b" COEFFS 0.000000 1.000000 0.000000 0.000000 0.000000 1.000000 /end COMPU_METHOD
/* Scalar calibration for DDE 'LOGc_b_EnableDM1'. */
/begin CHARACTERISTIC LOGc_b_EnableDM1 "Duty Cycle blower" VALUE 0x8ce73 RL_LOGC_B_ENABLEDM1 1.000000 CU_LOGC_B_ENABLEDM1 0.000000 1.000000 BYTE_ORDER MSB_FIRST /end CHARACTERISTIC
/begin RECORD_LAYOUT RL_LOGC_B_ENABLEDM1 FNC_VALUES 1 UBYTE COLUMN_DIR DIRECT /end RECORD_LAYOUT
/begin COMPU_METHOD CU_LOGC_B_ENABLEDM1 "Conversion method for LOGc_b_EnableDM1" RAT_FUNC "%10.0" "b" COEFFS 0.000000 1.000000 0.000000 0.000000 0.000000 1.000000 /end COMPU_METHOD
/* Scalar calibration for DDE 'LOGc_b_ML_gen'. */
/begin CHARACTERISTIC LOGc_b_ML_gen "Allow generated ML menssage for gearbox performance" VALUE 0x8bdf6 RL_LOGC_B_ML_GEN 1.000000 CU_LOGC_B_ML_GEN 0.000000 1.000000 BYTE_ORDER MSB_FIRST /end CHARACTERISTIC
/begin RECORD_LAYOUT RL_LOGC_B_ML_GEN FNC_VALUES 1 UBYTE COLUMN_DIR DIRECT /end RECORD_LAYOUT
/begin COMPU_METHOD CU_LOGC_B_ML_GEN "Conversion method for LOGc_b_ML_gen" RAT_FUNC "%10.0" "b" COEFFS 0.000000 1.000000 0.000000 0.000000 0.000000 1.000000 /end COMPU_METHOD
/* Scalar calibration for DDE 'LOGc_b_RelePump1'. */
/begin CHARACTERISTIC LOGc_b_RelePump1 "(not defined)" VALUE 0x8d0dd RL_LOGC_B_RELEPUMP1 1.000000 CU_LOGC_B_RELEPUMP1 0.000000 1.000000 BYTE_ORDER MSB_FIRST /end CHARACTERISTIC
/begin RECORD_LAYOUT RL_LOGC_B_RELEPUMP1 FNC_VALUES 1 UBYTE COLUMN_DIR DIRECT /end RECORD_LAYOUT
/begin COMPU_METHOD CU_LOGC_B_RELEPUMP1 "Conversion method for LOGc_b_RelePump1" RAT_FUNC "%10.0" "b" COEFFS 0.000000 1.000000 0.000000 0.000000 0.000000 1.000000 /end COMPU_METHOD
/* Scalar calibration for DDE 'LOGc_b_RelePump2'. */
/begin CHARACTERISTIC LOGc_b_RelePump2 "(not defined)" VALUE 0x8d0df RL_LOGC_B_RELEPUMP2 1.000000 CU_LOGC_B_RELEPUMP2 0.000000 1.000000 BYTE_ORDER MSB_FIRST /end CHARACTERISTIC
/begin RECORD_LAYOUT RL_LOGC_B_RELEPUMP2 FNC_VALUES 1 UBYTE COLUMN_DIR DIRECT /end RECORD_LAYOUT
/begin COMPU_METHOD CU_LOGC_B_RELEPUMP2 "Conversion method for LOGc_b_RelePump2" RAT_FUNC "%10.0" "b" COEFFS 0.000000 1.000000 0.000000 0.000000 0.000000 1.000000 /end COMPU_METHOD
/* Scalar calibration for DDE 'LOGc_b_VDC1_gen'. */
/begin CHARACTERISTIC LOGc_b_VDC1_gen "Allow generated VDC1 menssage for gearbox performance" VALUE 0x8bdf7 RL_LOGC_B_VDC1_GEN 1.000000 CU_LOGC_B_VDC1_GEN 0.000000 1.000000 BYTE_ORDER MSB_FIRST /end CHARACTERISTIC
/begin RECORD_LAYOUT RL_LOGC_B_VDC1_GEN FNC_VALUES 1 UBYTE COLUMN_DIR DIRECT /end RECORD_LAYOUT
/begin COMPU_METHOD CU_LOGC_B_VDC1_GEN "Conversion method for LOGc_b_VDC1_gen" RAT_FUNC "%10.0" "b" COEFFS 0.000000 1.000000 0.000000 0.000000 0.000000 1.000000 /end COMPU_METHOD
/* Scalar calibration for DDE 'LOGc_b_VDC2_gen'. */
/begin CHARACTERISTIC LOGc_b_VDC2_gen "Allow generated VDC2 menssage for gearbox performance" VALUE 0x8bdf8 RL_LOGC_B_VDC2_GEN 1.000000 CU_LOGC_B_VDC2_GEN 0.000000 1.000000 BYTE_ORDER MSB_FIRST /end CHARACTERISTIC
/begin RECORD_LAYOUT RL_LOGC_B_VDC2_GEN FNC_VALUES 1 UBYTE COLUMN_DIR DIRECT /end RECORD_LAYOUT
/begin COMPU_METHOD CU_LOGC_B_VDC2_GEN "Conversion method for LOGc_b_VDC2_gen" RAT_FUNC "%10.0" "b" COEFFS 0.000000 1.000000 0.000000 0.000000 0.000000 1.000000 /end COMPU_METHOD
/* Scalar calibration for DDE 'LOGc_b_VDHR_gen'. */
/begin CHARACTERISTIC LOGc_b_VDHR_gen "Allow generated VDHR menssage for gearbox performance" VALUE 0x8bdf9 RL_LOGC_B_VDHR_GEN 1.000000 CU_LOGC_B_VDHR_GEN 0.000000 1.000000 BYTE_ORDER MSB_FIRST /end CHARACTERISTIC
/begin RECORD_LAYOUT RL_LOGC_B_VDHR_GEN FNC_VALUES 1 UBYTE COLUMN_DIR DIRECT /end RECORD_LAYOUT
/begin COMPU_METHOD CU_LOGC_B_VDHR_GEN "Conversion method for LOGc_b_VDHR_gen" RAT_FUNC "%10.0" "b" COEFFS 0.000000 1.000000 0.000000 0.000000 0.000000 1.000000 /end COMPU_METHOD
/* Scalar calibration for DDE 'LOGc_b_ZF_Auto'. */
/begin CHARACTERISTIC LOGc_b_ZF_Auto "(not defined)" VALUE 0x8bd89 RL_LOGC_B_ZF_AUTO 1.000000 CU_LOGC_B_ZF_AUTO 0.000000 1.000000 BYTE_ORDER MSB_FIRST /end CHARACTERISTIC
/begin RECORD_LAYOUT RL_LOGC_B_ZF_AUTO FNC_VALUES 1 UBYTE COLUMN_DIR DIRECT /end RECORD_LAYOUT
/begin COMPU_METHOD CU_LOGC_B_ZF_AUTO "Conversion method for LOGc_b_ZF_Auto" RAT_FUNC "%10.0" "b" COEFFS 0.000000 1.000000 0.000000 0.000000 0.000000 1.000000 /end COMPU_METHOD
/* Scalar calibration for DDE 'LOGc_b_ZF_auto_ena'. */
/begin CHARACTERISTIC LOGc_b_ZF_auto_ena "(not defined)" VALUE 0x8bd8a RL_LOGC_B_ZF_AUTO_ENA 1.000000 CU_LOGC_B_ZF_AUTO_ENA 0.000000 1.000000 BYTE_ORDER MSB_FIRST /end CHARACTERISTIC
/begin RECORD_LAYOUT RL_LOGC_B_ZF_AUTO_ENA FNC_VALUES 1 UBYTE COLUMN_DIR DIRECT /end RECORD_LAYOUT
/begin COMPU_METHOD CU_LOGC_B_ZF_AUTO_ENA "Conversion method for LOGc_b_ZF_auto_ena" RAT_FUNC "%10.0" "b" COEFFS 0.000000 1.000000 0.000000 0.000000 0.000000 1.000000 /end COMPU_METHOD
/* Scalar calibration for DDE 'LOGc_b_ZF_man_ena'. */
/begin CHARACTERISTIC LOGc_b_ZF_man_ena "(not defined)" VALUE 0x8be90 RL_LOGC_B_ZF_MAN_ENA 1.000000 CU_LOGC_B_ZF_MAN_ENA 0.000000 1.000000 BYTE_ORDER MSB_FIRST /end CHARACTERISTIC
/begin RECORD_LAYOUT RL_LOGC_B_ZF_MAN_ENA FNC_VALUES 1 UBYTE COLUMN_DIR DIRECT /end RECORD_LAYOUT
/begin COMPU_METHOD CU_LOGC_B_ZF_MAN_ENA "Conversion method for LOGc_b_ZF_man_ena" RAT_FUNC "%10.0" "b" COEFFS 0.000000 1.000000 0.000000 0.000000 0.000000 1.000000 /end COMPU_METHOD
/* Scalar calibration for DDE 'LOGc_o_BLOWER'. */
/begin CHARACTERISTIC LOGc_o_BLOWER "Override value" VALUE 0x8d2ac RL_LOGC_O_BLOWER 1.000000 CU_LOGC_O_BLOWER 0.000000 1.000000 BYTE_ORDER MSB_FIRST /end CHARACTERISTIC
/begin RECORD_LAYOUT RL_LOGC_O_BLOWER FNC_VALUES 1 UBYTE COLUMN_DIR DIRECT /end RECORD_LAYOUT
/begin COMPU_METHOD CU_LOGC_O_BLOWER "Conversion method for LOGc_o_BLOWER" RAT_FUNC "%10.0" "b" COEFFS 0.000000 1.000000 0.000000 0.000000 0.000000 1.000000 /end COMPU_METHOD
/* Scalar calibration for DDE 'LOGc_o_ENBOBD'. */
/begin CHARACTERISTIC LOGc_o_ENBOBD "Override value" VALUE 0x8ce62 RL_LOGC_O_ENBOBD 1.000000 CU_LOGC_O_ENBOBD 0.000000 1.000000 BYTE_ORDER MSB_FIRST /end CHARACTERISTIC
/begin RECORD_LAYOUT RL_LOGC_O_ENBOBD FNC_VALUES 1 UBYTE COLUMN_DIR DIRECT /end RECORD_LAYOUT
/begin COMPU_METHOD CU_LOGC_O_ENBOBD "Conversion method for LOGc_o_ENBOBD" RAT_FUNC "%10.0" "b" COEFFS 0.000000 1.000000 0.000000 0.000000 0.000000 1.000000 /end COMPU_METHOD
/* Scalar calibration for DDE 'LOGc_o_ManualPump'. */
/begin CHARACTERISTIC LOGc_o_ManualPump "Override signal for Throttle Angle Correction" VALUE 0x8d0c4 RL_LOGC_O_MANUALPUMP 1.000000 CU_LOGC_O_MANUALPUMP 0.000000 1.000000 BYTE_ORDER MSB_FIRST /end CHARACTERISTIC
/begin RECORD_LAYOUT RL_LOGC_O_MANUALPUMP FNC_VALUES 1 UBYTE COLUMN_DIR DIRECT /end RECORD_LAYOUT
/begin COMPU_METHOD CU_LOGC_O_MANUALPUMP "Conversion method for LOGc_o_ManualPump" RAT_FUNC "%10.0" "o" COEFFS 0.000000 1.000000 0.000000 0.000000 0.000000 1.000000 /end COMPU_METHOD
/* Scalar calibration for DDE 'LOGc_o_PUMP'. */
/begin CHARACTERISTIC LOGc_o_PUMP "Override value" VALUE 0x8d2ab RL_LOGC_O_PUMP 1.000000 CU_LOGC_O_PUMP 0.000000 1.000000 BYTE_ORDER MSB_FIRST /end CHARACTERISTIC
/begin RECORD_LAYOUT RL_LOGC_O_PUMP FNC_VALUES 1 UBYTE COLUMN_DIR DIRECT /end RECORD_LAYOUT
/begin COMPU_METHOD CU_LOGC_O_PUMP "Conversion method for LOGc_o_PUMP" RAT_FUNC "%10.0" "b" COEFFS 0.000000 1.000000 0.000000 0.000000 0.000000 1.000000 /end COMPU_METHOD
/* Scalar calibration for DDE 'LOGc_o_RelePump1'. */
/begin CHARACTERISTIC LOGc_o_RelePump1 "(not defined)" VALUE 0x8d0dc RL_LOGC_O_RELEPUMP1 1.000000 CU_LOGC_O_RELEPUMP1 0.000000 1.000000 BYTE_ORDER MSB_FIRST /end CHARACTERISTIC
/begin RECORD_LAYOUT RL_LOGC_O_RELEPUMP1 FNC_VALUES 1 UBYTE COLUMN_DIR DIRECT /end RECORD_LAYOUT
/begin COMPU_METHOD CU_LOGC_O_RELEPUMP1 "Conversion method for LOGc_o_RelePump1" RAT_FUNC "%10.0" "o" COEFFS 0.000000 1.000000 0.000000 0.000000 0.000000 1.000000 /end COMPU_METHOD
/* Scalar calibration for DDE 'LOGc_o_RelePump2'. */
/begin CHARACTERISTIC LOGc_o_RelePump2 "(not defined)" VALUE 0x8d0de RL_LOGC_O_RELEPUMP2 1.000000 CU_LOGC_O_RELEPUMP2 0.000000 1.000000 BYTE_ORDER MSB_FIRST /end CHARACTERISTIC
/begin RECORD_LAYOUT RL_LOGC_O_RELEPUMP2 FNC_VALUES 1 UBYTE COLUMN_DIR DIRECT /end RECORD_LAYOUT
/begin COMPU_METHOD CU_LOGC_O_RELEPUMP2 "Conversion method for LOGc_o_RelePump2" RAT_FUNC "%10.0" "o" COEFFS 0.000000 1.000000 0.000000 0.000000 0.000000 1.000000 /end COMPU_METHOD
/* Scalar calibration for DDE 'LOGc_o_ZF_Auto'. */
/begin CHARACTERISTIC LOGc_o_ZF_Auto "(not defined)" VALUE 0x8bd88 RL_LOGC_O_ZF_AUTO 1.000000 CU_LOGC_O_ZF_AUTO 0.000000 1.000000 BYTE_ORDER MSB_FIRST /end CHARACTERISTIC
/begin RECORD_LAYOUT RL_LOGC_O_ZF_AUTO FNC_VALUES 1 UBYTE COLUMN_DIR DIRECT /end RECORD_LAYOUT
/begin COMPU_METHOD CU_LOGC_O_ZF_AUTO "Conversion method for LOGc_o_ZF_Auto" RAT_FUNC "%10.0" "o" COEFFS 0.000000 1.000000 0.000000 0.000000 0.000000 1.000000 /end COMPU_METHOD
/* Scalar calibration for DDE 'LOGc_s_ResMisfCounter'. */
/begin CHARACTERISTIC LOGc_s_ResMisfCounter "Message transmit rate" VALUE 0x8c4b4 RL_LOGC_S_RESMISFCOUNTER 100000.000000 CU_LOGC_S_RESMISFCOUNTER 0.000000 100000.000000 BYTE_ORDER MSB_FIRST /end CHARACTERISTIC
/begin RECORD_LAYOUT RL_LOGC_S_RESMISFCOUNTER FNC_VALUES 1 FLOAT32_IEEE COLUMN_DIR DIRECT /end RECORD_LAYOUT
/begin COMPU_METHOD CU_LOGC_S_RESMISFCOUNTER "Conversion method for LOGc_s_ResMisfCounter" RAT_FUNC "%10.1" "s" COEFFS 0.000000 1.000000 0.000000 0.000000 0.000000 1.000000 /end COMPU_METHOD
/* Scalar calibration for DDE 'LOGc_s_SDG01_Period'. */
/begin CHARACTERISTIC LOGc_s_SDG01_Period "Message transmit rate" VALUE 0x8d2a4 RL_LOGC_S_SDG01_PERIOD 10.000000 CU_LOGC_S_SDG01_PERIOD 0.000000 10.000000 BYTE_ORDER MSB_FIRST /end CHARACTERISTIC
/begin RECORD_LAYOUT RL_LOGC_S_SDG01_PERIOD FNC_VALUES 1 FLOAT32_IEEE COLUMN_DIR DIRECT /end RECORD_LAYOUT
/begin COMPU_METHOD CU_LOGC_S_SDG01_PERIOD "Conversion method for LOGc_s_SDG01_Period" RAT_FUNC "%10.3" "s" COEFFS 0.000000 1.000000 0.000000 0.000000 0.000000 1.000000 /end COMPU_METHOD
/* Scalar calibration for DDE 'LOGc_s_TFrames'. */
/begin CHARACTERISTIC LOGc_s_TFrames "(not defined)" VALUE 0x8be8c RL_LOGC_S_TFRAMES 10.000000 CU_LOGC_S_TFRAMES 0.000000 10.000000 BYTE_ORDER MSB_FIRST /end CHARACTERISTIC
/begin RECORD_LAYOUT RL_LOGC_S_TFRAMES FNC_VALUES 1 FLOAT32_IEEE COLUMN_DIR DIRECT /end RECORD_LAYOUT
/begin COMPU_METHOD CU_LOGC_S_TFRAMES "Conversion method for LOGc_s_TFrames" RAT_FUNC "%10.3" "s" COEFFS 0.000000 1.000000 0.000000 0.000000 0.000000 1.000000 /end COMPU_METHOD
/* Scalar calibration for DDE 'MaxCruiseTorque_Nm'. */
/begin CHARACTERISTIC MaxCruiseTorque_Nm "CAL PID" VALUE 0x831b0 RL_MAXCRUISETORQUE_NM 20000.000000 CU_MAXCRUISETORQUE_NM -10000.000000 10000.000000 BYTE_ORDER MSB_FIRST /end CHARACTERISTIC
/begin RECORD_LAYOUT RL_MAXCRUISETORQUE_NM FNC_VALUES 1 FLOAT32_IEEE COLUMN_DIR DIRECT /end RECORD_LAYOUT
/begin COMPU_METHOD CU_MAXCRUISETORQUE_NM "Conversion method for MaxCruiseTorque_Nm" RAT_FUNC "%10.2" "V" COEFFS 0.000000 1.000000 0.000000 0.000000 0.000000 1.000000 /end COMPU_METHOD
/* Scalar calibration for DDE 'MinCruiseTorque_Nm'. */
/begin CHARACTERISTIC MinCruiseTorque_Nm "CAL PID" VALUE 0x831b4 RL_MINCRUISETORQUE_NM 20000.000000 CU_MINCRUISETORQUE_NM -10000.000000 10000.000000 BYTE_ORDER MSB_FIRST /end CHARACTERISTIC
/begin RECORD_LAYOUT RL_MINCRUISETORQUE_NM FNC_VALUES 1 FLOAT32_IEEE COLUMN_DIR DIRECT /end RECORD_LAYOUT
/begin COMPU_METHOD CU_MINCRUISETORQUE_NM "Conversion method for MinCruiseTorque_Nm" RAT_FUNC "%10.2" "V" COEFFS 0.000000 1.000000 0.000000 0.000000 0.000000 1.000000 /end COMPU_METHOD
/* Scalar calibration for DDE 'NVMc_NU_CyclesDflt'. */
/begin CHARACTERISTIC NVMc_NU_CyclesDflt "(not defined)" VALUE 0x91d04 RL_NVMC_NU_CYCLESDFLT 4294967295.000000 CU_NVMC_NU_CYCLESDFLT 0.000000 4294967295.000000 BYTE_ORDER MSB_FIRST /end CHARACTERISTIC
/begin RECORD_LAYOUT RL_NVMC_NU_CYCLESDFLT FNC_VALUES 1 FLOAT32_IEEE COLUMN_DIR DIRECT /end RECORD_LAYOUT
/begin COMPU_METHOD CU_NVMC_NU_CYCLESDFLT "Conversion method for NVMc_NU_CyclesDflt" RAT_FUNC "%10.0" "NU" COEFFS 0.000000 1.000000 0.000000 0.000000 0.000000 1.000000 /end COMPU_METHOD
/* Scalar calibration for DDE 'NVMc_NU_DistanceCounterDflt'. */
/begin CHARACTERISTIC NVMc_NU_DistanceCounterDflt "(not defined)" VALUE 0x91d0c RL_NVMC_NU_DISTANCECOUNTERDFLT 4294967295.000000 CU_NVMC_NU_DISTANCECOUNTERDFLT 0.000000 4294967295.000000 BYTE_ORDER MSB_FIRST /end CHARACTERISTIC
/begin RECORD_LAYOUT RL_NVMC_NU_DISTANCECOUNTERDFLT FNC_VALUES 1 FLOAT32_IEEE COLUMN_DIR DIRECT /end RECORD_LAYOUT
/begin COMPU_METHOD CU_NVMC_NU_DISTANCECOUNTERDFLT "Conversion method for NVMc_NU_DistanceCounterDflt" RAT_FUNC "%10.2" "s" COEFFS 0.000000 1.000000 0.000000 0.000000 0.000000 1.000000 /end COMPU_METHOD
/* Scalar calibration for DDE 'NVMc_NU_DistanceCounterMILDflt'. */
/begin CHARACTERISTIC NVMc_NU_DistanceCounterMILDflt "(not defined)" VALUE 0x91d10 RL_NVMC_NU_DISTANCECOUNTERMILD0 4294967295.000000 CU_NVMC_NU_DISTANCECOUNTERMILD0 0.000000 4294967295.000000 BYTE_ORDER MSB_FIRST /end CHARACTERISTIC
/begin RECORD_LAYOUT RL_NVMC_NU_DISTANCECOUNTERMILD0 FNC_VALUES 1 FLOAT32_IEEE COLUMN_DIR DIRECT /end RECORD_LAYOUT
/begin COMPU_METHOD CU_NVMC_NU_DISTANCECOUNTERMILD0 "Conversion method for NVMc_NU_DistanceCounterMILDflt" RAT_FUNC "%10.2" "s" COEFFS 0.000000 1.000000 0.000000 0.000000 0.000000 1.000000 /end COMPU_METHOD
/* Scalar calibration for DDE 'NVMc_NU_EngineRuntimeDflt'. */
/begin CHARACTERISTIC NVMc_NU_EngineRuntimeDflt "(not defined)" VALUE 0x91d08 RL_NVMC_NU_ENGINERUNTIMEDFLT 4294967295.000000 CU_NVMC_NU_ENGINERUNTIMEDFLT 0.000000 4294967295.000000 BYTE_ORDER MSB_FIRST /end CHARACTERISTIC
/begin RECORD_LAYOUT RL_NVMC_NU_ENGINERUNTIMEDFLT FNC_VALUES 1 FLOAT32_IEEE COLUMN_DIR DIRECT /end RECORD_LAYOUT
/begin COMPU_METHOD CU_NVMC_NU_ENGINERUNTIMEDFLT "Conversion method for NVMc_NU_EngineRuntimeDflt" RAT_FUNC "%10.2" "s" COEFFS 0.000000 1.000000 0.000000 0.000000 0.000000 1.000000 /end COMPU_METHOD
/* Scalar calibration for DDE 'NVMc_NU_EngineRuntimeDflt2'. */
/begin CHARACTERISTIC NVMc_NU_EngineRuntimeDflt2 "(not defined)" VALUE 0x91d14 RL_NVMC_NU_ENGINERUNTIMEDFLT2 4294967295.000000 CU_NVMC_NU_ENGINERUNTIMEDFLT2 0.000000 4294967295.000000 BYTE_ORDER MSB_FIRST /end CHARACTERISTIC
/begin RECORD_LAYOUT RL_NVMC_NU_ENGINERUNTIMEDFLT2 FNC_VALUES 1 FLOAT32_IEEE COLUMN_DIR DIRECT /end RECORD_LAYOUT
/begin COMPU_METHOD CU_NVMC_NU_ENGINERUNTIMEDFLT2 "Conversion method for NVMc_NU_EngineRuntimeDflt2" RAT_FUNC "%10.2" "s" COEFFS 0.000000 1.000000 0.000000 0.000000 0.000000 1.000000 /end COMPU_METHOD
/* Scalar calibration for DDE 'NVMc_NU_HOURSDflt'. */
/begin CHARACTERISTIC NVMc_NU_HOURSDflt "(not defined)" VALUE 0x91d18 RL_NVMC_NU_HOURSDFLT 4294967295.000000 CU_NVMC_NU_HOURSDFLT 0.000000 4294967295.000000 BYTE_ORDER MSB_FIRST /end CHARACTERISTIC
/begin RECORD_LAYOUT RL_NVMC_NU_HOURSDFLT FNC_VALUES 1 FLOAT32_IEEE COLUMN_DIR DIRECT /end RECORD_LAYOUT
/begin COMPU_METHOD CU_NVMC_NU_HOURSDFLT "Conversion method for NVMc_NU_HOURSDflt" RAT_FUNC "%10.2" "s" COEFFS 0.000000 1.000000 0.000000 0.000000 0.000000 1.000000 /end COMPU_METHOD
/* Scalar calibration for DDE 'NVMc_NU_MILcontinousDflt'. */
/begin CHARACTERISTIC NVMc_NU_MILcontinousDflt "(not defined)" VALUE 0x91d1c RL_NVMC_NU_MILCONTINOUSDFLT 4294967295.000000 CU_NVMC_NU_MILCONTINOUSDFLT 0.000000 4294967295.000000 BYTE_ORDER MSB_FIRST /end CHARACTERISTIC
/begin RECORD_LAYOUT RL_NVMC_NU_MILCONTINOUSDFLT FNC_VALUES 1 FLOAT32_IEEE COLUMN_DIR DIRECT /end RECORD_LAYOUT
/begin COMPU_METHOD CU_NVMC_NU_MILCONTINOUSDFLT "Conversion method for NVMc_NU_MILcontinousDflt" RAT_FUNC "%10.2" "s" COEFFS 0.000000 1.000000 0.000000 0.000000 0.000000 1.000000 /end COMPU_METHOD
/* Scalar calibration for DDE 'NVMc_NU_WarmCyclesCounterDflt'. */
/begin CHARACTERISTIC NVMc_NU_WarmCyclesCounterDflt "(not defined)" VALUE 0x918dc RL_NVMC_NU_WARMCYCLESCOUNTERDF0 4294967295.000000 CU_NVMC_NU_WARMCYCLESCOUNTERDF0 0.000000 4294967295.000000 BYTE_ORDER MSB_FIRST /end CHARACTERISTIC
/begin RECORD_LAYOUT RL_NVMC_NU_WARMCYCLESCOUNTERDF0 FNC_VALUES 1 FLOAT32_IEEE COLUMN_DIR DIRECT /end RECORD_LAYOUT
/begin COMPU_METHOD CU_NVMC_NU_WARMCYCLESCOUNTERDF0 "Conversion method for NVMc_NU_WarmCyclesCounterDflt" RAT_FUNC "%10.0" "NU" COEFFS 0.000000 1.000000 0.000000 0.000000 0.000000 1.000000 /end COMPU_METHOD
/* Scalar calibration for DDE 'NVMc_b_ResetDataCollected'. */
/begin CHARACTERISTIC NVMc_b_ResetDataCollected "(not defined)" VALUE 0x8d2ad RL_NVMC_B_RESETDATACOLLECTED 1.000000 CU_NVMC_B_RESETDATACOLLECTED 0.000000 1.000000 BYTE_ORDER MSB_FIRST /end CHARACTERISTIC
/begin RECORD_LAYOUT RL_NVMC_B_RESETDATACOLLECTED FNC_VALUES 1 UBYTE COLUMN_DIR DIRECT /end RECORD_LAYOUT
/begin COMPU_METHOD CU_NVMC_B_RESETDATACOLLECTED "Conversion method for NVMc_b_ResetDataCollected" RAT_FUNC "%10.0" "b" COEFFS 0.000000 1.000000 0.000000 0.000000 0.000000 1.000000 /end COMPU_METHOD
/* Scalar calibration for DDE 'NVMca_NU_CyclesDflt'. */
/begin CHARACTERISTIC NVMca_NU_CyclesDflt "(not defined)" VALUE 0x4000f890 RL_NVMCA_NU_CYCLESDFLT 4294967295.000000 CU_NVMCA_NU_CYCLESDFLT 0.000000 4294967295.000000 BYTE_ORDER MSB_FIRST /end CHARACTERISTIC
/begin RECORD_LAYOUT RL_NVMCA_NU_CYCLESDFLT FNC_VALUES 1 FLOAT32_IEEE COLUMN_DIR DIRECT /end RECORD_LAYOUT
/begin COMPU_METHOD CU_NVMCA_NU_CYCLESDFLT "Conversion method for NVMca_NU_CyclesDflt" RAT_FUNC "%10.0" "NU" COEFFS 0.000000 1.000000 0.000000 0.000000 0.000000 1.000000 /end COMPU_METHOD
/* Scalar calibration for DDE 'NVMca_NU_DistanceCounterDflt'. */
/begin CHARACTERISTIC NVMca_NU_DistanceCounterDflt "(not defined)" VALUE 0x4000f898 RL_NVMCA_NU_DISTANCECOUNTERDFLT 4294967295.000000 CU_NVMCA_NU_DISTANCECOUNTERDFLT 0.000000 4294967295.000000 BYTE_ORDER MSB_FIRST /end CHARACTERISTIC
/begin RECORD_LAYOUT RL_NVMCA_NU_DISTANCECOUNTERDFLT FNC_VALUES 1 FLOAT32_IEEE COLUMN_DIR DIRECT /end RECORD_LAYOUT
/begin COMPU_METHOD CU_NVMCA_NU_DISTANCECOUNTERDFLT "Conversion method for NVMca_NU_DistanceCounterDflt" RAT_FUNC "%10.2" "s" COEFFS 0.000000 1.000000 0.000000 0.000000 0.000000 1.000000 /end COMPU_METHOD
/* Scalar calibration for DDE 'NVMca_NU_DistanceCounterMILDflt'. */
/begin CHARACTERISTIC NVMca_NU_DistanceCounterMILDflt "(not defined)" VALUE 0x4000f89c RL_NVMCA_NU_DISTANCECOUNTERMIL0 4294967295.000000 CU_NVMCA_NU_DISTANCECOUNTERMIL0 0.000000 4294967295.000000 BYTE_ORDER MSB_FIRST /end CHARACTERISTIC
/begin RECORD_LAYOUT RL_NVMCA_NU_DISTANCECOUNTERMIL0 FNC_VALUES 1 FLOAT32_IEEE COLUMN_DIR DIRECT /end RECORD_LAYOUT
/begin COMPU_METHOD CU_NVMCA_NU_DISTANCECOUNTERMIL0 "Conversion method for NVMca_NU_DistanceCounterMILDflt" RAT_FUNC "%10.2" "s" COEFFS 0.000000 1.000000 0.000000 0.000000 0.000000 1.000000 /end COMPU_METHOD
/* Scalar calibration for DDE 'NVMca_NU_EngineRuntimeDflt'. */
/begin CHARACTERISTIC NVMca_NU_EngineRuntimeDflt "(not defined)" VALUE 0x4000f894 RL_NVMCA_NU_ENGINERUNTIMEDFLT 4294967295.000000 CU_NVMCA_NU_ENGINERUNTIMEDFLT 0.000000 4294967295.000000 BYTE_ORDER MSB_FIRST /end CHARACTERISTIC
/begin RECORD_LAYOUT RL_NVMCA_NU_ENGINERUNTIMEDFLT FNC_VALUES 1 FLOAT32_IEEE COLUMN_DIR DIRECT /end RECORD_LAYOUT
/begin COMPU_METHOD CU_NVMCA_NU_ENGINERUNTIMEDFLT "Conversion method for NVMca_NU_EngineRuntimeDflt" RAT_FUNC "%10.2" "s" COEFFS 0.000000 1.000000 0.000000 0.000000 0.000000 1.000000 /end COMPU_METHOD
/* Scalar calibration for DDE 'NVMca_NU_EngineRuntimeDflt2'. */
/begin CHARACTERISTIC NVMca_NU_EngineRuntimeDflt2 "(not defined)" VALUE 0x4000f8a0 RL_NVMCA_NU_ENGINERUNTIMEDFLT2 4294967295.000000 CU_NVMCA_NU_ENGINERUNTIMEDFLT2 0.000000 4294967295.000000 BYTE_ORDER MSB_FIRST /end CHARACTERISTIC
/begin RECORD_LAYOUT RL_NVMCA_NU_ENGINERUNTIMEDFLT2 FNC_VALUES 1 FLOAT32_IEEE COLUMN_DIR DIRECT /end RECORD_LAYOUT
/begin COMPU_METHOD CU_NVMCA_NU_ENGINERUNTIMEDFLT2 "Conversion method for NVMca_NU_EngineRuntimeDflt2" RAT_FUNC "%10.2" "s" COEFFS 0.000000 1.000000 0.000000 0.000000 0.000000 1.000000 /end COMPU_METHOD
/* Scalar calibration for DDE 'NVMca_NU_HOURSDflt'. */
/begin CHARACTERISTIC NVMca_NU_HOURSDflt "(not defined)" VALUE 0x4000f8a4 RL_NVMCA_NU_HOURSDFLT 4294967295.000000 CU_NVMCA_NU_HOURSDFLT 0.000000 4294967295.000000 BYTE_ORDER MSB_FIRST /end CHARACTERISTIC
/begin RECORD_LAYOUT RL_NVMCA_NU_HOURSDFLT FNC_VALUES 1 FLOAT32_IEEE COLUMN_DIR DIRECT /end RECORD_LAYOUT
/begin COMPU_METHOD CU_NVMCA_NU_HOURSDFLT "Conversion method for NVMca_NU_HOURSDflt" RAT_FUNC "%10.2" "s" COEFFS 0.000000 1.000000 0.000000 0.000000 0.000000 1.000000 /end COMPU_METHOD
/* Scalar calibration for DDE 'NVMca_NU_MILcontinousDflt'. */
/begin CHARACTERISTIC NVMca_NU_MILcontinousDflt "(not defined)" VALUE 0x4000f8a8 RL_NVMCA_NU_MILCONTINOUSDFLT 4294967295.000000 CU_NVMCA_NU_MILCONTINOUSDFLT 0.000000 4294967295.000000 BYTE_ORDER MSB_FIRST /end CHARACTERISTIC
/begin RECORD_LAYOUT RL_NVMCA_NU_MILCONTINOUSDFLT FNC_VALUES 1 FLOAT32_IEEE COLUMN_DIR DIRECT /end RECORD_LAYOUT
/begin COMPU_METHOD CU_NVMCA_NU_MILCONTINOUSDFLT "Conversion method for NVMca_NU_MILcontinousDflt" RAT_FUNC "%10.2" "s" COEFFS 0.000000 1.000000 0.000000 0.000000 0.000000 1.000000 /end COMPU_METHOD
/* Scalar calibration for DDE 'NVMca_NU_WarmCyclesCounterDflt'. */
/begin CHARACTERISTIC NVMca_NU_WarmCyclesCounterDflt "(not defined)" VALUE 0x4000f468 RL_NVMCA_NU_WARMCYCLESCOUNTERD0 4294967295.000000 CU_NVMCA_NU_WARMCYCLESCOUNTERD0 0.000000 4294967295.000000 BYTE_ORDER MSB_FIRST /end CHARACTERISTIC
/begin RECORD_LAYOUT RL_NVMCA_NU_WARMCYCLESCOUNTERD0 FNC_VALUES 1 FLOAT32_IEEE COLUMN_DIR DIRECT /end RECORD_LAYOUT
/begin COMPU_METHOD CU_NVMCA_NU_WARMCYCLESCOUNTERD0 "Conversion method for NVMca_NU_WarmCyclesCounterDflt" RAT_FUNC "%10.0" "NU" COEFFS 0.000000 1.000000 0.000000 0.000000 0.000000 1.000000 /end COMPU_METHOD
/* Scalar calibration for DDE 'OBDc_b_BegasCVN'. */
/begin CHARACTERISTIC OBDc_b_BegasCVN "Override flag" VALUE 0x8040a RL_OBDC_B_BEGASCVN 1.000000 CU_OBDC_B_BEGASCVN 0.000000 1.000000 BYTE_ORDER MSB_FIRST /end CHARACTERISTIC
/begin RECORD_LAYOUT RL_OBDC_B_BEGASCVN FNC_VALUES 1 UBYTE COLUMN_DIR DIRECT /end RECORD_LAYOUT
/begin COMPU_METHOD CU_OBDC_B_BEGASCVN "Conversion method for OBDc_b_BegasCVN" RAT_FUNC "%10.0" "b" COEFFS 0.000000 1.000000 0.000000 0.000000 0.000000 1.000000 /end COMPU_METHOD
/* Scalar calibration for DDE 'OUTc_A_InjHoldCurrent'. */
/begin CHARACTERISTIC OUTc_A_InjHoldCurrent "Current limit during HOLD phase of injection activation" VALUE 0x8d4f4 RL_OUTC_A_INJHOLDCURRENT 25.000000 CU_OUTC_A_INJHOLDCURRENT 0.000000 25.000000 BYTE_ORDER MSB_FIRST /end CHARACTERISTIC
/begin RECORD_LAYOUT RL_OUTC_A_INJHOLDCURRENT FNC_VALUES 1 FLOAT32_IEEE COLUMN_DIR DIRECT /end RECORD_LAYOUT
/begin COMPU_METHOD CU_OUTC_A_INJHOLDCURRENT "Conversion method for OUTc_A_InjHoldCurrent" RAT_FUNC "%10.1" "A" COEFFS 0.000000 1.000000 0.000000 0.000000 0.000000 1.000000 /end COMPU_METHOD
/* Scalar calibration for DDE 'OUTc_A_InjPeakCurrent'. */
/begin CHARACTERISTIC OUTc_A_InjPeakCurrent "Current limit" VALUE 0x8d4ec RL_OUTC_A_INJPEAKCURRENT 25.000000 CU_OUTC_A_INJPEAKCURRENT 0.000000 25.000000 BYTE_ORDER MSB_FIRST /end CHARACTERISTIC
/begin RECORD_LAYOUT RL_OUTC_A_INJPEAKCURRENT FNC_VALUES 1 FLOAT32_IEEE COLUMN_DIR DIRECT /end RECORD_LAYOUT
/begin COMPU_METHOD CU_OUTC_A_INJPEAKCURRENT "Conversion method for OUTc_A_InjPeakCurrent" RAT_FUNC "%10.1" "A" COEFFS 0.000000 1.000000 0.000000 0.000000 0.000000 1.000000 /end COMPU_METHOD
/* Scalar calibration for DDE 'OUTc_C_EFPFuelTemp'. */
/begin CHARACTERISTIC OUTc_C_EFPFuelTemp "Ambient temperature condition for max pressure fuel pump." VALUE 0x8d268 RL_OUTC_C_EFPFUELTEMP 140.000000 CU_OUTC_C_EFPFUELTEMP -40.000000 100.000000 BYTE_ORDER MSB_FIRST /end CHARACTERISTIC
/begin RECORD_LAYOUT RL_OUTC_C_EFPFUELTEMP FNC_VALUES 1 FLOAT32_IEEE COLUMN_DIR DIRECT /end RECORD_LAYOUT
/begin COMPU_METHOD CU_OUTC_C_EFPFUELTEMP "Conversion method for OUTc_C_EFPFuelTemp" RAT_FUNC "%10.1" "deg" COEFFS 0.000000 1.000000 0.000000 0.000000 0.000000 1.000000 /end COMPU_METHOD
/* Scalar calibration for DDE 'OUTc_C_FAN_ZF'. */
/begin CHARACTERISTIC OUTc_C_FAN_ZF "Override value" VALUE 0x83434 RL_OUTC_C_FAN_ZF 1000.000000 CU_OUTC_C_FAN_ZF 0.000000 1000.000000 BYTE_ORDER MSB_FIRST /end CHARACTERISTIC
/begin RECORD_LAYOUT RL_OUTC_C_FAN_ZF FNC_VALUES 1 FLOAT32_IEEE COLUMN_DIR DIRECT /end RECORD_LAYOUT
/begin COMPU_METHOD CU_OUTC_C_FAN_ZF "Conversion method for OUTc_C_FAN_ZF" RAT_FUNC "%10.3" "NU" COEFFS 0.000000 1.000000 0.000000 0.000000 0.000000 1.000000 /end COMPU_METHOD
/* Scalar calibration for DDE 'OUTc_C_TempZF_off'. */
/begin CHARACTERISTIC OUTc_C_TempZF_off "Umbral parada ventilador ZF" VALUE 0x8343c RL_OUTC_C_TEMPZF_OFF 255.000000 CU_OUTC_C_TEMPZF_OFF 0.000000 255.000000 BYTE_ORDER MSB_FIRST /end CHARACTERISTIC
/begin RECORD_LAYOUT RL_OUTC_C_TEMPZF_OFF FNC_VALUES 1 FLOAT32_IEEE COLUMN_DIR DIRECT /end RECORD_LAYOUT
/begin COMPU_METHOD CU_OUTC_C_TEMPZF_OFF "Conversion method for OUTc_C_TempZF_off" RAT_FUNC "%10.1" "deg" COEFFS 0.000000 1.000000 0.000000 0.000000 0.000000 1.000000 /end COMPU_METHOD
/* Scalar calibration for DDE 'OUTc_C_TempZF_on'. */
/begin CHARACTERISTIC OUTc_C_TempZF_on "Umbral disparo ventilador ZF" VALUE 0x83438 RL_OUTC_C_TEMPZF_ON 255.000000 CU_OUTC_C_TEMPZF_ON 0.000000 255.000000 BYTE_ORDER MSB_FIRST /end CHARACTERISTIC
/begin RECORD_LAYOUT RL_OUTC_C_TEMPZF_ON FNC_VALUES 1 FLOAT32_IEEE COLUMN_DIR DIRECT /end RECORD_LAYOUT
/begin COMPU_METHOD CU_OUTC_C_TEMPZF_ON "Conversion method for OUTc_C_TempZF_on" RAT_FUNC "%10.1" "deg" COEFFS 0.000000 1.000000 0.000000 0.000000 0.000000 1.000000 /end COMPU_METHOD
/* Scalar calibration for DDE 'OUTc_C_Thres_off'. */
/begin CHARACTERISTIC OUTc_C_Thres_off "Umbral disparo ventilador inferior" VALUE 0x8d274 RL_OUTC_C_THRES_OFF 255.000000 CU_OUTC_C_THRES_OFF 0.000000 255.000000 BYTE_ORDER MSB_FIRST /end CHARACTERISTIC
/begin RECORD_LAYOUT RL_OUTC_C_THRES_OFF FNC_VALUES 1 FLOAT32_IEEE COLUMN_DIR DIRECT /end RECORD_LAYOUT
/begin COMPU_METHOD CU_OUTC_C_THRES_OFF "Conversion method for OUTc_C_Thres_off" RAT_FUNC "%10.1" "deg" COEFFS 0.000000 1.000000 0.000000 0.000000 0.000000 1.000000 /end COMPU_METHOD
/* Scalar calibration for DDE 'OUTc_C_Thres_on'. */
/begin CHARACTERISTIC OUTc_C_Thres_on "Umbral disparo ventilador superior" VALUE 0x8d270 RL_OUTC_C_THRES_ON 255.000000 CU_OUTC_C_THRES_ON 0.000000 255.000000 BYTE_ORDER MSB_FIRST /end CHARACTERISTIC
/begin RECORD_LAYOUT RL_OUTC_C_THRES_ON FNC_VALUES 1 FLOAT32_IEEE COLUMN_DIR DIRECT /end RECORD_LAYOUT
/begin COMPU_METHOD CU_OUTC_C_THRES_ON "Conversion method for OUTc_C_Thres_on" RAT_FUNC "%10.1" "deg" COEFFS 0.000000 1.000000 0.000000 0.000000 0.000000 1.000000 /end COMPU_METHOD
/* Scalar calibration for DDE 'OUTc_C_Visco_off_1st'. */
/begin CHARACTERISTIC OUTc_C_Visco_off_1st "Umbral parada 1st speed ventilador inferior" VALUE 0x8d0e4 RL_OUTC_C_VISCO_OFF_1ST 255.000000 CU_OUTC_C_VISCO_OFF_1ST 0.000000 255.000000 BYTE_ORDER MSB_FIRST /end CHARACTERISTIC
/begin RECORD_LAYOUT RL_OUTC_C_VISCO_OFF_1ST FNC_VALUES 1 FLOAT32_IEEE COLUMN_DIR DIRECT /end RECORD_LAYOUT
/begin COMPU_METHOD CU_OUTC_C_VISCO_OFF_1ST "Conversion method for OUTc_C_Visco_off_1st" RAT_FUNC "%10.1" "deg" COEFFS 0.000000 1.000000 0.000000 0.000000 0.000000 1.000000 /end COMPU_METHOD
/* Scalar calibration for DDE 'OUTc_C_Visco_off_2nd'. */
/begin CHARACTERISTIC OUTc_C_Visco_off_2nd "Umbral parada 2nd speed ventilador inferior" VALUE 0x8d0f0 RL_OUTC_C_VISCO_OFF_2ND 255.000000 CU_OUTC_C_VISCO_OFF_2ND 0.000000 255.000000 BYTE_ORDER MSB_FIRST /end CHARACTERISTIC
/begin RECORD_LAYOUT RL_OUTC_C_VISCO_OFF_2ND FNC_VALUES 1 FLOAT32_IEEE COLUMN_DIR DIRECT /end RECORD_LAYOUT
/begin COMPU_METHOD CU_OUTC_C_VISCO_OFF_2ND "Conversion method for OUTc_C_Visco_off_2nd" RAT_FUNC "%10.1" "deg" COEFFS 0.000000 1.000000 0.000000 0.000000 0.000000 1.000000 /end COMPU_METHOD
/* Scalar calibration for DDE 'OUTc_C_Visco_on_1st'. */
/begin CHARACTERISTIC OUTc_C_Visco_on_1st "Umbral disparo 1st speed ventilador superior" VALUE 0x8d0e0 RL_OUTC_C_VISCO_ON_1ST 255.000000 CU_OUTC_C_VISCO_ON_1ST 0.000000 255.000000 BYTE_ORDER MSB_FIRST /end CHARACTERISTIC
/begin RECORD_LAYOUT RL_OUTC_C_VISCO_ON_1ST FNC_VALUES 1 FLOAT32_IEEE COLUMN_DIR DIRECT /end RECORD_LAYOUT
/begin COMPU_METHOD CU_OUTC_C_VISCO_ON_1ST "Conversion method for OUTc_C_Visco_on_1st" RAT_FUNC "%10.1" "deg" COEFFS 0.000000 1.000000 0.000000 0.000000 0.000000 1.000000 /end COMPU_METHOD
/* Scalar calibration for DDE 'OUTc_C_Visco_on_2nd'. */
/begin CHARACTERISTIC OUTc_C_Visco_on_2nd "Umbral disparo 2nd speed ventilador superior" VALUE 0x8d0ec RL_OUTC_C_VISCO_ON_2ND 255.000000 CU_OUTC_C_VISCO_ON_2ND 0.000000 255.000000 BYTE_ORDER MSB_FIRST /end CHARACTERISTIC
/begin RECORD_LAYOUT RL_OUTC_C_VISCO_ON_2ND FNC_VALUES 1 FLOAT32_IEEE COLUMN_DIR DIRECT /end RECORD_LAYOUT
/begin COMPU_METHOD CU_OUTC_C_VISCO_ON_2ND "Conversion method for OUTc_C_Visco_on_2nd" RAT_FUNC "%10.1" "deg" COEFFS 0.000000 1.000000 0.000000 0.000000 0.000000 1.000000 /end COMPU_METHOD
/* Scalar calibration for DDE 'OUTc_Hz_CompBypassFrq'. */
/begin CHARACTERISTIC OUTc_Hz_CompBypassFrq "Compressor bypass valve frequency" VALUE 0x80450 RL_OUTC_HZ_COMPBYPASSFRQ 4999.900000 CU_OUTC_HZ_COMPBYPASSFRQ 0.100000 5000.000000 BYTE_ORDER MSB_FIRST /end CHARACTERISTIC
/begin RECORD_LAYOUT RL_OUTC_HZ_COMPBYPASSFRQ FNC_VALUES 1 FLOAT32_IEEE COLUMN_DIR DIRECT /end RECORD_LAYOUT
/begin COMPU_METHOD CU_OUTC_HZ_COMPBYPASSFRQ "Conversion method for OUTc_Hz_CompBypassFrq" RAT_FUNC "%10.1" "Hz" COEFFS 0.000000 1.000000 0.000000 0.000000 0.000000 1.000000 /end COMPU_METHOD
/* Scalar calibration for DDE 'OUTc_Hz_EGO_HeaterFrq'. */
/begin CHARACTERISTIC OUTc_Hz_EGO_HeaterFrq "O2 sensor heater PWM frq" VALUE 0x8d26c RL_OUTC_HZ_EGO_HEATERFRQ 4999.900000 CU_OUTC_HZ_EGO_HEATERFRQ 0.100000 5000.000000 BYTE_ORDER MSB_FIRST /end CHARACTERISTIC
/begin RECORD_LAYOUT RL_OUTC_HZ_EGO_HEATERFRQ FNC_VALUES 1 FLOAT32_IEEE COLUMN_DIR DIRECT /end RECORD_LAYOUT
/begin COMPU_METHOD CU_OUTC_HZ_EGO_HEATERFRQ "Conversion method for OUTc_Hz_EGO_HeaterFrq" RAT_FUNC "%10.1" "Hz" COEFFS 0.000000 1.000000 0.000000 0.000000 0.000000 1.000000 /end COMPU_METHOD
/* Scalar calibration for DDE 'OUTc_Hz_ETC_HBridgeFrq'. */
/begin CHARACTERISTIC OUTc_Hz_ETC_HBridgeFrq "Output PWM frequency" VALUE 0x8d0bc RL_OUTC_HZ_ETC_HBRIDGEFRQ 9999.000000 CU_OUTC_HZ_ETC_HBRIDGEFRQ 1.000000 10000.000000 BYTE_ORDER MSB_FIRST /end CHARACTERISTIC
/begin RECORD_LAYOUT RL_OUTC_HZ_ETC_HBRIDGEFRQ FNC_VALUES 1 FLOAT32_IEEE COLUMN_DIR DIRECT /end RECORD_LAYOUT
/begin COMPU_METHOD CU_OUTC_HZ_ETC_HBRIDGEFRQ "Conversion method for OUTc_Hz_ETC_HBridgeFrq" RAT_FUNC "%10.0" "Hz" COEFFS 0.000000 1.000000 0.000000 0.000000 0.000000 1.000000 /end COMPU_METHOD
/* Scalar calibration for DDE 'OUTc_Hz_EngSpd'. */
/begin CHARACTERISTIC OUTc_Hz_EngSpd "(not defined)" VALUE 0x8d254 RL_OUTC_HZ_ENGSPD 10000.000000 CU_OUTC_HZ_ENGSPD 0.000000 10000.000000 BYTE_ORDER MSB_FIRST /end CHARACTERISTIC
/begin RECORD_LAYOUT RL_OUTC_HZ_ENGSPD FNC_VALUES 1 FLOAT32_IEEE COLUMN_DIR DIRECT /end RECORD_LAYOUT
/begin COMPU_METHOD CU_OUTC_HZ_ENGSPD "Conversion method for OUTc_Hz_EngSpd" RAT_FUNC "%10.0" "Hz" COEFFS 0.000000 1.000000 0.000000 0.000000 0.000000 1.000000 /end COMPU_METHOD
/* Scalar calibration for DDE 'OUTc_Hz_FreqStepsUEGOA'. */
/begin CHARACTERISTIC OUTc_Hz_FreqStepsUEGOA "24V warmup" VALUE 0x8c308 RL_OUTC_HZ_FREQSTEPSUEGOA 10000.000000 CU_OUTC_HZ_FREQSTEPSUEGOA 0.000000 10000.000000 BYTE_ORDER MSB_FIRST /end CHARACTERISTIC
/begin RECORD_LAYOUT RL_OUTC_HZ_FREQSTEPSUEGOA FNC_VALUES 1 FLOAT32_IEEE COLUMN_DIR DIRECT /end RECORD_LAYOUT
/begin COMPU_METHOD CU_OUTC_HZ_FREQSTEPSUEGOA "Conversion method for OUTc_Hz_FreqStepsUEGOA" RAT_FUNC "%10.0" "Hz" COEFFS 0.000000 1.000000 0.000000 0.000000 0.000000 1.000000 /end COMPU_METHOD
/* Scalar calibration for DDE 'OUTc_Hz_FreqUEGOA'. */
/begin CHARACTERISTIC OUTc_Hz_FreqUEGOA "Override value" VALUE 0x8c340 RL_OUTC_HZ_FREQUEGOA 10000.000000 CU_OUTC_HZ_FREQUEGOA 0.000000 10000.000000 BYTE_ORDER MSB_FIRST /end CHARACTERISTIC
/begin RECORD_LAYOUT RL_OUTC_HZ_FREQUEGOA FNC_VALUES 1 FLOAT32_IEEE COLUMN_DIR DIRECT /end RECORD_LAYOUT
/begin COMPU_METHOD CU_OUTC_HZ_FREQUEGOA "Conversion method for OUTc_Hz_FreqUEGOA" RAT_FUNC "%10.0" "Hz" COEFFS 0.000000 1.000000 0.000000 0.000000 0.000000 1.000000 /end COMPU_METHOD
/* Scalar calibration for DDE 'OUTc_Hz_FreqUEGO_A'. */
/begin CHARACTERISTIC OUTc_Hz_FreqUEGO_A "24V Warmup Initial Frequency" VALUE 0x8d504 RL_OUTC_HZ_FREQUEGO_A 10000.000000 CU_OUTC_HZ_FREQUEGO_A 0.000000 10000.000000 BYTE_ORDER MSB_FIRST /end CHARACTERISTIC
/begin RECORD_LAYOUT RL_OUTC_HZ_FREQUEGO_A FNC_VALUES 1 FLOAT32_IEEE COLUMN_DIR DIRECT /end RECORD_LAYOUT
/begin COMPU_METHOD CU_OUTC_HZ_FREQUEGO_A "Conversion method for OUTc_Hz_FreqUEGO_A" RAT_FUNC "%10.0" "Hz" COEFFS 0.000000 1.000000 0.000000 0.000000 0.000000 1.000000 /end COMPU_METHOD
/* Scalar calibration for DDE 'OUTc_Hz_LoThrshUEGOA'. */
/begin CHARACTERISTIC OUTc_Hz_LoThrshUEGOA "24V warmup" VALUE 0x8c344 RL_OUTC_HZ_LOTHRSHUEGOA 10000.000000 CU_OUTC_HZ_LOTHRSHUEGOA 0.000000 10000.000000 BYTE_ORDER MSB_FIRST /end CHARACTERISTIC
/begin RECORD_LAYOUT RL_OUTC_HZ_LOTHRSHUEGOA FNC_VALUES 1 FLOAT32_IEEE COLUMN_DIR DIRECT /end RECORD_LAYOUT
/begin COMPU_METHOD CU_OUTC_HZ_LOTHRSHUEGOA "Conversion method for OUTc_Hz_LoThrshUEGOA" RAT_FUNC "%10.0" "Hz" COEFFS 0.000000 1.000000 0.000000 0.000000 0.000000 1.000000 /end COMPU_METHOD
/* Scalar calibration for DDE 'OUTc_Hz_RampFreq_A'. */
/begin CHARACTERISTIC OUTc_Hz_RampFreq_A "24V warmup" VALUE 0x8c2fc RL_OUTC_HZ_RAMPFREQ_A 10000.000000 CU_OUTC_HZ_RAMPFREQ_A 0.000000 10000.000000 BYTE_ORDER MSB_FIRST /end CHARACTERISTIC
/begin RECORD_LAYOUT RL_OUTC_HZ_RAMPFREQ_A FNC_VALUES 1 FLOAT32_IEEE COLUMN_DIR DIRECT /end RECORD_LAYOUT
/begin COMPU_METHOD CU_OUTC_HZ_RAMPFREQ_A "Conversion method for OUTc_Hz_RampFreq_A" RAT_FUNC "%10.0" "Hz" COEFFS 0.000000 1.000000 0.000000 0.000000 0.000000 1.000000 /end COMPU_METHOD
/* Scalar calibration for DDE 'OUTc_Hz_ShutOffValveFrq'. */
/begin CHARACTERISTIC OUTc_Hz_ShutOffValveFrq "Shutoff valve frequency" VALUE 0x8d27c RL_OUTC_HZ_SHUTOFFVALVEFRQ 4000.000000 CU_OUTC_HZ_SHUTOFFVALVEFRQ 0.000000 4000.000000 BYTE_ORDER MSB_FIRST /end CHARACTERISTIC
/begin RECORD_LAYOUT RL_OUTC_HZ_SHUTOFFVALVEFRQ FNC_VALUES 1 FLOAT32_IEEE COLUMN_DIR DIRECT /end RECORD_LAYOUT
/begin COMPU_METHOD CU_OUTC_HZ_SHUTOFFVALVEFRQ "Conversion method for OUTc_Hz_ShutOffValveFrq" RAT_FUNC "%10.1" "Hz" COEFFS 0.000000 1.000000 0.000000 0.000000 0.000000 1.000000 /end COMPU_METHOD
/* Scalar calibration for DDE 'OUTc_Hz_TurCtrlFrq'. */
/begin CHARACTERISTIC OUTc_Hz_TurCtrlFrq "Turbo wastegate frequency" VALUE 0x8d0c0 RL_OUTC_HZ_TURCTRLFRQ 4999.900000 CU_OUTC_HZ_TURCTRLFRQ 0.100000 5000.000000 BYTE_ORDER MSB_FIRST /end CHARACTERISTIC
/begin RECORD_LAYOUT RL_OUTC_HZ_TURCTRLFRQ FNC_VALUES 1 FLOAT32_IEEE COLUMN_DIR DIRECT /end RECORD_LAYOUT
/begin COMPU_METHOD CU_OUTC_HZ_TURCTRLFRQ "Conversion method for OUTc_Hz_TurCtrlFrq" RAT_FUNC "%10.1" "Hz" COEFFS 0.000000 1.000000 0.000000 0.000000 0.000000 1.000000 /end COMPU_METHOD
/* Scalar calibration for DDE 'OUTc_Hz_VhSpd'. */
/begin CHARACTERISTIC OUTc_Hz_VhSpd "(not defined)" VALUE 0x8d1a4 RL_OUTC_HZ_VHSPD 10000.000000 CU_OUTC_HZ_VHSPD 0.000000 10000.000000 BYTE_ORDER MSB_FIRST /end CHARACTERISTIC
/begin RECORD_LAYOUT RL_OUTC_HZ_VHSPD FNC_VALUES 1 FLOAT32_IEEE COLUMN_DIR DIRECT /end RECORD_LAYOUT
/begin COMPU_METHOD CU_OUTC_HZ_VHSPD "Conversion method for OUTc_Hz_VhSpd" RAT_FUNC "%10.0" "Hz" COEFFS 0.000000 1.000000 0.000000 0.000000 0.000000 1.000000 /end COMPU_METHOD
/* Scalar calibration for DDE 'OUTc_NU_DM19CVN'. */
/begin CHARACTERISTIC OUTc_NU_DM19CVN "Cam phaser solenoid frequency" VALUE 0x80404 RL_OUTC_NU_DM19CVN 4294967295.000000 CU_OUTC_NU_DM19CVN 0.000000 4294967295.000000 BYTE_ORDER MSB_FIRST /end CHARACTERISTIC
/begin RECORD_LAYOUT RL_OUTC_NU_DM19CVN FNC_VALUES 1 ULONG COLUMN_DIR DIRECT /end RECORD_LAYOUT
/begin COMPU_METHOD CU_OUTC_NU_DM19CVN "Conversion method for OUTc_NU_DM19CVN" RAT_FUNC "%10.0" "NU" COEFFS 0.000000 1.000000 0.000000 0.000000 0.000000 1.000000 /end COMPU_METHOD
/* Scalar calibration for DDE 'OUTc_NU_EngSpdFq_Type'. */
/begin CHARACTERISTIC OUTc_NU_EngSpdFq_Type "(not defined)" VALUE 0x8d1ac RL_OUTC_NU_ENGSPDFQ_TYPE 255.000000 CU_OUTC_NU_ENGSPDFQ_TYPE 0.000000 255.000000 BYTE_ORDER MSB_FIRST /end CHARACTERISTIC
/begin RECORD_LAYOUT RL_OUTC_NU_ENGSPDFQ_TYPE FNC_VALUES 1 FLOAT32_IEEE COLUMN_DIR DIRECT /end RECORD_LAYOUT
/begin COMPU_METHOD CU_OUTC_NU_ENGSPDFQ_TYPE "Conversion method for OUTc_NU_EngSpdFq_Type" RAT_FUNC "%10.0" "NU" COEFFS 0.000000 1.000000 0.000000 0.000000 0.000000 1.000000 /end COMPU_METHOD
/* Scalar calibration for DDE 'OUTc_NU_VhSpdFq_Type'. */
/begin CHARACTERISTIC OUTc_NU_VhSpdFq_Type "(not defined)" VALUE 0x8d0fc RL_OUTC_NU_VHSPDFQ_TYPE 255.000000 CU_OUTC_NU_VHSPDFQ_TYPE 0.000000 255.000000 BYTE_ORDER MSB_FIRST /end CHARACTERISTIC
/begin RECORD_LAYOUT RL_OUTC_NU_VHSPDFQ_TYPE FNC_VALUES 1 FLOAT32_IEEE COLUMN_DIR DIRECT /end RECORD_LAYOUT
/begin COMPU_METHOD CU_OUTC_NU_VHSPDFQ_TYPE "Conversion method for OUTc_NU_VhSpdFq_Type" RAT_FUNC "%10.0" "NU" COEFFS 0.000000 1.000000 0.000000 0.000000 0.000000 1.000000 /end COMPU_METHOD
/* Scalar calibration for DDE 'OUTc_V_VoltUEGOThrsh'. */
/begin CHARACTERISTIC OUTc_V_VoltUEGOThrsh "If VBatt is greater than this threshold use 24V warmup" VALUE 0x8c2f0 RL_OUTC_V_VOLTUEGOTHRSH 1000.000000 CU_OUTC_V_VOLTUEGOTHRSH 0.000000 1000.000000 BYTE_ORDER MSB_FIRST /end CHARACTERISTIC
/begin RECORD_LAYOUT RL_OUTC_V_VOLTUEGOTHRSH FNC_VALUES 1 FLOAT32_IEEE COLUMN_DIR DIRECT /end RECORD_LAYOUT
/begin COMPU_METHOD CU_OUTC_V_VOLTUEGOTHRSH "Conversion method for OUTc_V_VoltUEGOThrsh" RAT_FUNC "%10.0" "V" COEFFS 0.000000 1.000000 0.000000 0.000000 0.000000 1.000000 /end COMPU_METHOD
/* Scalar calibration for DDE 'OUTc_b_18F00000'. */
/begin CHARACTERISTIC OUTc_b_18F00000 "Enable ERC1 msg @ 250ms" VALUE 0x8bdf0 RL_OUTC_B_18F00000 1.000000 CU_OUTC_B_18F00000 0.000000 1.000000 BYTE_ORDER MSB_FIRST /end CHARACTERISTIC
/begin RECORD_LAYOUT RL_OUTC_B_18F00000 FNC_VALUES 1 UBYTE COLUMN_DIR DIRECT /end RECORD_LAYOUT
/begin COMPU_METHOD CU_OUTC_B_18F00000 "Conversion method for OUTc_b_18F00000" RAT_FUNC "%10.0" "NU" COEFFS 0.000000 1.000000 0.000000 0.000000 0.000000 1.000000 /end COMPU_METHOD
/* Scalar calibration for DDE 'OUTc_b_18F00000_ena'. */
/begin CHARACTERISTIC OUTc_b_18F00000_ena "Override value of ERC1 msg @ 250ms" VALUE 0x8bdef RL_OUTC_B_18F00000_ENA 1.000000 CU_OUTC_B_18F00000_ENA 0.000000 1.000000 BYTE_ORDER MSB_FIRST /end CHARACTERISTIC
/begin RECORD_LAYOUT RL_OUTC_B_18F00000_ENA FNC_VALUES 1 UBYTE COLUMN_DIR DIRECT /end RECORD_LAYOUT
/begin COMPU_METHOD CU_OUTC_B_18F00000_ENA "Conversion method for OUTc_b_18F00000_ena" RAT_FUNC "%10.0" "NU" COEFFS 0.000000 1.000000 0.000000 0.000000 0.000000 1.000000 /end COMPU_METHOD
/* Scalar calibration for DDE 'OUTc_b_18F0010B'. */
/begin CHARACTERISTIC OUTc_b_18F0010B "Enable EBC1 msg @ 100ms" VALUE 0x8bdca RL_OUTC_B_18F0010B 1.000000 CU_OUTC_B_18F0010B 0.000000 1.000000 BYTE_ORDER MSB_FIRST /end CHARACTERISTIC
/begin RECORD_LAYOUT RL_OUTC_B_18F0010B FNC_VALUES 1 UBYTE COLUMN_DIR DIRECT /end RECORD_LAYOUT
/begin COMPU_METHOD CU_OUTC_B_18F0010B "Conversion method for OUTc_b_18F0010B" RAT_FUNC "%10.0" "NU" COEFFS 0.000000 1.000000 0.000000 0.000000 0.000000 1.000000 /end COMPU_METHOD
/* Scalar calibration for DDE 'OUTc_b_18F0010B_ena'. */
/begin CHARACTERISTIC OUTc_b_18F0010B_ena "Override value of enable EBC1 msg" VALUE 0x8bdc9 RL_OUTC_B_18F0010B_ENA 1.000000 CU_OUTC_B_18F0010B_ENA 0.000000 1.000000 BYTE_ORDER MSB_FIRST /end CHARACTERISTIC
/begin RECORD_LAYOUT RL_OUTC_B_18F0010B_ENA FNC_VALUES 1 UBYTE COLUMN_DIR DIRECT /end RECORD_LAYOUT
/begin COMPU_METHOD CU_OUTC_B_18F0010B_ENA "Conversion method for OUTc_b_18F0010B_ena" RAT_FUNC "%10.0" "NU" COEFFS 0.000000 1.000000 0.000000 0.000000 0.000000 1.000000 /end COMPU_METHOD
/* Scalar calibration for DDE 'OUTc_b_18FDC40B'. */
/begin CHARACTERISTIC OUTc_b_18FDC40B "Enable EBC5 msg @ 100ms" VALUE 0x8bdcd RL_OUTC_B_18FDC40B 1.000000 CU_OUTC_B_18FDC40B 0.000000 1.000000 BYTE_ORDER MSB_FIRST /end CHARACTERISTIC
/begin RECORD_LAYOUT RL_OUTC_B_18FDC40B FNC_VALUES 1 UBYTE COLUMN_DIR DIRECT /end RECORD_LAYOUT
/begin COMPU_METHOD CU_OUTC_B_18FDC40B "Conversion method for OUTc_b_18FDC40B" RAT_FUNC "%10.0" "NU" COEFFS 0.000000 1.000000 0.000000 0.000000 0.000000 1.000000 /end COMPU_METHOD
/* Scalar calibration for DDE 'OUTc_b_18FDC40B_ena'. */
/begin CHARACTERISTIC OUTc_b_18FDC40B_ena "Override value of EBC5 msg @ 100ms" VALUE 0x8bdcc RL_OUTC_B_18FDC40B_ENA 1.000000 CU_OUTC_B_18FDC40B_ENA 0.000000 1.000000 BYTE_ORDER MSB_FIRST /end CHARACTERISTIC
/begin RECORD_LAYOUT RL_OUTC_B_18FDC40B_ENA FNC_VALUES 1 UBYTE COLUMN_DIR DIRECT /end RECORD_LAYOUT
/begin COMPU_METHOD CU_OUTC_B_18FDC40B_ENA "Conversion method for OUTc_b_18FDC40B_ena" RAT_FUNC "%10.0" "NU" COEFFS 0.000000 1.000000 0.000000 0.000000 0.000000 1.000000 /end COMPU_METHOD
/* Scalar calibration for DDE 'OUTc_b_18FE6E00'. */
/begin CHARACTERISTIC OUTc_b_18FE6E00 "Enable HRW msg @ 20ms" VALUE 0x8bdde RL_OUTC_B_18FE6E00 1.000000 CU_OUTC_B_18FE6E00 0.000000 1.000000 BYTE_ORDER MSB_FIRST /end CHARACTERISTIC
/begin RECORD_LAYOUT RL_OUTC_B_18FE6E00 FNC_VALUES 1 UBYTE COLUMN_DIR DIRECT /end RECORD_LAYOUT
/begin COMPU_METHOD CU_OUTC_B_18FE6E00 "Conversion method for OUTc_b_18FE6E00" RAT_FUNC "%10.0" "NU" COEFFS 0.000000 1.000000 0.000000 0.000000 0.000000 1.000000 /end COMPU_METHOD
/* Scalar calibration for DDE 'OUTc_b_18FE6E00_ena'. */
/begin CHARACTERISTIC OUTc_b_18FE6E00_ena "Override HRW msg @ 20ms" VALUE 0x8bddd RL_OUTC_B_18FE6E00_ENA 1.000000 CU_OUTC_B_18FE6E00_ENA 0.000000 1.000000 BYTE_ORDER MSB_FIRST /end CHARACTERISTIC
/begin RECORD_LAYOUT RL_OUTC_B_18FE6E00_ENA FNC_VALUES 1 UBYTE COLUMN_DIR DIRECT /end RECORD_LAYOUT
/begin COMPU_METHOD CU_OUTC_B_18FE6E00_ENA "Conversion method for OUTc_b_18FE6E00_ena" RAT_FUNC "%10.0" "NU" COEFFS 0.000000 1.000000 0.000000 0.000000 0.000000 1.000000 /end COMPU_METHOD
/* Scalar calibration for DDE 'OUTc_b_18FEE100'. */
/begin CHARACTERISTIC OUTc_b_18FEE100 "Enable FEE1 msg @ 250ms" VALUE 0x8bdf3 RL_OUTC_B_18FEE100 1.000000 CU_OUTC_B_18FEE100 0.000000 1.000000 BYTE_ORDER MSB_FIRST /end CHARACTERISTIC
/begin RECORD_LAYOUT RL_OUTC_B_18FEE100 FNC_VALUES 1 UBYTE COLUMN_DIR DIRECT /end RECORD_LAYOUT
/begin COMPU_METHOD CU_OUTC_B_18FEE100 "Conversion method for OUTc_b_18FEE100" RAT_FUNC "%10.0" "NU" COEFFS 0.000000 1.000000 0.000000 0.000000 0.000000 1.000000 /end COMPU_METHOD
/* Scalar calibration for DDE 'OUTc_b_18FEE100_ena'. */
/begin CHARACTERISTIC OUTc_b_18FEE100_ena "Override value of FEE1 msg @ 250ms" VALUE 0x8bdf2 RL_OUTC_B_18FEE100_ENA 1.000000 CU_OUTC_B_18FEE100_ENA 0.000000 1.000000 BYTE_ORDER MSB_FIRST /end CHARACTERISTIC
/begin RECORD_LAYOUT RL_OUTC_B_18FEE100_ENA FNC_VALUES 1 UBYTE COLUMN_DIR DIRECT /end RECORD_LAYOUT
/begin COMPU_METHOD CU_OUTC_B_18FEE100_ENA "Conversion method for OUTc_b_18FEE100_ena" RAT_FUNC "%10.0" "NU" COEFFS 0.000000 1.000000 0.000000 0.000000 0.000000 1.000000 /end COMPU_METHOD
/* Scalar calibration for DDE 'OUTc_b_18FEE600'. */
/begin CHARACTERISTIC OUTc_b_18FEE600 "Enable FEE6 msg @ 1000ms" VALUE 0x8bded RL_OUTC_B_18FEE600 1.000000 CU_OUTC_B_18FEE600 0.000000 1.000000 BYTE_ORDER MSB_FIRST /end CHARACTERISTIC
/begin RECORD_LAYOUT RL_OUTC_B_18FEE600 FNC_VALUES 1 UBYTE COLUMN_DIR DIRECT /end RECORD_LAYOUT
/begin COMPU_METHOD CU_OUTC_B_18FEE600 "Conversion method for OUTc_b_18FEE600" RAT_FUNC "%10.0" "NU" COEFFS 0.000000 1.000000 0.000000 0.000000 0.000000 1.000000 /end COMPU_METHOD
/* Scalar calibration for DDE 'OUTc_b_18FEE600_ena'. */
/begin CHARACTERISTIC OUTc_b_18FEE600_ena "Override value of FEE6 msg @ 1000ms" VALUE 0x8bdec RL_OUTC_B_18FEE600_ENA 1.000000 CU_OUTC_B_18FEE600_ENA 0.000000 1.000000 BYTE_ORDER MSB_FIRST /end CHARACTERISTIC
/begin RECORD_LAYOUT RL_OUTC_B_18FEE600_ENA FNC_VALUES 1 UBYTE COLUMN_DIR DIRECT /end RECORD_LAYOUT
/begin COMPU_METHOD CU_OUTC_B_18FEE600_ENA "Conversion method for OUTc_b_18FEE600_ena" RAT_FUNC "%10.0" "NU" COEFFS 0.000000 1.000000 0.000000 0.000000 0.000000 1.000000 /end COMPU_METHOD
/* Scalar calibration for DDE 'OUTc_b_18FEEE00'. */
/begin CHARACTERISTIC OUTc_b_18FEEE00 "Enable FEEE msg @ 1000ms" VALUE 0x8bdd0 RL_OUTC_B_18FEEE00 1.000000 CU_OUTC_B_18FEEE00 0.000000 1.000000 BYTE_ORDER MSB_FIRST /end CHARACTERISTIC
/begin RECORD_LAYOUT RL_OUTC_B_18FEEE00 FNC_VALUES 1 UBYTE COLUMN_DIR DIRECT /end RECORD_LAYOUT
/begin COMPU_METHOD CU_OUTC_B_18FEEE00 "Conversion method for OUTc_b_18FEEE00" RAT_FUNC "%10.0" "NU" COEFFS 0.000000 1.000000 0.000000 0.000000 0.000000 1.000000 /end COMPU_METHOD
/* Scalar calibration for DDE 'OUTc_b_18FEEE00_ena'. */
/begin CHARACTERISTIC OUTc_b_18FEEE00_ena "Enable FEEE msg @ 1000ms" VALUE 0x8bdcf RL_OUTC_B_18FEEE00_ENA 1.000000 CU_OUTC_B_18FEEE00_ENA 0.000000 1.000000 BYTE_ORDER MSB_FIRST /end CHARACTERISTIC
/begin RECORD_LAYOUT RL_OUTC_B_18FEEE00_ENA FNC_VALUES 1 UBYTE COLUMN_DIR DIRECT /end RECORD_LAYOUT
/begin COMPU_METHOD CU_OUTC_B_18FEEE00_ENA "Conversion method for OUTc_b_18FEEE00_ena" RAT_FUNC "%10.0" "NU" COEFFS 0.000000 1.000000 0.000000 0.000000 0.000000 1.000000 /end COMPU_METHOD
/* Scalar calibration for DDE 'OUTc_b_BCM'. */
/begin CHARACTERISTIC OUTc_b_BCM "Enable BCM" VALUE 0x8bd8d RL_OUTC_B_BCM 1.000000 CU_OUTC_B_BCM 0.000000 1.000000 BYTE_ORDER MSB_FIRST /end CHARACTERISTIC
/begin RECORD_LAYOUT RL_OUTC_B_BCM FNC_VALUES 1 UBYTE COLUMN_DIR DIRECT /end RECORD_LAYOUT
/begin COMPU_METHOD CU_OUTC_B_BCM "Conversion method for OUTc_b_BCM" RAT_FUNC "%10.0" "NU" COEFFS 0.000000 1.000000 0.000000 0.000000 0.000000 1.000000 /end COMPU_METHOD
/* Scalar calibration for DDE 'OUTc_b_BCM_ZF'. */
/begin CHARACTERISTIC OUTc_b_BCM_ZF "Enable BCM" VALUE 0x8bd90 RL_OUTC_B_BCM_ZF 1.000000 CU_OUTC_B_BCM_ZF 0.000000 1.000000 BYTE_ORDER MSB_FIRST /end CHARACTERISTIC
/begin RECORD_LAYOUT RL_OUTC_B_BCM_ZF FNC_VALUES 1 UBYTE COLUMN_DIR DIRECT /end RECORD_LAYOUT
/begin COMPU_METHOD CU_OUTC_B_BCM_ZF "Conversion method for OUTc_b_BCM_ZF" RAT_FUNC "%10.0" "NU" COEFFS 0.000000 1.000000 0.000000 0.000000 0.000000 1.000000 /end COMPU_METHOD
/* Scalar calibration for DDE 'OUTc_b_BCM_ZF_ena'. */
/begin CHARACTERISTIC OUTc_b_BCM_ZF_ena "Override BCM" VALUE 0x8bd8f RL_OUTC_B_BCM_ZF_ENA 1.000000 CU_OUTC_B_BCM_ZF_ENA 0.000000 1.000000 BYTE_ORDER MSB_FIRST /end CHARACTERISTIC
/begin RECORD_LAYOUT RL_OUTC_B_BCM_ZF_ENA FNC_VALUES 1 UBYTE COLUMN_DIR DIRECT /end RECORD_LAYOUT
/begin COMPU_METHOD CU_OUTC_B_BCM_ZF_ENA "Conversion method for OUTc_b_BCM_ZF_ena" RAT_FUNC "%10.0" "NU" COEFFS 0.000000 1.000000 0.000000 0.000000 0.000000 1.000000 /end COMPU_METHOD
/* Scalar calibration for DDE 'OUTc_b_BCM_ena'. */
/begin CHARACTERISTIC OUTc_b_BCM_ena "Override BCM" VALUE 0x8bd8c RL_OUTC_B_BCM_ENA 1.000000 CU_OUTC_B_BCM_ENA 0.000000 1.000000 BYTE_ORDER MSB_FIRST /end CHARACTERISTIC
/begin RECORD_LAYOUT RL_OUTC_B_BCM_ENA FNC_VALUES 1 UBYTE COLUMN_DIR DIRECT /end RECORD_LAYOUT
/begin COMPU_METHOD CU_OUTC_B_BCM_ENA "Conversion method for OUTc_b_BCM_ena" RAT_FUNC "%10.0" "NU" COEFFS 0.000000 1.000000 0.000000 0.000000 0.000000 1.000000 /end COMPU_METHOD
/* Scalar calibration for DDE 'OUTc_b_CombustionAllCyls'. */
/begin CHARACTERISTIC OUTc_b_CombustionAllCyls "Override value" VALUE 0x8d298 RL_OUTC_B_COMBUSTIONALLCYLS 1.000000 CU_OUTC_B_COMBUSTIONALLCYLS 0.000000 1.000000 BYTE_ORDER MSB_FIRST /end CHARACTERISTIC
/begin RECORD_LAYOUT RL_OUTC_B_COMBUSTIONALLCYLS FNC_VALUES 1 UBYTE COLUMN_DIR DIRECT /end RECORD_LAYOUT
/begin COMPU_METHOD CU_OUTC_B_COMBUSTIONALLCYLS "Conversion method for OUTc_b_CombustionAllCyls" RAT_FUNC "%10.0" "b" COEFFS 0.000000 1.000000 0.000000 0.000000 0.000000 1.000000 /end COMPU_METHOD
/* Scalar calibration for DDE 'OUTc_b_DM19Request'. */
/begin CHARACTERISTIC OUTc_b_DM19Request "ZF Fan" VALUE 0x80409 RL_OUTC_B_DM19REQUEST 1.000000 CU_OUTC_B_DM19REQUEST 0.000000 1.000000 BYTE_ORDER MSB_FIRST /end CHARACTERISTIC
/begin RECORD_LAYOUT RL_OUTC_B_DM19REQUEST FNC_VALUES 1 UBYTE COLUMN_DIR DIRECT /end RECORD_LAYOUT
/begin COMPU_METHOD CU_OUTC_B_DM19REQUEST "Conversion method for OUTc_b_DM19Request" RAT_FUNC "%10.0" "b" COEFFS 0.000000 1.000000 0.000000 0.000000 0.000000 1.000000 /end COMPU_METHOD
/* Scalar calibration for DDE 'OUTc_b_EnableBankA_Inj'. */
/begin CHARACTERISTIC OUTc_b_EnableBankA_Inj "Highside output enable" VALUE 0x8bf79 RL_OUTC_B_ENABLEBANKA_INJ 1.000000 CU_OUTC_B_ENABLEBANKA_INJ 0.000000 1.000000 BYTE_ORDER MSB_FIRST /end CHARACTERISTIC
/begin RECORD_LAYOUT RL_OUTC_B_ENABLEBANKA_INJ FNC_VALUES 1 UBYTE COLUMN_DIR DIRECT /end RECORD_LAYOUT
/begin COMPU_METHOD CU_OUTC_B_ENABLEBANKA_INJ "Conversion method for OUTc_b_EnableBankA_Inj" RAT_FUNC "%10.0" "b" COEFFS 0.000000 1.000000 0.000000 0.000000 0.000000 1.000000 /end COMPU_METHOD
/* Scalar calibration for DDE 'OUTc_b_EnableBankB_Inj'. */
/begin CHARACTERISTIC OUTc_b_EnableBankB_Inj "Highside output enable" VALUE 0x8bf7b RL_OUTC_B_ENABLEBANKB_INJ 1.000000 CU_OUTC_B_ENABLEBANKB_INJ 0.000000 1.000000 BYTE_ORDER MSB_FIRST /end CHARACTERISTIC
/begin RECORD_LAYOUT RL_OUTC_B_ENABLEBANKB_INJ FNC_VALUES 1 UBYTE COLUMN_DIR DIRECT /end RECORD_LAYOUT
/begin COMPU_METHOD CU_OUTC_B_ENABLEBANKB_INJ "Conversion method for OUTc_b_EnableBankB_Inj" RAT_FUNC "%10.0" "b" COEFFS 0.000000 1.000000 0.000000 0.000000 0.000000 1.000000 /end COMPU_METHOD
/* Scalar calibration for DDE 'OUTc_b_EnableCCO'. */
/begin CHARACTERISTIC OUTc_b_EnableCCO "Enable CCO group of LSD outputs" VALUE 0x8bf88 RL_OUTC_B_ENABLECCO 1.000000 CU_OUTC_B_ENABLECCO 0.000000 1.000000 BYTE_ORDER MSB_FIRST /end CHARACTERISTIC
/begin RECORD_LAYOUT RL_OUTC_B_ENABLECCO FNC_VALUES 1 UBYTE COLUMN_DIR DIRECT /end RECORD_LAYOUT
/begin COMPU_METHOD CU_OUTC_B_ENABLECCO "Conversion method for OUTc_b_EnableCCO" RAT_FUNC "%10.0" "b" COEFFS 0.000000 1.000000 0.000000 0.000000 0.000000 1.000000 /end COMPU_METHOD
/* Scalar calibration for DDE 'OUTc_b_EnableHighsideY1'. */
/begin CHARACTERISTIC OUTc_b_EnableHighsideY1 "(not defined)" VALUE 0x8d290 RL_OUTC_B_ENABLEHIGHSIDEY1 1.000000 CU_OUTC_B_ENABLEHIGHSIDEY1 0.000000 1.000000 BYTE_ORDER MSB_FIRST /end CHARACTERISTIC
/begin RECORD_LAYOUT RL_OUTC_B_ENABLEHIGHSIDEY1 FNC_VALUES 1 UBYTE COLUMN_DIR DIRECT /end RECORD_LAYOUT
/begin COMPU_METHOD CU_OUTC_B_ENABLEHIGHSIDEY1 "Conversion method for OUTc_b_EnableHighsideY1" RAT_FUNC "%10.0" "b" COEFFS 0.000000 1.000000 0.000000 0.000000 0.000000 1.000000 /end COMPU_METHOD
/* Scalar calibration for DDE 'OUTc_b_EnableHighsideY5'. */
/begin CHARACTERISTIC OUTc_b_EnableHighsideY5 "Override value" VALUE 0x8d28f RL_OUTC_B_ENABLEHIGHSIDEY5 1.000000 CU_OUTC_B_ENABLEHIGHSIDEY5 0.000000 1.000000 BYTE_ORDER MSB_FIRST /end CHARACTERISTIC
/begin RECORD_LAYOUT RL_OUTC_B_ENABLEHIGHSIDEY5 FNC_VALUES 1 UBYTE COLUMN_DIR DIRECT /end RECORD_LAYOUT
/begin COMPU_METHOD CU_OUTC_B_ENABLEHIGHSIDEY5 "Conversion method for OUTc_b_EnableHighsideY5" RAT_FUNC "%10.0" "b" COEFFS 0.000000 1.000000 0.000000 0.000000 0.000000 1.000000 /end COMPU_METHOD
/* Scalar calibration for DDE 'OUTc_b_EnablePowerHold'. */
/begin CHARACTERISTIC OUTc_b_EnablePowerHold "Enable Ignition off ECU power hold" VALUE 0x8d0b4 RL_OUTC_B_ENABLEPOWERHOLD 1.000000 CU_OUTC_B_ENABLEPOWERHOLD 0.000000 1.000000 BYTE_ORDER MSB_FIRST /end CHARACTERISTIC
/begin RECORD_LAYOUT RL_OUTC_B_ENABLEPOWERHOLD FNC_VALUES 1 UBYTE COLUMN_DIR DIRECT /end RECORD_LAYOUT
/begin COMPU_METHOD CU_OUTC_B_ENABLEPOWERHOLD "Conversion method for OUTc_b_EnablePowerHold" RAT_FUNC "%10.0" "b" COEFFS 0.000000 1.000000 0.000000 0.000000 0.000000 1.000000 /end COMPU_METHOD
/* Scalar calibration for DDE 'OUTc_b_EnablePowertrainRly'. */
/begin CHARACTERISTIC OUTc_b_EnablePowertrainRly "Enable powertrain relay" VALUE 0x8bf7a RL_OUTC_B_ENABLEPOWERTRAINRLY 1.000000 CU_OUTC_B_ENABLEPOWERTRAINRLY 0.000000 1.000000 BYTE_ORDER MSB_FIRST /end CHARACTERISTIC
/begin RECORD_LAYOUT RL_OUTC_B_ENABLEPOWERTRAINRLY FNC_VALUES 1 UBYTE COLUMN_DIR DIRECT /end RECORD_LAYOUT
/begin COMPU_METHOD CU_OUTC_B_ENABLEPOWERTRAINRLY "Conversion method for OUTc_b_EnablePowertrainRly" RAT_FUNC "%10.0" "b" COEFFS 0.000000 1.000000 0.000000 0.000000 0.000000 1.000000 /end COMPU_METHOD
/* Scalar calibration for DDE 'OUTc_b_EnblManualFuelCut'. */
/begin CHARACTERISTIC OUTc_b_EnblManualFuelCut "Enable the fuel-cut logic for testing purposes" VALUE 0x8d289 RL_OUTC_B_ENBLMANUALFUELCUT 1.000000 CU_OUTC_B_ENBLMANUALFUELCUT 0.000000 1.000000 BYTE_ORDER MSB_FIRST /end CHARACTERISTIC
/begin RECORD_LAYOUT RL_OUTC_B_ENBLMANUALFUELCUT FNC_VALUES 1 UBYTE COLUMN_DIR DIRECT /end RECORD_LAYOUT
/begin COMPU_METHOD CU_OUTC_B_ENBLMANUALFUELCUT "Conversion method for OUTc_b_EnblManualFuelCut" RAT_FUNC "%10.0" "b" COEFFS 0.000000 1.000000 0.000000 0.000000 0.000000 1.000000 /end COMPU_METHOD
/* Scalar calibration for DDE 'OUTc_b_EnblManualSparkCut'. */
/begin CHARACTERISTIC OUTc_b_EnblManualSparkCut "Enable the spark-cut logic for testing purposes" VALUE 0x8d283 RL_OUTC_B_ENBLMANUALSPARKCUT 1.000000 CU_OUTC_B_ENBLMANUALSPARKCUT 0.000000 1.000000 BYTE_ORDER MSB_FIRST /end CHARACTERISTIC
/begin RECORD_LAYOUT RL_OUTC_B_ENBLMANUALSPARKCUT FNC_VALUES 1 UBYTE COLUMN_DIR DIRECT /end RECORD_LAYOUT
/begin COMPU_METHOD CU_OUTC_B_ENBLMANUALSPARKCUT "Conversion method for OUTc_b_EnblManualSparkCut" RAT_FUNC "%10.0" "b" COEFFS 0.000000 1.000000 0.000000 0.000000 0.000000 1.000000 /end COMPU_METHOD
/* Scalar calibration for DDE 'OUTc_b_FuelEnIgnoreSync'. */
/begin CHARACTERISTIC OUTc_b_FuelEnIgnoreSync "If True, allow injection LSD whether sycncd or not" VALUE 0x8d288 RL_OUTC_B_FUELENIGNORESYNC 1.000000 CU_OUTC_B_FUELENIGNORESYNC 0.000000 1.000000 BYTE_ORDER MSB_FIRST /end CHARACTERISTIC
/begin RECORD_LAYOUT RL_OUTC_B_FUELENIGNORESYNC FNC_VALUES 1 UBYTE COLUMN_DIR DIRECT /end RECORD_LAYOUT
/begin COMPU_METHOD CU_OUTC_B_FUELENIGNORESYNC "Conversion method for OUTc_b_FuelEnIgnoreSync" RAT_FUNC "%10.0" "b" COEFFS 0.000000 1.000000 0.000000 0.000000 0.000000 1.000000 /end COMPU_METHOD
/* Scalar calibration for DDE 'OUTc_b_InvertETC'. */
/begin CHARACTERISTIC OUTc_b_InvertETC "Configures the polarity of the ETC output" VALUE 0x8d0ba RL_OUTC_B_INVERTETC 1.000000 CU_OUTC_B_INVERTETC 0.000000 1.000000 BYTE_ORDER MSB_FIRST /end CHARACTERISTIC
/begin RECORD_LAYOUT RL_OUTC_B_INVERTETC FNC_VALUES 1 UBYTE COLUMN_DIR DIRECT /end RECORD_LAYOUT
/begin COMPU_METHOD CU_OUTC_B_INVERTETC "Conversion method for OUTc_b_InvertETC" RAT_FUNC "%10.0" "b" COEFFS 0.000000 1.000000 0.000000 0.000000 0.000000 1.000000 /end COMPU_METHOD
/end MODULE
/end PROJECT
