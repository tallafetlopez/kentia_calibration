ASAP2_VERSION 1 31
/begin PROJECT M670_Engine_Control_1.2.0_M670_000 "BeGas B430LG Turbocharged engine"
/begin HEADER "Begas Motor 2017-2022 (c)" VERSION "1_2_0" /end HEADER
/begin MODULE OpenECU_M670_000 ""
/* Scalar measurable for DDE 'ETC_b_TP2_LearnFull'. */
/begin MEASUREMENT ETC_b_TP2_LearnFull "Displayable" UBYTE CU_ETC_B_TP2_LEARNFULL 1 100 0.0 1.0 ECU_ADDRESS 0x40002eae BYTE_ORDER MSB_FIRST /end MEASUREMENT
/begin COMPU_METHOD CU_ETC_B_TP2_LEARNFULL "Conversion method for ETC_b_TP2_LearnFull" RAT_FUNC "%10.0" "b" COEFFS 0.000000 1.000000 0.000000 0.000000 0.000000 1.000000 /end COMPU_METHOD
/* Scalar measurable for DDE 'ETC_b_TP2_LearnZero'. */
/begin MEASUREMENT ETC_b_TP2_LearnZero "Displayable" UBYTE CU_ETC_B_TP2_LEARNZERO 1 100 0.0 1.0 ECU_ADDRESS 0x40002eb2 BYTE_ORDER MSB_FIRST /end MEASUREMENT
/begin COMPU_METHOD CU_ETC_B_TP2_LEARNZERO "Conversion method for ETC_b_TP2_LearnZero" RAT_FUNC "%10.0" "b" COEFFS 0.000000 1.000000 0.000000 0.000000 0.000000 1.000000 /end COMPU_METHOD
/* Scalar measurable for DDE 'ETC_b_TP2_ZeroPosOOR'. */
/begin MEASUREMENT ETC_b_TP2_ZeroPosOOR "Displayable" UBYTE CU_ETC_B_TP2_ZEROPOSOOR 1 100 0.0 1.0 ECU_ADDRESS 0x40002eb1 BYTE_ORDER MSB_FIRST /end MEASUREMENT
/begin COMPU_METHOD CU_ETC_B_TP2_ZEROPOSOOR "Conversion method for ETC_b_TP2_ZeroPosOOR" RAT_FUNC "%10.0" "b" COEFFS 0.000000 1.000000 0.000000 0.000000 0.000000 1.000000 /end COMPU_METHOD
/* Scalar measurable for DDE 'ETC_b_TP_CorrFlt'. */
/begin MEASUREMENT ETC_b_TP_CorrFlt "DiagFail flag" UBYTE CU_ETC_B_TP_CORRFLT 1 100 0.0 1.0 ECU_ADDRESS 0x40002ea3 BYTE_ORDER MSB_FIRST /end MEASUREMENT
/begin COMPU_METHOD CU_ETC_B_TP_CORRFLT "Conversion method for ETC_b_TP_CorrFlt" RAT_FUNC "%10.0" "b" COEFFS 0.000000 1.000000 0.000000 0.000000 0.000000 1.000000 /end COMPU_METHOD
/* Scalar measurable for DDE 'ETC_deg_Error'. */
/begin MEASUREMENT ETC_deg_Error "Displayable" FLOAT32_IEEE CU_ETC_DEG_ERROR 1 100 0.0 0.0 ECU_ADDRESS 0x400031a4 BYTE_ORDER MSB_FIRST /end MEASUREMENT
/begin COMPU_METHOD CU_ETC_DEG_ERROR "Conversion method for ETC_deg_Error" RAT_FUNC "%10.1" "deg" COEFFS 0.000000 1.000000 0.000000 0.000000 0.000000 1.000000 /end COMPU_METHOD
/* Scalar measurable for DDE 'ETC_deg_RelativeThRqst'. */
/begin MEASUREMENT ETC_deg_RelativeThRqst "Difference between rqst and rest position (used for FF lookup)" FLOAT32_IEEE CU_ETC_DEG_RELATIVETHRQST 1 100 0.0 0.0 ECU_ADDRESS 0x4000319c BYTE_ORDER MSB_FIRST /end MEASUREMENT
/begin COMPU_METHOD CU_ETC_DEG_RELATIVETHRQST "Conversion method for ETC_deg_RelativeThRqst" RAT_FUNC "%10.1" "deg" COEFFS 0.000000 1.000000 0.000000 0.000000 0.000000 1.000000 /end COMPU_METHOD
/* Scalar measurable for DDE 'ETC_deg_RestPos'. */
/begin MEASUREMENT ETC_deg_RestPos "Displayable" FLOAT32_IEEE CU_ETC_DEG_RESTPOS 1 100 0.0 90.0 ECU_ADDRESS 0x40003344 BYTE_ORDER MSB_FIRST /end MEASUREMENT
/begin COMPU_METHOD CU_ETC_DEG_RESTPOS "Conversion method for ETC_deg_RestPos" RAT_FUNC "%10.2" "deg" COEFFS 0.000000 1.000000 0.000000 0.000000 0.000000 1.000000 /end COMPU_METHOD
/* Scalar measurable for DDE 'ETC_deg_ThRqstFiltd'. */
/begin MEASUREMENT ETC_deg_ThRqstFiltd "Monitoring Corrected Throttle Angle" FLOAT32_IEEE CU_ETC_DEG_THRQSTFILTD 1 100 0.0 0.0 ECU_ADDRESS 0x40003338 BYTE_ORDER MSB_FIRST /end MEASUREMENT
/begin COMPU_METHOD CU_ETC_DEG_THRQSTFILTD "Conversion method for ETC_deg_ThRqstFiltd" RAT_FUNC "%10.3" "deg" COEFFS 0.000000 1.000000 0.000000 0.000000 0.000000 1.000000 /end COMPU_METHOD
/* Scalar measurable for DDE 'ETC_deg_ThRqstHPF'. */
/begin MEASUREMENT ETC_deg_ThRqstHPF "Throttle request HPF result" FLOAT32_IEEE CU_ETC_DEG_THRQSTHPF 1 100 0.0 0.0 ECU_ADDRESS 0x400031a8 BYTE_ORDER MSB_FIRST /end MEASUREMENT
/begin COMPU_METHOD CU_ETC_DEG_THRQSTHPF "Conversion method for ETC_deg_ThRqstHPF" RAT_FUNC "%10.2" "deg" COEFFS 0.000000 1.000000 0.000000 0.000000 0.000000 1.000000 /end COMPU_METHOD
/* Scalar measurable for DDE 'ETC_deg_VlvPos'. */
/begin MEASUREMENT ETC_deg_VlvPos "Arbitrated throttle blade position" FLOAT32_IEEE CU_ETC_DEG_VLVPOS 1 100 0.0 0.0 ECU_ADDRESS 0x40003348 BYTE_ORDER MSB_FIRST /end MEASUREMENT
/begin COMPU_METHOD CU_ETC_DEG_VLVPOS "Conversion method for ETC_deg_VlvPos" RAT_FUNC "%10.1" "deg" COEFFS 0.000000 1.000000 0.000000 0.000000 0.000000 1.000000 /end COMPU_METHOD
/* Scalar measurable for DDE 'ETC_pct_AvgTP'. */
/begin MEASUREMENT ETC_pct_AvgTP "Average throttle position (taken after xfr)" FLOAT32_IEEE CU_ETC_PCT_AVGTP 1 100 0.0 0.0 ECU_ADDRESS 0x40003230 BYTE_ORDER MSB_FIRST /end MEASUREMENT
/begin COMPU_METHOD CU_ETC_PCT_AVGTP "Conversion method for ETC_pct_AvgTP" RAT_FUNC "%10.2" "pct" COEFFS 0.000000 1.000000 0.000000 0.000000 0.000000 1.000000 /end COMPU_METHOD
/* Scalar measurable for DDE 'ETC_pct_Effort'. */
/begin MEASUREMENT ETC_pct_Effort "Displayable" FLOAT32_IEEE CU_ETC_PCT_EFFORT 1 100 0.0 0.0 ECU_ADDRESS 0x4000317c BYTE_ORDER MSB_FIRST /end MEASUREMENT
/begin COMPU_METHOD CU_ETC_PCT_EFFORT "Conversion method for ETC_pct_Effort" RAT_FUNC "%10.2" "pct" COEFFS 0.000000 1.000000 0.000000 0.000000 0.000000 1.000000 /end COMPU_METHOD
/* Scalar measurable for DDE 'ETC_pct_FB'. */
/begin MEASUREMENT ETC_pct_FB "Displayable" FLOAT32_IEEE CU_ETC_PCT_FB 1 100 0.0 0.0 ECU_ADDRESS 0x40003180 BYTE_ORDER MSB_FIRST /end MEASUREMENT
/begin COMPU_METHOD CU_ETC_PCT_FB "Conversion method for ETC_pct_FB" RAT_FUNC "%10.2" "pct" COEFFS 0.000000 1.000000 0.000000 0.000000 0.000000 1.000000 /end COMPU_METHOD
/* Scalar measurable for DDE 'ETC_pct_FF'. */
/begin MEASUREMENT ETC_pct_FF "Feedforward effort" FLOAT32_IEEE CU_ETC_PCT_FF 1 100 0.0 0.0 ECU_ADDRESS 0x40003198 BYTE_ORDER MSB_FIRST /end MEASUREMENT
/begin COMPU_METHOD CU_ETC_PCT_FF "Conversion method for ETC_pct_FF" RAT_FUNC "%10.2" "pct" COEFFS 0.000000 1.000000 0.000000 0.000000 0.000000 1.000000 /end COMPU_METHOD
/* Scalar measurable for DDE 'ETC_pct_Hyst'. */
/begin MEASUREMENT ETC_pct_Hyst "Feedforward effort" FLOAT32_IEEE CU_ETC_PCT_HYST 1 100 0.0 0.0 ECU_ADDRESS 0x400031a0 BYTE_ORDER MSB_FIRST /end MEASUREMENT
/begin COMPU_METHOD CU_ETC_PCT_HYST "Conversion method for ETC_pct_Hyst" RAT_FUNC "%10.3" "pct" COEFFS 0.000000 1.000000 0.000000 0.000000 0.000000 1.000000 /end COMPU_METHOD
/* Scalar measurable for DDE 'ETC_pct_Kick'. */
/begin MEASUREMENT ETC_pct_Kick "Kick term output" FLOAT32_IEEE CU_ETC_PCT_KICK 1 100 0.0 0.0 ECU_ADDRESS 0x40003174 BYTE_ORDER MSB_FIRST /end MEASUREMENT
/begin COMPU_METHOD CU_ETC_PCT_KICK "Conversion method for ETC_pct_Kick" RAT_FUNC "%10.3" "pct" COEFFS 0.000000 1.000000 0.000000 0.000000 0.000000 1.000000 /end COMPU_METHOD
/* Scalar measurable for DDE 'ETC_pct_Kick_error'. */
/begin MEASUREMENT ETC_pct_Kick_error "(not defined)" FLOAT32_IEEE CU_ETC_PCT_KICK_ERROR 1 100 -1000.0 1000.0 ECU_ADDRESS 0x4000316c BYTE_ORDER MSB_FIRST /end MEASUREMENT
/begin COMPU_METHOD CU_ETC_PCT_KICK_ERROR "Conversion method for ETC_pct_Kick_error" RAT_FUNC "%10.2" "pct" COEFFS 0.000000 1.000000 0.000000 0.000000 0.000000 1.000000 /end COMPU_METHOD
/* Scalar measurable for DDE 'ETC_pct_MotorCmd'. */
/begin MEASUREMENT ETC_pct_MotorCmd "Final actuator command" FLOAT32_IEEE CU_ETC_PCT_MOTORCMD 1 100 0.0 0.0 ECU_ADDRESS 0x400031fc BYTE_ORDER MSB_FIRST /end MEASUREMENT
/begin COMPU_METHOD CU_ETC_PCT_MOTORCMD "Conversion method for ETC_pct_MotorCmd" RAT_FUNC "%10.2" "pct" COEFFS 0.000000 1.000000 0.000000 0.000000 0.000000 1.000000 /end COMPU_METHOD
/* Scalar measurable for DDE 'ETC_pct_MotorCmdVb'. */
/begin MEASUREMENT ETC_pct_MotorCmdVb "Final actuator command" FLOAT32_IEEE CU_ETC_PCT_MOTORCMDVB 1 100 0.0 0.0 ECU_ADDRESS 0x40003334 BYTE_ORDER MSB_FIRST /end MEASUREMENT
/begin COMPU_METHOD CU_ETC_PCT_MOTORCMDVB "Conversion method for ETC_pct_MotorCmdVb" RAT_FUNC "%10.2" "pct" COEFFS 0.000000 1.000000 0.000000 0.000000 0.000000 1.000000 /end COMPU_METHOD
/* Scalar measurable for DDE 'ETC_pct_TP1'. */
/begin MEASUREMENT ETC_pct_TP1 "throttle position 1 percent" FLOAT32_IEEE CU_ETC_PCT_TP1 1 100 0.0 0.0 ECU_ADDRESS 0x4000335c BYTE_ORDER MSB_FIRST /end MEASUREMENT
/begin COMPU_METHOD CU_ETC_PCT_TP1 "Conversion method for ETC_pct_TP1" RAT_FUNC "%10.3" "pct" COEFFS 0.000000 1.000000 0.000000 0.000000 0.000000 1.000000 /end COMPU_METHOD
/* Scalar measurable for DDE 'ETC_pct_TP2'. */
/begin MEASUREMENT ETC_pct_TP2 "throttle position 2 percent" FLOAT32_IEEE CU_ETC_PCT_TP2 1 100 0.0 0.0 ECU_ADDRESS 0x40003350 BYTE_ORDER MSB_FIRST /end MEASUREMENT
/begin COMPU_METHOD CU_ETC_PCT_TP2 "Conversion method for ETC_pct_TP2" RAT_FUNC "%10.3" "pct" COEFFS 0.000000 1.000000 0.000000 0.000000 0.000000 1.000000 /end COMPU_METHOD
/* Scalar measurable for DDE 'ETC_pct_TP_Delta'. */
/begin MEASUREMENT ETC_pct_TP_Delta "TP1-TP2 difference" FLOAT32_IEEE CU_ETC_PCT_TP_DELTA 1 100 0.0 0.0 ECU_ADDRESS 0x4000334c BYTE_ORDER MSB_FIRST /end MEASUREMENT
/begin COMPU_METHOD CU_ETC_PCT_TP_DELTA "Conversion method for ETC_pct_TP_Delta" RAT_FUNC "%10.2" "pct" COEFFS 0.000000 1.000000 0.000000 0.000000 0.000000 1.000000 /end COMPU_METHOD
/* Scalar measurable for DDE 'FCA_Km_AcumDistance'. */
/begin MEASUREMENT FCA_Km_AcumDistance "Distance learn default value" FLOAT32_IEEE CU_FCA_KM_ACUMDISTANCE 1 100 0.0 0.0 ECU_ADDRESS 0x400031d8 BYTE_ORDER MSB_FIRST /end MEASUREMENT
/begin COMPU_METHOD CU_FCA_KM_ACUMDISTANCE "Conversion method for FCA_Km_AcumDistance" RAT_FUNC "%10.0" "km" COEFFS 0.000000 1.000000 0.000000 0.000000 0.000000 1.000000 /end COMPU_METHOD
/* Scalar measurable for DDE 'FCA_L_AcumFuelComsuption'. */
/begin MEASUREMENT FCA_L_AcumFuelComsuption "Fuel consumption learn default value" FLOAT32_IEEE CU_FCA_L_ACUMFUELCOMSUPTION 1 100 0.0 0.0 ECU_ADDRESS 0x400031d0 BYTE_ORDER MSB_FIRST /end MEASUREMENT
/begin COMPU_METHOD CU_FCA_L_ACUMFUELCOMSUPTION "Conversion method for FCA_L_AcumFuelComsuption" RAT_FUNC "%10.1" "L" COEFFS 0.000000 1.000000 0.000000 0.000000 0.000000 1.000000 /end COMPU_METHOD
/* Scalar measurable for DDE 'FCA_L_TotalFuelFlow'. */
/begin MEASUREMENT FCA_L_TotalFuelFlow "Fuel consumption" FLOAT32_IEEE CU_FCA_L_TOTALFUELFLOW 1 100 0.0 0.0 ECU_ADDRESS 0x400031d4 BYTE_ORDER MSB_FIRST /end MEASUREMENT
/begin COMPU_METHOD CU_FCA_L_TOTALFUELFLOW "Conversion method for FCA_L_TotalFuelFlow" RAT_FUNC "%10.1" "L" COEFFS 0.000000 1.000000 0.000000 0.000000 0.000000 1.000000 /end COMPU_METHOD
/* Scalar measurable for DDE 'FCA_kps_VhSpd'. */
/begin MEASUREMENT FCA_kps_VhSpd "vehicle speed (kilometers per seconds)" FLOAT32_IEEE CU_FCA_KPS_VHSPD 1 100 0.0 0.0 ECU_ADDRESS 0x400031dc BYTE_ORDER MSB_FIRST /end MEASUREMENT
/begin COMPU_METHOD CU_FCA_KPS_VHSPD "Conversion method for FCA_kps_VhSpd" RAT_FUNC "%10.5" "kps" COEFFS 0.000000 1.000000 0.000000 0.000000 0.000000 1.000000 /end COMPU_METHOD
/* Scalar measurable for DDE 'FCA_lpk_AverageFuelConsumption'. */
/begin MEASUREMENT FCA_lpk_AverageFuelConsumption "Fuel consumption in Liters per 100km" FLOAT32_IEEE CU_FCA_LPK_AVERAGEFUELCONSUMPT0 1 100 0.0 0.0 ECU_ADDRESS 0x400031f8 BYTE_ORDER MSB_FIRST /end MEASUREMENT
/begin COMPU_METHOD CU_FCA_LPK_AVERAGEFUELCONSUMPT0 "Conversion method for FCA_lpk_AverageFuelConsumption" RAT_FUNC "%10.1" "lpk" COEFFS 0.000000 1.000000 0.000000 0.000000 0.000000 1.000000 /end COMPU_METHOD
/* Scalar measurable for DDE 'FLT_NU_APP1'. */
/begin MEASUREMENT FLT_NU_APP1 "Exported Global for sensor fault status" UBYTE CU_FLT_NU_APP1 1 100 0.0 0.0 ECU_ADDRESS 0x40003000 BYTE_ORDER MSB_FIRST /end MEASUREMENT
/begin COMPU_METHOD CU_FLT_NU_APP1 "Conversion method for FLT_NU_APP1" RAT_FUNC "%10.0" "NU" COEFFS 0.000000 1.000000 0.000000 0.000000 0.000000 1.000000 /end COMPU_METHOD
/* Scalar measurable for DDE 'FLT_NU_APP2'. */
/begin MEASUREMENT FLT_NU_APP2 "Exported Global for sensor fault status" UBYTE CU_FLT_NU_APP2 1 100 0.0 0.0 ECU_ADDRESS 0x40002fff BYTE_ORDER MSB_FIRST /end MEASUREMENT
/begin COMPU_METHOD CU_FLT_NU_APP2 "Conversion method for FLT_NU_APP2" RAT_FUNC "%10.0" "NU" COEFFS 0.000000 1.000000 0.000000 0.000000 0.000000 1.000000 /end COMPU_METHOD
/* Scalar measurable for DDE 'FLT_NU_BrkSw'. */
/begin MEASUREMENT FLT_NU_BrkSw "Exported Global for sensor fault status" UBYTE CU_FLT_NU_BRKSW 1 100 0.0 0.0 ECU_ADDRESS 0x40003001 BYTE_ORDER MSB_FIRST /end MEASUREMENT
/begin COMPU_METHOD CU_FLT_NU_BRKSW "Conversion method for FLT_NU_BrkSw" RAT_FUNC "%10.0" "NU" COEFFS 0.000000 1.000000 0.000000 0.000000 0.000000 1.000000 /end COMPU_METHOD
/* Scalar measurable for DDE 'FLT_NU_CAN_CCVS'. */
/begin MEASUREMENT FLT_NU_CAN_CCVS "Exported Global for sensor fault status" UBYTE CU_FLT_NU_CAN_CCVS 1 100 0.0 0.0 ECU_ADDRESS 0x40002ffe BYTE_ORDER MSB_FIRST /end MEASUREMENT
/begin COMPU_METHOD CU_FLT_NU_CAN_CCVS "Conversion method for FLT_NU_CAN_CCVS" RAT_FUNC "%10.0" "NU" COEFFS 0.000000 1.000000 0.000000 0.000000 0.000000 1.000000 /end COMPU_METHOD
/* Scalar measurable for DDE 'FLT_NU_CamPhaser'. */
/begin MEASUREMENT FLT_NU_CamPhaser "Exported Global for sensor fault status" UBYTE CU_FLT_NU_CAMPHASER 1 100 0.0 0.0 ECU_ADDRESS 0x40002ffc BYTE_ORDER MSB_FIRST /end MEASUREMENT
/begin COMPU_METHOD CU_FLT_NU_CAMPHASER "Conversion method for FLT_NU_CamPhaser" RAT_FUNC "%10.0" "NU" COEFFS 0.000000 1.000000 0.000000 0.000000 0.000000 1.000000 /end COMPU_METHOD
/* Scalar measurable for DDE 'FLT_NU_CoolantTemp'. */
/begin MEASUREMENT FLT_NU_CoolantTemp "Exported Global for sensor fault status" UBYTE CU_FLT_NU_COOLANTTEMP 1 100 0.0 0.0 ECU_ADDRESS 0x40003006 BYTE_ORDER MSB_FIRST /end MEASUREMENT
/begin COMPU_METHOD CU_FLT_NU_COOLANTTEMP "Conversion method for FLT_NU_CoolantTemp" RAT_FUNC "%10.0" "NU" COEFFS 0.000000 1.000000 0.000000 0.000000 0.000000 1.000000 /end COMPU_METHOD
/* Scalar measurable for DDE 'FLT_NU_ECU'. */
/begin MEASUREMENT FLT_NU_ECU "Exported Global for sensor fault status" UBYTE CU_FLT_NU_ECU 1 100 0.0 0.0 ECU_ADDRESS 0x40003002 BYTE_ORDER MSB_FIRST /end MEASUREMENT
/begin COMPU_METHOD CU_FLT_NU_ECU "Conversion method for FLT_NU_ECU" RAT_FUNC "%10.0" "NU" COEFFS 0.000000 1.000000 0.000000 0.000000 0.000000 1.000000 /end COMPU_METHOD
/* Scalar measurable for DDE 'FLT_NU_EGO11'. */
/begin MEASUREMENT FLT_NU_EGO11 "Exported Global for sensor fault status" UBYTE CU_FLT_NU_EGO11 1 100 0.0 0.0 ECU_ADDRESS 0x4000300c BYTE_ORDER MSB_FIRST /end MEASUREMENT
/begin COMPU_METHOD CU_FLT_NU_EGO11 "Conversion method for FLT_NU_EGO11" RAT_FUNC "%10.0" "NU" COEFFS 0.000000 1.000000 0.000000 0.000000 0.000000 1.000000 /end COMPU_METHOD
/* Scalar measurable for DDE 'FLT_NU_EGO12'. */
/begin MEASUREMENT FLT_NU_EGO12 "Exported Global for sensor fault status" UBYTE CU_FLT_NU_EGO12 1 100 0.0 0.0 ECU_ADDRESS 0x4000300a BYTE_ORDER MSB_FIRST /end MEASUREMENT
/begin COMPU_METHOD CU_FLT_NU_EGO12 "Conversion method for FLT_NU_EGO12" RAT_FUNC "%10.0" "NU" COEFFS 0.000000 1.000000 0.000000 0.000000 0.000000 1.000000 /end COMPU_METHOD
/* Scalar measurable for DDE 'FLT_NU_EGO21'. */
/begin MEASUREMENT FLT_NU_EGO21 "Exported Global for sensor fault status" UBYTE CU_FLT_NU_EGO21 1 100 0.0 0.0 ECU_ADDRESS 0x4000300b BYTE_ORDER MSB_FIRST /end MEASUREMENT
/begin COMPU_METHOD CU_FLT_NU_EGO21 "Conversion method for FLT_NU_EGO21" RAT_FUNC "%10.0" "NU" COEFFS 0.000000 1.000000 0.000000 0.000000 0.000000 1.000000 /end COMPU_METHOD
/* Scalar measurable for DDE 'FLT_NU_EGO22'. */
/begin MEASUREMENT FLT_NU_EGO22 "Exported Global for sensor fault status" UBYTE CU_FLT_NU_EGO22 1 100 0.0 0.0 ECU_ADDRESS 0x40003009 BYTE_ORDER MSB_FIRST /end MEASUREMENT
/begin COMPU_METHOD CU_FLT_NU_EGO22 "Conversion method for FLT_NU_EGO22" RAT_FUNC "%10.0" "NU" COEFFS 0.000000 1.000000 0.000000 0.000000 0.000000 1.000000 /end COMPU_METHOD
/* Scalar measurable for DDE 'FLT_NU_ETC'. */
/begin MEASUREMENT FLT_NU_ETC "Exported Global for sensor fault status" UBYTE CU_FLT_NU_ETC 1 100 0.0 0.0 ECU_ADDRESS 0x40002ffd BYTE_ORDER MSB_FIRST /end MEASUREMENT
/begin COMPU_METHOD CU_FLT_NU_ETC "Conversion method for FLT_NU_ETC" RAT_FUNC "%10.0" "NU" COEFFS 0.000000 1.000000 0.000000 0.000000 0.000000 1.000000 /end COMPU_METHOD
/* Scalar measurable for DDE 'FLT_NU_FCV'. */
/begin MEASUREMENT FLT_NU_FCV "Exported Global for sensor fault status" UBYTE CU_FLT_NU_FCV 1 100 0.0 0.0 ECU_ADDRESS 0x40002ffb BYTE_ORDER MSB_FIRST /end MEASUREMENT
/begin COMPU_METHOD CU_FLT_NU_FCV "Conversion method for FLT_NU_FCV" RAT_FUNC "%10.0" "NU" COEFFS 0.000000 1.000000 0.000000 0.000000 0.000000 1.000000 /end COMPU_METHOD
/* Scalar measurable for DDE 'FLT_NU_HighLevel1'. */
/begin MEASUREMENT FLT_NU_HighLevel1 "High level Exported Global for sensor fault status" ULONG CU_FLT_NU_HIGHLEVEL1 1 100 0.0 0.0 ECU_ADDRESS 0x40003044 BYTE_ORDER MSB_FIRST /end MEASUREMENT
/begin COMPU_METHOD CU_FLT_NU_HIGHLEVEL1 "Conversion method for FLT_NU_HighLevel1" RAT_FUNC "%10.0" "NU" COEFFS 0.000000 1.000000 0.000000 0.000000 0.000000 1.000000 /end COMPU_METHOD
/* Scalar measurable for DDE 'FLT_NU_HighLevel2'. */
/begin MEASUREMENT FLT_NU_HighLevel2 "High level Exported Global for sensor fault status" ULONG CU_FLT_NU_HIGHLEVEL2 1 100 0.0 0.0 ECU_ADDRESS 0x40003040 BYTE_ORDER MSB_FIRST /end MEASUREMENT
/begin COMPU_METHOD CU_FLT_NU_HIGHLEVEL2 "Conversion method for FLT_NU_HighLevel2" RAT_FUNC "%10.0" "NU" COEFFS 0.000000 1.000000 0.000000 0.000000 0.000000 1.000000 /end COMPU_METHOD
/* Scalar measurable for DDE 'FLT_NU_Inj1'. */
/begin MEASUREMENT FLT_NU_Inj1 "Exported Global for sensor fault status" UBYTE CU_FLT_NU_INJ1 1 100 0.0 0.0 ECU_ADDRESS 0x40002ff8 BYTE_ORDER MSB_FIRST /end MEASUREMENT
/begin COMPU_METHOD CU_FLT_NU_INJ1 "Conversion method for FLT_NU_Inj1" RAT_FUNC "%10.0" "NU" COEFFS 0.000000 1.000000 0.000000 0.000000 0.000000 1.000000 /end COMPU_METHOD
/* Scalar measurable for DDE 'FLT_NU_Inj2'. */
/begin MEASUREMENT FLT_NU_Inj2 "Exported Global for sensor fault status" UBYTE CU_FLT_NU_INJ2 1 100 0.0 0.0 ECU_ADDRESS 0x40002ff7 BYTE_ORDER MSB_FIRST /end MEASUREMENT
/begin COMPU_METHOD CU_FLT_NU_INJ2 "Conversion method for FLT_NU_Inj2" RAT_FUNC "%10.0" "NU" COEFFS 0.000000 1.000000 0.000000 0.000000 0.000000 1.000000 /end COMPU_METHOD
/* Scalar measurable for DDE 'FLT_NU_Inj3'. */
/begin MEASUREMENT FLT_NU_Inj3 "Exported Global for sensor fault status" UBYTE CU_FLT_NU_INJ3 1 100 0.0 0.0 ECU_ADDRESS 0x40002ff6 BYTE_ORDER MSB_FIRST /end MEASUREMENT
/begin COMPU_METHOD CU_FLT_NU_INJ3 "Conversion method for FLT_NU_Inj3" RAT_FUNC "%10.0" "NU" COEFFS 0.000000 1.000000 0.000000 0.000000 0.000000 1.000000 /end COMPU_METHOD
/* Scalar measurable for DDE 'FLT_NU_Inj4'. */
/begin MEASUREMENT FLT_NU_Inj4 "Exported Global for sensor fault status" UBYTE CU_FLT_NU_INJ4 1 100 0.0 0.0 ECU_ADDRESS 0x40002ff5 BYTE_ORDER MSB_FIRST /end MEASUREMENT
/begin COMPU_METHOD CU_FLT_NU_INJ4 "Conversion method for FLT_NU_Inj4" RAT_FUNC "%10.0" "NU" COEFFS 0.000000 1.000000 0.000000 0.000000 0.000000 1.000000 /end COMPU_METHOD
/* Scalar measurable for DDE 'FLT_NU_Inj5'. */
/begin MEASUREMENT FLT_NU_Inj5 "Exported Global for sensor fault status" UBYTE CU_FLT_NU_INJ5 1 100 0.0 0.0 ECU_ADDRESS 0x40002ff4 BYTE_ORDER MSB_FIRST /end MEASUREMENT
/begin COMPU_METHOD CU_FLT_NU_INJ5 "Conversion method for FLT_NU_Inj5" RAT_FUNC "%10.0" "NU" COEFFS 0.000000 1.000000 0.000000 0.000000 0.000000 1.000000 /end COMPU_METHOD
/* Scalar measurable for DDE 'FLT_NU_Inj6'. */
/begin MEASUREMENT FLT_NU_Inj6 "Exported Global for sensor fault status" UBYTE CU_FLT_NU_INJ6 1 100 0.0 0.0 ECU_ADDRESS 0x40002ff3 BYTE_ORDER MSB_FIRST /end MEASUREMENT
/begin COMPU_METHOD CU_FLT_NU_INJ6 "Conversion method for FLT_NU_Inj6" RAT_FUNC "%10.0" "NU" COEFFS 0.000000 1.000000 0.000000 0.000000 0.000000 1.000000 /end COMPU_METHOD
/* Scalar measurable for DDE 'FLT_NU_Inj7'. */
/begin MEASUREMENT FLT_NU_Inj7 "Exported Global for sensor fault status" UBYTE CU_FLT_NU_INJ7 1 100 0.0 0.0 ECU_ADDRESS 0x40002ff2 BYTE_ORDER MSB_FIRST /end MEASUREMENT
/begin COMPU_METHOD CU_FLT_NU_INJ7 "Conversion method for FLT_NU_Inj7" RAT_FUNC "%10.0" "NU" COEFFS 0.000000 1.000000 0.000000 0.000000 0.000000 1.000000 /end COMPU_METHOD
/* Scalar measurable for DDE 'FLT_NU_Inj8'. */
/begin MEASUREMENT FLT_NU_Inj8 "Exported Global for sensor fault status" UBYTE CU_FLT_NU_INJ8 1 100 0.0 0.0 ECU_ADDRESS 0x40002ff1 BYTE_ORDER MSB_FIRST /end MEASUREMENT
/begin COMPU_METHOD CU_FLT_NU_INJ8 "Conversion method for FLT_NU_Inj8" RAT_FUNC "%10.0" "NU" COEFFS 0.000000 1.000000 0.000000 0.000000 0.000000 1.000000 /end COMPU_METHOD
/* Scalar measurable for DDE 'FLT_NU_MAF'. */
/begin MEASUREMENT FLT_NU_MAF "Exported Global for sensor fault status" UBYTE CU_FLT_NU_MAF 1 100 0.0 0.0 ECU_ADDRESS 0x4000300d BYTE_ORDER MSB_FIRST /end MEASUREMENT
/begin COMPU_METHOD CU_FLT_NU_MAF "Conversion method for FLT_NU_MAF" RAT_FUNC "%10.0" "NU" COEFFS 0.000000 1.000000 0.000000 0.000000 0.000000 1.000000 /end COMPU_METHOD
/* Scalar measurable for DDE 'FLT_NU_OilTemp'. */
/begin MEASUREMENT FLT_NU_OilTemp "Exported Global for sensor fault status" UBYTE CU_FLT_NU_OILTEMP 1 100 0.0 0.0 ECU_ADDRESS 0x40003005 BYTE_ORDER MSB_FIRST /end MEASUREMENT
/begin COMPU_METHOD CU_FLT_NU_OILTEMP "Conversion method for FLT_NU_OilTemp" RAT_FUNC "%10.0" "NU" COEFFS 0.000000 1.000000 0.000000 0.000000 0.000000 1.000000 /end COMPU_METHOD
/* Scalar measurable for DDE 'FLT_NU_PSU'. */
/begin MEASUREMENT FLT_NU_PSU "Exported Global for sensor fault status" UBYTE CU_FLT_NU_PSU 1 100 0.0 0.0 ECU_ADDRESS 0x40003003 BYTE_ORDER MSB_FIRST /end MEASUREMENT
/begin COMPU_METHOD CU_FLT_NU_PSU "Conversion method for FLT_NU_PSU" RAT_FUNC "%10.0" "NU" COEFFS 0.000000 1.000000 0.000000 0.000000 0.000000 1.000000 /end COMPU_METHOD
/* Scalar measurable for DDE 'FLT_NU_PurgeVlv'. */
/begin MEASUREMENT FLT_NU_PurgeVlv "Exported Global for sensor fault status" UBYTE CU_FLT_NU_PURGEVLV 1 100 0.0 0.0 ECU_ADDRESS 0x40002ff9 BYTE_ORDER MSB_FIRST /end MEASUREMENT
/begin COMPU_METHOD CU_FLT_NU_PURGEVLV "Conversion method for FLT_NU_PurgeVlv" RAT_FUNC "%10.0" "NU" COEFFS 0.000000 1.000000 0.000000 0.000000 0.000000 1.000000 /end COMPU_METHOD
/* Scalar measurable for DDE 'FLT_NU_Spk1'. */
/begin MEASUREMENT FLT_NU_Spk1 "Exported Global for sensor fault status" UBYTE CU_FLT_NU_SPK1 1 100 0.0 0.0 ECU_ADDRESS 0x40002ff0 BYTE_ORDER MSB_FIRST /end MEASUREMENT
/begin COMPU_METHOD CU_FLT_NU_SPK1 "Conversion method for FLT_NU_Spk1" RAT_FUNC "%10.0" "NU" COEFFS 0.000000 1.000000 0.000000 0.000000 0.000000 1.000000 /end COMPU_METHOD
/* Scalar measurable for DDE 'FLT_NU_Spk2'. */
/begin MEASUREMENT FLT_NU_Spk2 "Exported Global for sensor fault status" UBYTE CU_FLT_NU_SPK2 1 100 0.0 0.0 ECU_ADDRESS 0x40002fef BYTE_ORDER MSB_FIRST /end MEASUREMENT
/begin COMPU_METHOD CU_FLT_NU_SPK2 "Conversion method for FLT_NU_Spk2" RAT_FUNC "%10.0" "NU" COEFFS 0.000000 1.000000 0.000000 0.000000 0.000000 1.000000 /end COMPU_METHOD
/* Scalar measurable for DDE 'FLT_NU_Spk3'. */
/begin MEASUREMENT FLT_NU_Spk3 "Exported Global for sensor fault status" UBYTE CU_FLT_NU_SPK3 1 100 0.0 0.0 ECU_ADDRESS 0x40002fee BYTE_ORDER MSB_FIRST /end MEASUREMENT
/begin COMPU_METHOD CU_FLT_NU_SPK3 "Conversion method for FLT_NU_Spk3" RAT_FUNC "%10.0" "NU" COEFFS 0.000000 1.000000 0.000000 0.000000 0.000000 1.000000 /end COMPU_METHOD
/* Scalar measurable for DDE 'FLT_NU_Spk4'. */
/begin MEASUREMENT FLT_NU_Spk4 "Exported Global for sensor fault status" UBYTE CU_FLT_NU_SPK4 1 100 0.0 0.0 ECU_ADDRESS 0x40002fed BYTE_ORDER MSB_FIRST /end MEASUREMENT
/begin COMPU_METHOD CU_FLT_NU_SPK4 "Conversion method for FLT_NU_Spk4" RAT_FUNC "%10.0" "NU" COEFFS 0.000000 1.000000 0.000000 0.000000 0.000000 1.000000 /end COMPU_METHOD
/* Scalar measurable for DDE 'FLT_NU_Spk5'. */
/begin MEASUREMENT FLT_NU_Spk5 "Exported Global for sensor fault status" UBYTE CU_FLT_NU_SPK5 1 100 0.0 0.0 ECU_ADDRESS 0x40002fec BYTE_ORDER MSB_FIRST /end MEASUREMENT
/begin COMPU_METHOD CU_FLT_NU_SPK5 "Conversion method for FLT_NU_Spk5" RAT_FUNC "%10.0" "NU" COEFFS 0.000000 1.000000 0.000000 0.000000 0.000000 1.000000 /end COMPU_METHOD
/* Scalar measurable for DDE 'FLT_NU_Spk6'. */
/begin MEASUREMENT FLT_NU_Spk6 "Exported Global for sensor fault status" UBYTE CU_FLT_NU_SPK6 1 100 0.0 0.0 ECU_ADDRESS 0x40002feb BYTE_ORDER MSB_FIRST /end MEASUREMENT
/begin COMPU_METHOD CU_FLT_NU_SPK6 "Conversion method for FLT_NU_Spk6" RAT_FUNC "%10.0" "NU" COEFFS 0.000000 1.000000 0.000000 0.000000 0.000000 1.000000 /end COMPU_METHOD
/* Scalar measurable for DDE 'FLT_NU_Spk7'. */
/begin MEASUREMENT FLT_NU_Spk7 "Exported Global for sensor fault status" UBYTE CU_FLT_NU_SPK7 1 100 0.0 0.0 ECU_ADDRESS 0x40002fea BYTE_ORDER MSB_FIRST /end MEASUREMENT
/begin COMPU_METHOD CU_FLT_NU_SPK7 "Conversion method for FLT_NU_Spk7" RAT_FUNC "%10.0" "NU" COEFFS 0.000000 1.000000 0.000000 0.000000 0.000000 1.000000 /end COMPU_METHOD
/* Scalar measurable for DDE 'FLT_NU_Spk8'. */
/begin MEASUREMENT FLT_NU_Spk8 "Exported Global for sensor fault status" UBYTE CU_FLT_NU_SPK8 1 100 0.0 0.0 ECU_ADDRESS 0x40002fe9 BYTE_ORDER MSB_FIRST /end MEASUREMENT
/begin COMPU_METHOD CU_FLT_NU_SPK8 "Conversion method for FLT_NU_Spk8" RAT_FUNC "%10.0" "NU" COEFFS 0.000000 1.000000 0.000000 0.000000 0.000000 1.000000 /end COMPU_METHOD
/* Scalar measurable for DDE 'FLT_NU_TP1'. */
/begin MEASUREMENT FLT_NU_TP1 "Exported Global for sensor fault status" UBYTE CU_FLT_NU_TP1 1 100 0.0 0.0 ECU_ADDRESS 0x40003010 BYTE_ORDER MSB_FIRST /end MEASUREMENT
/begin COMPU_METHOD CU_FLT_NU_TP1 "Conversion method for FLT_NU_TP1" RAT_FUNC "%10.0" "NU" COEFFS 0.000000 1.000000 0.000000 0.000000 0.000000 1.000000 /end COMPU_METHOD
/* Scalar measurable for DDE 'FLT_NU_TP2'. */
/begin MEASUREMENT FLT_NU_TP2 "Exported Global for sensor fault status" UBYTE CU_FLT_NU_TP2 1 100 0.0 0.0 ECU_ADDRESS 0x4000300f BYTE_ORDER MSB_FIRST /end MEASUREMENT
/begin COMPU_METHOD CU_FLT_NU_TP2 "Conversion method for FLT_NU_TP2" RAT_FUNC "%10.0" "NU" COEFFS 0.000000 1.000000 0.000000 0.000000 0.000000 1.000000 /end COMPU_METHOD
/* Scalar measurable for DDE 'FLT_NU_TurCtrl'. */
/begin MEASUREMENT FLT_NU_TurCtrl "Exported Global for sensor fault status" UBYTE CU_FLT_NU_TURCTRL 1 100 0.0 0.0 ECU_ADDRESS 0x40002ffa BYTE_ORDER MSB_FIRST /end MEASUREMENT
/begin COMPU_METHOD CU_FLT_NU_TURCTRL "Conversion method for FLT_NU_TurCtrl" RAT_FUNC "%10.0" "NU" COEFFS 0.000000 1.000000 0.000000 0.000000 0.000000 1.000000 /end COMPU_METHOD
/* Scalar measurable for DDE 'FLT_NU_UEGO1'. */
/begin MEASUREMENT FLT_NU_UEGO1 "Exported Global for sensor fault status" UBYTE CU_FLT_NU_UEGO1 1 100 0.0 0.0 ECU_ADDRESS 0x40003008 BYTE_ORDER MSB_FIRST /end MEASUREMENT
/begin COMPU_METHOD CU_FLT_NU_UEGO1 "Conversion method for FLT_NU_UEGO1" RAT_FUNC "%10.0" "NU" COEFFS 0.000000 1.000000 0.000000 0.000000 0.000000 1.000000 /end COMPU_METHOD
/* Scalar measurable for DDE 'FLT_NU_UEGO2'. */
/begin MEASUREMENT FLT_NU_UEGO2 "Exported Global for sensor fault status" UBYTE CU_FLT_NU_UEGO2 1 100 0.0 0.0 ECU_ADDRESS 0x40003007 BYTE_ORDER MSB_FIRST /end MEASUREMENT
/begin COMPU_METHOD CU_FLT_NU_UEGO2 "Conversion method for FLT_NU_UEGO2" RAT_FUNC "%10.0" "NU" COEFFS 0.000000 1.000000 0.000000 0.000000 0.000000 1.000000 /end COMPU_METHOD
/* Scalar measurable for DDE 'FLT_NU_VCP'. */
/begin MEASUREMENT FLT_NU_VCP "Exported Global for sensor fault status" UBYTE CU_FLT_NU_VCP 1 100 0.0 0.0 ECU_ADDRESS 0x4000300e BYTE_ORDER MSB_FIRST /end MEASUREMENT
/begin COMPU_METHOD CU_FLT_NU_VCP "Conversion method for FLT_NU_VCP" RAT_FUNC "%10.0" "NU" COEFFS 0.000000 1.000000 0.000000 0.000000 0.000000 1.000000 /end COMPU_METHOD
/* Scalar measurable for DDE 'FLT_NU_VRef'. */
/begin MEASUREMENT FLT_NU_VRef "Exported Global for sensor fault status" UBYTE CU_FLT_NU_VREF 1 100 0.0 0.0 ECU_ADDRESS 0x40003004 BYTE_ORDER MSB_FIRST /end MEASUREMENT
/begin COMPU_METHOD CU_FLT_NU_VREF "Conversion method for FLT_NU_VRef" RAT_FUNC "%10.0" "NU" COEFFS 0.000000 1.000000 0.000000 0.000000 0.000000 1.000000 /end COMPU_METHOD
/* Scalar measurable for DDE 'FLT_b_EH_Open_A'. */
/begin MEASUREMENT FLT_b_EH_Open_A "DIN fault flag from OE block for external heater open" UBYTE CU_FLT_B_EH_OPEN_A 1 100 0.0 1.0 ECU_ADDRESS 0x40002e33 BYTE_ORDER MSB_FIRST /end MEASUREMENT
/begin COMPU_METHOD CU_FLT_B_EH_OPEN_A "Conversion method for FLT_b_EH_Open_A" RAT_FUNC "%10.0" "b" COEFFS 0.000000 1.000000 0.000000 0.000000 0.000000 1.000000 /end COMPU_METHOD
/* Scalar measurable for DDE 'FLT_b_EH_Open_B'. */
/begin MEASUREMENT FLT_b_EH_Open_B "DIN fault flag from OE block for external heater open" UBYTE CU_FLT_B_EH_OPEN_B 1 100 0.0 1.0 ECU_ADDRESS 0x40002e3e BYTE_ORDER MSB_FIRST /end MEASUREMENT
/begin COMPU_METHOD CU_FLT_B_EH_OPEN_B "Conversion method for FLT_b_EH_Open_B" RAT_FUNC "%10.0" "b" COEFFS 0.000000 1.000000 0.000000 0.000000 0.000000 1.000000 /end COMPU_METHOD
/* Scalar measurable for DDE 'FLT_b_EH_ShrtGrnd_A'. */
/begin MEASUREMENT FLT_b_EH_ShrtGrnd_A "DIN fault flag from OE block for external heater short to ground" UBYTE CU_FLT_B_EH_SHRTGRND_A 1 100 0.0 1.0 ECU_ADDRESS 0x40002e36 BYTE_ORDER MSB_FIRST /end MEASUREMENT
/begin COMPU_METHOD CU_FLT_B_EH_SHRTGRND_A "Conversion method for FLT_b_EH_ShrtGrnd_A" RAT_FUNC "%10.0" "b" COEFFS 0.000000 1.000000 0.000000 0.000000 0.000000 1.000000 /end COMPU_METHOD
/* Scalar measurable for DDE 'FLT_b_EH_ShrtGrnd_B'. */
/begin MEASUREMENT FLT_b_EH_ShrtGrnd_B "DIN fault flag from OE block for external heater short to ground" UBYTE CU_FLT_B_EH_SHRTGRND_B 1 100 0.0 1.0 ECU_ADDRESS 0x40002e41 BYTE_ORDER MSB_FIRST /end MEASUREMENT
/begin COMPU_METHOD CU_FLT_B_EH_SHRTGRND_B "Conversion method for FLT_b_EH_ShrtGrnd_B" RAT_FUNC "%10.0" "b" COEFFS 0.000000 1.000000 0.000000 0.000000 0.000000 1.000000 /end COMPU_METHOD
/* Scalar measurable for DDE 'FLT_b_EH_ShrtVBatt_A'. */
/begin MEASUREMENT FLT_b_EH_ShrtVBatt_A "DIN fault flag from OE block for external heater short to Vbatt" UBYTE CU_FLT_B_EH_SHRTVBATT_A 1 100 0.0 1.0 ECU_ADDRESS 0x40002e35 BYTE_ORDER MSB_FIRST /end MEASUREMENT
/begin COMPU_METHOD CU_FLT_B_EH_SHRTVBATT_A "Conversion method for FLT_b_EH_ShrtVBatt_A" RAT_FUNC "%10.0" "b" COEFFS 0.000000 1.000000 0.000000 0.000000 0.000000 1.000000 /end COMPU_METHOD
/* Scalar measurable for DDE 'FLT_b_EH_ShrtVBatt_B'. */
/begin MEASUREMENT FLT_b_EH_ShrtVBatt_B "DIN fault flag from OE block for external heater short to Vbatt" UBYTE CU_FLT_B_EH_SHRTVBATT_B 1 100 0.0 1.0 ECU_ADDRESS 0x40002e40 BYTE_ORDER MSB_FIRST /end MEASUREMENT
/begin COMPU_METHOD CU_FLT_B_EH_SHRTVBATT_B "Conversion method for FLT_b_EH_ShrtVBatt_B" RAT_FUNC "%10.0" "b" COEFFS 0.000000 1.000000 0.000000 0.000000 0.000000 1.000000 /end COMPU_METHOD
/* Scalar measurable for DDE 'FLT_b_HtrPWM_NoResponse_A'. */
/begin MEASUREMENT FLT_b_HtrPWM_NoResponse_A "Fault flag to indicate heater PWM was on too long without response from UR" UBYTE CU_FLT_B_HTRPWM_NORESPONSE_A 1 100 0.0 1.0 ECU_ADDRESS 0x40002e4d BYTE_ORDER MSB_FIRST /end MEASUREMENT
/begin COMPU_METHOD CU_FLT_B_HTRPWM_NORESPONSE_A "Conversion method for FLT_b_HtrPWM_NoResponse_A" RAT_FUNC "%10.0" "b" COEFFS 0.000000 1.000000 0.000000 0.000000 0.000000 1.000000 /end COMPU_METHOD
/* Scalar measurable for DDE 'FLT_b_HtrPWM_NoResponse_B'. */
/begin MEASUREMENT FLT_b_HtrPWM_NoResponse_B "Fault flag to indicate heater PWM was on too long without response from UR" UBYTE CU_FLT_B_HTRPWM_NORESPONSE_B 1 100 0.0 1.0 ECU_ADDRESS 0x40002e5e BYTE_ORDER MSB_FIRST /end MEASUREMENT
/begin COMPU_METHOD CU_FLT_B_HTRPWM_NORESPONSE_B "Conversion method for FLT_b_HtrPWM_NoResponse_B" RAT_FUNC "%10.0" "b" COEFFS 0.000000 1.000000 0.000000 0.000000 0.000000 1.000000 /end COMPU_METHOD
/* Scalar measurable for DDE 'FLT_b_IaIp_ShrtGrnd_A'. */
/begin MEASUREMENT FLT_b_IaIp_ShrtGrnd_A "DIN fault flag from OE block for setup current/pump current short to ground" UBYTE CU_FLT_B_IAIP_SHRTGRND_A 1 100 0.0 1.0 ECU_ADDRESS 0x40002e32 BYTE_ORDER MSB_FIRST /end MEASUREMENT
/begin COMPU_METHOD CU_FLT_B_IAIP_SHRTGRND_A "Conversion method for FLT_b_IaIp_ShrtGrnd_A" RAT_FUNC "%10.0" "b" COEFFS 0.000000 1.000000 0.000000 0.000000 0.000000 1.000000 /end COMPU_METHOD
/* Scalar measurable for DDE 'FLT_b_IaIp_ShrtGrnd_B'. */
/begin MEASUREMENT FLT_b_IaIp_ShrtGrnd_B "DIN fault flag from OE block for setup current/pump current short to ground" UBYTE CU_FLT_B_IAIP_SHRTGRND_B 1 100 0.0 1.0 ECU_ADDRESS 0x40002e3d BYTE_ORDER MSB_FIRST /end MEASUREMENT
/begin COMPU_METHOD CU_FLT_B_IAIP_SHRTGRND_B "Conversion method for FLT_b_IaIp_ShrtGrnd_B" RAT_FUNC "%10.0" "b" COEFFS 0.000000 1.000000 0.000000 0.000000 0.000000 1.000000 /end COMPU_METHOD
/* Scalar measurable for DDE 'FLT_b_IaIp_ShrtVBatt_A'. */
/begin MEASUREMENT FLT_b_IaIp_ShrtVBatt_A "DIN fault flag from OE block for setup current/pump current short to Vbatt" UBYTE CU_FLT_B_IAIP_SHRTVBATT_A 1 100 0.0 1.0 ECU_ADDRESS 0x40002e31 BYTE_ORDER MSB_FIRST /end MEASUREMENT
/begin COMPU_METHOD CU_FLT_B_IAIP_SHRTVBATT_A "Conversion method for FLT_b_IaIp_ShrtVBatt_A" RAT_FUNC "%10.0" "b" COEFFS 0.000000 1.000000 0.000000 0.000000 0.000000 1.000000 /end COMPU_METHOD
/* Scalar measurable for DDE 'FLT_b_IaIp_ShrtVBatt_B'. */
/begin MEASUREMENT FLT_b_IaIp_ShrtVBatt_B "DIN fault flag from OE block for setup current/pump current short to Vbatt" UBYTE CU_FLT_B_IAIP_SHRTVBATT_B 1 100 0.0 1.0 ECU_ADDRESS 0x40002e3c BYTE_ORDER MSB_FIRST /end MEASUREMENT
/begin COMPU_METHOD CU_FLT_B_IAIP_SHRTVBATT_B "Conversion method for FLT_b_IaIp_ShrtVBatt_B" RAT_FUNC "%10.0" "b" COEFFS 0.000000 1.000000 0.000000 0.000000 0.000000 1.000000 /end COMPU_METHOD
/* Scalar measurable for DDE 'FLT_b_SpiCtrl_A'. */
/begin MEASUREMENT FLT_b_SpiCtrl_A "Fault flag from Spi counter indication" UBYTE CU_FLT_B_SPICTRL_A 1 100 0.0 1.0 ECU_ADDRESS 0x40002e52 BYTE_ORDER MSB_FIRST /end MEASUREMENT
/begin COMPU_METHOD CU_FLT_B_SPICTRL_A "Conversion method for FLT_b_SpiCtrl_A" RAT_FUNC "%10.0" "b" COEFFS 0.000000 1.000000 0.000000 0.000000 0.000000 1.000000 /end COMPU_METHOD
/* Scalar measurable for DDE 'FLT_b_SpiCtrl_B'. */
/begin MEASUREMENT FLT_b_SpiCtrl_B "Fault flag from leaky bucket counter for Spi control diagnostic" UBYTE CU_FLT_B_SPICTRL_B 1 100 0.0 1.0 ECU_ADDRESS 0x40002e63 BYTE_ORDER MSB_FIRST /end MEASUREMENT
/begin COMPU_METHOD CU_FLT_B_SPICTRL_B "Conversion method for FLT_b_SpiCtrl_B" RAT_FUNC "%10.0" "b" COEFFS 0.000000 1.000000 0.000000 0.000000 0.000000 1.000000 /end COMPU_METHOD
/* Scalar measurable for DDE 'FLT_b_UA_OORHi_A'. */
/begin MEASUREMENT FLT_b_UA_OORHi_A "Fault flag for OOR" UBYTE CU_FLT_B_UA_OORHI_A 1 100 0.0 1.0 ECU_ADDRESS 0x40002e51 BYTE_ORDER MSB_FIRST /end MEASUREMENT
/begin COMPU_METHOD CU_FLT_B_UA_OORHI_A "Conversion method for FLT_b_UA_OORHi_A" RAT_FUNC "%10.0" "b" COEFFS 0.000000 1.000000 0.000000 0.000000 0.000000 1.000000 /end COMPU_METHOD
/* Scalar measurable for DDE 'FLT_b_UA_OORHi_B'. */
/begin MEASUREMENT FLT_b_UA_OORHi_B "Fault flag for OOR" UBYTE CU_FLT_B_UA_OORHI_B 1 100 0.0 1.0 ECU_ADDRESS 0x40002e62 BYTE_ORDER MSB_FIRST /end MEASUREMENT
/begin COMPU_METHOD CU_FLT_B_UA_OORHI_B "Conversion method for FLT_b_UA_OORHi_B" RAT_FUNC "%10.0" "b" COEFFS 0.000000 1.000000 0.000000 0.000000 0.000000 1.000000 /end COMPU_METHOD
/* Scalar measurable for DDE 'FLT_b_UA_OORLo_A'. */
/begin MEASUREMENT FLT_b_UA_OORLo_A "Fault flag for OOR" UBYTE CU_FLT_B_UA_OORLO_A 1 100 0.0 1.0 ECU_ADDRESS 0x40002e4f BYTE_ORDER MSB_FIRST /end MEASUREMENT
/begin COMPU_METHOD CU_FLT_B_UA_OORLO_A "Conversion method for FLT_b_UA_OORLo_A" RAT_FUNC "%10.0" "b" COEFFS 0.000000 1.000000 0.000000 0.000000 0.000000 1.000000 /end COMPU_METHOD
/* Scalar measurable for DDE 'FLT_b_UA_OORLo_B'. */
/begin MEASUREMENT FLT_b_UA_OORLo_B "Fault flag for OOR" UBYTE CU_FLT_B_UA_OORLO_B 1 100 0.0 1.0 ECU_ADDRESS 0x40002e60 BYTE_ORDER MSB_FIRST /end MEASUREMENT
/begin COMPU_METHOD CU_FLT_B_UA_OORLO_B "Conversion method for FLT_b_UA_OORLo_B" RAT_FUNC "%10.0" "b" COEFFS 0.000000 1.000000 0.000000 0.000000 0.000000 1.000000 /end COMPU_METHOD
/* Scalar measurable for DDE 'FLT_b_UR_OORHi_A'. */
/begin MEASUREMENT FLT_b_UR_OORHi_A "Fault flag for OOR" UBYTE CU_FLT_B_UR_OORHI_A 1 100 0.0 1.0 ECU_ADDRESS 0x40002e50 BYTE_ORDER MSB_FIRST /end MEASUREMENT
/begin COMPU_METHOD CU_FLT_B_UR_OORHI_A "Conversion method for FLT_b_UR_OORHi_A" RAT_FUNC "%10.0" "b" COEFFS 0.000000 1.000000 0.000000 0.000000 0.000000 1.000000 /end COMPU_METHOD
/* Scalar measurable for DDE 'FLT_b_UR_OORHi_B'. */
/begin MEASUREMENT FLT_b_UR_OORHi_B "Fault flag for OOR" UBYTE CU_FLT_B_UR_OORHI_B 1 100 0.0 1.0 ECU_ADDRESS 0x40002e61 BYTE_ORDER MSB_FIRST /end MEASUREMENT
/begin COMPU_METHOD CU_FLT_B_UR_OORHI_B "Conversion method for FLT_b_UR_OORHi_B" RAT_FUNC "%10.0" "b" COEFFS 0.000000 1.000000 0.000000 0.000000 0.000000 1.000000 /end COMPU_METHOD
/* Scalar measurable for DDE 'FLT_b_UR_OORLo_A'. */
/begin MEASUREMENT FLT_b_UR_OORLo_A "Fault flag for OOR" UBYTE CU_FLT_B_UR_OORLO_A 1 100 0.0 1.0 ECU_ADDRESS 0x40002e4e BYTE_ORDER MSB_FIRST /end MEASUREMENT
/begin COMPU_METHOD CU_FLT_B_UR_OORLO_A "Conversion method for FLT_b_UR_OORLo_A" RAT_FUNC "%10.0" "b" COEFFS 0.000000 1.000000 0.000000 0.000000 0.000000 1.000000 /end COMPU_METHOD
/* Scalar measurable for DDE 'FLT_b_UR_OORLo_B'. */
/begin MEASUREMENT FLT_b_UR_OORLo_B "Fault flag for OOR" UBYTE CU_FLT_B_UR_OORLO_B 1 100 0.0 1.0 ECU_ADDRESS 0x40002e5f BYTE_ORDER MSB_FIRST /end MEASUREMENT
/begin COMPU_METHOD CU_FLT_B_UR_OORLO_B "Conversion method for FLT_b_UR_OORLo_B" RAT_FUNC "%10.0" "b" COEFFS 0.000000 1.000000 0.000000 0.000000 0.000000 1.000000 /end COMPU_METHOD
/* Scalar measurable for DDE 'FLT_b_Un_Open_A'. */
/begin MEASUREMENT FLT_b_Un_Open_A "DIN fault flag from OE block for Nernst cell open" UBYTE CU_FLT_B_UN_OPEN_A 1 100 0.0 1.0 ECU_ADDRESS 0x40002e2d BYTE_ORDER MSB_FIRST /end MEASUREMENT
/begin COMPU_METHOD CU_FLT_B_UN_OPEN_A "Conversion method for FLT_b_Un_Open_A" RAT_FUNC "%10.0" "b" COEFFS 0.000000 1.000000 0.000000 0.000000 0.000000 1.000000 /end COMPU_METHOD
/* Scalar measurable for DDE 'FLT_b_Un_Open_B'. */
/begin MEASUREMENT FLT_b_Un_Open_B "DIN fault flag from OE block for Nernst cell open" UBYTE CU_FLT_B_UN_OPEN_B 1 100 0.0 1.0 ECU_ADDRESS 0x40002e38 BYTE_ORDER MSB_FIRST /end MEASUREMENT
/begin COMPU_METHOD CU_FLT_B_UN_OPEN_B "Conversion method for FLT_b_Un_Open_B" RAT_FUNC "%10.0" "b" COEFFS 0.000000 1.000000 0.000000 0.000000 0.000000 1.000000 /end COMPU_METHOD
/* Scalar measurable for DDE 'FLT_b_Un_ShrtGrnd_A'. */
/begin MEASUREMENT FLT_b_Un_ShrtGrnd_A "DIN fault flag from OE block for Nernst cell short to ground" UBYTE CU_FLT_B_UN_SHRTGRND_A 1 100 0.0 1.0 ECU_ADDRESS 0x40002e30 BYTE_ORDER MSB_FIRST /end MEASUREMENT
/begin COMPU_METHOD CU_FLT_B_UN_SHRTGRND_A "Conversion method for FLT_b_Un_ShrtGrnd_A" RAT_FUNC "%10.0" "b" COEFFS 0.000000 1.000000 0.000000 0.000000 0.000000 1.000000 /end COMPU_METHOD
/* Scalar measurable for DDE 'FLT_b_Un_ShrtGrnd_B'. */
/begin MEASUREMENT FLT_b_Un_ShrtGrnd_B "DIN fault flag from OE block for Nernst cell short to ground" UBYTE CU_FLT_B_UN_SHRTGRND_B 1 100 0.0 1.0 ECU_ADDRESS 0x40002e3b BYTE_ORDER MSB_FIRST /end MEASUREMENT
/begin COMPU_METHOD CU_FLT_B_UN_SHRTGRND_B "Conversion method for FLT_b_Un_ShrtGrnd_B" RAT_FUNC "%10.0" "b" COEFFS 0.000000 1.000000 0.000000 0.000000 0.000000 1.000000 /end COMPU_METHOD
/* Scalar measurable for DDE 'FLT_b_Un_ShrtVBatt_A'. */
/begin MEASUREMENT FLT_b_Un_ShrtVBatt_A "DIN fault flag from OE block for Nernst cell short to Vbatt" UBYTE CU_FLT_B_UN_SHRTVBATT_A 1 100 0.0 1.0 ECU_ADDRESS 0x40002e2f BYTE_ORDER MSB_FIRST /end MEASUREMENT
/begin COMPU_METHOD CU_FLT_B_UN_SHRTVBATT_A "Conversion method for FLT_b_Un_ShrtVBatt_A" RAT_FUNC "%10.0" "b" COEFFS 0.000000 1.000000 0.000000 0.000000 0.000000 1.000000 /end COMPU_METHOD
/* Scalar measurable for DDE 'FLT_b_Un_ShrtVBatt_B'. */
/begin MEASUREMENT FLT_b_Un_ShrtVBatt_B "DIN fault flag from OE block for Nernst cell short to Vbatt" UBYTE CU_FLT_B_UN_SHRTVBATT_B 1 100 0.0 1.0 ECU_ADDRESS 0x40002e3a BYTE_ORDER MSB_FIRST /end MEASUREMENT
/begin COMPU_METHOD CU_FLT_B_UN_SHRTVBATT_B "Conversion method for FLT_b_Un_ShrtVBatt_B" RAT_FUNC "%10.0" "b" COEFFS 0.000000 1.000000 0.000000 0.000000 0.000000 1.000000 /end COMPU_METHOD
/* Scalar measurable for DDE 'FLT_b_Vm_Open_B'. */
/begin MEASUREMENT FLT_b_Vm_Open_B "DIN fault flag from OE block for virtual ground open" UBYTE CU_FLT_B_VM_OPEN_B 1 100 0.0 1.0 ECU_ADDRESS 0x40002e37 BYTE_ORDER MSB_FIRST /end MEASUREMENT
/begin COMPU_METHOD CU_FLT_B_VM_OPEN_B "Conversion method for FLT_b_Vm_Open_B" RAT_FUNC "%10.0" "b" COEFFS 0.000000 1.000000 0.000000 0.000000 0.000000 1.000000 /end COMPU_METHOD
/* Scalar measurable for DDE 'FLT_b_Vm_ShrtGrnd_A'. */
/begin MEASUREMENT FLT_b_Vm_ShrtGrnd_A "DIN fault flag from OE block for virtual ground short to ground" UBYTE CU_FLT_B_VM_SHRTGRND_A 1 100 0.0 1.0 ECU_ADDRESS 0x40002e2e BYTE_ORDER MSB_FIRST /end MEASUREMENT
/begin COMPU_METHOD CU_FLT_B_VM_SHRTGRND_A "Conversion method for FLT_b_Vm_ShrtGrnd_A" RAT_FUNC "%10.0" "b" COEFFS 0.000000 1.000000 0.000000 0.000000 0.000000 1.000000 /end COMPU_METHOD
/* Scalar measurable for DDE 'FLT_b_Vm_ShrtGrnd_B'. */
/begin MEASUREMENT FLT_b_Vm_ShrtGrnd_B "DIN fault flag from OE block for virtual ground short to ground" UBYTE CU_FLT_B_VM_SHRTGRND_B 1 100 0.0 1.0 ECU_ADDRESS 0x40002e39 BYTE_ORDER MSB_FIRST /end MEASUREMENT
/begin COMPU_METHOD CU_FLT_B_VM_SHRTGRND_B "Conversion method for FLT_b_Vm_ShrtGrnd_B" RAT_FUNC "%10.0" "b" COEFFS 0.000000 1.000000 0.000000 0.000000 0.000000 1.000000 /end COMPU_METHOD
/* Scalar measurable for DDE 'FLT_b_Vm_ShrtVBatt_A'. */
/begin MEASUREMENT FLT_b_Vm_ShrtVBatt_A "DIN fault flag from OE block for virtual ground short to Vbatt" UBYTE CU_FLT_B_VM_SHRTVBATT_A 1 100 0.0 1.0 ECU_ADDRESS 0x40002e34 BYTE_ORDER MSB_FIRST /end MEASUREMENT
/begin COMPU_METHOD CU_FLT_B_VM_SHRTVBATT_A "Conversion method for FLT_b_Vm_ShrtVBatt_A" RAT_FUNC "%10.0" "b" COEFFS 0.000000 1.000000 0.000000 0.000000 0.000000 1.000000 /end COMPU_METHOD
/* Scalar measurable for DDE 'FLT_b_Vm_ShrtVBatt_B'. */
/begin MEASUREMENT FLT_b_Vm_ShrtVBatt_B "DIN fault flag from OE block for virtual ground short to Vbatt" UBYTE CU_FLT_B_VM_SHRTVBATT_B 1 100 0.0 1.0 ECU_ADDRESS 0x40002e3f BYTE_ORDER MSB_FIRST /end MEASUREMENT
/begin COMPU_METHOD CU_FLT_B_VM_SHRTVBATT_B "Conversion method for FLT_b_Vm_ShrtVBatt_B" RAT_FUNC "%10.0" "b" COEFFS 0.000000 1.000000 0.000000 0.000000 0.000000 1.000000 /end COMPU_METHOD
/* Scalar measurable for DDE 'FMG_e_FltReset'. */
/begin MEASUREMENT FMG_e_FltReset "Displayable- global fault management control signal, sent to each FBM" UBYTE CU_FMG_E_FLTRESET 1 100 0.0 0.0 ECU_ADDRESS 0x40003013 BYTE_ORDER MSB_FIRST /end MEASUREMENT
/begin COMPU_METHOD CU_FMG_E_FLTRESET "Conversion method for FMG_e_FltReset" RAT_FUNC "%10.0" "e" COEFFS 0.000000 1.000000 0.000000 0.000000 0.000000 1.000000 /end COMPU_METHOD
/* Scalar measurable for DDE 'HHT_pct_EGO11_HeaterDuty'. */
/begin MEASUREMENT HHT_pct_EGO11_HeaterDuty "Displayable" FLOAT32_IEEE CU_HHT_PCT_EGO11_HEATERDUTY 1 100 0.0 0.0 ECU_ADDRESS 0x400036c4 BYTE_ORDER MSB_FIRST /end MEASUREMENT
/begin COMPU_METHOD CU_HHT_PCT_EGO11_HEATERDUTY "Conversion method for HHT_pct_EGO11_HeaterDuty" RAT_FUNC "%10.2" "pct" COEFFS 0.000000 1.000000 0.000000 0.000000 0.000000 1.000000 /end COMPU_METHOD
/* Scalar measurable for DDE 'HHT_pct_EGO12_HeaterDuty'. */
/begin MEASUREMENT HHT_pct_EGO12_HeaterDuty "Displayable" FLOAT32_IEEE CU_HHT_PCT_EGO12_HEATERDUTY 1 100 0.0 0.0 ECU_ADDRESS 0x400036bc BYTE_ORDER MSB_FIRST /end MEASUREMENT
/begin COMPU_METHOD CU_HHT_PCT_EGO12_HEATERDUTY "Conversion method for HHT_pct_EGO12_HeaterDuty" RAT_FUNC "%10.2" "pct" COEFFS 0.000000 1.000000 0.000000 0.000000 0.000000 1.000000 /end COMPU_METHOD
/* Scalar measurable for DDE 'HHT_pct_EGO21_HeaterDuty'. */
/begin MEASUREMENT HHT_pct_EGO21_HeaterDuty "Displayable" FLOAT32_IEEE CU_HHT_PCT_EGO21_HEATERDUTY 1 100 0.0 0.0 ECU_ADDRESS 0x400036c0 BYTE_ORDER MSB_FIRST /end MEASUREMENT
/begin COMPU_METHOD CU_HHT_PCT_EGO21_HEATERDUTY "Conversion method for HHT_pct_EGO21_HeaterDuty" RAT_FUNC "%10.2" "pct" COEFFS 0.000000 1.000000 0.000000 0.000000 0.000000 1.000000 /end COMPU_METHOD
/* Scalar measurable for DDE 'HHT_pct_EGO22_HeaterDuty'. */
/begin MEASUREMENT HHT_pct_EGO22_HeaterDuty "Displayable" FLOAT32_IEEE CU_HHT_PCT_EGO22_HEATERDUTY 1 100 0.0 0.0 ECU_ADDRESS 0x400036b8 BYTE_ORDER MSB_FIRST /end MEASUREMENT
/begin COMPU_METHOD CU_HHT_PCT_EGO22_HEATERDUTY "Conversion method for HHT_pct_EGO22_HeaterDuty" RAT_FUNC "%10.2" "pct" COEFFS 0.000000 1.000000 0.000000 0.000000 0.000000 1.000000 /end COMPU_METHOD
/* Scalar measurable for DDE 'HTR_C_SensorTemperature_A'. */
/begin MEASUREMENT HTR_C_SensorTemperature_A "Sensor temperature in deg Celsius" FLOAT32_IEEE CU_HTR_C_SENSORTEMPERATURE_A 1 100 0.0 0.0 ECU_ADDRESS 0x400030f0 BYTE_ORDER MSB_FIRST /end MEASUREMENT
/begin COMPU_METHOD CU_HTR_C_SENSORTEMPERATURE_A "Conversion method for HTR_C_SensorTemperature_A" RAT_FUNC "%10.3" "C" COEFFS 0.000000 1.000000 0.000000 0.000000 0.000000 1.000000 /end COMPU_METHOD
/* Scalar measurable for DDE 'HTR_C_SensorTemperature_B'. */
/begin MEASUREMENT HTR_C_SensorTemperature_B "Sensor temperature in deg Celsius" FLOAT32_IEEE CU_HTR_C_SENSORTEMPERATURE_B 1 100 0.0 0.0 ECU_ADDRESS 0x40003120 BYTE_ORDER MSB_FIRST /end MEASUREMENT
/begin COMPU_METHOD CU_HTR_C_SENSORTEMPERATURE_B "Conversion method for HTR_C_SensorTemperature_B" RAT_FUNC "%10.3" "C" COEFFS 0.000000 1.000000 0.000000 0.000000 0.000000 1.000000 /end COMPU_METHOD
/* Scalar measurable for DDE 'HTR_NU_SysVoltCompCL'. */
/begin MEASUREMENT HTR_NU_SysVoltCompCL "System voltage compensation gain to the Closed Loop PWM command" FLOAT32_IEEE CU_HTR_NU_SYSVOLTCOMPCL 1 100 0.0 0.0 ECU_ADDRESS 0x400030e0 BYTE_ORDER MSB_FIRST /end MEASUREMENT
/begin COMPU_METHOD CU_HTR_NU_SYSVOLTCOMPCL "Conversion method for HTR_NU_SysVoltCompCL" RAT_FUNC "%10.3" "NU" COEFFS 0.000000 1.000000 0.000000 0.000000 0.000000 1.000000 /end COMPU_METHOD
/* Scalar measurable for DDE 'HTR_NU_SysVoltCompCL_B'. */
/begin MEASUREMENT HTR_NU_SysVoltCompCL_B "System voltage compensation gain to the Closed Loop PWM command" FLOAT32_IEEE CU_HTR_NU_SYSVOLTCOMPCL_B 1 100 0.0 0.0 ECU_ADDRESS 0x40003110 BYTE_ORDER MSB_FIRST /end MEASUREMENT
/begin COMPU_METHOD CU_HTR_NU_SYSVOLTCOMPCL_B "Conversion method for HTR_NU_SysVoltCompCL_B" RAT_FUNC "%10.3" "NU" COEFFS 0.000000 1.000000 0.000000 0.000000 0.000000 1.000000 /end COMPU_METHOD
/* Scalar measurable for DDE 'HTR_NU_SysVoltCompOL'. */
/begin MEASUREMENT HTR_NU_SysVoltCompOL "System voltage compensation gain to the Open Loop PWM command" FLOAT32_IEEE CU_HTR_NU_SYSVOLTCOMPOL 1 100 0.0 0.0 ECU_ADDRESS 0x400030e8 BYTE_ORDER MSB_FIRST /end MEASUREMENT
/begin COMPU_METHOD CU_HTR_NU_SYSVOLTCOMPOL "Conversion method for HTR_NU_SysVoltCompOL" RAT_FUNC "%10.3" "NU" COEFFS 0.000000 1.000000 0.000000 0.000000 0.000000 1.000000 /end COMPU_METHOD
/* Scalar measurable for DDE 'HTR_NU_SysVoltCompOL_B'. */
/begin MEASUREMENT HTR_NU_SysVoltCompOL_B "System voltage compensation gain to the Open Loop PWM command" FLOAT32_IEEE CU_HTR_NU_SYSVOLTCOMPOL_B 1 100 0.0 0.0 ECU_ADDRESS 0x40003118 BYTE_ORDER MSB_FIRST /end MEASUREMENT
/begin COMPU_METHOD CU_HTR_NU_SYSVOLTCOMPOL_B "Conversion method for HTR_NU_SysVoltCompOL_B" RAT_FUNC "%10.3" "NU" COEFFS 0.000000 1.000000 0.000000 0.000000 0.000000 1.000000 /end COMPU_METHOD
/* Scalar measurable for DDE 'HTR_b_ClosedLoopActv_A'. */
/begin MEASUREMENT HTR_b_ClosedLoopActv_A "Closed Loop heater control active flag" UBYTE CU_HTR_B_CLOSEDLOOPACTV_A 1 100 0.0 1.0 ECU_ADDRESS 0x40002e43 BYTE_ORDER MSB_FIRST /end MEASUREMENT
/begin COMPU_METHOD CU_HTR_B_CLOSEDLOOPACTV_A "Conversion method for HTR_b_ClosedLoopActv_A" RAT_FUNC "%10.0" "b" COEFFS 0.000000 1.000000 0.000000 0.000000 0.000000 1.000000 /end COMPU_METHOD
/* Scalar measurable for DDE 'HTR_b_ClosedLoopActv_B'. */
/begin MEASUREMENT HTR_b_ClosedLoopActv_B "Closed Loop heater control active flag" UBYTE CU_HTR_B_CLOSEDLOOPACTV_B 1 100 0.0 1.0 ECU_ADDRESS 0x40002e54 BYTE_ORDER MSB_FIRST /end MEASUREMENT
/begin COMPU_METHOD CU_HTR_B_CLOSEDLOOPACTV_B "Conversion method for HTR_b_ClosedLoopActv_B" RAT_FUNC "%10.0" "b" COEFFS 0.000000 1.000000 0.000000 0.000000 0.000000 1.000000 /end COMPU_METHOD
/* Scalar measurable for DDE 'HTR_b_FaultBasedHeaterLimit_A'. */
/begin MEASUREMENT HTR_b_FaultBasedHeaterLimit_A "Flag to indicate heater is disabled due to a cj125 fault" UBYTE CU_HTR_B_FAULTBASEDHEATERLIMIT0 1 100 0.0 1.0 ECU_ADDRESS 0x40002e47 BYTE_ORDER MSB_FIRST /end MEASUREMENT
/begin COMPU_METHOD CU_HTR_B_FAULTBASEDHEATERLIMIT0 "Conversion method for HTR_b_FaultBasedHeaterLimit_A" RAT_FUNC "%10.0" "b" COEFFS 0.000000 1.000000 0.000000 0.000000 0.000000 1.000000 /end COMPU_METHOD
/* Scalar measurable for DDE 'HTR_b_FaultBasedHeaterLimit_B'. */
/begin MEASUREMENT HTR_b_FaultBasedHeaterLimit_B "Flag to indicate heater is disabled due to a cj125 fault" UBYTE CU_HTR_B_FAULTBASEDHEATERLIMIT1 1 100 0.0 1.0 ECU_ADDRESS 0x40002e58 BYTE_ORDER MSB_FIRST /end MEASUREMENT
/begin COMPU_METHOD CU_HTR_B_FAULTBASEDHEATERLIMIT1 "Conversion method for HTR_b_FaultBasedHeaterLimit_B" RAT_FUNC "%10.0" "b" COEFFS 0.000000 1.000000 0.000000 0.000000 0.000000 1.000000 /end COMPU_METHOD
/* Scalar measurable for DDE 'HTR_b_HeaterEnabled_A'. */
/begin MEASUREMENT HTR_b_HeaterEnabled_A "Flag to indicate heater is enabled" UBYTE CU_HTR_B_HEATERENABLED_A 1 100 0.0 1.0 ECU_ADDRESS 0x40002e48 BYTE_ORDER MSB_FIRST /end MEASUREMENT
/begin COMPU_METHOD CU_HTR_B_HEATERENABLED_A "Conversion method for HTR_b_HeaterEnabled_A" RAT_FUNC "%10.0" "b" COEFFS 0.000000 1.000000 0.000000 0.000000 0.000000 1.000000 /end COMPU_METHOD
/* Scalar measurable for DDE 'HTR_b_HeaterEnabled_B'. */
/begin MEASUREMENT HTR_b_HeaterEnabled_B "Flag to indicate heater is enabled" UBYTE CU_HTR_B_HEATERENABLED_B 1 100 0.0 1.0 ECU_ADDRESS 0x40002e59 BYTE_ORDER MSB_FIRST /end MEASUREMENT
/begin COMPU_METHOD CU_HTR_B_HEATERENABLED_B "Conversion method for HTR_b_HeaterEnabled_B" RAT_FUNC "%10.0" "b" COEFFS 0.000000 1.000000 0.000000 0.000000 0.000000 1.000000 /end COMPU_METHOD
/* Scalar measurable for DDE 'HTR_b_OpenLoopActv_A'. */
/begin MEASUREMENT HTR_b_OpenLoopActv_A "Open Loop heater control active flag" UBYTE CU_HTR_B_OPENLOOPACTV_A 1 100 0.0 1.0 ECU_ADDRESS 0x40002e44 BYTE_ORDER MSB_FIRST /end MEASUREMENT
/begin COMPU_METHOD CU_HTR_B_OPENLOOPACTV_A "Conversion method for HTR_b_OpenLoopActv_A" RAT_FUNC "%10.0" "b" COEFFS 0.000000 1.000000 0.000000 0.000000 0.000000 1.000000 /end COMPU_METHOD
/* Scalar measurable for DDE 'HTR_b_OpenLoopActv_B'. */
/begin MEASUREMENT HTR_b_OpenLoopActv_B "Open Loop heater control active flag" UBYTE CU_HTR_B_OPENLOOPACTV_B 1 100 0.0 1.0 ECU_ADDRESS 0x40002e55 BYTE_ORDER MSB_FIRST /end MEASUREMENT
/begin COMPU_METHOD CU_HTR_B_OPENLOOPACTV_B "Conversion method for HTR_b_OpenLoopActv_B" RAT_FUNC "%10.0" "b" COEFFS 0.000000 1.000000 0.000000 0.000000 0.000000 1.000000 /end COMPU_METHOD
/* Scalar measurable for DDE 'HTR_b_OpenLoopReset_A'. */
/begin MEASUREMENT HTR_b_OpenLoopReset_A "Open Loop heater control reset flag" UBYTE CU_HTR_B_OPENLOOPRESET_A 1 100 0.0 1.0 ECU_ADDRESS 0x40002e45 BYTE_ORDER MSB_FIRST /end MEASUREMENT
/begin COMPU_METHOD CU_HTR_B_OPENLOOPRESET_A "Conversion method for HTR_b_OpenLoopReset_A" RAT_FUNC "%10.0" "b" COEFFS 0.000000 1.000000 0.000000 0.000000 0.000000 1.000000 /end COMPU_METHOD
/* Scalar measurable for DDE 'HTR_b_OpenLoopReset_B'. */
/begin MEASUREMENT HTR_b_OpenLoopReset_B "Open Loop heater control reset flag" UBYTE CU_HTR_B_OPENLOOPRESET_B 1 100 0.0 1.0 ECU_ADDRESS 0x40002e56 BYTE_ORDER MSB_FIRST /end MEASUREMENT
/begin COMPU_METHOD CU_HTR_B_OPENLOOPRESET_B "Conversion method for HTR_b_OpenLoopReset_B" RAT_FUNC "%10.0" "b" COEFFS 0.000000 1.000000 0.000000 0.000000 0.000000 1.000000 /end COMPU_METHOD
/* Scalar measurable for DDE 'HTR_b_OpenLoopSet_A'. */
/begin MEASUREMENT HTR_b_OpenLoopSet_A "Open Loop heater control set flag" UBYTE CU_HTR_B_OPENLOOPSET_A 1 100 0.0 1.0 ECU_ADDRESS 0x40002e46 BYTE_ORDER MSB_FIRST /end MEASUREMENT
/begin COMPU_METHOD CU_HTR_B_OPENLOOPSET_A "Conversion method for HTR_b_OpenLoopSet_A" RAT_FUNC "%10.0" "b" COEFFS 0.000000 1.000000 0.000000 0.000000 0.000000 1.000000 /end COMPU_METHOD
/* Scalar measurable for DDE 'HTR_b_OpenLoopSet_B'. */
/begin MEASUREMENT HTR_b_OpenLoopSet_B "Open Loop heater control set flag" UBYTE CU_HTR_B_OPENLOOPSET_B 1 100 0.0 1.0 ECU_ADDRESS 0x40002e57 BYTE_ORDER MSB_FIRST /end MEASUREMENT
/begin COMPU_METHOD CU_HTR_B_OPENLOOPSET_B "Conversion method for HTR_b_OpenLoopSet_B" RAT_FUNC "%10.0" "b" COEFFS 0.000000 1.000000 0.000000 0.000000 0.000000 1.000000 /end COMPU_METHOD
/* Scalar measurable for DDE 'HTR_b_WaterCondensActv_A'. */
/begin MEASUREMENT HTR_b_WaterCondensActv_A "Open Loop heater control Water Condensation period is active flag" UBYTE CU_HTR_B_WATERCONDENSACTV_A 1 100 0.0 1.0 ECU_ADDRESS 0x40002e42 BYTE_ORDER MSB_FIRST /end MEASUREMENT
/begin COMPU_METHOD CU_HTR_B_WATERCONDENSACTV_A "Conversion method for HTR_b_WaterCondensActv_A" RAT_FUNC "%10.0" "b" COEFFS 0.000000 1.000000 0.000000 0.000000 0.000000 1.000000 /end COMPU_METHOD
/* Scalar measurable for DDE 'HTR_b_WaterCondensActv_B'. */
/begin MEASUREMENT HTR_b_WaterCondensActv_B "Open Loop heater control Water Condensation period is active flag" UBYTE CU_HTR_B_WATERCONDENSACTV_B 1 100 0.0 1.0 ECU_ADDRESS 0x40002e53 BYTE_ORDER MSB_FIRST /end MEASUREMENT
/begin COMPU_METHOD CU_HTR_B_WATERCONDENSACTV_B "Conversion method for HTR_b_WaterCondensActv_B" RAT_FUNC "%10.0" "b" COEFFS 0.000000 1.000000 0.000000 0.000000 0.000000 1.000000 /end COMPU_METHOD
/* Scalar measurable for DDE 'HTR_e_RefCurrEnum_A'. */
/begin MEASUREMENT HTR_e_RefCurrEnum_A "Temporary applied reference current enumeration" UBYTE CU_HTR_E_REFCURRENUM_A 1 100 0.0 0.0 ECU_ADDRESS 0x40002fda BYTE_ORDER MSB_FIRST /end MEASUREMENT
/begin COMPU_METHOD CU_HTR_E_REFCURRENUM_A "Conversion method for HTR_e_RefCurrEnum_A" RAT_FUNC "%10.0" "e" COEFFS 0.000000 1.000000 0.000000 0.000000 0.000000 1.000000 /end COMPU_METHOD
/* Scalar measurable for DDE 'HTR_e_RefCurrEnum_B'. */
/begin MEASUREMENT HTR_e_RefCurrEnum_B "Temporary applied reference current enumeration" UBYTE CU_HTR_E_REFCURRENUM_B 1 100 0.0 0.0 ECU_ADDRESS 0x40002fdb BYTE_ORDER MSB_FIRST /end MEASUREMENT
/begin COMPU_METHOD CU_HTR_E_REFCURRENUM_B "Conversion method for HTR_e_RefCurrEnum_B" RAT_FUNC "%10.0" "e" COEFFS 0.000000 1.000000 0.000000 0.000000 0.000000 1.000000 /end COMPU_METHOD
/* Scalar measurable for DDE 'HTR_pct_ClosedLoopPWMCmd_A'. */
/begin MEASUREMENT HTR_pct_ClosedLoopPWMCmd_A "Closed Loop control heater PWM command" FLOAT32_IEEE CU_HTR_PCT_CLOSEDLOOPPWMCMD_A 1 100 0.0 0.0 ECU_ADDRESS 0x400030dc BYTE_ORDER MSB_FIRST /end MEASUREMENT
/begin COMPU_METHOD CU_HTR_PCT_CLOSEDLOOPPWMCMD_A "Conversion method for HTR_pct_ClosedLoopPWMCmd_A" RAT_FUNC "%10.3" "pct" COEFFS 0.000000 1.000000 0.000000 0.000000 0.000000 1.000000 /end COMPU_METHOD
/* Scalar measurable for DDE 'HTR_pct_ClosedLoopPWMCmd_B'. */
/begin MEASUREMENT HTR_pct_ClosedLoopPWMCmd_B "Closed Loop control heater PWM command" FLOAT32_IEEE CU_HTR_PCT_CLOSEDLOOPPWMCMD_B 1 100 0.0 0.0 ECU_ADDRESS 0x4000310c BYTE_ORDER MSB_FIRST /end MEASUREMENT
/begin COMPU_METHOD CU_HTR_PCT_CLOSEDLOOPPWMCMD_B "Conversion method for HTR_pct_ClosedLoopPWMCmd_B" RAT_FUNC "%10.3" "pct" COEFFS 0.000000 1.000000 0.000000 0.000000 0.000000 1.000000 /end COMPU_METHOD
/* Scalar measurable for DDE 'HTR_pct_FinalPWMCmd_A'. */
/begin MEASUREMENT HTR_pct_FinalPWMCmd_A "Final heater PWM command" FLOAT32_IEEE CU_HTR_PCT_FINALPWMCMD_A 1 100 0.0 0.0 ECU_ADDRESS 0x400030ec BYTE_ORDER MSB_FIRST /end MEASUREMENT
/begin COMPU_METHOD CU_HTR_PCT_FINALPWMCMD_A "Conversion method for HTR_pct_FinalPWMCmd_A" RAT_FUNC "%10.3" "pct" COEFFS 0.000000 1.000000 0.000000 0.000000 0.000000 1.000000 /end COMPU_METHOD
/* Scalar measurable for DDE 'HTR_pct_FinalPWMCmd_B'. */
/begin MEASUREMENT HTR_pct_FinalPWMCmd_B "Final heater PWM command" FLOAT32_IEEE CU_HTR_PCT_FINALPWMCMD_B 1 100 0.0 0.0 ECU_ADDRESS 0x4000311c BYTE_ORDER MSB_FIRST /end MEASUREMENT
/begin COMPU_METHOD CU_HTR_PCT_FINALPWMCMD_B "Conversion method for HTR_pct_FinalPWMCmd_B" RAT_FUNC "%10.3" "pct" COEFFS 0.000000 1.000000 0.000000 0.000000 0.000000 1.000000 /end COMPU_METHOD
/* Scalar measurable for DDE 'HTR_pct_OpenLoopPWMCmd_A'. */
/begin MEASUREMENT HTR_pct_OpenLoopPWMCmd_A "Open Loop control heater PWM command" FLOAT32_IEEE CU_HTR_PCT_OPENLOOPPWMCMD_A 1 100 0.0 0.0 ECU_ADDRESS 0x400030e4 BYTE_ORDER MSB_FIRST /end MEASUREMENT
/begin COMPU_METHOD CU_HTR_PCT_OPENLOOPPWMCMD_A "Conversion method for HTR_pct_OpenLoopPWMCmd_A" RAT_FUNC "%10.3" "pct" COEFFS 0.000000 1.000000 0.000000 0.000000 0.000000 1.000000 /end COMPU_METHOD
/* Scalar measurable for DDE 'HTR_pct_OpenLoopPWMCmd_B'. */
/begin MEASUREMENT HTR_pct_OpenLoopPWMCmd_B "Open Loop control heater PWM command" FLOAT32_IEEE CU_HTR_PCT_OPENLOOPPWMCMD_B 1 100 0.0 0.0 ECU_ADDRESS 0x40003114 BYTE_ORDER MSB_FIRST /end MEASUREMENT
/begin COMPU_METHOD CU_HTR_PCT_OPENLOOPPWMCMD_B "Conversion method for HTR_pct_OpenLoopPWMCmd_B" RAT_FUNC "%10.3" "pct" COEFFS 0.000000 1.000000 0.000000 0.000000 0.000000 1.000000 /end COMPU_METHOD
/* Scalar measurable for DDE 'IDL_NU_AirDTerm'. */
/begin MEASUREMENT IDL_NU_AirDTerm "Displayable" FLOAT32_IEEE CU_IDL_NU_AIRDTERM 1 100 0.0 0.0 ECU_ADDRESS 0x40003400 BYTE_ORDER MSB_FIRST /end MEASUREMENT
/begin COMPU_METHOD CU_IDL_NU_AIRDTERM "Conversion method for IDL_NU_AirDTerm" RAT_FUNC "%10.3" "NU" COEFFS 0.000000 1.000000 0.000000 0.000000 0.000000 1.000000 /end COMPU_METHOD
/* Scalar measurable for DDE 'IDL_NU_AirITerm'. */
/begin MEASUREMENT IDL_NU_AirITerm "Displayable" FLOAT32_IEEE CU_IDL_NU_AIRITERM 1 100 0.0 0.0 ECU_ADDRESS 0x40003404 BYTE_ORDER MSB_FIRST /end MEASUREMENT
/begin COMPU_METHOD CU_IDL_NU_AIRITERM "Conversion method for IDL_NU_AirITerm" RAT_FUNC "%10.3" "NU" COEFFS 0.000000 1.000000 0.000000 0.000000 0.000000 1.000000 /end COMPU_METHOD
/* Scalar measurable for DDE 'IDL_NU_AirPIDEffort'. */
/begin MEASUREMENT IDL_NU_AirPIDEffort "Effort displayable" FLOAT32_IEEE CU_IDL_NU_AIRPIDEFFORT 1 100 0.0 0.0 ECU_ADDRESS 0x400033fc BYTE_ORDER MSB_FIRST /end MEASUREMENT
/begin COMPU_METHOD CU_IDL_NU_AIRPIDEFFORT "Conversion method for IDL_NU_AirPIDEffort" RAT_FUNC "%10.3" "NU" COEFFS 0.000000 1.000000 0.000000 0.000000 0.000000 1.000000 /end COMPU_METHOD
/* Scalar measurable for DDE 'IDL_NU_AirPTerm'. */
/begin MEASUREMENT IDL_NU_AirPTerm "Displayable" FLOAT32_IEEE CU_IDL_NU_AIRPTERM 1 100 0.0 0.0 ECU_ADDRESS 0x40003408 BYTE_ORDER MSB_FIRST /end MEASUREMENT
/begin COMPU_METHOD CU_IDL_NU_AIRPTERM "Conversion method for IDL_NU_AirPTerm" RAT_FUNC "%10.3" "NU" COEFFS 0.000000 1.000000 0.000000 0.000000 0.000000 1.000000 /end COMPU_METHOD
/* Scalar measurable for DDE 'IDL_NU_ErrorROC'. */
/begin MEASUREMENT IDL_NU_ErrorROC "(RPM/s) rate of change of air flow rate error" FLOAT32_IEEE CU_IDL_NU_ERRORROC 1 100 0.0 0.0 ECU_ADDRESS 0x4000346c BYTE_ORDER MSB_FIRST /end MEASUREMENT
/begin COMPU_METHOD CU_IDL_NU_ERRORROC "Conversion method for IDL_NU_ErrorROC" RAT_FUNC "%10.0" "NU" COEFFS 0.000000 1.000000 0.000000 0.000000 0.000000 1.000000 /end COMPU_METHOD
/* Scalar measurable for DDE 'IDL_NU_IdlAirGEAR_FF'. */
/begin MEASUREMENT IDL_NU_IdlAirGEAR_FF "Feedforward idle Air" FLOAT32_IEEE CU_IDL_NU_IDLAIRGEAR_FF 1 100 0.0 0.0 ECU_ADDRESS 0x400033f0 BYTE_ORDER MSB_FIRST /end MEASUREMENT
/begin COMPU_METHOD CU_IDL_NU_IDLAIRGEAR_FF "Conversion method for IDL_NU_IdlAirGEAR_FF" RAT_FUNC "%10.3" "NU" COEFFS 0.000000 1.000000 0.000000 0.000000 0.000000 1.000000 /end COMPU_METHOD
/* Scalar measurable for DDE 'IDL_NU_SparkDTerm'. */
/begin MEASUREMENT IDL_NU_SparkDTerm "Displayable" FLOAT32_IEEE CU_IDL_NU_SPARKDTERM 1 100 0.0 0.0 ECU_ADDRESS 0x40003468 BYTE_ORDER MSB_FIRST /end MEASUREMENT
/begin COMPU_METHOD CU_IDL_NU_SPARKDTERM "Conversion method for IDL_NU_SparkDTerm" RAT_FUNC "%10.3" "NU" COEFFS 0.000000 1.000000 0.000000 0.000000 0.000000 1.000000 /end COMPU_METHOD
/* Scalar measurable for DDE 'IDL_NU_SparkITerm'. */
/begin MEASUREMENT IDL_NU_SparkITerm "Displayable" FLOAT32_IEEE CU_IDL_NU_SPARKITERM 1 100 0.0 0.0 ECU_ADDRESS 0x40003474 BYTE_ORDER MSB_FIRST /end MEASUREMENT
/begin COMPU_METHOD CU_IDL_NU_SPARKITERM "Conversion method for IDL_NU_SparkITerm" RAT_FUNC "%10.3" "NU" COEFFS 0.000000 1.000000 0.000000 0.000000 0.000000 1.000000 /end COMPU_METHOD
/* Scalar measurable for DDE 'IDL_NU_SparkPID_Effort'. */
/begin MEASUREMENT IDL_NU_SparkPID_Effort "Effort displayable" FLOAT32_IEEE CU_IDL_NU_SPARKPID_EFFORT 1 100 0.0 0.0 ECU_ADDRESS 0x40003464 BYTE_ORDER MSB_FIRST /end MEASUREMENT
/begin COMPU_METHOD CU_IDL_NU_SPARKPID_EFFORT "Conversion method for IDL_NU_SparkPID_Effort" RAT_FUNC "%10.3" "NU" COEFFS 0.000000 1.000000 0.000000 0.000000 0.000000 1.000000 /end COMPU_METHOD
/* Scalar measurable for DDE 'IDL_NU_SparkPTerm'. */
/begin MEASUREMENT IDL_NU_SparkPTerm "Displayable" FLOAT32_IEEE CU_IDL_NU_SPARKPTERM 1 100 0.0 0.0 ECU_ADDRESS 0x40003478 BYTE_ORDER MSB_FIRST /end MEASUREMENT
/begin COMPU_METHOD CU_IDL_NU_SPARKPTERM "Conversion method for IDL_NU_SparkPTerm" RAT_FUNC "%10.3" "NU" COEFFS 0.000000 1.000000 0.000000 0.000000 0.000000 1.000000 /end COMPU_METHOD
/* Scalar measurable for DDE 'IDL_RPM_AC_Term'. */
/begin MEASUREMENT IDL_RPM_AC_Term "Idle speed adder based on AC compressor" FLOAT32_IEEE CU_IDL_RPM_AC_TERM 1 100 0.0 0.0 ECU_ADDRESS 0x400035a8 BYTE_ORDER MSB_FIRST /end MEASUREMENT
/begin COMPU_METHOD CU_IDL_RPM_AC_TERM "Conversion method for IDL_RPM_AC_Term" RAT_FUNC "%10.0" "RPM" COEFFS 0.000000 1.000000 0.000000 0.000000 0.000000 1.000000 /end COMPU_METHOD
/* Scalar measurable for DDE 'IDL_RPM_Added'. */
/begin MEASUREMENT IDL_RPM_Added "Displayable" FLOAT32_IEEE CU_IDL_RPM_ADDED 1 100 0.0 0.0 ECU_ADDRESS 0x4000359c BYTE_ORDER MSB_FIRST /end MEASUREMENT
/begin COMPU_METHOD CU_IDL_RPM_ADDED "Conversion method for IDL_RPM_Added" RAT_FUNC "%10.0" "RPM" COEFFS 0.000000 1.000000 0.000000 0.000000 0.000000 1.000000 /end COMPU_METHOD
/* Scalar measurable for DDE 'IDL_RPM_AlternatorTerm'. */
/begin MEASUREMENT IDL_RPM_AlternatorTerm "Idle speed adder based on alternator current" FLOAT32_IEEE CU_IDL_RPM_ALTERNATORTERM 1 100 0.0 0.0 ECU_ADDRESS 0x400035ac BYTE_ORDER MSB_FIRST /end MEASUREMENT
/begin COMPU_METHOD CU_IDL_RPM_ALTERNATORTERM "Conversion method for IDL_RPM_AlternatorTerm" RAT_FUNC "%10.0" "RPM" COEFFS 0.000000 1.000000 0.000000 0.000000 0.000000 1.000000 /end COMPU_METHOD
/* Scalar measurable for DDE 'IDL_RPM_AlternatorTermRaw'. */
/begin MEASUREMENT IDL_RPM_AlternatorTermRaw "Map output value" FLOAT32_IEEE CU_IDL_RPM_ALTERNATORTERMRAW 1 100 0.0 0.0 ECU_ADDRESS 0x400035b0 BYTE_ORDER MSB_FIRST /end MEASUREMENT
/begin COMPU_METHOD CU_IDL_RPM_ALTERNATORTERMRAW "Conversion method for IDL_RPM_AlternatorTermRaw" RAT_FUNC "%10.0" "RPM" COEFFS 0.000000 1.000000 0.000000 0.000000 0.000000 1.000000 /end COMPU_METHOD
/* Scalar measurable for DDE 'IDL_RPM_Base'. */
/begin MEASUREMENT IDL_RPM_Base "Temp and StartTime idle speed target result" FLOAT32_IEEE CU_IDL_RPM_BASE 1 100 0.0 0.0 ECU_ADDRESS 0x400035b8 BYTE_ORDER MSB_FIRST /end MEASUREMENT
/begin COMPU_METHOD CU_IDL_RPM_BASE "Conversion method for IDL_RPM_Base" RAT_FUNC "%10.0" "RPM" COEFFS 0.000000 1.000000 0.000000 0.000000 0.000000 1.000000 /end COMPU_METHOD
/* Scalar measurable for DDE 'IDL_RPM_DrivingTerm'. */
/begin MEASUREMENT IDL_RPM_DrivingTerm "Displayable" FLOAT32_IEEE CU_IDL_RPM_DRIVINGTERM 1 100 0.0 0.0 ECU_ADDRESS 0x400035a4 BYTE_ORDER MSB_FIRST /end MEASUREMENT
/begin COMPU_METHOD CU_IDL_RPM_DRIVINGTERM "Conversion method for IDL_RPM_DrivingTerm" RAT_FUNC "%10.0" "RPM" COEFFS 0.000000 1.000000 0.000000 0.000000 0.000000 1.000000 /end COMPU_METHOD
/* Scalar measurable for DDE 'IDL_RPM_Error'. */
/begin MEASUREMENT IDL_RPM_Error "Speed error used for FB control" FLOAT32_IEEE CU_IDL_RPM_ERROR 1 100 0.0 0.0 ECU_ADDRESS 0x40003594 BYTE_ORDER MSB_FIRST /end MEASUREMENT
/begin COMPU_METHOD CU_IDL_RPM_ERROR "Conversion method for IDL_RPM_Error" RAT_FUNC "%10.0" "RPM" COEFFS 0.000000 1.000000 0.000000 0.000000 0.000000 1.000000 /end COMPU_METHOD
/* Scalar measurable for DDE 'IDL_RPM_ErrorLPF'. */
/begin MEASUREMENT IDL_RPM_ErrorLPF "Displayable" FLOAT32_IEEE CU_IDL_RPM_ERRORLPF 1 100 0.0 0.0 ECU_ADDRESS 0x40003470 BYTE_ORDER MSB_FIRST /end MEASUREMENT
/begin COMPU_METHOD CU_IDL_RPM_ERRORLPF "Conversion method for IDL_RPM_ErrorLPF" RAT_FUNC "%10.0" "RPM" COEFFS 0.000000 1.000000 0.000000 0.000000 0.000000 1.000000 /end COMPU_METHOD
/* Scalar measurable for DDE 'IDL_RPM_Trgt'. */
/begin MEASUREMENT IDL_RPM_Trgt "Displayable" FLOAT32_IEEE CU_IDL_RPM_TRGT 1 100 0.0 0.0 ECU_ADDRESS 0x400035a0 BYTE_ORDER MSB_FIRST /end MEASUREMENT
/begin COMPU_METHOD CU_IDL_RPM_TRGT "Conversion method for IDL_RPM_Trgt" RAT_FUNC "%10.0" "RPM" COEFFS 0.000000 1.000000 0.000000 0.000000 0.000000 1.000000 /end COMPU_METHOD
/* Scalar measurable for DDE 'IDL_RPM_Trgt_trt'. */
/begin MEASUREMENT IDL_RPM_Trgt_trt "Displayable" FLOAT32_IEEE CU_IDL_RPM_TRGT_TRT 1 100 0.0 0.0 ECU_ADDRESS 0x40003598 BYTE_ORDER MSB_FIRST /end MEASUREMENT
/begin COMPU_METHOD CU_IDL_RPM_TRGT_TRT "Conversion method for IDL_RPM_Trgt_trt" RAT_FUNC "%10.0" "RPM" COEFFS 0.000000 1.000000 0.000000 0.000000 0.000000 1.000000 /end COMPU_METHOD
/* Scalar measurable for DDE 'IDL_b_Actv'. */
/begin MEASUREMENT IDL_b_Actv "Displayable" UBYTE CU_IDL_B_ACTV 1 100 0.0 1.0 ECU_ADDRESS 0x40002ed4 BYTE_ORDER MSB_FIRST /end MEASUREMENT
/begin COMPU_METHOD CU_IDL_B_ACTV "Conversion method for IDL_b_Actv" RAT_FUNC "%10.0" "b" COEFFS 0.000000 1.000000 0.000000 0.000000 0.000000 1.000000 /end COMPU_METHOD
/* Scalar measurable for DDE 'IDL_gps_Air'. */
/begin MEASUREMENT IDL_gps_Air "Final Idle Air request" FLOAT32_IEEE CU_IDL_GPS_AIR 1 100 0.0 0.0 ECU_ADDRESS 0x400033e8 BYTE_ORDER MSB_FIRST /end MEASUREMENT
/begin COMPU_METHOD CU_IDL_GPS_AIR "Conversion method for IDL_gps_Air" RAT_FUNC "%10.3" "gps" COEFFS 0.000000 1.000000 0.000000 0.000000 0.000000 1.000000 /end COMPU_METHOD
/* Scalar measurable for DDE 'IDL_gps_IdlAC_FF'. */
/begin MEASUREMENT IDL_gps_IdlAC_FF "Feedforward idle Air" FLOAT32_IEEE CU_IDL_GPS_IDLAC_FF 1 100 0.0 0.0 ECU_ADDRESS 0x400033ec BYTE_ORDER MSB_FIRST /end MEASUREMENT
/begin COMPU_METHOD CU_IDL_GPS_IDLAC_FF "Conversion method for IDL_gps_IdlAC_FF" RAT_FUNC "%10.3" "NU" COEFFS 0.000000 1.000000 0.000000 0.000000 0.000000 1.000000 /end COMPU_METHOD
/* Scalar measurable for DDE 'IDL_gps_IdlAir_FF'. */
/begin MEASUREMENT IDL_gps_IdlAir_FF "Feedforward idle Air" FLOAT32_IEEE CU_IDL_GPS_IDLAIR_FF 1 100 0.0 100.0 ECU_ADDRESS 0x400033f4 BYTE_ORDER MSB_FIRST /end MEASUREMENT
/begin COMPU_METHOD CU_IDL_GPS_IDLAIR_FF "Conversion method for IDL_gps_IdlAir_FF" RAT_FUNC "%10.3" "gps" COEFFS 0.000000 1.000000 0.000000 0.000000 0.000000 1.000000 /end COMPU_METHOD
/* Scalar measurable for DDE 'IDL_gps_IdlAir_PID'. */
/begin MEASUREMENT IDL_gps_IdlAir_PID "Idle Air feedback term" FLOAT32_IEEE CU_IDL_GPS_IDLAIR_PID 1 100 -1000.0 1000.0 ECU_ADDRESS 0x400033f8 BYTE_ORDER MSB_FIRST /end MEASUREMENT
/begin COMPU_METHOD CU_IDL_GPS_IDLAIR_PID "Conversion method for IDL_gps_IdlAir_PID" RAT_FUNC "%10.3" "gps" COEFFS 0.000000 1.000000 0.000000 0.000000 0.000000 1.000000 /end COMPU_METHOD
/* Scalar measurable for DDE 'IDL_ret_Spark'. */
/begin MEASUREMENT IDL_ret_Spark "Final Idle spark request" FLOAT32_IEEE CU_IDL_RET_SPARK 1 100 0.0 0.0 ECU_ADDRESS 0x40003460 BYTE_ORDER MSB_FIRST /end MEASUREMENT
/begin COMPU_METHOD CU_IDL_RET_SPARK "Conversion method for IDL_ret_Spark" RAT_FUNC "%10.1" "(not defined)" COEFFS 0.000000 1.000000 0.000000 0.000000 0.000000 1.000000 /end COMPU_METHOD
/* Scalar measurable for DDE 'IJT_NU_TotalFuelFlowKgPerHr'. */
/begin MEASUREMENT IJT_NU_TotalFuelFlowKgPerHr "(kg/hr) Commanded engine-total fuel flow rate" FLOAT32_IEEE CU_IJT_NU_TOTALFUELFLOWKGPERHR 1 100 0.0 0.0 ECU_ADDRESS 0x400032fc BYTE_ORDER MSB_FIRST /end MEASUREMENT
/begin COMPU_METHOD CU_IJT_NU_TOTALFUELFLOWKGPERHR "Conversion method for IJT_NU_TotalFuelFlowKgPerHr" RAT_FUNC "%10.1" "NU" COEFFS 0.000000 1.000000 0.000000 0.000000 0.000000 1.000000 /end COMPU_METHOD
/* Scalar measurable for DDE 'IJT_adv_CrankingSOI'. */
/begin MEASUREMENT IJT_adv_CrankingSOI "Displayable" FLOAT32_IEEE CU_IJT_ADV_CRANKINGSOI 1 100 0.0 0.0 ECU_ADDRESS 0x40003330 BYTE_ORDER MSB_FIRST /end MEASUREMENT
/begin COMPU_METHOD CU_IJT_ADV_CRANKINGSOI "Conversion method for IJT_adv_CrankingSOI" RAT_FUNC "%10.2" "adv" COEFFS 0.000000 1.000000 0.000000 0.000000 0.000000 1.000000 /end COMPU_METHOD
/* Scalar measurable for DDE 'IJT_adv_RunningSOI'. */
/begin MEASUREMENT IJT_adv_RunningSOI "Displayable" FLOAT32_IEEE CU_IJT_ADV_RUNNINGSOI 1 100 0.0 0.0 ECU_ADDRESS 0x4000332c BYTE_ORDER MSB_FIRST /end MEASUREMENT
/begin COMPU_METHOD CU_IJT_ADV_RUNNINGSOI "Conversion method for IJT_adv_RunningSOI" RAT_FUNC "%10.2" "adv" COEFFS 0.000000 1.000000 0.000000 0.000000 0.000000 1.000000 /end COMPU_METHOD
/* Scalar measurable for DDE 'IJT_adv_SOC_Inj1'. */
/begin MEASUREMENT IJT_adv_SOC_Inj1 "Displayable" FLOAT32_IEEE CU_IJT_ADV_SOC_INJ1 1 100 0.0 0.0 ECU_ADDRESS 0x40003324 BYTE_ORDER MSB_FIRST /end MEASUREMENT
/begin COMPU_METHOD CU_IJT_ADV_SOC_INJ1 "Conversion method for IJT_adv_SOC_Inj1" RAT_FUNC "%10.2" "adv" COEFFS 0.000000 1.000000 0.000000 0.000000 0.000000 1.000000 /end COMPU_METHOD
/* Scalar measurable for DDE 'IJT_adv_SOC_Inj2'. */
/begin MEASUREMENT IJT_adv_SOC_Inj2 "Displayable" FLOAT32_IEEE CU_IJT_ADV_SOC_INJ2 1 100 0.0 0.0 ECU_ADDRESS 0x40003320 BYTE_ORDER MSB_FIRST /end MEASUREMENT
/begin COMPU_METHOD CU_IJT_ADV_SOC_INJ2 "Conversion method for IJT_adv_SOC_Inj2" RAT_FUNC "%10.2" "adv" COEFFS 0.000000 1.000000 0.000000 0.000000 0.000000 1.000000 /end COMPU_METHOD
/* Scalar measurable for DDE 'IJT_adv_SOC_Inj3'. */
/begin MEASUREMENT IJT_adv_SOC_Inj3 "Displayable" FLOAT32_IEEE CU_IJT_ADV_SOC_INJ3 1 100 0.0 0.0 ECU_ADDRESS 0x4000331c BYTE_ORDER MSB_FIRST /end MEASUREMENT
/begin COMPU_METHOD CU_IJT_ADV_SOC_INJ3 "Conversion method for IJT_adv_SOC_Inj3" RAT_FUNC "%10.2" "adv" COEFFS 0.000000 1.000000 0.000000 0.000000 0.000000 1.000000 /end COMPU_METHOD
/* Scalar measurable for DDE 'IJT_adv_SOC_Inj4'. */
/begin MEASUREMENT IJT_adv_SOC_Inj4 "Displayable" FLOAT32_IEEE CU_IJT_ADV_SOC_INJ4 1 100 0.0 0.0 ECU_ADDRESS 0x40003318 BYTE_ORDER MSB_FIRST /end MEASUREMENT
/begin COMPU_METHOD CU_IJT_ADV_SOC_INJ4 "Conversion method for IJT_adv_SOC_Inj4" RAT_FUNC "%10.2" "adv" COEFFS 0.000000 1.000000 0.000000 0.000000 0.000000 1.000000 /end COMPU_METHOD
/* Scalar measurable for DDE 'IJT_b_Inj1_InjectionSent'. */
/begin MEASUREMENT IJT_b_Inj1_InjectionSent "Displayable" UBYTE CU_IJT_B_INJ1_INJECTIONSENT 1 100 0.0 1.0 ECU_ADDRESS 0x40002ea0 BYTE_ORDER MSB_FIRST /end MEASUREMENT
/begin COMPU_METHOD CU_IJT_B_INJ1_INJECTIONSENT "Conversion method for IJT_b_Inj1_InjectionSent" RAT_FUNC "%10.0" "b" COEFFS 0.000000 1.000000 0.000000 0.000000 0.000000 1.000000 /end COMPU_METHOD
/* Scalar measurable for DDE 'IJT_b_Inj2_InjectionSent'. */
/begin MEASUREMENT IJT_b_Inj2_InjectionSent "Displayable" UBYTE CU_IJT_B_INJ2_INJECTIONSENT 1 100 0.0 1.0 ECU_ADDRESS 0x40002e9f BYTE_ORDER MSB_FIRST /end MEASUREMENT
/begin COMPU_METHOD CU_IJT_B_INJ2_INJECTIONSENT "Conversion method for IJT_b_Inj2_InjectionSent" RAT_FUNC "%10.0" "b" COEFFS 0.000000 1.000000 0.000000 0.000000 0.000000 1.000000 /end COMPU_METHOD
/* Scalar measurable for DDE 'IJT_b_Inj3_InjectionSent'. */
/begin MEASUREMENT IJT_b_Inj3_InjectionSent "Displayable" UBYTE CU_IJT_B_INJ3_INJECTIONSENT 1 100 0.0 1.0 ECU_ADDRESS 0x40002e9e BYTE_ORDER MSB_FIRST /end MEASUREMENT
/begin COMPU_METHOD CU_IJT_B_INJ3_INJECTIONSENT "Conversion method for IJT_b_Inj3_InjectionSent" RAT_FUNC "%10.0" "b" COEFFS 0.000000 1.000000 0.000000 0.000000 0.000000 1.000000 /end COMPU_METHOD
/* Scalar measurable for DDE 'IJT_b_Inj4_InjectionSent'. */
/begin MEASUREMENT IJT_b_Inj4_InjectionSent "Displayable" UBYTE CU_IJT_B_INJ4_INJECTIONSENT 1 100 0.0 1.0 ECU_ADDRESS 0x40002e9d BYTE_ORDER MSB_FIRST /end MEASUREMENT
/begin COMPU_METHOD CU_IJT_B_INJ4_INJECTIONSENT "Conversion method for IJT_b_Inj4_InjectionSent" RAT_FUNC "%10.0" "b" COEFFS 0.000000 1.000000 0.000000 0.000000 0.000000 1.000000 /end COMPU_METHOD
/* Scalar measurable for DDE 'IJT_b_InjectorOverlap'. */
/begin MEASUREMENT IJT_b_InjectorOverlap "Displayable" UBYTE CU_IJT_B_INJECTOROVERLAP 1 100 0.0 1.0 ECU_ADDRESS 0x40002e98 BYTE_ORDER MSB_FIRST /end MEASUREMENT
/begin COMPU_METHOD CU_IJT_B_INJECTOROVERLAP "Conversion method for IJT_b_InjectorOverlap" RAT_FUNC "%10.0" "b" COEFFS 0.000000 1.000000 0.000000 0.000000 0.000000 1.000000 /end COMPU_METHOD
/* Scalar measurable for DDE 'IJT_b_PrimingPulseActiveCyl1'. */
/begin MEASUREMENT IJT_b_PrimingPulseActiveCyl1 "Displayable" UBYTE CU_IJT_B_PRIMINGPULSEACTIVECYL1 1 100 0.0 1.0 ECU_ADDRESS 0x40002e9c BYTE_ORDER MSB_FIRST /end MEASUREMENT
/begin COMPU_METHOD CU_IJT_B_PRIMINGPULSEACTIVECYL1 "Conversion method for IJT_b_PrimingPulseActiveCyl1" RAT_FUNC "%10.0" "b" COEFFS 0.000000 1.000000 0.000000 0.000000 0.000000 1.000000 /end COMPU_METHOD
/* Scalar measurable for DDE 'IJT_b_PrimingPulseActiveCyl2'. */
/begin MEASUREMENT IJT_b_PrimingPulseActiveCyl2 "Displayable" UBYTE CU_IJT_B_PRIMINGPULSEACTIVECYL2 1 100 0.0 1.0 ECU_ADDRESS 0x40002e9b BYTE_ORDER MSB_FIRST /end MEASUREMENT
/begin COMPU_METHOD CU_IJT_B_PRIMINGPULSEACTIVECYL2 "Conversion method for IJT_b_PrimingPulseActiveCyl2" RAT_FUNC "%10.0" "b" COEFFS 0.000000 1.000000 0.000000 0.000000 0.000000 1.000000 /end COMPU_METHOD
/* Scalar measurable for DDE 'IJT_b_PrimingPulseActiveCyl3'. */
/begin MEASUREMENT IJT_b_PrimingPulseActiveCyl3 "Displayable" UBYTE CU_IJT_B_PRIMINGPULSEACTIVECYL3 1 100 0.0 1.0 ECU_ADDRESS 0x40002e9a BYTE_ORDER MSB_FIRST /end MEASUREMENT
/begin COMPU_METHOD CU_IJT_B_PRIMINGPULSEACTIVECYL3 "Conversion method for IJT_b_PrimingPulseActiveCyl3" RAT_FUNC "%10.0" "b" COEFFS 0.000000 1.000000 0.000000 0.000000 0.000000 1.000000 /end COMPU_METHOD
/* Scalar measurable for DDE 'IJT_b_PrimingPulseActiveCyl4'. */
/begin MEASUREMENT IJT_b_PrimingPulseActiveCyl4 "Displayable" UBYTE CU_IJT_B_PRIMINGPULSEACTIVECYL4 1 100 0.0 1.0 ECU_ADDRESS 0x40002e99 BYTE_ORDER MSB_FIRST /end MEASUREMENT
/begin COMPU_METHOD CU_IJT_B_PRIMINGPULSEACTIVECYL4 "Conversion method for IJT_b_PrimingPulseActiveCyl4" RAT_FUNC "%10.0" "b" COEFFS 0.000000 1.000000 0.000000 0.000000 0.000000 1.000000 /end COMPU_METHOD
/* Scalar measurable for DDE 'IJT_bar_EffectivePress'. */
/begin MEASUREMENT IJT_bar_EffectivePress "Effective pressure (DeltaP) at injector" FLOAT32_IEEE CU_IJT_BAR_EFFECTIVEPRESS 1 100 0.0 200.0 ECU_ADDRESS 0x400032f4 BYTE_ORDER MSB_FIRST /end MEASUREMENT
/begin COMPU_METHOD CU_IJT_BAR_EFFECTIVEPRESS "Conversion method for IJT_bar_EffectivePress" RAT_FUNC "%10.2" "bar" COEFFS 0.000000 1.000000 0.000000 0.000000 0.000000 1.000000 /end COMPU_METHOD
/* Scalar measurable for DDE 'IJT_cnt_PrimingPulsesCyl1'. */
/begin MEASUREMENT IJT_cnt_PrimingPulsesCyl1 "Displayable" UBYTE CU_IJT_CNT_PRIMINGPULSESCYL1 1 100 0.0 0.0 ECU_ADDRESS 0x40002fdf BYTE_ORDER MSB_FIRST /end MEASUREMENT
/begin COMPU_METHOD CU_IJT_CNT_PRIMINGPULSESCYL1 "Conversion method for IJT_cnt_PrimingPulsesCyl1" RAT_FUNC "%10.0" "cnt" COEFFS 0.000000 1.000000 0.000000 0.000000 0.000000 1.000000 /end COMPU_METHOD
/* Scalar measurable for DDE 'IJT_cnt_PrimingPulsesCyl2'. */
/begin MEASUREMENT IJT_cnt_PrimingPulsesCyl2 "Displayable" UBYTE CU_IJT_CNT_PRIMINGPULSESCYL2 1 100 0.0 0.0 ECU_ADDRESS 0x40002fde BYTE_ORDER MSB_FIRST /end MEASUREMENT
/begin COMPU_METHOD CU_IJT_CNT_PRIMINGPULSESCYL2 "Conversion method for IJT_cnt_PrimingPulsesCyl2" RAT_FUNC "%10.0" "cnt" COEFFS 0.000000 1.000000 0.000000 0.000000 0.000000 1.000000 /end COMPU_METHOD
/* Scalar measurable for DDE 'IJT_cnt_PrimingPulsesCyl3'. */
/begin MEASUREMENT IJT_cnt_PrimingPulsesCyl3 "Displayable" UBYTE CU_IJT_CNT_PRIMINGPULSESCYL3 1 100 0.0 0.0 ECU_ADDRESS 0x40002fdd BYTE_ORDER MSB_FIRST /end MEASUREMENT
/begin COMPU_METHOD CU_IJT_CNT_PRIMINGPULSESCYL3 "Conversion method for IJT_cnt_PrimingPulsesCyl3" RAT_FUNC "%10.0" "cnt" COEFFS 0.000000 1.000000 0.000000 0.000000 0.000000 1.000000 /end COMPU_METHOD
/* Scalar measurable for DDE 'IJT_cnt_PrimingPulsesCyl4'. */
/begin MEASUREMENT IJT_cnt_PrimingPulsesCyl4 "Displayable" UBYTE CU_IJT_CNT_PRIMINGPULSESCYL4 1 100 0.0 0.0 ECU_ADDRESS 0x40002fdc BYTE_ORDER MSB_FIRST /end MEASUREMENT
/begin COMPU_METHOD CU_IJT_CNT_PRIMINGPULSESCYL4 "Conversion method for IJT_cnt_PrimingPulsesCyl4" RAT_FUNC "%10.0" "cnt" COEFFS 0.000000 1.000000 0.000000 0.000000 0.000000 1.000000 /end COMPU_METHOD
/* Scalar measurable for DDE 'IJT_deg_Inj1'. */
/begin MEASUREMENT IJT_deg_Inj1 "Displayable" FLOAT32_IEEE CU_IJT_DEG_INJ1 1 100 0.0 0.0 ECU_ADDRESS 0x400032e8 BYTE_ORDER MSB_FIRST /end MEASUREMENT
/begin COMPU_METHOD CU_IJT_DEG_INJ1 "Conversion method for IJT_deg_Inj1" RAT_FUNC "%10.2" "deg" COEFFS 0.000000 1.000000 0.000000 0.000000 0.000000 1.000000 /end COMPU_METHOD
/* Scalar measurable for DDE 'IJT_deg_Inj2'. */
/begin MEASUREMENT IJT_deg_Inj2 "Displayable" FLOAT32_IEEE CU_IJT_DEG_INJ2 1 100 0.0 0.0 ECU_ADDRESS 0x400032e4 BYTE_ORDER MSB_FIRST /end MEASUREMENT
/begin COMPU_METHOD CU_IJT_DEG_INJ2 "Conversion method for IJT_deg_Inj2" RAT_FUNC "%10.2" "deg" COEFFS 0.000000 1.000000 0.000000 0.000000 0.000000 1.000000 /end COMPU_METHOD
/* Scalar measurable for DDE 'IJT_deg_Inj3'. */
/begin MEASUREMENT IJT_deg_Inj3 "Displayable" FLOAT32_IEEE CU_IJT_DEG_INJ3 1 100 0.0 0.0 ECU_ADDRESS 0x400032e0 BYTE_ORDER MSB_FIRST /end MEASUREMENT
/begin COMPU_METHOD CU_IJT_DEG_INJ3 "Conversion method for IJT_deg_Inj3" RAT_FUNC "%10.2" "deg" COEFFS 0.000000 1.000000 0.000000 0.000000 0.000000 1.000000 /end COMPU_METHOD
/* Scalar measurable for DDE 'IJT_deg_Inj4'. */
/begin MEASUREMENT IJT_deg_Inj4 "Displayable" FLOAT32_IEEE CU_IJT_DEG_INJ4 1 100 0.0 0.0 ECU_ADDRESS 0x400032dc BYTE_ORDER MSB_FIRST /end MEASUREMENT
/begin COMPU_METHOD CU_IJT_DEG_INJ4 "Conversion method for IJT_deg_Inj4" RAT_FUNC "%10.2" "deg" COEFFS 0.000000 1.000000 0.000000 0.000000 0.000000 1.000000 /end COMPU_METHOD
/* Scalar measurable for DDE 'IJT_gps_InjectorFlowRatePFI'. */
/begin MEASUREMENT IJT_gps_InjectorFlowRatePFI "(not defined)" FLOAT32_IEEE CU_IJT_GPS_INJECTORFLOWRATEPFI 1 100 0.0 0.0 ECU_ADDRESS 0x400032f0 BYTE_ORDER MSB_FIRST /end MEASUREMENT
/begin COMPU_METHOD CU_IJT_GPS_INJECTORFLOWRATEPFI "Conversion method for IJT_gps_InjectorFlowRatePFI" RAT_FUNC "%10.4" "gps" COEFFS 0.000000 1.000000 0.000000 0.000000 0.000000 1.000000 /end COMPU_METHOD
/* Scalar measurable for DDE 'IJT_gps_TotalFuelFlow'. */
/begin MEASUREMENT IJT_gps_TotalFuelFlow "(g/s) Commanded engine-total fuel flow rate" FLOAT32_IEEE CU_IJT_GPS_TOTALFUELFLOW 1 100 0.0 0.0 ECU_ADDRESS 0x40003300 BYTE_ORDER MSB_FIRST /end MEASUREMENT
/begin COMPU_METHOD CU_IJT_GPS_TOTALFUELFLOW "Conversion method for IJT_gps_TotalFuelFlow" RAT_FUNC "%10.1" "gps" COEFFS 0.000000 1.000000 0.000000 0.000000 0.000000 1.000000 /end COMPU_METHOD
/* Scalar measurable for DDE 'IJT_mg_Inj1'. */
/begin MEASUREMENT IJT_mg_Inj1 "Displayable" FLOAT32_IEEE CU_IJT_MG_INJ1 1 100 0.0 0.0 ECU_ADDRESS 0x400032d8 BYTE_ORDER MSB_FIRST /end MEASUREMENT
/begin COMPU_METHOD CU_IJT_MG_INJ1 "Conversion method for IJT_mg_Inj1" RAT_FUNC "%10.2" "mg" COEFFS 0.000000 1.000000 0.000000 0.000000 0.000000 1.000000 /end COMPU_METHOD
/* Scalar measurable for DDE 'IJT_mg_Inj2'. */
/begin MEASUREMENT IJT_mg_Inj2 "Displayable" FLOAT32_IEEE CU_IJT_MG_INJ2 1 100 0.0 0.0 ECU_ADDRESS 0x400032d4 BYTE_ORDER MSB_FIRST /end MEASUREMENT
/begin COMPU_METHOD CU_IJT_MG_INJ2 "Conversion method for IJT_mg_Inj2" RAT_FUNC "%10.2" "mg" COEFFS 0.000000 1.000000 0.000000 0.000000 0.000000 1.000000 /end COMPU_METHOD
/* Scalar measurable for DDE 'IJT_mg_Inj3'. */
/begin MEASUREMENT IJT_mg_Inj3 "Displayable" FLOAT32_IEEE CU_IJT_MG_INJ3 1 100 0.0 0.0 ECU_ADDRESS 0x400032d0 BYTE_ORDER MSB_FIRST /end MEASUREMENT
/begin COMPU_METHOD CU_IJT_MG_INJ3 "Conversion method for IJT_mg_Inj3" RAT_FUNC "%10.2" "mg" COEFFS 0.000000 1.000000 0.000000 0.000000 0.000000 1.000000 /end COMPU_METHOD
/* Scalar measurable for DDE 'IJT_mg_Inj4'. */
/begin MEASUREMENT IJT_mg_Inj4 "Displayable" FLOAT32_IEEE CU_IJT_MG_INJ4 1 100 0.0 0.0 ECU_ADDRESS 0x400032cc BYTE_ORDER MSB_FIRST /end MEASUREMENT
/begin COMPU_METHOD CU_IJT_MG_INJ4 "Conversion method for IJT_mg_Inj4" RAT_FUNC "%10.2" "mg" COEFFS 0.000000 1.000000 0.000000 0.000000 0.000000 1.000000 /end COMPU_METHOD
/* Scalar measurable for DDE 'IJT_ms_Inj1'. */
/begin MEASUREMENT IJT_ms_Inj1 "Displayable" FLOAT32_IEEE CU_IJT_MS_INJ1 1 100 0.0 0.0 ECU_ADDRESS 0x40003220 BYTE_ORDER MSB_FIRST /end MEASUREMENT
/begin COMPU_METHOD CU_IJT_MS_INJ1 "Conversion method for IJT_ms_Inj1" RAT_FUNC "%10.3" "ms" COEFFS 0.000000 1.000000 0.000000 0.000000 0.000000 1.000000 /end COMPU_METHOD
/* Scalar measurable for DDE 'IJT_ms_Inj2'. */
/begin MEASUREMENT IJT_ms_Inj2 "Displayable" FLOAT32_IEEE CU_IJT_MS_INJ2 1 100 0.0 0.0 ECU_ADDRESS 0x40003224 BYTE_ORDER MSB_FIRST /end MEASUREMENT
/begin COMPU_METHOD CU_IJT_MS_INJ2 "Conversion method for IJT_ms_Inj2" RAT_FUNC "%10.3" "ms" COEFFS 0.000000 1.000000 0.000000 0.000000 0.000000 1.000000 /end COMPU_METHOD
/* Scalar measurable for DDE 'IJT_ms_Inj3'. */
/begin MEASUREMENT IJT_ms_Inj3 "Displayable" FLOAT32_IEEE CU_IJT_MS_INJ3 1 100 0.0 0.0 ECU_ADDRESS 0x4000322c BYTE_ORDER MSB_FIRST /end MEASUREMENT
/begin COMPU_METHOD CU_IJT_MS_INJ3 "Conversion method for IJT_ms_Inj3" RAT_FUNC "%10.3" "ms" COEFFS 0.000000 1.000000 0.000000 0.000000 0.000000 1.000000 /end COMPU_METHOD
/* Scalar measurable for DDE 'IJT_ms_Inj4'. */
/begin MEASUREMENT IJT_ms_Inj4 "Displayable" FLOAT32_IEEE CU_IJT_MS_INJ4 1 100 0.0 0.0 ECU_ADDRESS 0x40003228 BYTE_ORDER MSB_FIRST /end MEASUREMENT
/begin COMPU_METHOD CU_IJT_MS_INJ4 "Conversion method for IJT_ms_Inj4" RAT_FUNC "%10.3" "ms" COEFFS 0.000000 1.000000 0.000000 0.000000 0.000000 1.000000 /end COMPU_METHOD
/* Scalar measurable for DDE 'IJT_ms_OpeningDelay'. */
/begin MEASUREMENT IJT_ms_OpeningDelay "Calculated Opening delay" FLOAT32_IEEE CU_IJT_MS_OPENINGDELAY 1 100 0.0 2.0 ECU_ADDRESS 0x40003328 BYTE_ORDER MSB_FIRST /end MEASUREMENT
/begin COMPU_METHOD CU_IJT_MS_OPENINGDELAY "Conversion method for IJT_ms_OpeningDelay" RAT_FUNC "%10.3" "ms" COEFFS 0.000000 1.000000 0.000000 0.000000 0.000000 1.000000 /end COMPU_METHOD
/* Scalar measurable for DDE 'IJT_ms_OpeningDelayInj1'. */
/begin MEASUREMENT IJT_ms_OpeningDelayInj1 "Displayable" FLOAT32_IEEE CU_IJT_MS_OPENINGDELAYINJ1 1 100 0.0 0.0 ECU_ADDRESS 0x4000321c BYTE_ORDER MSB_FIRST /end MEASUREMENT
/begin COMPU_METHOD CU_IJT_MS_OPENINGDELAYINJ1 "Conversion method for IJT_ms_OpeningDelayInj1" RAT_FUNC "%10.3" "ms" COEFFS 0.000000 1.000000 0.000000 0.000000 0.000000 1.000000 /end COMPU_METHOD
/* Scalar measurable for DDE 'IJT_ms_OpeningDelayInj2'. */
/begin MEASUREMENT IJT_ms_OpeningDelayInj2 "Displayable" FLOAT32_IEEE CU_IJT_MS_OPENINGDELAYINJ2 1 100 0.0 0.0 ECU_ADDRESS 0x40003218 BYTE_ORDER MSB_FIRST /end MEASUREMENT
/begin COMPU_METHOD CU_IJT_MS_OPENINGDELAYINJ2 "Conversion method for IJT_ms_OpeningDelayInj2" RAT_FUNC "%10.3" "ms" COEFFS 0.000000 1.000000 0.000000 0.000000 0.000000 1.000000 /end COMPU_METHOD
/* Scalar measurable for DDE 'IJT_ms_OpeningDelayInj3'. */
/begin MEASUREMENT IJT_ms_OpeningDelayInj3 "Displayable" FLOAT32_IEEE CU_IJT_MS_OPENINGDELAYINJ3 1 100 0.0 0.0 ECU_ADDRESS 0x40003214 BYTE_ORDER MSB_FIRST /end MEASUREMENT
/begin COMPU_METHOD CU_IJT_MS_OPENINGDELAYINJ3 "Conversion method for IJT_ms_OpeningDelayInj3" RAT_FUNC "%10.3" "ms" COEFFS 0.000000 1.000000 0.000000 0.000000 0.000000 1.000000 /end COMPU_METHOD
/* Scalar measurable for DDE 'IJT_ms_OpeningDelayInj4'. */
/begin MEASUREMENT IJT_ms_OpeningDelayInj4 "Displayable" FLOAT32_IEEE CU_IJT_MS_OPENINGDELAYINJ4 1 100 0.0 0.0 ECU_ADDRESS 0x40003210 BYTE_ORDER MSB_FIRST /end MEASUREMENT
/begin COMPU_METHOD CU_IJT_MS_OPENINGDELAYINJ4 "Conversion method for IJT_ms_OpeningDelayInj4" RAT_FUNC "%10.3" "ms" COEFFS 0.000000 1.000000 0.000000 0.000000 0.000000 1.000000 /end COMPU_METHOD
/* Scalar measurable for DDE 'IJT_ms_OverlapThrsh'. */
/begin MEASUREMENT IJT_ms_OverlapThrsh "If injector flow time exceeds this value consider it overlap" FLOAT32_IEEE CU_IJT_MS_OVERLAPTHRSH 1 100 0.0 0.0 ECU_ADDRESS 0x400032ec BYTE_ORDER MSB_FIRST /end MEASUREMENT
/begin COMPU_METHOD CU_IJT_MS_OVERLAPTHRSH "Conversion method for IJT_ms_OverlapThrsh" RAT_FUNC "%10.1" "ms" COEFFS 0.000000 1.000000 0.000000 0.000000 0.000000 1.000000 /end COMPU_METHOD
/* Scalar measurable for DDE 'IJT_pct_FuelTempCF'. */
/begin MEASUREMENT IJT_pct_FuelTempCF "Injection quantity fuel rail temperature compensation factor" FLOAT32_IEEE CU_IJT_PCT_FUELTEMPCF 1 100 0.0 0.0 ECU_ADDRESS 0x400032f8 BYTE_ORDER MSB_FIRST /end MEASUREMENT
/begin COMPU_METHOD CU_IJT_PCT_FUELTEMPCF "Conversion method for IJT_pct_FuelTempCF" RAT_FUNC "%10.2" "pct" COEFFS 0.000000 1.000000 0.000000 0.000000 0.000000 1.000000 /end COMPU_METHOD
/* Scalar measurable for DDE 'IJT_s_Slack'. */
/begin MEASUREMENT IJT_s_Slack "Displayable" FLOAT32_IEEE CU_IJT_S_SLACK 1 100 0.0 0.0 ECU_ADDRESS 0x40003314 BYTE_ORDER MSB_FIRST /end MEASUREMENT
/begin COMPU_METHOD CU_IJT_S_SLACK "Conversion method for IJT_s_Slack" RAT_FUNC "%10.3" "s" COEFFS 0.000000 1.000000 0.000000 0.000000 0.000000 1.000000 /end COMPU_METHOD
/* Scalar measurable for DDE 'INP_C_AmbientTemp'. */
/begin MEASUREMENT INP_C_AmbientTemp "Displayable" FLOAT32_IEEE CU_INP_C_AMBIENTTEMP 1 100 0.0 0.0 ECU_ADDRESS 0x40003754 BYTE_ORDER MSB_FIRST /end MEASUREMENT
/begin COMPU_METHOD CU_INP_C_AMBIENTTEMP "Conversion method for INP_C_AmbientTemp" RAT_FUNC "%10.3" "C" COEFFS 0.000000 1.000000 0.000000 0.000000 0.000000 1.000000 /end COMPU_METHOD
/* Scalar measurable for DDE 'INP_C_CompOutTemp'. */
/begin MEASUREMENT INP_C_CompOutTemp "Displayable" FLOAT32_IEEE CU_INP_C_COMPOUTTEMP 1 100 0.0 0.0 ECU_ADDRESS 0x40003744 BYTE_ORDER MSB_FIRST /end MEASUREMENT
/begin COMPU_METHOD CU_INP_C_COMPOUTTEMP "Conversion method for INP_C_CompOutTemp" RAT_FUNC "%10.3" "C" COEFFS 0.000000 1.000000 0.000000 0.000000 0.000000 1.000000 /end COMPU_METHOD
/* Scalar measurable for DDE 'INP_C_CoolantTemp'. */
/begin MEASUREMENT INP_C_CoolantTemp "Displayable" FLOAT32_IEEE CU_INP_C_COOLANTTEMP 1 100 0.0 0.0 ECU_ADDRESS 0x40003714 BYTE_ORDER MSB_FIRST /end MEASUREMENT
/begin COMPU_METHOD CU_INP_C_COOLANTTEMP "Conversion method for INP_C_CoolantTemp" RAT_FUNC "%10.0" "C" COEFFS 0.000000 1.000000 0.000000 0.000000 0.000000 1.000000 /end COMPU_METHOD
/* Scalar measurable for DDE 'INP_C_ExhaustTemp'. */
/begin MEASUREMENT INP_C_ExhaustTemp "(not defined)" FLOAT32_IEEE CU_INP_C_EXHAUSTTEMP 1 100 -40.0 1000.0 ECU_ADDRESS 0x40003740 BYTE_ORDER MSB_FIRST /end MEASUREMENT
/begin COMPU_METHOD CU_INP_C_EXHAUSTTEMP "Conversion method for INP_C_ExhaustTemp" RAT_FUNC "%10.1" "C" COEFFS 0.000000 1.000000 0.000000 0.000000 0.000000 1.000000 /end COMPU_METHOD
/* Scalar measurable for DDE 'INP_C_FuelTemp'. */
/begin MEASUREMENT INP_C_FuelTemp "Displayable" FLOAT32_IEEE CU_INP_C_FUELTEMP 1 100 0.0 0.0 ECU_ADDRESS 0x40003720 BYTE_ORDER MSB_FIRST /end MEASUREMENT
/begin COMPU_METHOD CU_INP_C_FUELTEMP "Conversion method for INP_C_FuelTemp" RAT_FUNC "%10.0" "C" COEFFS 0.000000 1.000000 0.000000 0.000000 0.000000 1.000000 /end COMPU_METHOD
/* Scalar measurable for DDE 'INP_C_ManifoldTemp'. */
/begin MEASUREMENT INP_C_ManifoldTemp "Displayable" FLOAT32_IEEE CU_INP_C_MANIFOLDTEMP 1 100 0.0 0.0 ECU_ADDRESS 0x40003718 BYTE_ORDER MSB_FIRST /end MEASUREMENT
/begin COMPU_METHOD CU_INP_C_MANIFOLDTEMP "Conversion method for INP_C_ManifoldTemp" RAT_FUNC "%10.3" "C" COEFFS 0.000000 1.000000 0.000000 0.000000 0.000000 1.000000 /end COMPU_METHOD
/* Scalar measurable for DDE 'INP_C_OilTemp'. */
/begin MEASUREMENT INP_C_OilTemp "Displayable" FLOAT32_IEEE CU_INP_C_OILTEMP 1 100 0.0 0.0 ECU_ADDRESS 0x40003730 BYTE_ORDER MSB_FIRST /end MEASUREMENT
/begin COMPU_METHOD CU_INP_C_OILTEMP "Conversion method for INP_C_OilTemp" RAT_FUNC "%10.2" "C" COEFFS 0.000000 1.000000 0.000000 0.000000 0.000000 1.000000 /end COMPU_METHOD
/* Scalar measurable for DDE 'INP_L_TotalFuelLevel_L'. */
/begin MEASUREMENT INP_L_TotalFuelLevel_L "Displayable" FLOAT32_IEEE CU_INP_L_TOTALFUELLEVEL_L 1 100 0.0 0.0 ECU_ADDRESS 0x400038cc BYTE_ORDER MSB_FIRST /end MEASUREMENT
/begin COMPU_METHOD CU_INP_L_TOTALFUELLEVEL_L "Conversion method for INP_L_TotalFuelLevel_L" RAT_FUNC "%10.2" "L" COEFFS 0.000000 1.000000 0.000000 0.000000 0.000000 1.000000 /end COMPU_METHOD
/* Scalar measurable for DDE 'INP_NU_APP1_Raw'. */
/begin MEASUREMENT INP_NU_APP1_Raw "Displayable" FLOAT32_IEEE CU_INP_NU_APP1_RAW 1 100 0.0 0.0 ECU_ADDRESS 0x40003778 BYTE_ORDER MSB_FIRST /end MEASUREMENT
/begin COMPU_METHOD CU_INP_NU_APP1_RAW "Conversion method for INP_NU_APP1_Raw" RAT_FUNC "%10.3" "NU" COEFFS 0.000000 1.000000 0.000000 0.000000 0.000000 1.000000 /end COMPU_METHOD
/* Scalar measurable for DDE 'INP_NU_APP2_Raw'. */
/begin MEASUREMENT INP_NU_APP2_Raw "Displayable" FLOAT32_IEEE CU_INP_NU_APP2_RAW 1 100 0.0 0.0 ECU_ADDRESS 0x40003774 BYTE_ORDER MSB_FIRST /end MEASUREMENT
/begin COMPU_METHOD CU_INP_NU_APP2_RAW "Conversion method for INP_NU_APP2_Raw" RAT_FUNC "%10.3" "NU" COEFFS 0.000000 1.000000 0.000000 0.000000 0.000000 1.000000 /end COMPU_METHOD
/* Scalar measurable for DDE 'INP_NU_SpiCtrlCnts_A'. */
/begin MEASUREMENT INP_NU_SpiCtrlCnts_A "Counter for SPI control counts - how many times a SPI register write/read error occurred according to OE block" FLOAT32_IEEE CU_INP_NU_SPICTRLCNTS_A 1 100 0.0 0.0 ECU_ADDRESS 0x400030c4 BYTE_ORDER MSB_FIRST /end MEASUREMENT
/begin COMPU_METHOD CU_INP_NU_SPICTRLCNTS_A "Conversion method for INP_NU_SpiCtrlCnts_A" RAT_FUNC "%10.0" "NU" COEFFS 0.000000 1.000000 0.000000 0.000000 0.000000 1.000000 /end COMPU_METHOD
/* Scalar measurable for DDE 'INP_NU_SpiCtrlCnts_B'. */
/begin MEASUREMENT INP_NU_SpiCtrlCnts_B "Counter for SPI control counts - how many times a SPI register write/read error occurred according to OE block" FLOAT32_IEEE CU_INP_NU_SPICTRLCNTS_B 1 100 0.0 0.0 ECU_ADDRESS 0x400030d0 BYTE_ORDER MSB_FIRST /end MEASUREMENT
/begin COMPU_METHOD CU_INP_NU_SPICTRLCNTS_B "Conversion method for INP_NU_SpiCtrlCnts_B" RAT_FUNC "%10.0" "NU" COEFFS 0.000000 1.000000 0.000000 0.000000 0.000000 1.000000 /end COMPU_METHOD
/* Scalar measurable for DDE 'INP_NU_TP1_Raw'. */
/begin MEASUREMENT INP_NU_TP1_Raw "Displayable" FLOAT32_IEEE CU_INP_NU_TP1_RAW 1 100 0.0 0.0 ECU_ADDRESS 0x40003710 BYTE_ORDER MSB_FIRST /end MEASUREMENT
/begin COMPU_METHOD CU_INP_NU_TP1_RAW "Conversion method for INP_NU_TP1_Raw" RAT_FUNC "%10.1" "NU" COEFFS 0.000000 1.000000 0.000000 0.000000 0.000000 1.000000 /end COMPU_METHOD
/* Scalar measurable for DDE 'INP_NU_TP2_Raw'. */
/begin MEASUREMENT INP_NU_TP2_Raw "Displayable" FLOAT32_IEEE CU_INP_NU_TP2_RAW 1 100 0.0 0.0 ECU_ADDRESS 0x40003770 BYTE_ORDER MSB_FIRST /end MEASUREMENT
/begin COMPU_METHOD CU_INP_NU_TP2_RAW "Conversion method for INP_NU_TP2_Raw" RAT_FUNC "%10.1" "NU" COEFFS 0.000000 1.000000 0.000000 0.000000 0.000000 1.000000 /end COMPU_METHOD
/* Scalar measurable for DDE 'INP_RPM_CrankSpd'. */
/begin MEASUREMENT INP_RPM_CrankSpd "(not defined)" FLOAT32_IEEE CU_INP_RPM_CRANKSPD 1 100 0.0 0.0 ECU_ADDRESS 0x40003808 BYTE_ORDER MSB_FIRST /end MEASUREMENT
/begin COMPU_METHOD CU_INP_RPM_CRANKSPD "Conversion method for INP_RPM_CrankSpd" RAT_FUNC "%10.3" "RPM" COEFFS 0.000000 1.000000 0.000000 0.000000 0.000000 1.000000 /end COMPU_METHOD
/* Scalar measurable for DDE 'INP_RPM_EngSpd'. */
/begin MEASUREMENT INP_RPM_EngSpd "Displayable" FLOAT32_IEEE CU_INP_RPM_ENGSPD 1 100 0.0 0.0 ECU_ADDRESS 0x40003734 BYTE_ORDER MSB_FIRST /end MEASUREMENT
/begin COMPU_METHOD CU_INP_RPM_ENGSPD "Conversion method for INP_RPM_EngSpd" RAT_FUNC "%10.0" "RPM" COEFFS 0.000000 1.000000 0.000000 0.000000 0.000000 1.000000 /end COMPU_METHOD
/* Scalar measurable for DDE 'INP_V_EGO11'. */
/begin MEASUREMENT INP_V_EGO11 "Displayable" FLOAT32_IEEE CU_INP_V_EGO11 1 100 0.0 0.0 ECU_ADDRESS 0x40003780 BYTE_ORDER MSB_FIRST /end MEASUREMENT
/begin COMPU_METHOD CU_INP_V_EGO11 "Conversion method for INP_V_EGO11" RAT_FUNC "%10.1" "V" COEFFS 0.000000 1.000000 0.000000 0.000000 0.000000 1.000000 /end COMPU_METHOD
/* Scalar measurable for DDE 'INP_V_EGO21'. */
/begin MEASUREMENT INP_V_EGO21 "Displayable" FLOAT32_IEEE CU_INP_V_EGO21 1 100 0.0 0.0 ECU_ADDRESS 0x40003760 BYTE_ORDER MSB_FIRST /end MEASUREMENT
/begin COMPU_METHOD CU_INP_V_EGO21 "Conversion method for INP_V_EGO21" RAT_FUNC "%10.1" "V" COEFFS 0.000000 1.000000 0.000000 0.000000 0.000000 1.000000 /end COMPU_METHOD
/* Scalar measurable for DDE 'INP_V_FuelLevel1'. */
/begin MEASUREMENT INP_V_FuelLevel1 "Displayable" FLOAT32_IEEE CU_INP_V_FUELLEVEL1 1 100 0.0 0.0 ECU_ADDRESS 0x400038e4 BYTE_ORDER MSB_FIRST /end MEASUREMENT
/begin COMPU_METHOD CU_INP_V_FUELLEVEL1 "Conversion method for INP_V_FuelLevel1" RAT_FUNC "%10.2" "V" COEFFS 0.000000 1.000000 0.000000 0.000000 0.000000 1.000000 /end COMPU_METHOD
/* Scalar measurable for DDE 'INP_V_FuelLevel2'. */
/begin MEASUREMENT INP_V_FuelLevel2 "Displayable" FLOAT32_IEEE CU_INP_V_FUELLEVEL2 1 100 0.0 0.0 ECU_ADDRESS 0x400038e0 BYTE_ORDER MSB_FIRST /end MEASUREMENT
/begin COMPU_METHOD CU_INP_V_FUELLEVEL2 "Conversion method for INP_V_FuelLevel2" RAT_FUNC "%10.2" "V" COEFFS 0.000000 1.000000 0.000000 0.000000 0.000000 1.000000 /end COMPU_METHOD
/* Scalar measurable for DDE 'INP_V_VBatt'. */
/begin MEASUREMENT INP_V_VBatt "Displayable" FLOAT32_IEEE CU_INP_V_VBATT 1 100 0.0 0.0 ECU_ADDRESS 0x4000377c BYTE_ORDER MSB_FIRST /end MEASUREMENT
/begin COMPU_METHOD CU_INP_V_VBATT "Conversion method for INP_V_VBatt" RAT_FUNC "%10.1" "V" COEFFS 0.000000 1.000000 0.000000 0.000000 0.000000 1.000000 /end COMPU_METHOD
/* Scalar measurable for DDE 'INP_b_AC_PressSw'. */
/begin MEASUREMENT INP_b_AC_PressSw "Displayable" UBYTE CU_INP_B_AC_PRESSSW 1 100 0.0 1.0 ECU_ADDRESS 0x40002f3c BYTE_ORDER MSB_FIRST /end MEASUREMENT
/begin COMPU_METHOD CU_INP_B_AC_PRESSSW "Conversion method for INP_b_AC_PressSw" RAT_FUNC "%10.0" "b" COEFFS 0.000000 1.000000 0.000000 0.000000 0.000000 1.000000 /end COMPU_METHOD
/* Scalar measurable for DDE 'INP_b_AC_Rqst'. */
/begin MEASUREMENT INP_b_AC_Rqst "Displayable" UBYTE CU_INP_B_AC_RQST 1 100 0.0 1.0 ECU_ADDRESS 0x40002f3b BYTE_ORDER MSB_FIRST /end MEASUREMENT
/begin COMPU_METHOD CU_INP_B_AC_RQST "Conversion method for INP_b_AC_Rqst" RAT_FUNC "%10.0" "b" COEFFS 0.000000 1.000000 0.000000 0.000000 0.000000 1.000000 /end COMPU_METHOD
/* Scalar measurable for DDE 'INP_b_CamWheelMvmt'. */
/begin MEASUREMENT INP_b_CamWheelMvmt "(not defined)" UBYTE CU_INP_B_CAMWHEELMVMT 1 100 0.0 1.0 ECU_ADDRESS 0x40002fd4 BYTE_ORDER MSB_FIRST /end MEASUREMENT
/begin COMPU_METHOD CU_INP_B_CAMWHEELMVMT "Conversion method for INP_b_CamWheelMvmt" RAT_FUNC "%10.0" "b" COEFFS 0.000000 1.000000 0.000000 0.000000 0.000000 1.000000 /end COMPU_METHOD
/* Scalar measurable for DDE 'INP_b_CrankAngValid'. */
/begin MEASUREMENT INP_b_CrankAngValid "(not defined)" UBYTE CU_INP_B_CRANKANGVALID 1 100 0.0 1.0 ECU_ADDRESS 0x40002fd6 BYTE_ORDER MSB_FIRST /end MEASUREMENT
/begin COMPU_METHOD CU_INP_B_CRANKANGVALID "Conversion method for INP_b_CrankAngValid" RAT_FUNC "%10.0" "b" COEFFS 0.000000 1.000000 0.000000 0.000000 0.000000 1.000000 /end COMPU_METHOD
/* Scalar measurable for DDE 'INP_b_CrankMvmt'. */
/begin MEASUREMENT INP_b_CrankMvmt "(not defined)" UBYTE CU_INP_B_CRANKMVMT 1 100 0.0 1.0 ECU_ADDRESS 0x40002fd3 BYTE_ORDER MSB_FIRST /end MEASUREMENT
/begin COMPU_METHOD CU_INP_B_CRANKMVMT "Conversion method for INP_b_CrankMvmt" RAT_FUNC "%10.0" "b" COEFFS 0.000000 1.000000 0.000000 0.000000 0.000000 1.000000 /end COMPU_METHOD
/* Scalar measurable for DDE 'INP_b_EngAngValid'. */
/begin MEASUREMENT INP_b_EngAngValid "(not defined)" UBYTE CU_INP_B_ENGANGVALID 1 100 0.0 1.0 ECU_ADDRESS 0x40002fd5 BYTE_ORDER MSB_FIRST /end MEASUREMENT
/begin COMPU_METHOD CU_INP_B_ENGANGVALID "Conversion method for INP_b_EngAngValid" RAT_FUNC "%10.0" "b" COEFFS 0.000000 1.000000 0.000000 0.000000 0.000000 1.000000 /end COMPU_METHOD
/* Scalar measurable for DDE 'INP_b_EngSync'. */
/begin MEASUREMENT INP_b_EngSync "Displayable" UBYTE CU_INP_B_ENGSYNC 1 100 0.0 1.0 ECU_ADDRESS 0x40002f3e BYTE_ORDER MSB_FIRST /end MEASUREMENT
/begin COMPU_METHOD CU_INP_B_ENGSYNC "Conversion method for INP_b_EngSync" RAT_FUNC "%10.0" "b" COEFFS 0.000000 1.000000 0.000000 0.000000 0.000000 1.000000 /end COMPU_METHOD
/* Scalar measurable for DDE 'INP_b_Ign'. */
/begin MEASUREMENT INP_b_Ign "Displayable" UBYTE CU_INP_B_IGN 1 100 0.0 1.0 ECU_ADDRESS 0x40002f3a BYTE_ORDER MSB_FIRST /end MEASUREMENT
/begin COMPU_METHOD CU_INP_B_IGN "Conversion method for INP_b_Ign" RAT_FUNC "%10.0" "b" COEFFS 0.000000 1.000000 0.000000 0.000000 0.000000 1.000000 /end COMPU_METHOD
/* Scalar measurable for DDE 'INP_b_OilPrSw'. */
/begin MEASUREMENT INP_b_OilPrSw "(not defined)" UBYTE CU_INP_B_OILPRSW 1 100 0.0 1.0 ECU_ADDRESS 0x40002f3d BYTE_ORDER MSB_FIRST /end MEASUREMENT
/begin COMPU_METHOD CU_INP_B_OILPRSW "Conversion method for INP_b_OilPrSw" RAT_FUNC "%10.0" "b" COEFFS 0.000000 1.000000 0.000000 0.000000 0.000000 1.000000 /end COMPU_METHOD
/* Scalar measurable for DDE 'INP_b_XG4'. */
/begin MEASUREMENT INP_b_XG4 "Displayable" UBYTE CU_INP_B_XG4 1 100 0.0 1.0 ECU_ADDRESS 0x40002f74 BYTE_ORDER MSB_FIRST /end MEASUREMENT
/begin COMPU_METHOD CU_INP_B_XG4 "Conversion method for INP_b_XG4" RAT_FUNC "%10.0" "b" COEFFS 0.000000 1.000000 0.000000 0.000000 0.000000 1.000000 /end COMPU_METHOD
/* Scalar measurable for DDE 'INP_bar_FuelPress'. */
/begin MEASUREMENT INP_bar_FuelPress "ABSOLUTE fuel pressure displayable" FLOAT32_IEEE CU_INP_BAR_FUELPRESS 1 100 0.0 0.0 ECU_ADDRESS 0x40003758 BYTE_ORDER MSB_FIRST /end MEASUREMENT
/begin COMPU_METHOD CU_INP_BAR_FUELPRESS "Conversion method for INP_bar_FuelPress" RAT_FUNC "%10.2" "bar" COEFFS 0.000000 1.000000 0.000000 0.000000 0.000000 1.000000 /end COMPU_METHOD
/* Scalar measurable for DDE 'INP_cnt_IgnCount'. */
/begin MEASUREMENT INP_cnt_IgnCount "Cuenta Ignition" UWORD CU_INP_CNT_IGNCOUNT 1 100 1.0 65535.0 ECU_ADDRESS 0x40003028 BYTE_ORDER MSB_FIRST /end MEASUREMENT
/begin COMPU_METHOD CU_INP_CNT_IGNCOUNT "Conversion method for INP_cnt_IgnCount" RAT_FUNC "%10.0" "cnt" COEFFS 0.000000 1.000000 0.000000 0.000000 0.000000 1.000000 /end COMPU_METHOD
/* Scalar measurable for DDE 'INP_cnt_count_1'. */
/begin MEASUREMENT INP_cnt_count_1 "Cuenta misfire cil 1" UBYTE CU_INP_CNT_COUNT_1 1 100 1.0 255.0 ECU_ADDRESS 0x40003022 BYTE_ORDER MSB_FIRST /end MEASUREMENT
/begin COMPU_METHOD CU_INP_CNT_COUNT_1 "Conversion method for INP_cnt_count_1" RAT_FUNC "%10.0" "cnt" COEFFS 0.000000 1.000000 0.000000 0.000000 0.000000 1.000000 /end COMPU_METHOD
/* Scalar measurable for DDE 'INP_cnt_count_2'. */
/begin MEASUREMENT INP_cnt_count_2 "Cuenta misfire cil 2" UBYTE CU_INP_CNT_COUNT_2 1 100 1.0 255.0 ECU_ADDRESS 0x40003021 BYTE_ORDER MSB_FIRST /end MEASUREMENT
/begin COMPU_METHOD CU_INP_CNT_COUNT_2 "Conversion method for INP_cnt_count_2" RAT_FUNC "%10.0" "cnt" COEFFS 0.000000 1.000000 0.000000 0.000000 0.000000 1.000000 /end COMPU_METHOD
/* Scalar measurable for DDE 'INP_cnt_count_3'. */
/begin MEASUREMENT INP_cnt_count_3 "Cuenta misfire cil 3" UBYTE CU_INP_CNT_COUNT_3 1 100 1.0 255.0 ECU_ADDRESS 0x40003020 BYTE_ORDER MSB_FIRST /end MEASUREMENT
/begin COMPU_METHOD CU_INP_CNT_COUNT_3 "Conversion method for INP_cnt_count_3" RAT_FUNC "%10.0" "cnt" COEFFS 0.000000 1.000000 0.000000 0.000000 0.000000 1.000000 /end COMPU_METHOD
/* Scalar measurable for DDE 'INP_cnt_count_4'. */
/begin MEASUREMENT INP_cnt_count_4 "Cuenta misfire cil 4" UBYTE CU_INP_CNT_COUNT_4 1 100 1.0 255.0 ECU_ADDRESS 0x4000301f BYTE_ORDER MSB_FIRST /end MEASUREMENT
/begin COMPU_METHOD CU_INP_CNT_COUNT_4 "Conversion method for INP_cnt_count_4" RAT_FUNC "%10.0" "cnt" COEFFS 0.000000 1.000000 0.000000 0.000000 0.000000 1.000000 /end COMPU_METHOD
/* Scalar measurable for DDE 'INP_deg_CrankAng'. */
/begin MEASUREMENT INP_deg_CrankAng "(not defined)" FLOAT32_IEEE CU_INP_DEG_CRANKANG 1 100 0.0 0.0 ECU_ADDRESS 0x40003994 BYTE_ORDER MSB_FIRST /end MEASUREMENT
/begin COMPU_METHOD CU_INP_DEG_CRANKANG "Conversion method for INP_deg_CrankAng" RAT_FUNC "%10.3" "deg" COEFFS 0.000000 1.000000 0.000000 0.000000 0.000000 1.000000 /end COMPU_METHOD
/* Scalar measurable for DDE 'INP_deg_EngAng'. */
/begin MEASUREMENT INP_deg_EngAng "(not defined)" FLOAT32_IEEE CU_INP_DEG_ENGANG 1 100 0.0 0.0 ECU_ADDRESS 0x40003990 BYTE_ORDER MSB_FIRST /end MEASUREMENT
/begin COMPU_METHOD CU_INP_DEG_ENGANG "Conversion method for INP_deg_EngAng" RAT_FUNC "%10.3" "deg" COEFFS 0.000000 1.000000 0.000000 0.000000 0.000000 1.000000 /end COMPU_METHOD
/* Scalar measurable for DDE 'INP_e_TransGear'. */
/begin MEASUREMENT INP_e_TransGear "Displayable" SBYTE CU_INP_E_TRANSGEAR 1 100 0.0 0.0 ECU_ADDRESS 0x40002fd8 BYTE_ORDER MSB_FIRST /end MEASUREMENT
/begin COMPU_METHOD CU_INP_E_TRANSGEAR "Conversion method for INP_e_TransGear" RAT_FUNC "%10.0" "e" COEFFS 0.000000 1.000000 0.000000 0.000000 0.000000 1.000000 /end COMPU_METHOD
/* Scalar measurable for DDE 'INP_gps_MAF'. */
/begin MEASUREMENT INP_gps_MAF "Displayable" FLOAT32_IEEE CU_INP_GPS_MAF 1 100 0.0 0.0 ECU_ADDRESS 0x40003784 BYTE_ORDER MSB_FIRST /end MEASUREMENT
/begin COMPU_METHOD CU_INP_GPS_MAF "Conversion method for INP_gps_MAF" RAT_FUNC "%10.0" "gps" COEFFS 0.000000 1.000000 0.000000 0.000000 0.000000 1.000000 /end COMPU_METHOD
/* Scalar measurable for DDE 'INP_kPa_Baro'. */
/begin MEASUREMENT INP_kPa_Baro "Displayable" FLOAT32_IEEE CU_INP_KPA_BARO 1 100 0.0 0.0 ECU_ADDRESS 0x4000374c BYTE_ORDER MSB_FIRST /end MEASUREMENT
/begin COMPU_METHOD CU_INP_KPA_BARO "Conversion method for INP_kPa_Baro" RAT_FUNC "%10.3" "kPa" COEFFS 0.000000 1.000000 0.000000 0.000000 0.000000 1.000000 /end COMPU_METHOD
/* Scalar measurable for DDE 'INP_kPa_CompOutPress'. */
/begin MEASUREMENT INP_kPa_CompOutPress "Displayable" FLOAT32_IEEE CU_INP_KPA_COMPOUTPRESS 1 100 0.0 0.0 ECU_ADDRESS 0x40003750 BYTE_ORDER MSB_FIRST /end MEASUREMENT
/begin COMPU_METHOD CU_INP_KPA_COMPOUTPRESS "Conversion method for INP_kPa_CompOutPress" RAT_FUNC "%10.3" "kPa" COEFFS 0.000000 1.000000 0.000000 0.000000 0.000000 1.000000 /end COMPU_METHOD
/* Scalar measurable for DDE 'INP_kPa_MAP'. */
/begin MEASUREMENT INP_kPa_MAP "Displayable" FLOAT32_IEEE CU_INP_KPA_MAP 1 100 0.0 0.0 ECU_ADDRESS 0x40003724 BYTE_ORDER MSB_FIRST /end MEASUREMENT
/begin COMPU_METHOD CU_INP_KPA_MAP "Conversion method for INP_kPa_MAP" RAT_FUNC "%10.0" "kPa" COEFFS 0.000000 1.000000 0.000000 0.000000 0.000000 1.000000 /end COMPU_METHOD
/* Scalar measurable for DDE 'INP_kPa_OilPress'. */
/begin MEASUREMENT INP_kPa_OilPress "Displayable" FLOAT32_IEEE CU_INP_KPA_OILPRESS 1 100 0.0 0.0 ECU_ADDRESS 0x4000375c BYTE_ORDER MSB_FIRST /end MEASUREMENT
/begin COMPU_METHOD CU_INP_KPA_OILPRESS "Conversion method for INP_kPa_OilPress" RAT_FUNC "%10.3" "kPa" COEFFS 0.000000 1.000000 0.000000 0.000000 0.000000 1.000000 /end COMPU_METHOD
/* Scalar measurable for DDE 'INP_kph_VehSpd'. */
/begin MEASUREMENT INP_kph_VehSpd "Displayable" FLOAT32_IEEE CU_INP_KPH_VEHSPD 1 100 0.0 0.0 ECU_ADDRESS 0x40003738 BYTE_ORDER MSB_FIRST /end MEASUREMENT
/begin COMPU_METHOD CU_INP_KPH_VEHSPD "Conversion method for INP_kph_VehSpd" RAT_FUNC "%10.2" "kph" COEFFS 0.000000 1.000000 0.000000 0.000000 0.000000 1.000000 /end COMPU_METHOD
/* Scalar measurable for DDE 'INP_lam_UEGO1'. */
/begin MEASUREMENT INP_lam_UEGO1 "Displayable" FLOAT32_IEEE CU_INP_LAM_UEGO1 1 100 0.0 0.0 ECU_ADDRESS 0x4000372c BYTE_ORDER MSB_FIRST /end MEASUREMENT
/begin COMPU_METHOD CU_INP_LAM_UEGO1 "Conversion method for INP_lam_UEGO1" RAT_FUNC "%10.1" "lam" COEFFS 0.000000 1.000000 0.000000 0.000000 0.000000 1.000000 /end COMPU_METHOD
/* Scalar measurable for DDE 'INP_lam_UEGO2'. */
/begin MEASUREMENT INP_lam_UEGO2 "Displayable" FLOAT32_IEEE CU_INP_LAM_UEGO2 1 100 0.0 0.0 ECU_ADDRESS 0x40003728 BYTE_ORDER MSB_FIRST /end MEASUREMENT
/begin COMPU_METHOD CU_INP_LAM_UEGO2 "Conversion method for INP_lam_UEGO2" RAT_FUNC "%10.1" "lam" COEFFS 0.000000 1.000000 0.000000 0.000000 0.000000 1.000000 /end COMPU_METHOD
/* Scalar measurable for DDE 'INP_pct_AltLoad'. */
/begin MEASUREMENT INP_pct_AltLoad "Displayable" FLOAT32_IEEE CU_INP_PCT_ALTLOAD 1 100 0.0 0.0 ECU_ADDRESS 0x4000373c BYTE_ORDER MSB_FIRST /end MEASUREMENT
/begin COMPU_METHOD CU_INP_PCT_ALTLOAD "Conversion method for INP_pct_AltLoad" RAT_FUNC "%10.3" "pct" COEFFS 0.000000 1.000000 0.000000 0.000000 0.000000 1.000000 /end COMPU_METHOD
/* Scalar measurable for DDE 'INP_pct_Cylinder1_Knock'. */
/begin MEASUREMENT INP_pct_Cylinder1_Knock "Displayable" FLOAT32_IEEE CU_INP_PCT_CYLINDER1_KNOCK 1 100 0.0 0.0 ECU_ADDRESS 0x4000371c BYTE_ORDER MSB_FIRST /end MEASUREMENT
/begin COMPU_METHOD CU_INP_PCT_CYLINDER1_KNOCK "Conversion method for INP_pct_Cylinder1_Knock" RAT_FUNC "%10.2" "pct" COEFFS 0.000000 1.000000 0.000000 0.000000 0.000000 1.000000 /end COMPU_METHOD
/* Scalar measurable for DDE 'INP_pct_Cylinder2_Knock'. */
/begin MEASUREMENT INP_pct_Cylinder2_Knock "Displayable" FLOAT32_IEEE CU_INP_PCT_CYLINDER2_KNOCK 1 100 0.0 0.0 ECU_ADDRESS 0x4000376c BYTE_ORDER MSB_FIRST /end MEASUREMENT
/begin COMPU_METHOD CU_INP_PCT_CYLINDER2_KNOCK "Conversion method for INP_pct_Cylinder2_Knock" RAT_FUNC "%10.2" "pct" COEFFS 0.000000 1.000000 0.000000 0.000000 0.000000 1.000000 /end COMPU_METHOD
/* Scalar measurable for DDE 'INP_pct_Cylinder3_Knock'. */
/begin MEASUREMENT INP_pct_Cylinder3_Knock "Displayable" FLOAT32_IEEE CU_INP_PCT_CYLINDER3_KNOCK 1 100 0.0 0.0 ECU_ADDRESS 0x40003768 BYTE_ORDER MSB_FIRST /end MEASUREMENT
/begin COMPU_METHOD CU_INP_PCT_CYLINDER3_KNOCK "Conversion method for INP_pct_Cylinder3_Knock" RAT_FUNC "%10.2" "pct" COEFFS 0.000000 1.000000 0.000000 0.000000 0.000000 1.000000 /end COMPU_METHOD
/* Scalar measurable for DDE 'INP_pct_Cylinder4_Knock'. */
/begin MEASUREMENT INP_pct_Cylinder4_Knock "Displayable" FLOAT32_IEEE CU_INP_PCT_CYLINDER4_KNOCK 1 100 0.0 0.0 ECU_ADDRESS 0x40003764 BYTE_ORDER MSB_FIRST /end MEASUREMENT
/begin COMPU_METHOD CU_INP_PCT_CYLINDER4_KNOCK "Conversion method for INP_pct_Cylinder4_Knock" RAT_FUNC "%10.2" "pct" COEFFS 0.000000 1.000000 0.000000 0.000000 0.000000 1.000000 /end COMPU_METHOD
/* Scalar measurable for DDE 'INP_pct_EstimatedGearRatio'. */
/begin MEASUREMENT INP_pct_EstimatedGearRatio "Estimate ratio between EngSpd & TOSS" FLOAT32_IEEE CU_INP_PCT_ESTIMATEDGEARRATIO 1 100 0.0 0.0 ECU_ADDRESS 0x40003788 BYTE_ORDER MSB_FIRST /end MEASUREMENT
/begin COMPU_METHOD CU_INP_PCT_ESTIMATEDGEARRATIO "Conversion method for INP_pct_EstimatedGearRatio" RAT_FUNC "%10.2" "pct" COEFFS 0.000000 1.000000 0.000000 0.000000 0.000000 1.000000 /end COMPU_METHOD
/* Scalar measurable for DDE 'INP_pct_GLPLevel1'. */
/begin MEASUREMENT INP_pct_GLPLevel1 "Displayable" FLOAT32_IEEE CU_INP_PCT_GLPLEVEL1 1 100 0.0 0.0 ECU_ADDRESS 0x400038d0 BYTE_ORDER MSB_FIRST /end MEASUREMENT
/begin COMPU_METHOD CU_INP_PCT_GLPLEVEL1 "Conversion method for INP_pct_GLPLevel1" RAT_FUNC "%10.2" "V" COEFFS 0.000000 1.000000 0.000000 0.000000 0.000000 1.000000 /end COMPU_METHOD
/* Scalar measurable for DDE 'INP_pct_GLPLevel2'. */
/begin MEASUREMENT INP_pct_GLPLevel2 "Displayable" FLOAT32_IEEE CU_INP_PCT_GLPLEVEL2 1 100 0.0 0.0 ECU_ADDRESS 0x400038dc BYTE_ORDER MSB_FIRST /end MEASUREMENT
/begin COMPU_METHOD CU_INP_PCT_GLPLEVEL2 "Conversion method for INP_pct_GLPLevel2" RAT_FUNC "%10.2" "V" COEFFS 0.000000 1.000000 0.000000 0.000000 0.000000 1.000000 /end COMPU_METHOD
/* Scalar measurable for DDE 'INP_pct_PrefiltTotalFuelLevel'. */
/begin MEASUREMENT INP_pct_PrefiltTotalFuelLevel "Displayable" FLOAT32_IEEE CU_INP_PCT_PREFILTTOTALFUELLEV0 1 100 0.0 0.0 ECU_ADDRESS 0x400038d8 BYTE_ORDER MSB_FIRST /end MEASUREMENT
/begin COMPU_METHOD CU_INP_PCT_PREFILTTOTALFUELLEV0 "Conversion method for INP_pct_PrefiltTotalFuelLevel" RAT_FUNC "%10.2" "pct" COEFFS 0.000000 1.000000 0.000000 0.000000 0.000000 1.000000 /end COMPU_METHOD
/* Scalar measurable for DDE 'INP_pct_TotalFuelLevel'. */
/begin MEASUREMENT INP_pct_TotalFuelLevel "Displayable" FLOAT32_IEEE CU_INP_PCT_TOTALFUELLEVEL 1 100 0.0 0.0 ECU_ADDRESS 0x400038d4 BYTE_ORDER MSB_FIRST /end MEASUREMENT
/begin COMPU_METHOD CU_INP_PCT_TOTALFUELLEVEL "Conversion method for INP_pct_TotalFuelLevel" RAT_FUNC "%10.2" "pct" COEFFS 0.000000 1.000000 0.000000 0.000000 0.000000 1.000000 /end COMPU_METHOD
/* Scalar measurable for DDE 'INP_ret_VCP_Pos'. */
/begin MEASUREMENT INP_ret_VCP_Pos "Displayable" FLOAT32_IEEE CU_INP_RET_VCP_POS 1 100 0.0 0.0 ECU_ADDRESS 0x40003748 BYTE_ORDER MSB_FIRST /end MEASUREMENT
/begin COMPU_METHOD CU_INP_RET_VCP_POS "Conversion method for INP_ret_VCP_Pos" RAT_FUNC "%10.2" "ret" COEFFS 0.000000 1.000000 0.000000 0.000000 0.000000 1.000000 /end COMPU_METHOD
/* Scalar measurable for DDE 'INP_rpm_EngSpdPre_ang_1'. */
/begin MEASUREMENT INP_rpm_EngSpdPre_ang_1 "(not defined)" FLOAT32_IEEE CU_INP_RPM_ENGSPDPRE_ANG_1 1 100 0.0 10000.0 ECU_ADDRESS 0x400030b8 BYTE_ORDER MSB_FIRST /end MEASUREMENT
/begin COMPU_METHOD CU_INP_RPM_ENGSPDPRE_ANG_1 "Conversion method for INP_rpm_EngSpdPre_ang_1" RAT_FUNC "%10.0" "RPM" COEFFS 0.000000 1.000000 0.000000 0.000000 0.000000 1.000000 /end COMPU_METHOD
/* Scalar measurable for DDE 'INP_rpm_EngSpdPre_ang_2'. */
/begin MEASUREMENT INP_rpm_EngSpdPre_ang_2 "(not defined)" FLOAT32_IEEE CU_INP_RPM_ENGSPDPRE_ANG_2 1 100 0.0 10000.0 ECU_ADDRESS 0x400030a8 BYTE_ORDER MSB_FIRST /end MEASUREMENT
/begin COMPU_METHOD CU_INP_RPM_ENGSPDPRE_ANG_2 "Conversion method for INP_rpm_EngSpdPre_ang_2" RAT_FUNC "%10.0" "RPM" COEFFS 0.000000 1.000000 0.000000 0.000000 0.000000 1.000000 /end COMPU_METHOD
/* Scalar measurable for DDE 'INP_rpm_EngSpdPre_ang_3'. */
/begin MEASUREMENT INP_rpm_EngSpdPre_ang_3 "(not defined)" FLOAT32_IEEE CU_INP_RPM_ENGSPDPRE_ANG_3 1 100 0.0 10000.0 ECU_ADDRESS 0x40003098 BYTE_ORDER MSB_FIRST /end MEASUREMENT
/begin COMPU_METHOD CU_INP_RPM_ENGSPDPRE_ANG_3 "Conversion method for INP_rpm_EngSpdPre_ang_3" RAT_FUNC "%10.0" "RPM" COEFFS 0.000000 1.000000 0.000000 0.000000 0.000000 1.000000 /end COMPU_METHOD
/* Scalar measurable for DDE 'INP_rpm_EngSpdPre_ang_4'. */
/begin MEASUREMENT INP_rpm_EngSpdPre_ang_4 "(not defined)" FLOAT32_IEEE CU_INP_RPM_ENGSPDPRE_ANG_4 1 100 0.0 10000.0 ECU_ADDRESS 0x40003088 BYTE_ORDER MSB_FIRST /end MEASUREMENT
/begin COMPU_METHOD CU_INP_RPM_ENGSPDPRE_ANG_4 "Conversion method for INP_rpm_EngSpdPre_ang_4" RAT_FUNC "%10.0" "RPM" COEFFS 0.000000 1.000000 0.000000 0.000000 0.000000 1.000000 /end COMPU_METHOD
/* Scalar measurable for DDE 'INP_rpm_EngSpdPst_ang_1'. */
/begin MEASUREMENT INP_rpm_EngSpdPst_ang_1 "(not defined)" FLOAT32_IEEE CU_INP_RPM_ENGSPDPST_ANG_1 1 100 0.0 10000.0 ECU_ADDRESS 0x400030b4 BYTE_ORDER MSB_FIRST /end MEASUREMENT
/begin COMPU_METHOD CU_INP_RPM_ENGSPDPST_ANG_1 "Conversion method for INP_rpm_EngSpdPst_ang_1" RAT_FUNC "%10.0" "RPM" COEFFS 0.000000 1.000000 0.000000 0.000000 0.000000 1.000000 /end COMPU_METHOD
/* Scalar measurable for DDE 'INP_rpm_EngSpdPst_ang_2'. */
/begin MEASUREMENT INP_rpm_EngSpdPst_ang_2 "(not defined)" FLOAT32_IEEE CU_INP_RPM_ENGSPDPST_ANG_2 1 100 0.0 10000.0 ECU_ADDRESS 0x400030a4 BYTE_ORDER MSB_FIRST /end MEASUREMENT
/begin COMPU_METHOD CU_INP_RPM_ENGSPDPST_ANG_2 "Conversion method for INP_rpm_EngSpdPst_ang_2" RAT_FUNC "%10.0" "RPM" COEFFS 0.000000 1.000000 0.000000 0.000000 0.000000 1.000000 /end COMPU_METHOD
/* Scalar measurable for DDE 'INP_rpm_EngSpdPst_ang_3'. */
/begin MEASUREMENT INP_rpm_EngSpdPst_ang_3 "(not defined)" FLOAT32_IEEE CU_INP_RPM_ENGSPDPST_ANG_3 1 100 0.0 10000.0 ECU_ADDRESS 0x40003094 BYTE_ORDER MSB_FIRST /end MEASUREMENT
/begin COMPU_METHOD CU_INP_RPM_ENGSPDPST_ANG_3 "Conversion method for INP_rpm_EngSpdPst_ang_3" RAT_FUNC "%10.0" "RPM" COEFFS 0.000000 1.000000 0.000000 0.000000 0.000000 1.000000 /end COMPU_METHOD
/* Scalar measurable for DDE 'INP_rpm_EngSpdPst_ang_4'. */
/begin MEASUREMENT INP_rpm_EngSpdPst_ang_4 "(not defined)" FLOAT32_IEEE CU_INP_RPM_ENGSPDPST_ANG_4 1 100 0.0 10000.0 ECU_ADDRESS 0x40003084 BYTE_ORDER MSB_FIRST /end MEASUREMENT
/begin COMPU_METHOD CU_INP_RPM_ENGSPDPST_ANG_4 "Conversion method for INP_rpm_EngSpdPst_ang_4" RAT_FUNC "%10.0" "RPM" COEFFS 0.000000 1.000000 0.000000 0.000000 0.000000 1.000000 /end COMPU_METHOD
/* Scalar measurable for DDE 'KNK_NU_EngSpdCorr'. */
/begin MEASUREMENT KNK_NU_EngSpdCorr "Map output displayable" FLOAT32_IEEE CU_KNK_NU_ENGSPDCORR 1 100 0.0 0.0 ECU_ADDRESS 0x4000349c BYTE_ORDER MSB_FIRST /end MEASUREMENT
/begin COMPU_METHOD CU_KNK_NU_ENGSPDCORR "Conversion method for KNK_NU_EngSpdCorr" RAT_FUNC "%10.2" "pct" COEFFS 0.000000 1.000000 0.000000 0.000000 0.000000 1.000000 /end COMPU_METHOD
/* Scalar measurable for DDE 'KNK_b_EnrichFuel'. */
/begin MEASUREMENT KNK_b_EnrichFuel "Displayable" UBYTE CU_KNK_B_ENRICHFUEL 1 100 0.0 1.0 ECU_ADDRESS 0x40002e73 BYTE_ORDER MSB_FIRST /end MEASUREMENT
/begin COMPU_METHOD CU_KNK_B_ENRICHFUEL "Conversion method for KNK_b_EnrichFuel" RAT_FUNC "%10.0" "b" COEFFS 0.000000 1.000000 0.000000 0.000000 0.000000 1.000000 /end COMPU_METHOD
/* Scalar measurable for DDE 'KNK_b_NewKnockEvent'. */
/begin MEASUREMENT KNK_b_NewKnockEvent "Displayable" UBYTE CU_KNK_B_NEWKNOCKEVENT 1 100 0.0 1.0 ECU_ADDRESS 0x40002ee2 BYTE_ORDER MSB_FIRST /end MEASUREMENT
/begin COMPU_METHOD CU_KNK_B_NEWKNOCKEVENT "Conversion method for KNK_b_NewKnockEvent" RAT_FUNC "%10.0" "b" COEFFS 0.000000 1.000000 0.000000 0.000000 0.000000 1.000000 /end COMPU_METHOD
/* Scalar measurable for DDE 'KNK_lam_AFR_Lim'. */
/begin MEASUREMENT KNK_lam_AFR_Lim "AFR limit" FLOAT32_IEEE CU_KNK_LAM_AFR_LIM 1 100 0.0 0.0 ECU_ADDRESS 0x400031f0 BYTE_ORDER MSB_FIRST /end MEASUREMENT
/begin COMPU_METHOD CU_KNK_LAM_AFR_LIM "Conversion method for KNK_lam_AFR_Lim" RAT_FUNC "%10.2" "lam" COEFFS 0.000000 1.000000 0.000000 0.000000 0.000000 1.000000 /end COMPU_METHOD
/* Scalar measurable for DDE 'KNK_ret_SensorBased'. */
/begin MEASUREMENT KNK_ret_SensorBased "Output from sensor-based retard logic" FLOAT32_IEEE CU_KNK_RET_SENSORBASED 1 100 0.0 0.0 ECU_ADDRESS 0x400031ac BYTE_ORDER MSB_FIRST /end MEASUREMENT
/begin COMPU_METHOD CU_KNK_RET_SENSORBASED "Conversion method for KNK_ret_SensorBased" RAT_FUNC "%10.1" "ret" COEFFS 0.000000 1.000000 0.000000 0.000000 0.000000 1.000000 /end COMPU_METHOD
/* Scalar measurable for DDE 'KNK_ret_SparkMod'. */
/begin MEASUREMENT KNK_ret_SparkMod "Final knock spark modifier" FLOAT32_IEEE CU_KNK_RET_SPARKMOD 1 100 0.0 0.0 ECU_ADDRESS 0x40003494 BYTE_ORDER MSB_FIRST /end MEASUREMENT
/begin COMPU_METHOD CU_KNK_RET_SPARKMOD "Conversion method for KNK_ret_SparkMod" RAT_FUNC "%10.2" "ret" COEFFS 0.000000 1.000000 0.000000 0.000000 0.000000 1.000000 /end COMPU_METHOD
/* Scalar measurable for DDE 'KNK_ret_TempBased'. */
/begin MEASUREMENT KNK_ret_TempBased "Open-loop retard command" FLOAT32_IEEE CU_KNK_RET_TEMPBASED 1 100 0.0 0.0 ECU_ADDRESS 0x40003498 BYTE_ORDER MSB_FIRST /end MEASUREMENT
/begin COMPU_METHOD CU_KNK_RET_TEMPBASED "Conversion method for KNK_ret_TempBased" RAT_FUNC "%10.1" "ret" COEFFS 0.000000 1.000000 0.000000 0.000000 0.000000 1.000000 /end COMPU_METHOD
/* Scalar measurable for DDE 'LAM_NU_AmpFactor_A'. */
/begin MEASUREMENT LAM_NU_AmpFactor_A "Amplification factor used for Lambda calculation" FLOAT32_IEEE CU_LAM_NU_AMPFACTOR_A 1 100 0.0 0.0 ECU_ADDRESS 0x400030fc BYTE_ORDER MSB_FIRST /end MEASUREMENT
/begin COMPU_METHOD CU_LAM_NU_AMPFACTOR_A "Conversion method for LAM_NU_AmpFactor_A" RAT_FUNC "%10.0" "NU" COEFFS 0.000000 1.000000 0.000000 0.000000 0.000000 1.000000 /end COMPU_METHOD
/* Scalar measurable for DDE 'LAM_NU_AmpFactor_B'. */
/begin MEASUREMENT LAM_NU_AmpFactor_B "Amplification factor used for Lambda calculation" FLOAT32_IEEE CU_LAM_NU_AMPFACTOR_B 1 100 0.0 0.0 ECU_ADDRESS 0x4000312c BYTE_ORDER MSB_FIRST /end MEASUREMENT
/begin COMPU_METHOD CU_LAM_NU_AMPFACTOR_B "Conversion method for LAM_NU_AmpFactor_B" RAT_FUNC "%10.0" "NU" COEFFS 0.000000 1.000000 0.000000 0.000000 0.000000 1.000000 /end COMPU_METHOD
/* Scalar measurable for DDE 'LAM_NU_Lambda_A'. */
/begin MEASUREMENT LAM_NU_Lambda_A "Lambda value" FLOAT32_IEEE CU_LAM_NU_LAMBDA_A 1 100 0.0 0.0 ECU_ADDRESS 0x400030f4 BYTE_ORDER MSB_FIRST /end MEASUREMENT
/begin COMPU_METHOD CU_LAM_NU_LAMBDA_A "Conversion method for LAM_NU_Lambda_A" RAT_FUNC "%10.3" "NU" COEFFS 0.000000 1.000000 0.000000 0.000000 0.000000 1.000000 /end COMPU_METHOD
/* Scalar measurable for DDE 'LAM_NU_Lambda_B'. */
/begin MEASUREMENT LAM_NU_Lambda_B "Lambda value" FLOAT32_IEEE CU_LAM_NU_LAMBDA_B 1 100 0.0 0.0 ECU_ADDRESS 0x40003124 BYTE_ORDER MSB_FIRST /end MEASUREMENT
/begin COMPU_METHOD CU_LAM_NU_LAMBDA_B "Conversion method for LAM_NU_Lambda_B" RAT_FUNC "%10.3" "NU" COEFFS 0.000000 1.000000 0.000000 0.000000 0.000000 1.000000 /end COMPU_METHOD
/* Scalar measurable for DDE 'LAM_b_AmpFactorFlag_A'. */
/begin MEASUREMENT LAM_b_AmpFactorFlag_A "Amplification factor flag used to switch OE block" UBYTE CU_LAM_B_AMPFACTORFLAG_A 1 100 0.0 1.0 ECU_ADDRESS 0x40002e4a BYTE_ORDER MSB_FIRST /end MEASUREMENT
/begin COMPU_METHOD CU_LAM_B_AMPFACTORFLAG_A "Conversion method for LAM_b_AmpFactorFlag_A" RAT_FUNC "%10.0" "b" COEFFS 0.000000 1.000000 0.000000 0.000000 0.000000 1.000000 /end COMPU_METHOD
/* Scalar measurable for DDE 'LAM_b_AmpFactorFlag_B'. */
/begin MEASUREMENT LAM_b_AmpFactorFlag_B "Amplification factor flag used to switch OE block" UBYTE CU_LAM_B_AMPFACTORFLAG_B 1 100 0.0 1.0 ECU_ADDRESS 0x40002e5b BYTE_ORDER MSB_FIRST /end MEASUREMENT
/begin COMPU_METHOD CU_LAM_B_AMPFACTORFLAG_B "Conversion method for LAM_b_AmpFactorFlag_B" RAT_FUNC "%10.0" "b" COEFFS 0.000000 1.000000 0.000000 0.000000 0.000000 1.000000 /end COMPU_METHOD
/* Scalar measurable for DDE 'LAM_b_LambdaValidFlag_A'. */
/begin MEASUREMENT LAM_b_LambdaValidFlag_A "Flag to indicate the Lambda calculation is valid" UBYTE CU_LAM_B_LAMBDAVALIDFLAG_A 1 100 0.0 1.0 ECU_ADDRESS 0x40002e49 BYTE_ORDER MSB_FIRST /end MEASUREMENT
/begin COMPU_METHOD CU_LAM_B_LAMBDAVALIDFLAG_A "Conversion method for LAM_b_LambdaValidFlag_A" RAT_FUNC "%10.0" "b" COEFFS 0.000000 1.000000 0.000000 0.000000 0.000000 1.000000 /end COMPU_METHOD
/* Scalar measurable for DDE 'LAM_b_LambdaValidFlag_B'. */
/begin MEASUREMENT LAM_b_LambdaValidFlag_B "Flag to indicate the Lambda calculation is valid" UBYTE CU_LAM_B_LAMBDAVALIDFLAG_B 1 100 0.0 1.0 ECU_ADDRESS 0x40002e5a BYTE_ORDER MSB_FIRST /end MEASUREMENT
/begin COMPU_METHOD CU_LAM_B_LAMBDAVALIDFLAG_B "Conversion method for LAM_b_LambdaValidFlag_B" RAT_FUNC "%10.0" "b" COEFFS 0.000000 1.000000 0.000000 0.000000 0.000000 1.000000 /end COMPU_METHOD
/* Scalar measurable for DDE 'LAM_mA_Ip_A'. */
/begin MEASUREMENT LAM_mA_Ip_A "Pump cell current" FLOAT32_IEEE CU_LAM_MA_IP_A 1 100 0.0 0.0 ECU_ADDRESS 0x400030f8 BYTE_ORDER MSB_FIRST /end MEASUREMENT
/begin COMPU_METHOD CU_LAM_MA_IP_A "Conversion method for LAM_mA_Ip_A" RAT_FUNC "%10.3" "mA" COEFFS 0.000000 1.000000 0.000000 0.000000 0.000000 1.000000 /end COMPU_METHOD
/* Scalar measurable for DDE 'LAM_mA_Ip_B'. */
/begin MEASUREMENT LAM_mA_Ip_B "Pump cell current" FLOAT32_IEEE CU_LAM_MA_IP_B 1 100 0.0 0.0 ECU_ADDRESS 0x40003128 BYTE_ORDER MSB_FIRST /end MEASUREMENT
/begin COMPU_METHOD CU_LAM_MA_IP_B "Conversion method for LAM_mA_Ip_B" RAT_FUNC "%10.3" "mA" COEFFS 0.000000 1.000000 0.000000 0.000000 0.000000 1.000000 /end COMPU_METHOD
/* Scalar measurable for DDE 'LOG_NU_ManualPump'. */
/begin MEASUREMENT LOG_NU_ManualPump "Corrected Throttle Angle request output" ULONG CU_LOG_NU_MANUALPUMP 1 100 0.0 0.0 ECU_ADDRESS 0x40003058 BYTE_ORDER MSB_FIRST /end MEASUREMENT
/begin COMPU_METHOD CU_LOG_NU_MANUALPUMP "Conversion method for LOG_NU_ManualPump" RAT_FUNC "%10.0" "NU" COEFFS 0.000000 1.000000 0.000000 0.000000 0.000000 1.000000 /end COMPU_METHOD
/* Scalar measurable for DDE 'LOG_NU_TqCvLuEngg'. */
/begin MEASUREMENT LOG_NU_TqCvLuEngg "(not defined)" FLOAT32_IEEE CU_LOG_NU_TQCVLUENGG 1 100 0.0 0.0 ECU_ADDRESS 0x4000379c BYTE_ORDER MSB_FIRST /end MEASUREMENT
/begin COMPU_METHOD CU_LOG_NU_TQCVLUENGG "Conversion method for LOG_NU_TqCvLuEngg" RAT_FUNC "%10.0" "NU" COEFFS 0.000000 1.000000 0.000000 0.000000 0.000000 1.000000 /end COMPU_METHOD
/* Scalar measurable for DDE 'LOG_NU_TransDrvEngg'. */
/begin MEASUREMENT LOG_NU_TransDrvEngg "(not defined)" FLOAT32_IEEE CU_LOG_NU_TRANSDRVENGG 1 100 0.0 0.0 ECU_ADDRESS 0x400037a0 BYTE_ORDER MSB_FIRST /end MEASUREMENT
/begin COMPU_METHOD CU_LOG_NU_TRANSDRVENGG "Conversion method for LOG_NU_TransDrvEngg" RAT_FUNC "%10.0" "NU" COEFFS 0.000000 1.000000 0.000000 0.000000 0.000000 1.000000 /end COMPU_METHOD
/* Scalar measurable for DDE 'LOG_NU_TransShftPrcs'. */
/begin MEASUREMENT LOG_NU_TransShftPrcs "(not defined)" FLOAT32_IEEE CU_LOG_NU_TRANSSHFTPRCS 1 100 0.0 0.0 ECU_ADDRESS 0x40003798 BYTE_ORDER MSB_FIRST /end MEASUREMENT
/begin COMPU_METHOD CU_LOG_NU_TRANSSHFTPRCS "Conversion method for LOG_NU_TransShftPrcs" RAT_FUNC "%10.0" "NU" COEFFS 0.000000 1.000000 0.000000 0.000000 0.000000 1.000000 /end COMPU_METHOD
/* Scalar measurable for DDE 'LOG_PWM_BLOWER'. */
/begin MEASUREMENT LOG_PWM_BLOWER "Displayable" FLOAT32_IEEE CU_LOG_PWM_BLOWER 1 100 0.0 1.0 ECU_ADDRESS 0x400036a4 BYTE_ORDER MSB_FIRST /end MEASUREMENT
/begin COMPU_METHOD CU_LOG_PWM_BLOWER "Conversion method for LOG_PWM_BLOWER" RAT_FUNC "%10.2" "V" COEFFS 0.000000 1.000000 0.000000 0.000000 0.000000 1.000000 /end COMPU_METHOD
/* Scalar measurable for DDE 'LOG_PWM_PUMP'. */
/begin MEASUREMENT LOG_PWM_PUMP "Displayable" FLOAT32_IEEE CU_LOG_PWM_PUMP 1 100 0.0 1.0 ECU_ADDRESS 0x400036a8 BYTE_ORDER MSB_FIRST /end MEASUREMENT
/begin COMPU_METHOD CU_LOG_PWM_PUMP "Conversion method for LOG_PWM_PUMP" RAT_FUNC "%10.2" "V" COEFFS 0.000000 1.000000 0.000000 0.000000 0.000000 1.000000 /end COMPU_METHOD
/* Scalar measurable for DDE 'LOG_b_EC1_state'. */
/begin MEASUREMENT LOG_b_EC1_state "(not defined)" UBYTE CU_LOG_B_EC1_STATE 1 100 0.0 1.0 ECU_ADDRESS 0x40002e7c BYTE_ORDER MSB_FIRST /end MEASUREMENT
/begin COMPU_METHOD CU_LOG_B_EC1_STATE "Conversion method for LOG_b_EC1_state" RAT_FUNC "%10.0" "b" COEFFS 0.000000 1.000000 0.000000 0.000000 0.000000 1.000000 /end COMPU_METHOD
/* Scalar measurable for DDE 'LOG_b_ENBOBD'. */
/begin MEASUREMENT LOG_b_ENBOBD "Displayable" UBYTE CU_LOG_B_ENBOBD 1 100 0.0 1.0 ECU_ADDRESS 0x40002f34 BYTE_ORDER MSB_FIRST /end MEASUREMENT
/begin COMPU_METHOD CU_LOG_B_ENBOBD "Conversion method for LOG_b_ENBOBD" RAT_FUNC "%10.0" "b" COEFFS 0.000000 1.000000 0.000000 0.000000 0.000000 1.000000 /end COMPU_METHOD
/* Scalar measurable for DDE 'LOG_b_RelePump1'. */
/begin MEASUREMENT LOG_b_RelePump1 "(not defined)" UBYTE CU_LOG_B_RELEPUMP1 1 100 0.0 1.0 ECU_ADDRESS 0x40002f22 BYTE_ORDER MSB_FIRST /end MEASUREMENT
/begin COMPU_METHOD CU_LOG_B_RELEPUMP1 "Conversion method for LOG_b_RelePump1" RAT_FUNC "%10.0" "b" COEFFS 0.000000 1.000000 0.000000 0.000000 0.000000 1.000000 /end COMPU_METHOD
/* Scalar measurable for DDE 'LOG_b_RelePump2'. */
/begin MEASUREMENT LOG_b_RelePump2 "(not defined)" UBYTE CU_LOG_B_RELEPUMP2 1 100 0.0 1.0 ECU_ADDRESS 0x40002f21 BYTE_ORDER MSB_FIRST /end MEASUREMENT
/begin COMPU_METHOD CU_LOG_B_RELEPUMP2 "Conversion method for LOG_b_RelePump2" RAT_FUNC "%10.0" "b" COEFFS 0.000000 1.000000 0.000000 0.000000 0.000000 1.000000 /end COMPU_METHOD
/* Scalar measurable for DDE 'LOG_b_ZF_Auto'. */
/begin MEASUREMENT LOG_b_ZF_Auto "(not defined)" UBYTE CU_LOG_B_ZF_AUTO 1 100 0.0 1.0 ECU_ADDRESS 0x40002e8e BYTE_ORDER MSB_FIRST /end MEASUREMENT
/begin COMPU_METHOD CU_LOG_B_ZF_AUTO "Conversion method for LOG_b_ZF_Auto" RAT_FUNC "%10.0" "b" COEFFS 0.000000 1.000000 0.000000 0.000000 0.000000 1.000000 /end COMPU_METHOD
/* Scalar measurable for DDE 'LOG_pct_PercentClutchSlip'. */
/begin MEASUREMENT LOG_pct_PercentClutchSlip "Displayable" FLOAT32_IEEE CU_LOG_PCT_PERCENTCLUTCHSLIP 1 100 0.0 0.0 ECU_ADDRESS 0x40003794 BYTE_ORDER MSB_FIRST /end MEASUREMENT
/begin COMPU_METHOD CU_LOG_PCT_PERCENTCLUTCHSLIP "Conversion method for LOG_pct_PercentClutchSlip" RAT_FUNC "%10.0" "pct" COEFFS 0.000000 1.000000 0.000000 0.000000 0.000000 1.000000 /end COMPU_METHOD
/* Scalar measurable for DDE 'LOG_s_EC1_counter'. */
/begin MEASUREMENT LOG_s_EC1_counter "(not defined)" FLOAT32_IEEE CU_LOG_S_EC1_COUNTER 1 100 0.0 0.0 ECU_ADDRESS 0x40003164 BYTE_ORDER MSB_FIRST /end MEASUREMENT
/begin COMPU_METHOD CU_LOG_S_EC1_COUNTER "Conversion method for LOG_s_EC1_counter" RAT_FUNC "%10.1" "s" COEFFS 0.000000 1.000000 0.000000 0.000000 0.000000 1.000000 /end COMPU_METHOD
/* Scalar measurable for DDE 'Log_b_TPDT1'. */
/begin MEASUREMENT Log_b_TPDT1 "Displayable- global fault management control signal, sent to each FBM" UBYTE CU_LOG_B_TPDT1 1 100 0.0 1.0 ECU_ADDRESS 0x40002e7a BYTE_ORDER MSB_FIRST /end MEASUREMENT
/begin COMPU_METHOD CU_LOG_B_TPDT1 "Conversion method for Log_b_TPDT1" RAT_FUNC "%10.0" "b" COEFFS 0.000000 1.000000 0.000000 0.000000 0.000000 1.000000 /end COMPU_METHOD
/* Scalar measurable for DDE 'Log_b_TPDT2'. */
/begin MEASUREMENT Log_b_TPDT2 "Displayable- global fault management control signal, sent to each FBM" UBYTE CU_LOG_B_TPDT2 1 100 0.0 1.0 ECU_ADDRESS 0x40002e79 BYTE_ORDER MSB_FIRST /end MEASUREMENT
/begin COMPU_METHOD CU_LOG_B_TPDT2 "Conversion method for Log_b_TPDT2" RAT_FUNC "%10.0" "b" COEFFS 0.000000 1.000000 0.000000 0.000000 0.000000 1.000000 /end COMPU_METHOD
/* Scalar measurable for DDE 'Log_b_TPDT3'. */
/begin MEASUREMENT Log_b_TPDT3 "Displayable- global fault management control signal, sent to each FBM" UBYTE CU_LOG_B_TPDT3 1 100 0.0 1.0 ECU_ADDRESS 0x40002e78 BYTE_ORDER MSB_FIRST /end MEASUREMENT
/begin COMPU_METHOD CU_LOG_B_TPDT3 "Conversion method for Log_b_TPDT3" RAT_FUNC "%10.0" "b" COEFFS 0.000000 1.000000 0.000000 0.000000 0.000000 1.000000 /end COMPU_METHOD
/* Scalar measurable for DDE 'Log_b_TPDT4'. */
/begin MEASUREMENT Log_b_TPDT4 "Displayable- global fault management control signal, sent to each FBM" UBYTE CU_LOG_B_TPDT4 1 100 0.0 1.0 ECU_ADDRESS 0x40002e77 BYTE_ORDER MSB_FIRST /end MEASUREMENT
/begin COMPU_METHOD CU_LOG_B_TPDT4 "Conversion method for Log_b_TPDT4" RAT_FUNC "%10.0" "b" COEFFS 0.000000 1.000000 0.000000 0.000000 0.000000 1.000000 /end COMPU_METHOD
/* Scalar measurable for DDE 'Log_b_TPDT5'. */
/begin MEASUREMENT Log_b_TPDT5 "Displayable- global fault management control signal, sent to each FBM" UBYTE CU_LOG_B_TPDT5 1 100 0.0 1.0 ECU_ADDRESS 0x40002e76 BYTE_ORDER MSB_FIRST /end MEASUREMENT
/begin COMPU_METHOD CU_LOG_B_TPDT5 "Conversion method for Log_b_TPDT5" RAT_FUNC "%10.0" "b" COEFFS 0.000000 1.000000 0.000000 0.000000 0.000000 1.000000 /end COMPU_METHOD
/* Scalar measurable for DDE 'Log_b_TPDT6'. */
/begin MEASUREMENT Log_b_TPDT6 "Displayable- global fault management control signal, sent to each FBM" UBYTE CU_LOG_B_TPDT6 1 100 0.0 1.0 ECU_ADDRESS 0x40002e75 BYTE_ORDER MSB_FIRST /end MEASUREMENT
/begin COMPU_METHOD CU_LOG_B_TPDT6 "Conversion method for Log_b_TPDT6" RAT_FUNC "%10.0" "b" COEFFS 0.000000 1.000000 0.000000 0.000000 0.000000 1.000000 /end COMPU_METHOD
/* Scalar measurable for DDE 'NVM_NU_EngRunTime'. */
/begin MEASUREMENT NVM_NU_EngRunTime "(not defined)" FLOAT32_IEEE CU_NVM_NU_ENGRUNTIME 1 100 0.0 4294967295.0 ECU_ADDRESS 0x4000366c BYTE_ORDER MSB_FIRST /end MEASUREMENT
/begin COMPU_METHOD CU_NVM_NU_ENGRUNTIME "Conversion method for NVM_NU_EngRunTime" RAT_FUNC "%10.2" "s" COEFFS 0.000000 1.000000 0.000000 0.000000 0.000000 1.000000 /end COMPU_METHOD
/* Scalar measurable for DDE 'OUT_C_FAN_ZF'. */
/begin MEASUREMENT OUT_C_FAN_ZF "Displayable" FLOAT32_IEEE CU_OUT_C_FAN_ZF 1 100 0.0 0.0 ECU_ADDRESS 0x40003578 BYTE_ORDER MSB_FIRST /end MEASUREMENT
/begin COMPU_METHOD CU_OUT_C_FAN_ZF "Conversion method for OUT_C_FAN_ZF" RAT_FUNC "%10.3" "NU" COEFFS 0.000000 1.000000 0.000000 0.000000 0.000000 1.000000 /end COMPU_METHOD
/* Scalar measurable for DDE 'OUT_Hz_EngSpd'. */
/begin MEASUREMENT OUT_Hz_EngSpd "(not defined)" FLOAT32_IEEE CU_OUT_HZ_ENGSPD 1 100 0.0 0.0 ECU_ADDRESS 0x400036ac BYTE_ORDER MSB_FIRST /end MEASUREMENT
/begin COMPU_METHOD CU_OUT_HZ_ENGSPD "Conversion method for OUT_Hz_EngSpd" RAT_FUNC "%10.4" "Hz" COEFFS 0.000000 1.000000 0.000000 0.000000 0.000000 1.000000 /end COMPU_METHOD
/* Scalar measurable for DDE 'OUT_Hz_FreqUEGOA'. */
/begin MEASUREMENT OUT_Hz_FreqUEGOA "Displayable" FLOAT32_IEEE CU_OUT_HZ_FREQUEGOA 1 100 0.0 10000.0 ECU_ADDRESS 0x400038b4 BYTE_ORDER MSB_FIRST /end MEASUREMENT
/begin COMPU_METHOD CU_OUT_HZ_FREQUEGOA "Conversion method for OUT_Hz_FreqUEGOA" RAT_FUNC "%10.0" "Hz" COEFFS 0.000000 1.000000 0.000000 0.000000 0.000000 1.000000 /end COMPU_METHOD
/* Scalar measurable for DDE 'OUT_Hz_VhSpd'. */
/begin MEASUREMENT OUT_Hz_VhSpd "(not defined)" FLOAT32_IEEE CU_OUT_HZ_VHSPD 1 100 0.0 0.0 ECU_ADDRESS 0x400036b0 BYTE_ORDER MSB_FIRST /end MEASUREMENT
/begin COMPU_METHOD CU_OUT_HZ_VHSPD "Conversion method for OUT_Hz_VhSpd" RAT_FUNC "%10.4" "Hz" COEFFS 0.000000 1.000000 0.000000 0.000000 0.000000 1.000000 /end COMPU_METHOD
/* Scalar measurable for DDE 'OUT_NU_BankA_Faults'. */
/begin MEASUREMENT OUT_NU_BankA_Faults "Fault status bits" UBYTE CU_OUT_NU_BANKA_FAULTS 1 100 0.0 0.0 ECU_ADDRESS 0x4000301d BYTE_ORDER MSB_FIRST /end MEASUREMENT
/begin COMPU_METHOD CU_OUT_NU_BANKA_FAULTS "Conversion method for OUT_NU_BankA_Faults" RAT_FUNC "%10.0" "NU" COEFFS 0.000000 1.000000 0.000000 0.000000 0.000000 1.000000 /end COMPU_METHOD
/* Scalar measurable for DDE 'OUT_NU_DM19CVN'. */
/begin MEASUREMENT OUT_NU_DM19CVN "Fuel Pump PWM signal frequency" ULONG CU_OUT_NU_DM19CVN 1 100 0.0 4294967295.0 ECU_ADDRESS 0x40003054 BYTE_ORDER MSB_FIRST /end MEASUREMENT
/begin COMPU_METHOD CU_OUT_NU_DM19CVN "Conversion method for OUT_NU_DM19CVN" RAT_FUNC "%10.0" "NU" COEFFS 0.000000 1.000000 0.000000 0.000000 0.000000 1.000000 /end COMPU_METHOD
/* Scalar measurable for DDE 'OUT_NU_FCV_Faults'. */
/begin MEASUREMENT OUT_NU_FCV_Faults "Fault status bits" UBYTE CU_OUT_NU_FCV_FAULTS 1 100 0.0 0.0 ECU_ADDRESS 0x40003016 BYTE_ORDER MSB_FIRST /end MEASUREMENT
/begin COMPU_METHOD CU_OUT_NU_FCV_FAULTS "Conversion method for OUT_NU_FCV_Faults" RAT_FUNC "%10.0" "NU" COEFFS 0.000000 1.000000 0.000000 0.000000 0.000000 1.000000 /end COMPU_METHOD
/* Scalar measurable for DDE 'OUT_NU_INJ_A1_Faults'. */
/begin MEASUREMENT OUT_NU_INJ_A1_Faults "Fault status bits" UBYTE CU_OUT_NU_INJ_A1_FAULTS 1 100 0.0 0.0 ECU_ADDRESS 0x4000301c BYTE_ORDER MSB_FIRST /end MEASUREMENT
/begin COMPU_METHOD CU_OUT_NU_INJ_A1_FAULTS "Conversion method for OUT_NU_INJ_A1_Faults" RAT_FUNC "%10.0" "NU" COEFFS 0.000000 1.000000 0.000000 0.000000 0.000000 1.000000 /end COMPU_METHOD
/* Scalar measurable for DDE 'OUT_NU_INJ_A2_Faults'. */
/begin MEASUREMENT OUT_NU_INJ_A2_Faults "Fault status bits" UBYTE CU_OUT_NU_INJ_A2_FAULTS 1 100 0.0 0.0 ECU_ADDRESS 0x4000301b BYTE_ORDER MSB_FIRST /end MEASUREMENT
/begin COMPU_METHOD CU_OUT_NU_INJ_A2_FAULTS "Conversion method for OUT_NU_INJ_A2_Faults" RAT_FUNC "%10.0" "NU" COEFFS 0.000000 1.000000 0.000000 0.000000 0.000000 1.000000 /end COMPU_METHOD
/* Scalar measurable for DDE 'OUT_NU_INJ_A3_Faults'. */
/begin MEASUREMENT OUT_NU_INJ_A3_Faults "Fault status bits" UBYTE CU_OUT_NU_INJ_A3_FAULTS 1 100 0.0 0.0 ECU_ADDRESS 0x40003019 BYTE_ORDER MSB_FIRST /end MEASUREMENT
/begin COMPU_METHOD CU_OUT_NU_INJ_A3_FAULTS "Conversion method for OUT_NU_INJ_A3_Faults" RAT_FUNC "%10.0" "NU" COEFFS 0.000000 1.000000 0.000000 0.000000 0.000000 1.000000 /end COMPU_METHOD
/* Scalar measurable for DDE 'OUT_NU_INJ_A4_Faults'. */
/begin MEASUREMENT OUT_NU_INJ_A4_Faults "Fault status bits" UBYTE CU_OUT_NU_INJ_A4_FAULTS 1 100 0.0 0.0 ECU_ADDRESS 0x4000301a BYTE_ORDER MSB_FIRST /end MEASUREMENT
/begin COMPU_METHOD CU_OUT_NU_INJ_A4_FAULTS "Conversion method for OUT_NU_INJ_A4_Faults" RAT_FUNC "%10.0" "NU" COEFFS 0.000000 1.000000 0.000000 0.000000 0.000000 1.000000 /end COMPU_METHOD
/* Scalar measurable for DDE 'OUT_b_18F00000_ena'. */
/begin MEASUREMENT OUT_b_18F00000_ena "Value of enable ERC1 msg @ 250ms" UBYTE CU_OUT_B_18F00000_ENA 1 100 0.0 1.0 ECU_ADDRESS 0x40002e85 BYTE_ORDER MSB_FIRST /end MEASUREMENT
/begin COMPU_METHOD CU_OUT_B_18F00000_ENA "Conversion method for OUT_b_18F00000_ena" RAT_FUNC "%10.0" "NU" COEFFS 0.000000 1.000000 0.000000 0.000000 0.000000 1.000000 /end COMPU_METHOD
/* Scalar measurable for DDE 'OUT_b_18F0010B_ena'. */
/begin MEASUREMENT OUT_b_18F0010B_ena "Value of enable EBC1 msg" UBYTE CU_OUT_B_18F0010B_ENA 1 100 0.0 1.0 ECU_ADDRESS 0x40002e8b BYTE_ORDER MSB_FIRST /end MEASUREMENT
/begin COMPU_METHOD CU_OUT_B_18F0010B_ENA "Conversion method for OUT_b_18F0010B_ena" RAT_FUNC "%10.0" "NU" COEFFS 0.000000 1.000000 0.000000 0.000000 0.000000 1.000000 /end COMPU_METHOD
/* Scalar measurable for DDE 'OUT_b_18FDC40B_ena'. */
/begin MEASUREMENT OUT_b_18FDC40B_ena "Value of enable EBC5 msg @ 100ms" UBYTE CU_OUT_B_18FDC40B_ENA 1 100 0.0 1.0 ECU_ADDRESS 0x40002e8a BYTE_ORDER MSB_FIRST /end MEASUREMENT
/begin COMPU_METHOD CU_OUT_B_18FDC40B_ENA "Conversion method for OUT_b_18FDC40B_ena" RAT_FUNC "%10.0" "NU" COEFFS 0.000000 1.000000 0.000000 0.000000 0.000000 1.000000 /end COMPU_METHOD
/* Scalar measurable for DDE 'OUT_b_18FE6E00_ena'. */
/begin MEASUREMENT OUT_b_18FE6E00_ena "Value of enable HRW msg @ 20ms" UBYTE CU_OUT_B_18FE6E00_ENA 1 100 0.0 1.0 ECU_ADDRESS 0x40002e88 BYTE_ORDER MSB_FIRST /end MEASUREMENT
/begin COMPU_METHOD CU_OUT_B_18FE6E00_ENA "Conversion method for OUT_b_18FE6E00_ena" RAT_FUNC "%10.0" "NU" COEFFS 0.000000 1.000000 0.000000 0.000000 0.000000 1.000000 /end COMPU_METHOD
/* Scalar measurable for DDE 'OUT_b_18FEE100_ena'. */
/begin MEASUREMENT OUT_b_18FEE100_ena "Value of enable FEE1 msg @ 250ms" UBYTE CU_OUT_B_18FEE100_ENA 1 100 0.0 1.0 ECU_ADDRESS 0x40002e84 BYTE_ORDER MSB_FIRST /end MEASUREMENT
/begin COMPU_METHOD CU_OUT_B_18FEE100_ENA "Conversion method for OUT_b_18FEE100_ena" RAT_FUNC "%10.0" "NU" COEFFS 0.000000 1.000000 0.000000 0.000000 0.000000 1.000000 /end COMPU_METHOD
/* Scalar measurable for DDE 'OUT_b_18FEE600_ena'. */
/begin MEASUREMENT OUT_b_18FEE600_ena "Value of enable FEE6 msg @ 1000ms" UBYTE CU_OUT_B_18FEE600_ENA 1 100 0.0 1.0 ECU_ADDRESS 0x40002e86 BYTE_ORDER MSB_FIRST /end MEASUREMENT
/begin COMPU_METHOD CU_OUT_B_18FEE600_ENA "Conversion method for OUT_b_18FEE600_ena" RAT_FUNC "%10.0" "NU" COEFFS 0.000000 1.000000 0.000000 0.000000 0.000000 1.000000 /end COMPU_METHOD
/* Scalar measurable for DDE 'OUT_b_18FEEE00_ena'. */
/begin MEASUREMENT OUT_b_18FEEE00_ena "Value of enable FEEE msg @ 1000ms" UBYTE CU_OUT_B_18FEEE00_ENA 1 100 0.0 1.0 ECU_ADDRESS 0x40002e89 BYTE_ORDER MSB_FIRST /end MEASUREMENT
/begin COMPU_METHOD CU_OUT_B_18FEEE00_ENA "Conversion method for OUT_b_18FEEE00_ena" RAT_FUNC "%10.0" "NU" COEFFS 0.000000 1.000000 0.000000 0.000000 0.000000 1.000000 /end COMPU_METHOD
/* Scalar measurable for DDE 'OUT_b_24V_WarmupA'. */
/begin MEASUREMENT OUT_b_24V_WarmupA "displayable" UBYTE CU_OUT_B_24V_WARMUPA 1 100 0.0 1.0 ECU_ADDRESS 0x40002f9a BYTE_ORDER MSB_FIRST /end MEASUREMENT
/begin COMPU_METHOD CU_OUT_B_24V_WARMUPA "Conversion method for OUT_b_24V_WarmupA" RAT_FUNC "%10.0" "b" COEFFS 0.000000 1.000000 0.000000 0.000000 0.000000 1.000000 /end COMPU_METHOD
/* Scalar measurable for DDE 'OUT_b_BCM_ZF_ena'. */
/begin MEASUREMENT OUT_b_BCM_ZF_ena "Value of enable BCM" UBYTE CU_OUT_B_BCM_ZF_ENA 1 100 0.0 1.0 ECU_ADDRESS 0x40002e8c BYTE_ORDER MSB_FIRST /end MEASUREMENT
/begin COMPU_METHOD CU_OUT_B_BCM_ZF_ENA "Conversion method for OUT_b_BCM_ZF_ena" RAT_FUNC "%10.0" "NU" COEFFS 0.000000 1.000000 0.000000 0.000000 0.000000 1.000000 /end COMPU_METHOD
/* Scalar measurable for DDE 'OUT_b_BCM_ena'. */
/begin MEASUREMENT OUT_b_BCM_ena "Value of enable BCM" UBYTE CU_OUT_B_BCM_ENA 1 100 0.0 1.0 ECU_ADDRESS 0x40002e8d BYTE_ORDER MSB_FIRST /end MEASUREMENT
/begin COMPU_METHOD CU_OUT_B_BCM_ENA "Conversion method for OUT_b_BCM_ena" RAT_FUNC "%10.0" "NU" COEFFS 0.000000 1.000000 0.000000 0.000000 0.000000 1.000000 /end COMPU_METHOD
/* Scalar measurable for DDE 'OUT_b_BankA_Enbld'. */
/begin MEASUREMENT OUT_b_BankA_Enbld "Injections will not occur until this is enabled" UBYTE CU_OUT_B_BANKA_ENBLD 1 100 0.0 1.0 ECU_ADDRESS 0x40002f1d BYTE_ORDER MSB_FIRST /end MEASUREMENT
/begin COMPU_METHOD CU_OUT_B_BANKA_ENBLD "Conversion method for OUT_b_BankA_Enbld" RAT_FUNC "%10.0" "b" COEFFS 0.000000 1.000000 0.000000 0.000000 0.000000 1.000000 /end COMPU_METHOD
/* Scalar measurable for DDE 'OUT_b_BankB_Enbld'. */
/begin MEASUREMENT OUT_b_BankB_Enbld "Injections will not occur until this is enabled" UBYTE CU_OUT_B_BANKB_ENBLD 1 100 0.0 1.0 ECU_ADDRESS 0x40002f1c BYTE_ORDER MSB_FIRST /end MEASUREMENT
/begin COMPU_METHOD CU_OUT_B_BANKB_ENBLD "Conversion method for OUT_b_BankB_Enbld" RAT_FUNC "%10.0" "b" COEFFS 0.000000 1.000000 0.000000 0.000000 0.000000 1.000000 /end COMPU_METHOD
/* Scalar measurable for DDE 'OUT_b_CombustionAllCyls'. */
/begin MEASUREMENT OUT_b_CombustionAllCyls "Displayable" UBYTE CU_OUT_B_COMBUSTIONALLCYLS 1 100 0.0 1.0 ECU_ADDRESS 0x40002f0b BYTE_ORDER MSB_FIRST /end MEASUREMENT
/begin COMPU_METHOD CU_OUT_B_COMBUSTIONALLCYLS "Conversion method for OUT_b_CombustionAllCyls" RAT_FUNC "%10.0" "b" COEFFS 0.000000 1.000000 0.000000 0.000000 0.000000 1.000000 /end COMPU_METHOD
/* Scalar measurable for DDE 'OUT_b_DM19Request'. */
/begin MEASUREMENT OUT_b_DM19Request "ZF Fan" UBYTE CU_OUT_B_DM19REQUEST 1 100 0.0 1.0 ECU_ADDRESS 0x40002f09 BYTE_ORDER MSB_FIRST /end MEASUREMENT
/begin COMPU_METHOD CU_OUT_B_DM19REQUEST "Conversion method for OUT_b_DM19Request" RAT_FUNC "%10.0" "b" COEFFS 0.000000 1.000000 0.000000 0.000000 0.000000 1.000000 /end COMPU_METHOD
/* Scalar measurable for DDE 'OUT_b_FCV_OC'. */
/begin MEASUREMENT OUT_b_FCV_OC "Output overcurrent trip flag" UBYTE CU_OUT_B_FCV_OC 1 100 0.0 1.0 ECU_ADDRESS 0x40002f50 BYTE_ORDER MSB_FIRST /end MEASUREMENT
/begin COMPU_METHOD CU_OUT_B_FCV_OC "Conversion method for OUT_b_FCV_OC" RAT_FUNC "%10.0" "b" COEFFS 0.000000 1.000000 0.000000 0.000000 0.000000 1.000000 /end COMPU_METHOD
/* Scalar measurable for DDE 'OUT_b_FlashChecksum'. */
/begin MEASUREMENT OUT_b_FlashChecksum "Displayable" UBYTE CU_OUT_B_FLASHCHECKSUM 1 100 0.0 1.0 ECU_ADDRESS 0x40002f23 BYTE_ORDER MSB_FIRST /end MEASUREMENT
/begin COMPU_METHOD CU_OUT_B_FLASHCHECKSUM "Conversion method for OUT_b_FlashChecksum" RAT_FUNC "%10.0" "b" COEFFS 0.000000 1.000000 0.000000 0.000000 0.000000 1.000000 /end COMPU_METHOD
/* Scalar measurable for DDE 'OUT_b_HEGO11_Heater_OC'. */
/begin MEASUREMENT OUT_b_HEGO11_Heater_OC "Output overcurrent trip flag" UBYTE CU_OUT_B_HEGO11_HEATER_OC 1 100 0.0 1.0 ECU_ADDRESS 0x40002f4f BYTE_ORDER MSB_FIRST /end MEASUREMENT
/begin COMPU_METHOD CU_OUT_B_HEGO11_HEATER_OC "Conversion method for OUT_b_HEGO11_Heater_OC" RAT_FUNC "%10.0" "b" COEFFS 0.000000 1.000000 0.000000 0.000000 0.000000 1.000000 /end COMPU_METHOD
/* Scalar measurable for DDE 'OUT_b_HEGO12_Heater_OC'. */
/begin MEASUREMENT OUT_b_HEGO12_Heater_OC "Output overcurrent trip flag" UBYTE CU_OUT_B_HEGO12_HEATER_OC 1 100 0.0 1.0 ECU_ADDRESS 0x40002f4d BYTE_ORDER MSB_FIRST /end MEASUREMENT
/begin COMPU_METHOD CU_OUT_B_HEGO12_HEATER_OC "Conversion method for OUT_b_HEGO12_Heater_OC" RAT_FUNC "%10.0" "b" COEFFS 0.000000 1.000000 0.000000 0.000000 0.000000 1.000000 /end COMPU_METHOD
/* Scalar measurable for DDE 'OUT_b_HEGO21_Heater_OC'. */
/begin MEASUREMENT OUT_b_HEGO21_Heater_OC "Output overcurrent trip flag" UBYTE CU_OUT_B_HEGO21_HEATER_OC 1 100 0.0 1.0 ECU_ADDRESS 0x40002f4e BYTE_ORDER MSB_FIRST /end MEASUREMENT
/begin COMPU_METHOD CU_OUT_B_HEGO21_HEATER_OC "Conversion method for OUT_b_HEGO21_Heater_OC" RAT_FUNC "%10.0" "b" COEFFS 0.000000 1.000000 0.000000 0.000000 0.000000 1.000000 /end COMPU_METHOD
/* Scalar measurable for DDE 'OUT_b_HighsideY1'. */
/begin MEASUREMENT OUT_b_HighsideY1 "Displayable" UBYTE CU_OUT_B_HIGHSIDEY1 1 100 0.0 1.0 ECU_ADDRESS 0x40002f11 BYTE_ORDER MSB_FIRST /end MEASUREMENT
/begin COMPU_METHOD CU_OUT_B_HIGHSIDEY1 "Conversion method for OUT_b_HighsideY1" RAT_FUNC "%10.0" "b" COEFFS 0.000000 1.000000 0.000000 0.000000 0.000000 1.000000 /end COMPU_METHOD
/* Scalar measurable for DDE 'OUT_b_HighsideY5'. */
/begin MEASUREMENT OUT_b_HighsideY5 "Displayable" UBYTE CU_OUT_B_HIGHSIDEY5 1 100 0.0 1.0 ECU_ADDRESS 0x40002f12 BYTE_ORDER MSB_FIRST /end MEASUREMENT
/begin COMPU_METHOD CU_OUT_B_HIGHSIDEY5 "Conversion method for OUT_b_HighsideY5" RAT_FUNC "%10.0" "b" COEFFS 0.000000 1.000000 0.000000 0.000000 0.000000 1.000000 /end COMPU_METHOD
/* Scalar measurable for DDE 'OUT_b_Inj1_LSD_Active'. */
/begin MEASUREMENT OUT_b_Inj1_LSD_Active "Displayable" UBYTE CU_OUT_B_INJ1_LSD_ACTIVE 1 100 0.0 1.0 ECU_ADDRESS 0x40002f17 BYTE_ORDER MSB_FIRST /end MEASUREMENT
/begin COMPU_METHOD CU_OUT_B_INJ1_LSD_ACTIVE "Conversion method for OUT_b_Inj1_LSD_Active" RAT_FUNC "%10.0" "b" COEFFS 0.000000 1.000000 0.000000 0.000000 0.000000 1.000000 /end COMPU_METHOD
/* Scalar measurable for DDE 'OUT_b_Inj2_LSD_Active'. */
/begin MEASUREMENT OUT_b_Inj2_LSD_Active "Displayable" UBYTE CU_OUT_B_INJ2_LSD_ACTIVE 1 100 0.0 1.0 ECU_ADDRESS 0x40002f16 BYTE_ORDER MSB_FIRST /end MEASUREMENT
/begin COMPU_METHOD CU_OUT_B_INJ2_LSD_ACTIVE "Conversion method for OUT_b_Inj2_LSD_Active" RAT_FUNC "%10.0" "b" COEFFS 0.000000 1.000000 0.000000 0.000000 0.000000 1.000000 /end COMPU_METHOD
/* Scalar measurable for DDE 'OUT_b_Inj3_LSD_Active'. */
/begin MEASUREMENT OUT_b_Inj3_LSD_Active "Displayable" UBYTE CU_OUT_B_INJ3_LSD_ACTIVE 1 100 0.0 1.0 ECU_ADDRESS 0x40002f15 BYTE_ORDER MSB_FIRST /end MEASUREMENT
/begin COMPU_METHOD CU_OUT_B_INJ3_LSD_ACTIVE "Conversion method for OUT_b_Inj3_LSD_Active" RAT_FUNC "%10.0" "b" COEFFS 0.000000 1.000000 0.000000 0.000000 0.000000 1.000000 /end COMPU_METHOD
/* Scalar measurable for DDE 'OUT_b_Inj4_LSD_Active'. */
/begin MEASUREMENT OUT_b_Inj4_LSD_Active "Displayable" UBYTE CU_OUT_B_INJ4_LSD_ACTIVE 1 100 0.0 1.0 ECU_ADDRESS 0x40002f14 BYTE_ORDER MSB_FIRST /end MEASUREMENT
/begin COMPU_METHOD CU_OUT_B_INJ4_LSD_ACTIVE "Conversion method for OUT_b_Inj4_LSD_Active" RAT_FUNC "%10.0" "b" COEFFS 0.000000 1.000000 0.000000 0.000000 0.000000 1.000000 /end COMPU_METHOD
/* Scalar measurable for DDE 'OUT_b_InjHighsideOC'. */
/begin MEASUREMENT OUT_b_InjHighsideOC "Injector highside overcurrent trip flag" UBYTE CU_OUT_B_INJHIGHSIDEOC 1 100 0.0 1.0 ECU_ADDRESS 0x40002f51 BYTE_ORDER MSB_FIRST /end MEASUREMENT
/begin COMPU_METHOD CU_OUT_B_INJHIGHSIDEOC "Conversion method for OUT_b_InjHighsideOC" RAT_FUNC "%10.0" "b" COEFFS 0.000000 1.000000 0.000000 0.000000 0.000000 1.000000 /end COMPU_METHOD
/* Scalar measurable for DDE 'OUT_b_MIL_LED'. */
/begin MEASUREMENT OUT_b_MIL_LED "MIL Led" UBYTE CU_OUT_B_MIL_LED 1 100 0.0 1.0 ECU_ADDRESS 0x40002f2c BYTE_ORDER MSB_FIRST /end MEASUREMENT
/begin COMPU_METHOD CU_OUT_B_MIL_LED "Conversion method for OUT_b_MIL_LED" RAT_FUNC "%10.0" "b" COEFFS 0.000000 1.000000 0.000000 0.000000 0.000000 1.000000 /end COMPU_METHOD
/* Scalar measurable for DDE 'OUT_b_PT_Relay'. */
/begin MEASUREMENT OUT_b_PT_Relay "Displayable" UBYTE CU_OUT_B_PT_RELAY 1 100 0.0 1.0 ECU_ADDRESS 0x40002f13 BYTE_ORDER MSB_FIRST /end MEASUREMENT
/begin COMPU_METHOD CU_OUT_B_PT_RELAY "Conversion method for OUT_b_PT_Relay" RAT_FUNC "%10.0" "b" COEFFS 0.000000 1.000000 0.000000 0.000000 0.000000 1.000000 /end COMPU_METHOD
/* Scalar measurable for DDE 'OUT_b_PT_RelayEnergized'. */
/begin MEASUREMENT OUT_b_PT_RelayEnergized "Status reported to the rest of the system" UBYTE CU_OUT_B_PT_RELAYENERGIZED 1 100 0.0 1.0 ECU_ADDRESS 0x40002f0c BYTE_ORDER MSB_FIRST /end MEASUREMENT
/begin COMPU_METHOD CU_OUT_B_PT_RELAYENERGIZED "Conversion method for OUT_b_PT_RelayEnergized" RAT_FUNC "%10.0" "b" COEFFS 0.000000 1.000000 0.000000 0.000000 0.000000 1.000000 /end COMPU_METHOD
/* Scalar measurable for DDE 'OUT_b_RAM_Checksum'. */
/begin MEASUREMENT OUT_b_RAM_Checksum "Displayable" UBYTE CU_OUT_B_RAM_CHECKSUM 1 100 0.0 1.0 ECU_ADDRESS 0x40002f24 BYTE_ORDER MSB_FIRST /end MEASUREMENT
/begin COMPU_METHOD CU_OUT_B_RAM_CHECKSUM "Conversion method for OUT_b_RAM_Checksum" RAT_FUNC "%10.0" "b" COEFFS 0.000000 1.000000 0.000000 0.000000 0.000000 1.000000 /end COMPU_METHOD
/* Scalar measurable for DDE 'OUT_b_Spk1_Active'. */
/begin MEASUREMENT OUT_b_Spk1_Active "Displayable" UBYTE CU_OUT_B_SPK1_ACTIVE 1 100 0.0 1.0 ECU_ADDRESS 0x40002f1b BYTE_ORDER MSB_FIRST /end MEASUREMENT
/begin COMPU_METHOD CU_OUT_B_SPK1_ACTIVE "Conversion method for OUT_b_Spk1_Active" RAT_FUNC "%10.0" "b" COEFFS 0.000000 1.000000 0.000000 0.000000 0.000000 1.000000 /end COMPU_METHOD
/* Scalar measurable for DDE 'OUT_b_Spk2_Active'. */
/begin MEASUREMENT OUT_b_Spk2_Active "Displayable" UBYTE CU_OUT_B_SPK2_ACTIVE 1 100 0.0 1.0 ECU_ADDRESS 0x40002f1a BYTE_ORDER MSB_FIRST /end MEASUREMENT
/begin COMPU_METHOD CU_OUT_B_SPK2_ACTIVE "Conversion method for OUT_b_Spk2_Active" RAT_FUNC "%10.0" "b" COEFFS 0.000000 1.000000 0.000000 0.000000 0.000000 1.000000 /end COMPU_METHOD
/* Scalar measurable for DDE 'OUT_b_Spk3_Active'. */
/begin MEASUREMENT OUT_b_Spk3_Active "Displayable" UBYTE CU_OUT_B_SPK3_ACTIVE 1 100 0.0 1.0 ECU_ADDRESS 0x40002f19 BYTE_ORDER MSB_FIRST /end MEASUREMENT
/begin COMPU_METHOD CU_OUT_B_SPK3_ACTIVE "Conversion method for OUT_b_Spk3_Active" RAT_FUNC "%10.0" "b" COEFFS 0.000000 1.000000 0.000000 0.000000 0.000000 1.000000 /end COMPU_METHOD
/* Scalar measurable for DDE 'OUT_b_Spk4_Active'. */
/begin MEASUREMENT OUT_b_Spk4_Active "Displayable" UBYTE CU_OUT_B_SPK4_ACTIVE 1 100 0.0 1.0 ECU_ADDRESS 0x40002f18 BYTE_ORDER MSB_FIRST /end MEASUREMENT
/begin COMPU_METHOD CU_OUT_B_SPK4_ACTIVE "Conversion method for OUT_b_Spk4_Active" RAT_FUNC "%10.0" "b" COEFFS 0.000000 1.000000 0.000000 0.000000 0.000000 1.000000 /end COMPU_METHOD
/* Scalar measurable for DDE 'OUT_b_Spk5_Active'. */
/begin MEASUREMENT OUT_b_Spk5_Active "Displayable" UBYTE CU_OUT_B_SPK5_ACTIVE 1 100 0.0 1.0 ECU_ADDRESS 0x40002f10 BYTE_ORDER MSB_FIRST /end MEASUREMENT
/begin COMPU_METHOD CU_OUT_B_SPK5_ACTIVE "Conversion method for OUT_b_Spk5_Active" RAT_FUNC "%10.0" "b" COEFFS 0.000000 1.000000 0.000000 0.000000 0.000000 1.000000 /end COMPU_METHOD
/* Scalar measurable for DDE 'OUT_b_Spk6_Active'. */
/begin MEASUREMENT OUT_b_Spk6_Active "Displayable" UBYTE CU_OUT_B_SPK6_ACTIVE 1 100 0.0 1.0 ECU_ADDRESS 0x40002f0f BYTE_ORDER MSB_FIRST /end MEASUREMENT
/begin COMPU_METHOD CU_OUT_B_SPK6_ACTIVE "Conversion method for OUT_b_Spk6_Active" RAT_FUNC "%10.0" "b" COEFFS 0.000000 1.000000 0.000000 0.000000 0.000000 1.000000 /end COMPU_METHOD
/* Scalar measurable for DDE 'OUT_b_Spk7_Active'. */
/begin MEASUREMENT OUT_b_Spk7_Active "Displayable" UBYTE CU_OUT_B_SPK7_ACTIVE 1 100 0.0 1.0 ECU_ADDRESS 0x40002f0e BYTE_ORDER MSB_FIRST /end MEASUREMENT
/begin COMPU_METHOD CU_OUT_B_SPK7_ACTIVE "Conversion method for OUT_b_Spk7_Active" RAT_FUNC "%10.0" "b" COEFFS 0.000000 1.000000 0.000000 0.000000 0.000000 1.000000 /end COMPU_METHOD
/* Scalar measurable for DDE 'OUT_b_Spk8_Active'. */
/begin MEASUREMENT OUT_b_Spk8_Active "Displayable" UBYTE CU_OUT_B_SPK8_ACTIVE 1 100 0.0 1.0 ECU_ADDRESS 0x40002f0d BYTE_ORDER MSB_FIRST /end MEASUREMENT
/begin COMPU_METHOD CU_OUT_B_SPK8_ACTIVE "Conversion method for OUT_b_Spk8_Active" RAT_FUNC "%10.0" "b" COEFFS 0.000000 1.000000 0.000000 0.000000 0.000000 1.000000 /end COMPU_METHOD
/* Scalar measurable for DDE 'OUT_b_TCO_ena'. */
/begin MEASUREMENT OUT_b_TCO_ena "Value of enable TCO" UBYTE CU_OUT_B_TCO_ENA 1 100 0.0 1.0 ECU_ADDRESS 0x40002e87 BYTE_ORDER MSB_FIRST /end MEASUREMENT
/begin COMPU_METHOD CU_OUT_B_TCO_ENA "Conversion method for OUT_b_TCO_ena" RAT_FUNC "%10.0" "NU" COEFFS 0.000000 1.000000 0.000000 0.000000 0.000000 1.000000 /end COMPU_METHOD
/* Scalar measurable for DDE 'OUT_b_UEGOB_Heater_OC'. */
/begin MEASUREMENT OUT_b_UEGOB_Heater_OC "Output overcurrent trip flag" UBYTE CU_OUT_B_UEGOB_HEATER_OC 1 100 0.0 1.0 ECU_ADDRESS 0x40002f40 BYTE_ORDER MSB_FIRST /end MEASUREMENT
/begin COMPU_METHOD CU_OUT_B_UEGOB_HEATER_OC "Conversion method for OUT_b_UEGOB_Heater_OC" RAT_FUNC "%10.0" "b" COEFFS 0.000000 1.000000 0.000000 0.000000 0.000000 1.000000 /end COMPU_METHOD
/* Scalar measurable for DDE 'OUT_b_VISCO_1st'. */
/begin MEASUREMENT OUT_b_VISCO_1st "(not defined)" UBYTE CU_OUT_B_VISCO_1ST 1 100 0.0 1.0 ECU_ADDRESS 0x40002f20 BYTE_ORDER MSB_FIRST /end MEASUREMENT
/begin COMPU_METHOD CU_OUT_B_VISCO_1ST "Conversion method for OUT_b_VISCO_1st" RAT_FUNC "%10.0" "b" COEFFS 0.000000 1.000000 0.000000 0.000000 0.000000 1.000000 /end COMPU_METHOD
/* Scalar measurable for DDE 'OUT_b_VISCO_2nd'. */
/begin MEASUREMENT OUT_b_VISCO_2nd "(not defined)" UBYTE CU_OUT_B_VISCO_2ND 1 100 0.0 1.0 ECU_ADDRESS 0x40002f1f BYTE_ORDER MSB_FIRST /end MEASUREMENT
/begin COMPU_METHOD CU_OUT_B_VISCO_2ND "Conversion method for OUT_b_VISCO_2nd" RAT_FUNC "%10.0" "b" COEFFS 0.000000 1.000000 0.000000 0.000000 0.000000 1.000000 /end COMPU_METHOD
/* Scalar measurable for DDE 'OUT_b_VentiladorZF'. */
/begin MEASUREMENT OUT_b_VentiladorZF "ZF Fan" UBYTE CU_OUT_B_VENTILADORZF 1 100 0.0 1.0 ECU_ADDRESS 0x40002ed3 BYTE_ORDER MSB_FIRST /end MEASUREMENT
/begin COMPU_METHOD CU_OUT_B_VENTILADORZF "Conversion method for OUT_b_VentiladorZF" RAT_FUNC "%10.0" "b" COEFFS 0.000000 1.000000 0.000000 0.000000 0.000000 1.000000 /end COMPU_METHOD
/* Scalar measurable for DDE 'OUT_b_Y1_OC'. */
/begin MEASUREMENT OUT_b_Y1_OC "Highside output overcurrent trip flag" UBYTE CU_OUT_B_Y1_OC 1 100 0.0 1.0 ECU_ADDRESS 0x40002f4c BYTE_ORDER MSB_FIRST /end MEASUREMENT
/begin COMPU_METHOD CU_OUT_B_Y1_OC "Conversion method for OUT_b_Y1_OC" RAT_FUNC "%10.0" "b" COEFFS 0.000000 1.000000 0.000000 0.000000 0.000000 1.000000 /end COMPU_METHOD
/* Scalar measurable for DDE 'OUT_b_Y5_OC'. */
/begin MEASUREMENT OUT_b_Y5_OC "Highside output overcurrent trip flag" UBYTE CU_OUT_B_Y5_OC 1 100 0.0 1.0 ECU_ADDRESS 0x40002f4b BYTE_ORDER MSB_FIRST /end MEASUREMENT
/begin COMPU_METHOD CU_OUT_B_Y5_OC "Conversion method for OUT_b_Y5_OC" RAT_FUNC "%10.0" "b" COEFFS 0.000000 1.000000 0.000000 0.000000 0.000000 1.000000 /end COMPU_METHOD
/* Scalar measurable for DDE 'OUT_cnt_BankA_SPI_Flts'. */
/begin MEASUREMENT OUT_cnt_BankA_SPI_Flts "Displayable" ULONG CU_OUT_CNT_BANKA_SPI_FLTS 1 100 0.0 0.0 ECU_ADDRESS 0x4000306c BYTE_ORDER MSB_FIRST /end MEASUREMENT
/begin COMPU_METHOD CU_OUT_CNT_BANKA_SPI_FLTS "Conversion method for OUT_cnt_BankA_SPI_Flts" RAT_FUNC "%10.0" "cnt" COEFFS 0.000000 1.000000 0.000000 0.000000 0.000000 1.000000 /end COMPU_METHOD
/* Scalar measurable for DDE 'OUT_cnt_BankB_SPI_Flts'. */
/begin MEASUREMENT OUT_cnt_BankB_SPI_Flts "Displayable" ULONG CU_OUT_CNT_BANKB_SPI_FLTS 1 100 0.0 0.0 ECU_ADDRESS 0x40003068 BYTE_ORDER MSB_FIRST /end MEASUREMENT
/begin COMPU_METHOD CU_OUT_CNT_BANKB_SPI_FLTS "Conversion method for OUT_cnt_BankB_SPI_Flts" RAT_FUNC "%10.0" "cnt" COEFFS 0.000000 1.000000 0.000000 0.000000 0.000000 1.000000 /end COMPU_METHOD
/* Scalar measurable for DDE 'OUT_pct_UEGO_HTR_DC_A'. */
/begin MEASUREMENT OUT_pct_UEGO_HTR_DC_A "Displayable signal for UEGO HTR DC" FLOAT32_IEEE CU_OUT_PCT_UEGO_HTR_DC_A 1 100 0.0 1.0 ECU_ADDRESS 0x400038b8 BYTE_ORDER MSB_FIRST /end MEASUREMENT
/begin COMPU_METHOD CU_OUT_PCT_UEGO_HTR_DC_A "Conversion method for OUT_pct_UEGO_HTR_DC_A" RAT_FUNC "%10.2" "pct" COEFFS 0.000000 1.000000 0.000000 0.000000 0.000000 1.000000 /end COMPU_METHOD
/* Scalar measurable for DDE 'PIDEffort'. */
/begin MEASUREMENT PIDEffort "PID" FLOAT32_IEEE CU_PIDEFFORT 1 100 -10000.0 10000.0 ECU_ADDRESS 0x40003160 READ_WRITE BYTE_ORDER MSB_FIRST /end MEASUREMENT
/begin COMPU_METHOD CU_PIDEFFORT "Conversion method for PIDEffort" RAT_FUNC "%10.2" "NU" COEFFS 0.000000 1.000000 0.000000 0.000000 0.000000 1.000000 /end COMPU_METHOD
/* Scalar measurable for DDE 'PID_NU_DTerm'. */
/begin MEASUREMENT PID_NU_DTerm "Displayable" FLOAT32_IEEE CU_PID_NU_DTERM 1 100 0.0 0.0 ECU_ADDRESS 0x40003184 BYTE_ORDER MSB_FIRST /end MEASUREMENT
/begin COMPU_METHOD CU_PID_NU_DTERM "Conversion method for PID_NU_DTerm" RAT_FUNC "%10.3" "NU" COEFFS 0.000000 1.000000 0.000000 0.000000 0.000000 1.000000 /end COMPU_METHOD
/* Scalar measurable for DDE 'PID_NU_ITerm'. */
/begin MEASUREMENT PID_NU_ITerm "Displayable" FLOAT32_IEEE CU_PID_NU_ITERM 1 100 0.0 0.0 ECU_ADDRESS 0x4000318c BYTE_ORDER MSB_FIRST /end MEASUREMENT
/begin COMPU_METHOD CU_PID_NU_ITERM "Conversion method for PID_NU_ITerm" RAT_FUNC "%10.3" "NU" COEFFS 0.000000 1.000000 0.000000 0.000000 0.000000 1.000000 /end COMPU_METHOD
/* Scalar measurable for DDE 'PID_NU_PTerm'. */
/begin MEASUREMENT PID_NU_PTerm "Displayable" FLOAT32_IEEE CU_PID_NU_PTERM 1 100 0.0 0.0 ECU_ADDRESS 0x40003190 BYTE_ORDER MSB_FIRST /end MEASUREMENT
/begin COMPU_METHOD CU_PID_NU_PTERM "Conversion method for PID_NU_PTerm" RAT_FUNC "%10.3" "NU" COEFFS 0.000000 1.000000 0.000000 0.000000 0.000000 1.000000 /end COMPU_METHOD
/* Scalar measurable for DDE 'REM_Nm_TqLimit'. */
/begin MEASUREMENT REM_Nm_TqLimit "Displayable" FLOAT32_IEEE CU_REM_NM_TQLIMIT 1 100 0.0 0.0 ECU_ADDRESS 0x400036ec BYTE_ORDER MSB_FIRST /end MEASUREMENT
/begin COMPU_METHOD CU_REM_NM_TQLIMIT "Conversion method for REM_Nm_TqLimit" RAT_FUNC "%10.1" "Nm" COEFFS 0.000000 1.000000 0.000000 0.000000 0.000000 1.000000 /end COMPU_METHOD
/* Scalar measurable for DDE 'REM_b_StopCombustion'. */
/begin MEASUREMENT REM_b_StopCombustion "Displayable" UBYTE CU_REM_B_STOPCOMBUSTION 1 100 0.0 1.0 ECU_ADDRESS 0x40002f2a BYTE_ORDER MSB_FIRST /end MEASUREMENT
/begin COMPU_METHOD CU_REM_B_STOPCOMBUSTION "Conversion method for REM_b_StopCombustion" RAT_FUNC "%10.0" "b" COEFFS 0.000000 1.000000 0.000000 0.000000 0.000000 1.000000 /end COMPU_METHOD
/* Scalar measurable for DDE 'REM_e_TurbineState'. */
/begin MEASUREMENT REM_e_TurbineState "Turbo status" UBYTE CU_REM_E_TURBINESTATE 1 100 0.0 2.0 ECU_ADDRESS 0x40003015 BYTE_ORDER MSB_FIRST /end MEASUREMENT
/begin COMPU_METHOD CU_REM_E_TURBINESTATE "Conversion method for REM_e_TurbineState" TAB_VERB "%12.0" "e" COMPU_TAB_REF CT_REM_E_TURBINESTATE /end COMPU_METHOD
/begin COMPU_VTAB CT_REM_E_TURBINESTATE "Conversion method for REM_e_TurbineState" TAB_VERB 3 0 "REMk_e_TurbineNormal" 1 "REMk_e_TurbineTempWarning" 2 "REMk_e_TurbineOvertempShutdown" /end COMPU_VTAB
/* Scalar measurable for DDE 'REM_pct_OvertempThrottleLimit'. */
/begin MEASUREMENT REM_pct_OvertempThrottleLimit "Displayable" FLOAT32_IEEE CU_REM_PCT_OVERTEMPTHROTTLELIM0 1 100 0.0 0.0 ECU_ADDRESS 0x40003690 BYTE_ORDER MSB_FIRST /end MEASUREMENT
/begin COMPU_METHOD CU_REM_PCT_OVERTEMPTHROTTLELIM0 "Conversion method for REM_pct_OvertempThrottleLimit" RAT_FUNC "%10.2" "pct" COEFFS 0.000000 1.000000 0.000000 0.000000 0.000000 1.000000 /end COMPU_METHOD
/* Scalar measurable for DDE 'RFC_b_Active'. */
/begin MEASUREMENT RFC_b_Active "State displayable" UBYTE CU_RFC_B_ACTIVE 1 100 0.0 1.0 ECU_ADDRESS 0x40002e74 BYTE_ORDER MSB_FIRST /end MEASUREMENT
/begin COMPU_METHOD CU_RFC_B_ACTIVE "Conversion method for RFC_b_Active" RAT_FUNC "%10.0" "b" COEFFS 0.000000 1.000000 0.000000 0.000000 0.000000 1.000000 /end COMPU_METHOD
/* Scalar measurable for DDE 'RFC_mg_FuelRqstDelta'. */
/begin MEASUREMENT RFC_mg_FuelRqstDelta "Fuelmass change vs previous injection" FLOAT32_IEEE CU_RFC_MG_FUELRQSTDELTA 1 100 0.0 0.0 ECU_ADDRESS 0x40003030 BYTE_ORDER MSB_FIRST /end MEASUREMENT
/begin COMPU_METHOD CU_RFC_MG_FUELRQSTDELTA "Conversion method for RFC_mg_FuelRqstDelta" RAT_FUNC "%10.2" "mg" COEFFS 0.000000 1.000000 0.000000 0.000000 0.000000 1.000000 /end COMPU_METHOD
/* Scalar measurable for DDE 'RFC_mg_Inj1'. */
/begin MEASUREMENT RFC_mg_Inj1 "Displayable" FLOAT32_IEEE CU_RFC_MG_INJ1 1 100 0.0 0.0 ECU_ADDRESS 0x40003310 BYTE_ORDER MSB_FIRST /end MEASUREMENT
/begin COMPU_METHOD CU_RFC_MG_INJ1 "Conversion method for RFC_mg_Inj1" RAT_FUNC "%10.2" "mg" COEFFS 0.000000 1.000000 0.000000 0.000000 0.000000 1.000000 /end COMPU_METHOD
/* Scalar measurable for DDE 'RFC_mg_Inj2'. */
/begin MEASUREMENT RFC_mg_Inj2 "Displayable" FLOAT32_IEEE CU_RFC_MG_INJ2 1 100 0.0 0.0 ECU_ADDRESS 0x4000330c BYTE_ORDER MSB_FIRST /end MEASUREMENT
/begin COMPU_METHOD CU_RFC_MG_INJ2 "Conversion method for RFC_mg_Inj2" RAT_FUNC "%10.2" "mg" COEFFS 0.000000 1.000000 0.000000 0.000000 0.000000 1.000000 /end COMPU_METHOD
/* Scalar measurable for DDE 'RFC_mg_Inj3'. */
/begin MEASUREMENT RFC_mg_Inj3 "Displayable" FLOAT32_IEEE CU_RFC_MG_INJ3 1 100 0.0 0.0 ECU_ADDRESS 0x40003308 BYTE_ORDER MSB_FIRST /end MEASUREMENT
/begin COMPU_METHOD CU_RFC_MG_INJ3 "Conversion method for RFC_mg_Inj3" RAT_FUNC "%10.2" "mg" COEFFS 0.000000 1.000000 0.000000 0.000000 0.000000 1.000000 /end COMPU_METHOD
/* Scalar measurable for DDE 'RFC_mg_Inj4'. */
/begin MEASUREMENT RFC_mg_Inj4 "Displayable" FLOAT32_IEEE CU_RFC_MG_INJ4 1 100 0.0 0.0 ECU_ADDRESS 0x40003304 BYTE_ORDER MSB_FIRST /end MEASUREMENT
/begin COMPU_METHOD CU_RFC_MG_INJ4 "Conversion method for RFC_mg_Inj4" RAT_FUNC "%10.2" "mg" COEFFS 0.000000 1.000000 0.000000 0.000000 0.000000 1.000000 /end COMPU_METHOD
/* Scalar measurable for DDE 'RFC_pct_PfInvCyl1'. */
/begin MEASUREMENT RFC_pct_PfInvCyl1 "Fuel compensation factor" FLOAT32_IEEE CU_RFC_PCT_PFINVCYL1 1 100 0.0 0.0 ECU_ADDRESS 0x400031c8 BYTE_ORDER MSB_FIRST /end MEASUREMENT
/begin COMPU_METHOD CU_RFC_PCT_PFINVCYL1 "Conversion method for RFC_pct_PfInvCyl1" RAT_FUNC "%10.2" "pct" COEFFS 0.000000 1.000000 0.000000 0.000000 0.000000 1.000000 /end COMPU_METHOD
/* Scalar measurable for DDE 'RFC_pct_PfInvCyl2'. */
/begin MEASUREMENT RFC_pct_PfInvCyl2 "Fuel compensation factor" FLOAT32_IEEE CU_RFC_PCT_PFINVCYL2 1 100 0.0 0.0 ECU_ADDRESS 0x400031c4 BYTE_ORDER MSB_FIRST /end MEASUREMENT
/begin COMPU_METHOD CU_RFC_PCT_PFINVCYL2 "Conversion method for RFC_pct_PfInvCyl2" RAT_FUNC "%10.2" "pct" COEFFS 0.000000 1.000000 0.000000 0.000000 0.000000 1.000000 /end COMPU_METHOD
/* Scalar measurable for DDE 'RFC_pct_PfInvCyl3'. */
/begin MEASUREMENT RFC_pct_PfInvCyl3 "Fuel compensation factor" FLOAT32_IEEE CU_RFC_PCT_PFINVCYL3 1 100 0.0 0.0 ECU_ADDRESS 0x400031c0 BYTE_ORDER MSB_FIRST /end MEASUREMENT
/begin COMPU_METHOD CU_RFC_PCT_PFINVCYL3 "Conversion method for RFC_pct_PfInvCyl3" RAT_FUNC "%10.2" "pct" COEFFS 0.000000 1.000000 0.000000 0.000000 0.000000 1.000000 /end COMPU_METHOD
/* Scalar measurable for DDE 'RFC_pct_PfInvCyl4'. */
/begin MEASUREMENT RFC_pct_PfInvCyl4 "Fuel compensation factor" FLOAT32_IEEE CU_RFC_PCT_PFINVCYL4 1 100 0.0 0.0 ECU_ADDRESS 0x400031bc BYTE_ORDER MSB_FIRST /end MEASUREMENT
/begin COMPU_METHOD CU_RFC_PCT_PFINVCYL4 "Conversion method for RFC_pct_PfInvCyl4" RAT_FUNC "%10.2" "pct" COEFFS 0.000000 1.000000 0.000000 0.000000 0.000000 1.000000 /end COMPU_METHOD
/* Scalar measurable for DDE 'RFC_pct_RelativePfInv'. */
/begin MEASUREMENT RFC_pct_RelativePfInv "PfInv (relative gain) max from all cyls" FLOAT32_IEEE CU_RFC_PCT_RELATIVEPFINV 1 100 0.0 0.0 ECU_ADDRESS 0x40003034 BYTE_ORDER MSB_FIRST /end MEASUREMENT
/begin COMPU_METHOD CU_RFC_PCT_RELATIVEPFINV "Conversion method for RFC_pct_RelativePfInv" RAT_FUNC "%10.2" "pct" COEFFS 0.000000 1.000000 0.000000 0.000000 0.000000 1.000000 /end COMPU_METHOD
/* Scalar measurable for DDE 'RFC_pct_WallWetFraction'. */
/begin MEASUREMENT RFC_pct_WallWetFraction "Map output displayable" FLOAT32_IEEE CU_RFC_PCT_WALLWETFRACTION 1 100 0.0 0.0 ECU_ADDRESS 0x400031b8 BYTE_ORDER MSB_FIRST /end MEASUREMENT
/begin COMPU_METHOD CU_RFC_PCT_WALLWETFRACTION "Conversion method for RFC_pct_WallWetFraction" RAT_FUNC "%10.2" "pct" COEFFS 0.000000 1.000000 0.000000 0.000000 0.000000 1.000000 /end COMPU_METHOD
/* Scalar measurable for DDE 'RFC_s_DbncTimer'. */
/begin MEASUREMENT RFC_s_DbncTimer "Displayable" FLOAT32_IEEE CU_RFC_S_DBNCTIMER 1 100 0.0 0.0 ECU_ADDRESS 0x400031b0 BYTE_ORDER MSB_FIRST /end MEASUREMENT
/begin COMPU_METHOD CU_RFC_S_DBNCTIMER "Conversion method for RFC_s_DbncTimer" RAT_FUNC "%10.2" "s" COEFFS 0.000000 1.000000 0.000000 0.000000 0.000000 1.000000 /end COMPU_METHOD
/* Scalar measurable for DDE 'RFC_s_ExpTimer'. */
/begin MEASUREMENT RFC_s_ExpTimer "Displayable" FLOAT32_IEEE CU_RFC_S_EXPTIMER 1 100 0.0 0.0 ECU_ADDRESS 0x400031b4 BYTE_ORDER MSB_FIRST /end MEASUREMENT
/begin COMPU_METHOD CU_RFC_S_EXPTIMER "Conversion method for RFC_s_ExpTimer" RAT_FUNC "%10.2" "s" COEFFS 0.000000 1.000000 0.000000 0.000000 0.000000 1.000000 /end COMPU_METHOD
/* Scalar measurable for DDE 'RFC_s_PuddleVapTime'. */
/begin MEASUREMENT RFC_s_PuddleVapTime "Map output displayable" FLOAT32_IEEE CU_RFC_S_PUDDLEVAPTIME 1 100 0.0 0.0 ECU_ADDRESS 0x400031cc BYTE_ORDER MSB_FIRST /end MEASUREMENT
/begin COMPU_METHOD CU_RFC_S_PUDDLEVAPTIME "Conversion method for RFC_s_PuddleVapTime" RAT_FUNC "%10.2" "s" COEFFS 0.000000 1.000000 0.000000 0.000000 0.000000 1.000000 /end COMPU_METHOD
/* Scalar measurable for DDE 'SAR_adv_SparkAng'. */
/begin MEASUREMENT SAR_adv_SparkAng "Arbitrated spark advance angle" FLOAT32_IEEE CU_SAR_ADV_SPARKANG 1 100 -40.0 40.0 ECU_ADDRESS 0x40003448 BYTE_ORDER MSB_FIRST /end MEASUREMENT
/begin COMPU_METHOD CU_SAR_ADV_SPARKANG "Conversion method for SAR_adv_SparkAng" RAT_FUNC "%10.1" "adv" COEFFS 0.000000 1.000000 0.000000 0.000000 0.000000 1.000000 /end COMPU_METHOD
/* Scalar measurable for DDE 'SAR_ret_ArbitratedRetardRqst'. */
/begin MEASUREMENT SAR_ret_ArbitratedRetardRqst "Result of all retard modifers" FLOAT32_IEEE CU_SAR_RET_ARBITRATEDRETARDRQST 1 100 0.0 0.0 ECU_ADDRESS 0x4000344c BYTE_ORDER MSB_FIRST /end MEASUREMENT
/begin COMPU_METHOD CU_SAR_RET_ARBITRATEDRETARDRQST "Conversion method for SAR_ret_ArbitratedRetardRqst" RAT_FUNC "%10.1" "ret" COEFFS 0.000000 1.000000 0.000000 0.000000 0.000000 1.000000 /end COMPU_METHOD
/* Scalar measurable for DDE 'SOV_b_OpenValve1'. */
/begin MEASUREMENT SOV_b_OpenValve1 "Displayable" UBYTE CU_SOV_B_OPENVALVE1 1 100 0.0 1.0 ECU_ADDRESS 0x40002f26 BYTE_ORDER MSB_FIRST /end MEASUREMENT
/begin COMPU_METHOD CU_SOV_B_OPENVALVE1 "Conversion method for SOV_b_OpenValve1" RAT_FUNC "%10.0" "b" COEFFS 0.000000 1.000000 0.000000 0.000000 0.000000 1.000000 /end COMPU_METHOD
/* Scalar measurable for DDE 'SOV_b_OpenValve2'. */
/begin MEASUREMENT SOV_b_OpenValve2 "Displayable" UBYTE CU_SOV_B_OPENVALVE2 1 100 0.0 1.0 ECU_ADDRESS 0x40002f25 BYTE_ORDER MSB_FIRST /end MEASUREMENT
/begin COMPU_METHOD CU_SOV_B_OPENVALVE2 "Conversion method for SOV_b_OpenValve2" RAT_FUNC "%10.0" "b" COEFFS 0.000000 1.000000 0.000000 0.000000 0.000000 1.000000 /end COMPU_METHOD
/* Scalar measurable for DDE 'SPT_adv_CoilOffAng'. */
/begin MEASUREMENT SPT_adv_CoilOffAng "Spark coil off angle" FLOAT32_IEEE CU_SPT_ADV_COILOFFANG 1 100 -40.0 40.0 ECU_ADDRESS 0x40003208 BYTE_ORDER MSB_FIRST /end MEASUREMENT
/begin COMPU_METHOD CU_SPT_ADV_COILOFFANG "Conversion method for SPT_adv_CoilOffAng" RAT_FUNC "%10.1" "adv" COEFFS 0.000000 1.000000 0.000000 0.000000 0.000000 1.000000 /end COMPU_METHOD
/* Scalar measurable for DDE 'SPT_adv_CoilOnAng'. */
/begin MEASUREMENT SPT_adv_CoilOnAng "Spark coil on angle" FLOAT32_IEEE CU_SPT_ADV_COILONANG 1 100 -40.0 360.0 ECU_ADDRESS 0x4000320c BYTE_ORDER MSB_FIRST /end MEASUREMENT
/begin COMPU_METHOD CU_SPT_ADV_COILONANG "Conversion method for SPT_adv_CoilOnAng" RAT_FUNC "%10.1" "adv" COEFFS 0.000000 1.000000 0.000000 0.000000 0.000000 1.000000 /end COMPU_METHOD
/* Scalar measurable for DDE 'SPT_deg_DwellTime'. */
/begin MEASUREMENT SPT_deg_DwellTime "Dwell time in degrees of crank rotation" FLOAT32_IEEE CU_SPT_DEG_DWELLTIME 1 100 0.0 360.0 ECU_ADDRESS 0x4000329c BYTE_ORDER MSB_FIRST /end MEASUREMENT
/begin COMPU_METHOD CU_SPT_DEG_DWELLTIME "Conversion method for SPT_deg_DwellTime" RAT_FUNC "%10.2" "deg" COEFFS 0.000000 1.000000 0.000000 0.000000 0.000000 1.000000 /end COMPU_METHOD
/* Scalar measurable for DDE 'SPT_ms_DwellTime'. */
/begin MEASUREMENT SPT_ms_DwellTime "Final dwell time value" FLOAT32_IEEE CU_SPT_MS_DWELLTIME 1 100 0.0 20.0 ECU_ADDRESS 0x400032a0 BYTE_ORDER MSB_FIRST /end MEASUREMENT
/begin COMPU_METHOD CU_SPT_MS_DWELLTIME "Conversion method for SPT_ms_DwellTime" RAT_FUNC "%10.2" "ms" COEFFS 0.000000 1.000000 0.000000 0.000000 0.000000 1.000000 /end COMPU_METHOD
/* Scalar measurable for DDE 'SPT_ms_DwellTimeRaw'. */
/begin MEASUREMENT SPT_ms_DwellTimeRaw "Raw spark dwell time" FLOAT32_IEEE CU_SPT_MS_DWELLTIMERAW 1 100 0.0 10.0 ECU_ADDRESS 0x400032a8 BYTE_ORDER MSB_FIRST /end MEASUREMENT
/begin COMPU_METHOD CU_SPT_MS_DWELLTIMERAW "Conversion method for SPT_ms_DwellTimeRaw" RAT_FUNC "%10.2" "ms" COEFFS 0.000000 1.000000 0.000000 0.000000 0.000000 1.000000 /end COMPU_METHOD
/* Scalar measurable for DDE 'SPT_ms_MaxDwellTime'. */
/begin MEASUREMENT SPT_ms_MaxDwellTime "Calculated dwell limit based on current engine speed" FLOAT32_IEEE CU_SPT_MS_MAXDWELLTIME 1 100 0.0 0.0 ECU_ADDRESS 0x400032a4 BYTE_ORDER MSB_FIRST /end MEASUREMENT
/begin COMPU_METHOD CU_SPT_MS_MAXDWELLTIME "Conversion method for SPT_ms_MaxDwellTime" RAT_FUNC "%10.3" "ms" COEFFS 0.000000 1.000000 0.000000 0.000000 0.000000 1.000000 /end COMPU_METHOD
/* Scalar measurable for DDE 'STR_b_ManualStarter'. */
/begin MEASUREMENT STR_b_ManualStarter "Displayable- global fault management control signal, sent to each FBM" UBYTE CU_STR_B_MANUALSTARTER 1 100 0.0 1.0 ECU_ADDRESS 0x40002f2b BYTE_ORDER MSB_FIRST /end MEASUREMENT
/begin COMPU_METHOD CU_STR_B_MANUALSTARTER "Conversion method for STR_b_ManualStarter" RAT_FUNC "%10.0" "b" COEFFS 0.000000 1.000000 0.000000 0.000000 0.000000 1.000000 /end COMPU_METHOD
/* Scalar measurable for DDE 'SYS_EngSpedDelta1'. */
/begin MEASUREMENT SYS_EngSpedDelta1 "(not defined)" FLOAT32_IEEE CU_SYS_ENGSPEDDELTA1 1 100 -10000.0 10000.0 ECU_ADDRESS 0x400030b0 BYTE_ORDER MSB_FIRST /end MEASUREMENT
/begin COMPU_METHOD CU_SYS_ENGSPEDDELTA1 "Conversion method for SYS_EngSpedDelta1" RAT_FUNC "%10.3" "RPM" COEFFS 0.000000 1.000000 0.000000 0.000000 0.000000 1.000000 /end COMPU_METHOD
/* Scalar measurable for DDE 'SYS_EngSpedDelta1_after'. */
/begin MEASUREMENT SYS_EngSpedDelta1_after "(not defined)" FLOAT32_IEEE CU_SYS_ENGSPEDDELTA1_AFTER 1 100 -10000.0 10000.0 ECU_ADDRESS 0x400030ac BYTE_ORDER MSB_FIRST /end MEASUREMENT
/begin COMPU_METHOD CU_SYS_ENGSPEDDELTA1_AFTER "Conversion method for SYS_EngSpedDelta1_after" RAT_FUNC "%10.3" "RPM" COEFFS 0.000000 1.000000 0.000000 0.000000 0.000000 1.000000 /end COMPU_METHOD
/* Scalar measurable for DDE 'SYS_EngSpedDelta2'. */
/begin MEASUREMENT SYS_EngSpedDelta2 "(not defined)" FLOAT32_IEEE CU_SYS_ENGSPEDDELTA2 1 100 -10000.0 10000.0 ECU_ADDRESS 0x400030a0 BYTE_ORDER MSB_FIRST /end MEASUREMENT
/begin COMPU_METHOD CU_SYS_ENGSPEDDELTA2 "Conversion method for SYS_EngSpedDelta2" RAT_FUNC "%10.3" "RPM" COEFFS 0.000000 1.000000 0.000000 0.000000 0.000000 1.000000 /end COMPU_METHOD
/* Scalar measurable for DDE 'SYS_EngSpedDelta2_after'. */
/begin MEASUREMENT SYS_EngSpedDelta2_after "(not defined)" FLOAT32_IEEE CU_SYS_ENGSPEDDELTA2_AFTER 1 100 -10000.0 10000.0 ECU_ADDRESS 0x4000309c BYTE_ORDER MSB_FIRST /end MEASUREMENT
/begin COMPU_METHOD CU_SYS_ENGSPEDDELTA2_AFTER "Conversion method for SYS_EngSpedDelta2_after" RAT_FUNC "%10.3" "RPM" COEFFS 0.000000 1.000000 0.000000 0.000000 0.000000 1.000000 /end COMPU_METHOD
/* Scalar measurable for DDE 'SYS_EngSpedDelta3'. */
/begin MEASUREMENT SYS_EngSpedDelta3 "(not defined)" FLOAT32_IEEE CU_SYS_ENGSPEDDELTA3 1 100 -10000.0 10000.0 ECU_ADDRESS 0x40003090 BYTE_ORDER MSB_FIRST /end MEASUREMENT
/begin COMPU_METHOD CU_SYS_ENGSPEDDELTA3 "Conversion method for SYS_EngSpedDelta3" RAT_FUNC "%10.3" "RPM" COEFFS 0.000000 1.000000 0.000000 0.000000 0.000000 1.000000 /end COMPU_METHOD
/* Scalar measurable for DDE 'SYS_EngSpedDelta3_after'. */
/begin MEASUREMENT SYS_EngSpedDelta3_after "(not defined)" FLOAT32_IEEE CU_SYS_ENGSPEDDELTA3_AFTER 1 100 -10000.0 10000.0 ECU_ADDRESS 0x4000308c BYTE_ORDER MSB_FIRST /end MEASUREMENT
/begin COMPU_METHOD CU_SYS_ENGSPEDDELTA3_AFTER "Conversion method for SYS_EngSpedDelta3_after" RAT_FUNC "%10.3" "RPM" COEFFS 0.000000 1.000000 0.000000 0.000000 0.000000 1.000000 /end COMPU_METHOD
/* Scalar measurable for DDE 'SYS_EngSpedDelta4'. */
/begin MEASUREMENT SYS_EngSpedDelta4 "(not defined)" FLOAT32_IEEE CU_SYS_ENGSPEDDELTA4 1 100 -10000.0 10000.0 ECU_ADDRESS 0x40003080 BYTE_ORDER MSB_FIRST /end MEASUREMENT
/begin COMPU_METHOD CU_SYS_ENGSPEDDELTA4 "Conversion method for SYS_EngSpedDelta4" RAT_FUNC "%10.3" "RPM" COEFFS 0.000000 1.000000 0.000000 0.000000 0.000000 1.000000 /end COMPU_METHOD
/* Scalar measurable for DDE 'SYS_EngSpedDelta4_after'. */
/begin MEASUREMENT SYS_EngSpedDelta4_after "(not defined)" FLOAT32_IEEE CU_SYS_ENGSPEDDELTA4_AFTER 1 100 -10000.0 10000.0 ECU_ADDRESS 0x4000307c BYTE_ORDER MSB_FIRST /end MEASUREMENT
/begin COMPU_METHOD CU_SYS_ENGSPEDDELTA4_AFTER "Conversion method for SYS_EngSpedDelta4_after" RAT_FUNC "%10.3" "RPM" COEFFS 0.000000 1.000000 0.000000 0.000000 0.000000 1.000000 /end COMPU_METHOD
/* Scalar measurable for DDE 'SYS_NU_CrankWheelDecodeErr'. */
/begin MEASUREMENT SYS_NU_CrankWheelDecodeErr "Crank wheel error status" UWORD CU_SYS_NU_CRANKWHEELDECODEERR 1 100 0.0 65535.0 ECU_ADDRESS 0x4000302c BYTE_ORDER MSB_FIRST /end MEASUREMENT
/begin COMPU_METHOD CU_SYS_NU_CRANKWHEELDECODEERR "Conversion method for SYS_NU_CrankWheelDecodeErr" RAT_FUNC "%10.0" "NU" COEFFS 0.000000 1.000000 0.000000 0.000000 0.000000 1.000000 /end COMPU_METHOD
/* Scalar measurable for DDE 'SYS_NU_CrankWheelDecodeStat'. */
/begin MEASUREMENT SYS_NU_CrankWheelDecodeStat "Crank wheel decode status" UWORD CU_SYS_NU_CRANKWHEELDECODESTAT 1 100 0.0 65535.0 ECU_ADDRESS 0x4000302e BYTE_ORDER MSB_FIRST /end MEASUREMENT
/begin COMPU_METHOD CU_SYS_NU_CRANKWHEELDECODESTAT "Conversion method for SYS_NU_CrankWheelDecodeStat" RAT_FUNC "%10.0" "NU" COEFFS 0.000000 1.000000 0.000000 0.000000 0.000000 1.000000 /end COMPU_METHOD
/* Scalar measurable for DDE 'SYS_NU_CurrCyl'. */
/begin MEASUREMENT SYS_NU_CurrCyl "Current cyclinder" UBYTE CU_SYS_NU_CURRCYL 1 100 0.0 4.0 ECU_ADDRESS 0x40002fd9 BYTE_ORDER MSB_FIRST /end MEASUREMENT
/begin COMPU_METHOD CU_SYS_NU_CURRCYL "Conversion method for SYS_NU_CurrCyl" RAT_FUNC "%10.0" "NU" COEFFS 0.000000 1.000000 0.000000 0.000000 0.000000 1.000000 /end COMPU_METHOD
/* Scalar measurable for DDE 'SYS_NU_EngSyncReq'. */
/begin MEASUREMENT SYS_NU_EngSyncReq "SYSk_e_NoSync,SYSk_e_CrankRegionSync,SYSk_e_HalfEngSync,SYSk_e_FullEngSync" FLOAT32_IEEE CU_SYS_NU_ENGSYNCREQ 1 100 0.0 3.0 ECU_ADDRESS 0x40003025 BYTE_ORDER MSB_FIRST /end MEASUREMENT
/begin COMPU_METHOD CU_SYS_NU_ENGSYNCREQ "Conversion method for SYS_NU_EngSyncReq" RAT_FUNC "%10.0" "NU" COEFFS 0.000000 1.000000 0.000000 0.000000 0.000000 1.000000 /end COMPU_METHOD
/* Scalar measurable for DDE 'SYS_NU_EngToothOfst'. */
/begin MEASUREMENT SYS_NU_EngToothOfst "(not defined)" SWORD CU_SYS_NU_ENGTOOTHOFST 1 100 0.0 10.0 ECU_ADDRESS 0x40003026 BYTE_ORDER MSB_FIRST /end MEASUREMENT
/begin COMPU_METHOD CU_SYS_NU_ENGTOOTHOFST "Conversion method for SYS_NU_EngToothOfst" RAT_FUNC "%10.0" "NU" COEFFS 0.000000 1.000000 0.000000 0.000000 0.000000 1.000000 /end COMPU_METHOD
/* Scalar measurable for DDE 'SYS_NU_ResetType'. */
/begin MEASUREMENT SYS_NU_ResetType "Bit flags for reset status" UBYTE CU_SYS_NU_RESETTYPE 1 100 0.0 128.0 ECU_ADDRESS 0x40003014 BYTE_ORDER MSB_FIRST /end MEASUREMENT
/begin COMPU_METHOD CU_SYS_NU_RESETTYPE "Conversion method for SYS_NU_ResetType" RAT_FUNC "%10.0" "NU" COEFFS 0.000000 1.000000 0.000000 0.000000 0.000000 1.000000 /end COMPU_METHOD
/* Scalar measurable for DDE 'SYS_b_CrankAngValid'. */
/begin MEASUREMENT SYS_b_CrankAngValid "Displayable" UBYTE CU_SYS_B_CRANKANGVALID 1 100 0.0 1.0 ECU_ADDRESS 0x40003828 BYTE_ORDER MSB_FIRST /end MEASUREMENT
/begin COMPU_METHOD CU_SYS_B_CRANKANGVALID "Conversion method for SYS_b_CrankAngValid" RAT_FUNC "%10.0" "b" COEFFS 0.000000 1.000000 0.000000 0.000000 0.000000 1.000000 /end COMPU_METHOD
/* Scalar measurable for DDE 'SYS_b_CrankSync'. */
/begin MEASUREMENT SYS_b_CrankSync "Crank sync flag" UBYTE CU_SYS_B_CRANKSYNC 1 100 0.0 1.0 ECU_ADDRESS 0x40002f73 BYTE_ORDER MSB_FIRST /end MEASUREMENT
/begin COMPU_METHOD CU_SYS_B_CRANKSYNC "Conversion method for SYS_b_CrankSync" RAT_FUNC "%10.0" "b" COEFFS 0.000000 1.000000 0.000000 0.000000 0.000000 1.000000 /end COMPU_METHOD
/* Scalar measurable for DDE 'SYS_b_CurrCylValid'. */
/begin MEASUREMENT SYS_b_CurrCylValid "Current cyclinder valid flag" UBYTE CU_SYS_B_CURRCYLVALID 1 100 0.0 1.0 ECU_ADDRESS 0x40002e2c BYTE_ORDER MSB_FIRST /end MEASUREMENT
/begin COMPU_METHOD CU_SYS_B_CURRCYLVALID "Conversion method for SYS_b_CurrCylValid" RAT_FUNC "%10.0" "b" COEFFS 0.000000 1.000000 0.000000 0.000000 0.000000 1.000000 /end COMPU_METHOD
/* Scalar measurable for DDE 'SYS_b_EngSync'. */
/begin MEASUREMENT SYS_b_EngSync "Engine sync status" UBYTE CU_SYS_B_ENGSYNC 1 100 0.0 1.0 ECU_ADDRESS 0x40002f72 BYTE_ORDER MSB_FIRST /end MEASUREMENT
/begin COMPU_METHOD CU_SYS_B_ENGSYNC "Conversion method for SYS_b_EngSync" RAT_FUNC "%10.0" "b" COEFFS 0.000000 1.000000 0.000000 0.000000 0.000000 1.000000 /end COMPU_METHOD
/* Scalar measurable for DDE 'SYS_b_SyncInPhase'. */
/begin MEASUREMENT SYS_b_SyncInPhase "(not defined)" UBYTE CU_SYS_B_SYNCINPHASE 1 100 0.0 1.0 ECU_ADDRESS 0x40002fd1 BYTE_ORDER MSB_FIRST /end MEASUREMENT
/begin COMPU_METHOD CU_SYS_B_SYNCINPHASE "Conversion method for SYS_b_SyncInPhase" RAT_FUNC "%10.0" "b" COEFFS 0.000000 1.000000 0.000000 0.000000 0.000000 1.000000 /end COMPU_METHOD
/* Scalar measurable for DDE 'SYS_b_SyncOutBy360'. */
/begin MEASUREMENT SYS_b_SyncOutBy360 "(not defined)" UBYTE CU_SYS_B_SYNCOUTBY360 1 100 0.0 1.0 ECU_ADDRESS 0x40002fd0 BYTE_ORDER MSB_FIRST /end MEASUREMENT
/begin COMPU_METHOD CU_SYS_B_SYNCOUTBY360 "Conversion method for SYS_b_SyncOutBy360" RAT_FUNC "%10.0" "b" COEFFS 0.000000 1.000000 0.000000 0.000000 0.000000 1.000000 /end COMPU_METHOD
/* Scalar measurable for DDE 'SYS_b_TwoTeethMeas'. */
/begin MEASUREMENT SYS_b_TwoTeethMeas "(not defined)" UBYTE CU_SYS_B_TWOTEETHMEAS 1 100 0.0 1.0 ECU_ADDRESS 0x40002fd2 BYTE_ORDER MSB_FIRST /end MEASUREMENT
/begin COMPU_METHOD CU_SYS_B_TWOTEETHMEAS "Conversion method for SYS_b_TwoTeethMeas" RAT_FUNC "%10.0" "b" COEFFS 0.000000 1.000000 0.000000 0.000000 0.000000 1.000000 /end COMPU_METHOD
/* Scalar measurable for DDE 'SYS_cnt_LoopCounter'. */
/begin MEASUREMENT SYS_cnt_LoopCounter "Counter increments every loop.  Multiply by loop period to get actual time" ULONG CU_SYS_CNT_LOOPCOUNTER 1 100 0.0 4294967295.0 ECU_ADDRESS 0x40003078 BYTE_ORDER MSB_FIRST /end MEASUREMENT
/begin COMPU_METHOD CU_SYS_CNT_LOOPCOUNTER "Conversion method for SYS_cnt_LoopCounter" RAT_FUNC "%10.0" "cnt" COEFFS 0.000000 1.000000 0.000000 0.000000 0.000000 1.000000 /end COMPU_METHOD
/* Scalar measurable for DDE 'SYS_cnt_NumAngularFuncCalls'. */
/begin MEASUREMENT SYS_cnt_NumAngularFuncCalls "Displayable" ULONG CU_SYS_CNT_NUMANGULARFUNCCALLS 1 100 0.0 4294967295.0 ECU_ADDRESS 0x40003074 BYTE_ORDER MSB_FIRST /end MEASUREMENT
/begin COMPU_METHOD CU_SYS_CNT_NUMANGULARFUNCCALLS "Conversion method for SYS_cnt_NumAngularFuncCalls" RAT_FUNC "%10.0" "cnt" COEFFS 0.000000 1.000000 0.000000 0.000000 0.000000 1.000000 /end COMPU_METHOD
/* Scalar measurable for DDE 'SYS_deg_CamTooth1'. */
/begin MEASUREMENT SYS_deg_CamTooth1 "(not defined)" FLOAT32_IEEE CU_SYS_DEG_CAMTOOTH1 1 100 0.0 720.0 ECU_ADDRESS 0x40003980 BYTE_ORDER MSB_FIRST /end MEASUREMENT
/begin COMPU_METHOD CU_SYS_DEG_CAMTOOTH1 "Conversion method for SYS_deg_CamTooth1" RAT_FUNC "%10.0" "deg" COEFFS 0.000000 1.000000 0.000000 0.000000 0.000000 1.000000 /end COMPU_METHOD
/* Scalar measurable for DDE 'SYS_deg_CamTooth2'. */
/begin MEASUREMENT SYS_deg_CamTooth2 "(not defined)" FLOAT32_IEEE CU_SYS_DEG_CAMTOOTH2 1 100 0.0 720.0 ECU_ADDRESS 0x4000397c BYTE_ORDER MSB_FIRST /end MEASUREMENT
/begin COMPU_METHOD CU_SYS_DEG_CAMTOOTH2 "Conversion method for SYS_deg_CamTooth2" RAT_FUNC "%10.0" "deg" COEFFS 0.000000 1.000000 0.000000 0.000000 0.000000 1.000000 /end COMPU_METHOD
/* Scalar measurable for DDE 'SYS_deg_CamTooth3'. */
/begin MEASUREMENT SYS_deg_CamTooth3 "(not defined)" FLOAT32_IEEE CU_SYS_DEG_CAMTOOTH3 1 100 0.0 720.0 ECU_ADDRESS 0x40003974 BYTE_ORDER MSB_FIRST /end MEASUREMENT
/begin COMPU_METHOD CU_SYS_DEG_CAMTOOTH3 "Conversion method for SYS_deg_CamTooth3" RAT_FUNC "%10.0" "deg" COEFFS 0.000000 1.000000 0.000000 0.000000 0.000000 1.000000 /end COMPU_METHOD
/* Scalar measurable for DDE 'SYS_deg_CamTooth4'. */
/begin MEASUREMENT SYS_deg_CamTooth4 "(not defined)" FLOAT32_IEEE CU_SYS_DEG_CAMTOOTH4 1 100 0.0 720.0 ECU_ADDRESS 0x40003970 BYTE_ORDER MSB_FIRST /end MEASUREMENT
/begin COMPU_METHOD CU_SYS_DEG_CAMTOOTH4 "Conversion method for SYS_deg_CamTooth4" RAT_FUNC "%10.0" "deg" COEFFS 0.000000 1.000000 0.000000 0.000000 0.000000 1.000000 /end COMPU_METHOD
/* Scalar measurable for DDE 'SYS_deg_CrankAng'. */
/begin MEASUREMENT SYS_deg_CrankAng "Crank angle relative to missing tooth region" FLOAT32_IEEE CU_SYS_DEG_CRANKANG 1 100 0.0 0.0 ECU_ADDRESS 0x4000382c BYTE_ORDER MSB_FIRST /end MEASUREMENT
/begin COMPU_METHOD CU_SYS_DEG_CRANKANG "Conversion method for SYS_deg_CrankAng" RAT_FUNC "%10.0" "deg" COEFFS 0.000000 1.000000 0.000000 0.000000 0.000000 1.000000 /end COMPU_METHOD
/* Scalar measurable for DDE 'SYS_deg_EngAngOfst'. */
/begin MEASUREMENT SYS_deg_EngAngOfst "(not defined)" FLOAT32_IEEE CU_SYS_DEG_ENGANGOFST 1 100 0.0 720.0 ECU_ADDRESS 0x40003984 BYTE_ORDER MSB_FIRST /end MEASUREMENT
/begin COMPU_METHOD CU_SYS_DEG_ENGANGOFST "Conversion method for SYS_deg_EngAngOfst" RAT_FUNC "%10.0" "deg" COEFFS 0.000000 1.000000 0.000000 0.000000 0.000000 1.000000 /end COMPU_METHOD
/* Scalar measurable for DDE 'SYS_deg_EngAngOfstReq'. */
/begin MEASUREMENT SYS_deg_EngAngOfstReq "(not defined)" FLOAT32_IEEE CU_SYS_DEG_ENGANGOFSTREQ 1 100 -720.0 720.0 ECU_ADDRESS 0x40003978 BYTE_ORDER MSB_FIRST /end MEASUREMENT
/begin COMPU_METHOD CU_SYS_DEG_ENGANGOFSTREQ "Conversion method for SYS_deg_EngAngOfstReq" RAT_FUNC "%10.3" "deg" COEFFS 0.000000 1.000000 0.000000 0.000000 0.000000 1.000000 /end COMPU_METHOD
/* Scalar measurable for DDE 'SYS_e_CAN0_State'. */
/begin MEASUREMENT SYS_e_CAN0_State "CAN0 bus state" FLOAT32_IEEE CU_SYS_E_CAN0_STATE 1 100 0.0 2.0 ECU_ADDRESS 0x4000369c BYTE_ORDER MSB_FIRST /end MEASUREMENT
/begin COMPU_METHOD CU_SYS_E_CAN0_STATE "Conversion method for SYS_e_CAN0_State" TAB_VERB "%12.0" "e" COMPU_TAB_REF CT_SYS_E_CAN0_STATE /end COMPU_METHOD
/begin COMPU_VTAB CT_SYS_E_CAN0_STATE "Conversion method for SYS_e_CAN0_State" TAB_VERB 3 0 "SYSk_e_CAN_Active" 1 "SYSk_e_CAN_ErrorPassive" 2 "SYSk_e_CAN_BusOff" /end COMPU_VTAB
/* Scalar measurable for DDE 'SYS_e_CAN1_State'. */
/begin MEASUREMENT SYS_e_CAN1_State "CAN1 bus state" FLOAT32_IEEE CU_SYS_E_CAN1_STATE 1 100 0.0 2.0 ECU_ADDRESS 0x40003694 BYTE_ORDER MSB_FIRST /end MEASUREMENT
/begin COMPU_METHOD CU_SYS_E_CAN1_STATE "Conversion method for SYS_e_CAN1_State" TAB_VERB "%12.0" "e" COMPU_TAB_REF CT_SYS_E_CAN1_STATE /end COMPU_METHOD
/begin COMPU_VTAB CT_SYS_E_CAN1_STATE "Conversion method for SYS_e_CAN1_State" TAB_VERB 3 0 "SYSk_e_CAN_Active" 1 "SYSk_e_CAN_ErrorPassive" 2 "SYSk_e_CAN_BusOff" /end COMPU_VTAB
/* Scalar measurable for DDE 'SYS_e_CAN3_State'. */
/begin MEASUREMENT SYS_e_CAN3_State "CAN3 bus state" FLOAT32_IEEE CU_SYS_E_CAN3_STATE 1 100 0.0 2.0 ECU_ADDRESS 0x40003698 BYTE_ORDER MSB_FIRST /end MEASUREMENT
/begin COMPU_METHOD CU_SYS_E_CAN3_STATE "Conversion method for SYS_e_CAN3_State" TAB_VERB "%12.0" "e" COMPU_TAB_REF CT_SYS_E_CAN3_STATE /end COMPU_METHOD
/begin COMPU_VTAB CT_SYS_E_CAN3_STATE "Conversion method for SYS_e_CAN3_State" TAB_VERB 3 0 "SYSk_e_CAN_Active" 1 "SYSk_e_CAN_ErrorPassive" 2 "SYSk_e_CAN_BusOff" /end COMPU_VTAB
/* Scalar measurable for DDE 'SYS_e_EngSync'. */
/begin MEASUREMENT SYS_e_EngSync "(not defined)" FLOAT32_IEEE CU_SYS_E_ENGSYNC 1 100 0.0 3.0 ECU_ADDRESS 0x40003988 BYTE_ORDER MSB_FIRST /end MEASUREMENT
/begin COMPU_METHOD CU_SYS_E_ENGSYNC "Conversion method for SYS_e_EngSync" RAT_FUNC "%10.0" "e" COEFFS 0.000000 1.000000 0.000000 0.000000 0.000000 1.000000 /end COMPU_METHOD
/* Scalar measurable for DDE 'SYS_s_BootDuration'. */
/begin MEASUREMENT SYS_s_BootDuration "Time taken for ECU boot" FLOAT32_IEEE CU_SYS_S_BOOTDURATION 1 100 0.0 100.0 ECU_ADDRESS 0x400036b4 BYTE_ORDER MSB_FIRST /end MEASUREMENT
/begin COMPU_METHOD CU_SYS_S_BOOTDURATION "Conversion method for SYS_s_BootDuration" RAT_FUNC "%10.6" "s" COEFFS 0.000000 1.000000 0.000000 0.000000 0.000000 1.000000 /end COMPU_METHOD
/* Scalar measurable for DDE 'SYS_us_LoopA_Task'. */
/begin MEASUREMENT SYS_us_LoopA_Task "Duration of periodic task (last measured valued)" ULONG CU_SYS_US_LOOPA_TASK 1 100 0.0 0.0 ECU_ADDRESS 0x40003064 BYTE_ORDER MSB_FIRST /end MEASUREMENT
/begin COMPU_METHOD CU_SYS_US_LOOPA_TASK "Conversion method for SYS_us_LoopA_Task" RAT_FUNC "%10.0" "us" COEFFS 0.000000 1.000000 0.000000 0.000000 0.000000 1.000000 /end COMPU_METHOD
/* Scalar measurable for DDE 'SYS_us_LoopA_TaskMax'. */
/begin MEASUREMENT SYS_us_LoopA_TaskMax "Duration of periodic task (maximum since power up)" ULONG CU_SYS_US_LOOPA_TASKMAX 1 100 0.0 0.0 ECU_ADDRESS 0x4000305c BYTE_ORDER MSB_FIRST /end MEASUREMENT
/begin COMPU_METHOD CU_SYS_US_LOOPA_TASKMAX "Conversion method for SYS_us_LoopA_TaskMax" RAT_FUNC "%10.0" "us" COEFFS 0.000000 1.000000 0.000000 0.000000 0.000000 1.000000 /end COMPU_METHOD
/* Scalar measurable for DDE 'TAR_Nm_EEC1Tq'. */
/begin MEASUREMENT TAR_Nm_EEC1Tq "(not defined)" FLOAT32_IEEE CU_TAR_NM_EEC1TQ 1 100 0.0 0.0 ECU_ADDRESS 0x400032b0 BYTE_ORDER MSB_FIRST /end MEASUREMENT
/begin COMPU_METHOD CU_TAR_NM_EEC1TQ "Conversion method for TAR_Nm_EEC1Tq" RAT_FUNC "%10.0" "Nm" COEFFS 0.000000 1.000000 0.000000 0.000000 0.000000 1.000000 /end COMPU_METHOD
/* Scalar measurable for DDE 'TAR_Nm_EEC1Tqt'. */
/begin MEASUREMENT TAR_Nm_EEC1Tqt "(not defined)" FLOAT32_IEEE CU_TAR_NM_EEC1TQT 1 100 0.0 0.0 ECU_ADDRESS 0x400032ac BYTE_ORDER MSB_FIRST /end MEASUREMENT
/begin COMPU_METHOD CU_TAR_NM_EEC1TQT "Conversion method for TAR_Nm_EEC1Tqt" RAT_FUNC "%10.0" "Nm" COEFFS 0.000000 1.000000 0.000000 0.000000 0.000000 1.000000 /end COMPU_METHOD
/* Scalar measurable for DDE 'TAR_Nm_EngDmnd'. */
/begin MEASUREMENT TAR_Nm_EngDmnd "(not defined)" FLOAT32_IEEE CU_TAR_NM_ENGDMND 1 100 0.0 0.0 ECU_ADDRESS 0x4000355c BYTE_ORDER MSB_FIRST /end MEASUREMENT
/begin COMPU_METHOD CU_TAR_NM_ENGDMND "Conversion method for TAR_Nm_EngDmnd" RAT_FUNC "%10.0" "Nm" COEFFS 0.000000 1.000000 0.000000 0.000000 0.000000 1.000000 /end COMPU_METHOD
/* Scalar measurable for DDE 'TAR_Nm_J1939DrvrDmndTq'. */
/begin MEASUREMENT TAR_Nm_J1939DrvrDmndTq "(not defined)" FLOAT32_IEEE CU_TAR_NM_J1939DRVRDMNDTQ 1 100 3.0 3.0 ECU_ADDRESS 0x40003298 BYTE_ORDER MSB_FIRST /end MEASUREMENT
/begin COMPU_METHOD CU_TAR_NM_J1939DRVRDMNDTQ "Conversion method for TAR_Nm_J1939DrvrDmndTq" RAT_FUNC "%10.0" "Nm" COEFFS 0.000000 1.000000 0.000000 0.000000 0.000000 1.000000 /end COMPU_METHOD
/* Scalar measurable for DDE 'TAR_Nm_MaxTqTable'. */
/begin MEASUREMENT TAR_Nm_MaxTqTable "Maximum feasible torque at current RPM" FLOAT32_IEEE CU_TAR_NM_MAXTQTABLE 1 100 0.0 0.0 ECU_ADDRESS 0x40003600 BYTE_ORDER MSB_FIRST /end MEASUREMENT
/begin COMPU_METHOD CU_TAR_NM_MAXTQTABLE "Conversion method for TAR_Nm_MaxTqTable" RAT_FUNC "%10.1" "Nm" COEFFS 0.000000 1.000000 0.000000 0.000000 0.000000 1.000000 /end COMPU_METHOD
/* Scalar measurable for DDE 'TAR_Nm_RawArbTqRqst'. */
/begin MEASUREMENT TAR_Nm_RawArbTqRqst "Raw arbitrated torque request" FLOAT32_IEEE CU_TAR_NM_RAWARBTQRQST 1 100 0.0 0.0 ECU_ADDRESS 0x40003570 BYTE_ORDER MSB_FIRST /end MEASUREMENT
/begin COMPU_METHOD CU_TAR_NM_RAWARBTQRQST "Conversion method for TAR_Nm_RawArbTqRqst" RAT_FUNC "%10.1" "Nm" COEFFS 0.000000 1.000000 0.000000 0.000000 0.000000 1.000000 /end COMPU_METHOD
/* Scalar measurable for DDE 'TAR_Nm_TqFromAir'. */
/begin MEASUREMENT TAR_Nm_TqFromAir "(not defined)" FLOAT32_IEEE CU_TAR_NM_TQFROMAIR 1 100 0.0 0.0 ECU_ADDRESS 0x400032bc BYTE_ORDER MSB_FIRST /end MEASUREMENT
/begin COMPU_METHOD CU_TAR_NM_TQFROMAIR "Conversion method for TAR_Nm_TqFromAir" RAT_FUNC "%10.0" "Nm" COEFFS 0.000000 1.000000 0.000000 0.000000 0.000000 1.000000 /end COMPU_METHOD
/* Scalar measurable for DDE 'TAR_Nm_TqFromMAP'. */
/begin MEASUREMENT TAR_Nm_TqFromMAP "(not defined)" FLOAT32_IEEE CU_TAR_NM_TQFROMMAP 1 100 0.0 0.0 ECU_ADDRESS 0x400032c0 BYTE_ORDER MSB_FIRST /end MEASUREMENT
/begin COMPU_METHOD CU_TAR_NM_TQFROMMAP "Conversion method for TAR_Nm_TqFromMAP" RAT_FUNC "%10.0" "Nm" COEFFS 0.000000 1.000000 0.000000 0.000000 0.000000 1.000000 /end COMPU_METHOD
/* Scalar measurable for DDE 'TAR_Nm_TqFromMAP_Idle'. */
/begin MEASUREMENT TAR_Nm_TqFromMAP_Idle "(not defined)" FLOAT32_IEEE CU_TAR_NM_TQFROMMAP_IDLE 1 100 0.0 0.0 ECU_ADDRESS 0x400032c4 BYTE_ORDER MSB_FIRST /end MEASUREMENT
/begin COMPU_METHOD CU_TAR_NM_TQFROMMAP_IDLE "Conversion method for TAR_Nm_TqFromMAP_Idle" RAT_FUNC "%10.0" "Nm" COEFFS 0.000000 1.000000 0.000000 0.000000 0.000000 1.000000 /end COMPU_METHOD
/* Scalar measurable for DDE 'TAR_Nm_TqRqst'. */
/begin MEASUREMENT TAR_Nm_TqRqst "Arbitrated torque request" FLOAT32_IEEE CU_TAR_NM_TQRQST 1 100 0.0 0.0 ECU_ADDRESS 0x40003550 BYTE_ORDER MSB_FIRST /end MEASUREMENT
/begin COMPU_METHOD CU_TAR_NM_TQRQST "Conversion method for TAR_Nm_TqRqst" RAT_FUNC "%10.2" "Nm" COEFFS 0.000000 1.000000 0.000000 0.000000 0.000000 1.000000 /end COMPU_METHOD
/* Scalar measurable for DDE 'TAR_Nm_TqiFromMAP_Idle'. */
/begin MEASUREMENT TAR_Nm_TqiFromMAP_Idle "(not defined)" FLOAT32_IEEE CU_TAR_NM_TQIFROMMAP_IDLE 1 100 0.0 0.0 ECU_ADDRESS 0x400032b8 BYTE_ORDER MSB_FIRST /end MEASUREMENT
/begin COMPU_METHOD CU_TAR_NM_TQIFROMMAP_IDLE "Conversion method for TAR_Nm_TqiFromMAP_Idle" RAT_FUNC "%10.0" "Nm" COEFFS 0.000000 1.000000 0.000000 0.000000 0.000000 1.000000 /end COMPU_METHOD
/* Scalar measurable for DDE 'TAR_Nm_TqiFromModel'. */
/begin MEASUREMENT TAR_Nm_TqiFromModel "(not defined)" FLOAT32_IEEE CU_TAR_NM_TQIFROMMODEL 1 100 0.0 0.0 ECU_ADDRESS 0x400032b4 BYTE_ORDER MSB_FIRST /end MEASUREMENT
/begin COMPU_METHOD CU_TAR_NM_TQIFROMMODEL "Conversion method for TAR_Nm_TqiFromModel" RAT_FUNC "%10.0" "Nm" COEFFS 0.000000 1.000000 0.000000 0.000000 0.000000 1.000000 /end COMPU_METHOD
/* Scalar measurable for DDE 'TAR_b_DTC_TqLimit'. */
/begin MEASUREMENT TAR_b_DTC_TqLimit "Displayable" UBYTE CU_TAR_B_DTC_TQLIMIT 1 100 0.0 1.0 ECU_ADDRESS 0x40002ed1 BYTE_ORDER MSB_FIRST /end MEASUREMENT
/begin COMPU_METHOD CU_TAR_B_DTC_TQLIMIT "Conversion method for TAR_b_DTC_TqLimit" RAT_FUNC "%10.0" "b" COEFFS 0.000000 1.000000 0.000000 0.000000 0.000000 1.000000 /end COMPU_METHOD
/* Scalar measurable for DDE 'TAR_b_LimpHome'. */
/begin MEASUREMENT TAR_b_LimpHome "Displayable" UBYTE CU_TAR_B_LIMPHOME 1 100 0.0 1.0 ECU_ADDRESS 0x40002ee1 BYTE_ORDER MSB_FIRST /end MEASUREMENT
/begin COMPU_METHOD CU_TAR_B_LIMPHOME "Conversion method for TAR_b_LimpHome" RAT_FUNC "%10.0" "b" COEFFS 0.000000 1.000000 0.000000 0.000000 0.000000 1.000000 /end COMPU_METHOD
/* Scalar measurable for DDE 'TAR_b_TqFromMAP_act'. */
/begin MEASUREMENT TAR_b_TqFromMAP_act "(not defined)" UBYTE CU_TAR_B_TQFROMMAP_ACT 1 100 0.0 1.0 ECU_ADDRESS 0x40002e93 BYTE_ORDER MSB_FIRST /end MEASUREMENT
/begin COMPU_METHOD CU_TAR_B_TQFROMMAP_ACT "Conversion method for TAR_b_TqFromMAP_act" RAT_FUNC "%10.0" "b" COEFFS 0.000000 1.000000 0.000000 0.000000 0.000000 1.000000 /end COMPU_METHOD
/* Scalar measurable for DDE 'TRF_Nm_TqHPF'. */
/begin MEASUREMENT TRF_Nm_TqHPF "Filter result" FLOAT32_IEEE CU_TRF_NM_TQHPF 1 100 0.0 0.0 ECU_ADDRESS 0x400034cc BYTE_ORDER MSB_FIRST /end MEASUREMENT
/begin COMPU_METHOD CU_TRF_NM_TQHPF "Conversion method for TRF_Nm_TqHPF" RAT_FUNC "%10.2" "Nm" COEFFS 0.000000 1.000000 0.000000 0.000000 0.000000 1.000000 /end COMPU_METHOD
/* Scalar measurable for DDE 'TRF_b_Actv'. */
/begin MEASUREMENT TRF_b_Actv "TRF enabled" UBYTE CU_TRF_B_ACTV 1 100 0.0 1.0 ECU_ADDRESS 0x40002ec0 BYTE_ORDER MSB_FIRST /end MEASUREMENT
/begin COMPU_METHOD CU_TRF_B_ACTV "Conversion method for TRF_b_Actv" RAT_FUNC "%10.0" "b" COEFFS 0.000000 1.000000 0.000000 0.000000 0.000000 1.000000 /end COMPU_METHOD
/* Scalar measurable for DDE 'TRF_b_Transient'. */
/begin MEASUREMENT TRF_b_Transient "TRF Rate of change enable criteria passed" UBYTE CU_TRF_B_TRANSIENT 1 100 0.0 1.0 ECU_ADDRESS 0x40002ec1 BYTE_ORDER MSB_FIRST /end MEASUREMENT
/begin COMPU_METHOD CU_TRF_B_TRANSIENT "Conversion method for TRF_b_Transient" RAT_FUNC "%10.0" "b" COEFFS 0.000000 1.000000 0.000000 0.000000 0.000000 1.000000 /end COMPU_METHOD
/* Scalar measurable for DDE 'TRF_lam_EnrichmentRqst'. */
/begin MEASUREMENT TRF_lam_EnrichmentRqst "TRF AFR modifier raw value" FLOAT32_IEEE CU_TRF_LAM_ENRICHMENTRQST 1 100 0.0 0.0 ECU_ADDRESS 0x400034c8 BYTE_ORDER MSB_FIRST /end MEASUREMENT
/begin COMPU_METHOD CU_TRF_LAM_ENRICHMENTRQST "Conversion method for TRF_lam_EnrichmentRqst" RAT_FUNC "%10.3" "lam" COEFFS 0.000000 1.000000 0.000000 0.000000 0.000000 1.000000 /end COMPU_METHOD
/* Scalar measurable for DDE 'TRF_lam_Trim'. */
/begin MEASUREMENT TRF_lam_Trim "Final AFR modifier (lambda adder)" FLOAT32_IEEE CU_TRF_LAM_TRIM 1 100 0.0 0.0 ECU_ADDRESS 0x400034c4 BYTE_ORDER MSB_FIRST /end MEASUREMENT
/begin COMPU_METHOD CU_TRF_LAM_TRIM "Conversion method for TRF_lam_Trim" RAT_FUNC "%10.2" "lam" COEFFS 0.000000 1.000000 0.000000 0.000000 0.000000 1.000000 /end COMPU_METHOD
/* Scalar measurable for DDE 'TRS_Nm_TqHPF'. */
/begin MEASUREMENT TRS_Nm_TqHPF "Filter result" FLOAT32_IEEE CU_TRS_NM_TQHPF 1 100 0.0 0.0 ECU_ADDRESS 0x40003488 BYTE_ORDER MSB_FIRST /end MEASUREMENT
/begin COMPU_METHOD CU_TRS_NM_TQHPF "Conversion method for TRS_Nm_TqHPF" RAT_FUNC "%10.2" "Nm" COEFFS 0.000000 1.000000 0.000000 0.000000 0.000000 1.000000 /end COMPU_METHOD
/* Scalar measurable for DDE 'TRS_Nm_TqHPF_Peak'. */
/begin MEASUREMENT TRS_Nm_TqHPF_Peak "Peak value of the Torque HPF" FLOAT32_IEEE CU_TRS_NM_TQHPF_PEAK 1 100 0.0 0.0 ECU_ADDRESS 0x40003484 BYTE_ORDER MSB_FIRST /end MEASUREMENT
/begin COMPU_METHOD CU_TRS_NM_TQHPF_PEAK "Conversion method for TRS_Nm_TqHPF_Peak" RAT_FUNC "%10.2" "Nm" COEFFS 0.000000 1.000000 0.000000 0.000000 0.000000 1.000000 /end COMPU_METHOD
/* Scalar measurable for DDE 'TRS_b_Transient'. */
/begin MEASUREMENT TRS_b_Transient "TRS transient detected" UBYTE CU_TRS_B_TRANSIENT 1 100 0.0 1.0 ECU_ADDRESS 0x40002ebe BYTE_ORDER MSB_FIRST /end MEASUREMENT
/begin COMPU_METHOD CU_TRS_B_TRANSIENT "Conversion method for TRS_b_Transient" RAT_FUNC "%10.0" "b" COEFFS 0.000000 1.000000 0.000000 0.000000 0.000000 1.000000 /end COMPU_METHOD
/* Scalar measurable for DDE 'TRS_ret_SparkRqst'. */
/begin MEASUREMENT TRS_ret_SparkRqst "Displayable" FLOAT32_IEEE CU_TRS_RET_SPARKRQST 1 100 0.0 0.0 ECU_ADDRESS 0x4000347c BYTE_ORDER MSB_FIRST /end MEASUREMENT
/begin COMPU_METHOD CU_TRS_RET_SPARKRQST "Conversion method for TRS_ret_SparkRqst" RAT_FUNC "%10.1" "ret" COEFFS 0.000000 1.000000 0.000000 0.000000 0.000000 1.000000 /end COMPU_METHOD
/* Scalar measurable for DDE 'TRS_ret_SparkRqstRaw'. */
/begin MEASUREMENT TRS_ret_SparkRqstRaw "Raw transient spark retard" FLOAT32_IEEE CU_TRS_RET_SPARKRQSTRAW 1 100 0.0 0.0 ECU_ADDRESS 0x40003480 BYTE_ORDER MSB_FIRST /end MEASUREMENT
/begin COMPU_METHOD CU_TRS_RET_SPARKRQSTRAW "Conversion method for TRS_ret_SparkRqstRaw" RAT_FUNC "%10.1" "ret" COEFFS 0.000000 1.000000 0.000000 0.000000 0.000000 1.000000 /end COMPU_METHOD
/* Scalar measurable for DDE 'TSS_b_OBDtimeOK'. */
/begin MEASUREMENT TSS_b_OBDtimeOK "Displayable" UBYTE CU_TSS_B_OBDTIMEOK 1 100 0.0 1.0 ECU_ADDRESS 0x40002f36 BYTE_ORDER MSB_FIRST /end MEASUREMENT
/begin COMPU_METHOD CU_TSS_B_OBDTIMEOK "Conversion method for TSS_b_OBDtimeOK" RAT_FUNC "%10.0" "b" COEFFS 0.000000 1.000000 0.000000 0.000000 0.000000 1.000000 /end COMPU_METHOD
/begin FUNCTION Signals "Group /ByType/Signals"
 /begin LOC_MEASUREMENT ETC_b_TP2_LearnFull ETC_b_TP2_LearnZero ETC_b_TP2_ZeroPosOOR ETC_b_TP_CorrFlt ETC_deg_Error ETC_deg_RelativeThRqst ETC_deg_RestPos ETC_deg_ThRqstFiltd ETC_deg_ThRqstHPF ETC_deg_VlvPos ETC_pct_AvgTP ETC_pct_Effort ETC_pct_FB ETC_pct_FF ETC_pct_Hyst ETC_pct_Kick ETC_pct_Kick_error ETC_pct_MotorCmd ETC_pct_MotorCmdVb ETC_pct_TP1 ETC_pct_TP2 ETC_pct_TP_Delta FCA_Km_AcumDistance FCA_L_AcumFuelComsuption FCA_L_TotalFuelFlow FCA_kps_VhSpd FCA_lpk_AverageFuelConsumption FLT_NU_APP1 FLT_NU_APP2 FLT_NU_BrkSw FLT_NU_CAN_CCVS FLT_NU_CamPhaser FLT_NU_CoolantTemp FLT_NU_ECU FLT_NU_EGO11 FLT_NU_EGO12 FLT_NU_EGO21 FLT_NU_EGO22 FLT_NU_ETC FLT_NU_FCV FLT_NU_HighLevel1 FLT_NU_HighLevel2 FLT_NU_Inj1 FLT_NU_Inj2 FLT_NU_Inj3 FLT_NU_Inj4 FLT_NU_Inj5 FLT_NU_Inj6 FLT_NU_Inj7 FLT_NU_Inj8 FLT_NU_MAF FLT_NU_OilTemp FLT_NU_PSU FLT_NU_PurgeVlv FLT_NU_Spk1 FLT_NU_Spk2 FLT_NU_Spk3 FLT_NU_Spk4 FLT_NU_Spk5 FLT_NU_Spk6 FLT_NU_Spk7 FLT_NU_Spk8 FLT_NU_TP1 FLT_NU_TP2 FLT_NU_TurCtrl FLT_NU_UEGO1 FLT_NU_UEGO2 FLT_NU_VCP FLT_NU_VRef FLT_b_EH_Open_A FLT_b_EH_Open_B FLT_b_EH_ShrtGrnd_A FLT_b_EH_ShrtGrnd_B FLT_b_EH_ShrtVBatt_A FLT_b_EH_ShrtVBatt_B FLT_b_HtrPWM_NoResponse_A FLT_b_HtrPWM_NoResponse_B FLT_b_IaIp_ShrtGrnd_A FLT_b_IaIp_ShrtGrnd_B FLT_b_IaIp_ShrtVBatt_A FLT_b_IaIp_ShrtVBatt_B FLT_b_SpiCtrl_A FLT_b_SpiCtrl_B FLT_b_UA_OORHi_A FLT_b_UA_OORHi_B FLT_b_UA_OORLo_A FLT_b_UA_OORLo_B FLT_b_UR_OORHi_A FLT_b_UR_OORHi_B FLT_b_UR_OORLo_A FLT_b_UR_OORLo_B FLT_b_Un_Open_A FLT_b_Un_Open_B FLT_b_Un_ShrtGrnd_A FLT_b_Un_ShrtGrnd_B FLT_b_Un_ShrtVBatt_A FLT_b_Un_ShrtVBatt_B FLT_b_Vm_Open_B FLT_b_Vm_ShrtGrnd_A FLT_b_Vm_ShrtGrnd_B FLT_b_Vm_ShrtVBatt_A FLT_b_Vm_ShrtVBatt_B FMG_e_FltReset HHT_pct_EGO11_HeaterDuty HHT_pct_EGO12_HeaterDuty HHT_pct_EGO21_HeaterDuty HHT_pct_EGO22_HeaterDuty HTR_C_SensorTemperature_A HTR_C_SensorTemperature_B HTR_NU_SysVoltCompCL HTR_NU_SysVoltCompCL_B HTR_NU_SysVoltCompOL HTR_NU_SysVoltCompOL_B HTR_b_ClosedLoopActv_A HTR_b_ClosedLoopActv_B HTR_b_FaultBasedHeaterLimit_A HTR_b_FaultBasedHeaterLimit_B HTR_b_HeaterEnabled_A HTR_b_HeaterEnabled_B HTR_b_OpenLoopActv_A HTR_b_OpenLoopActv_B HTR_b_OpenLoopReset_A HTR_b_OpenLoopReset_B HTR_b_OpenLoopSet_A HTR_b_OpenLoopSet_B HTR_b_WaterCondensActv_A HTR_b_WaterCondensActv_B HTR_e_RefCurrEnum_A HTR_e_RefCurrEnum_B HTR_pct_ClosedLoopPWMCmd_A HTR_pct_ClosedLoopPWMCmd_B HTR_pct_FinalPWMCmd_A HTR_pct_FinalPWMCmd_B HTR_pct_OpenLoopPWMCmd_A HTR_pct_OpenLoopPWMCmd_B IDL_NU_AirDTerm IDL_NU_AirITerm IDL_NU_AirPIDEffort IDL_NU_AirPTerm IDL_NU_ErrorROC IDL_NU_IdlAirGEAR_FF IDL_NU_SparkDTerm IDL_NU_SparkITerm IDL_NU_SparkPID_Effort IDL_NU_SparkPTerm IDL_RPM_AC_Term IDL_RPM_Added IDL_RPM_AlternatorTerm IDL_RPM_AlternatorTermRaw IDL_RPM_Base IDL_RPM_DrivingTerm IDL_RPM_Error IDL_RPM_ErrorLPF IDL_RPM_Trgt IDL_RPM_Trgt_trt IDL_b_Actv IDL_gps_Air IDL_gps_IdlAC_FF IDL_gps_IdlAir_FF IDL_gps_IdlAir_PID IDL_ret_Spark IJT_NU_TotalFuelFlowKgPerHr IJT_adv_CrankingSOI IJT_adv_RunningSOI IJT_adv_SOC_Inj1 IJT_adv_SOC_Inj2 IJT_adv_SOC_Inj3 IJT_adv_SOC_Inj4 IJT_b_Inj1_InjectionSent IJT_b_Inj2_InjectionSent IJT_b_Inj3_InjectionSent IJT_b_Inj4_InjectionSent IJT_b_InjectorOverlap IJT_b_PrimingPulseActiveCyl1 IJT_b_PrimingPulseActiveCyl2 IJT_b_PrimingPulseActiveCyl3 IJT_b_PrimingPulseActiveCyl4 IJT_bar_EffectivePress IJT_cnt_PrimingPulsesCyl1 IJT_cnt_PrimingPulsesCyl2 IJT_cnt_PrimingPulsesCyl3 IJT_cnt_PrimingPulsesCyl4 IJT_deg_Inj1 IJT_deg_Inj2 IJT_deg_Inj3 IJT_deg_Inj4 IJT_gps_InjectorFlowRatePFI IJT_gps_TotalFuelFlow IJT_mg_Inj1 IJT_mg_Inj2 IJT_mg_Inj3 IJT_mg_Inj4 IJT_ms_Inj1 IJT_ms_Inj2 IJT_ms_Inj3 IJT_ms_Inj4 IJT_ms_OpeningDelay IJT_ms_OpeningDelayInj1 IJT_ms_OpeningDelayInj2 IJT_ms_OpeningDelayInj3 IJT_ms_OpeningDelayInj4 IJT_ms_OverlapThrsh IJT_pct_FuelTempCF IJT_s_Slack INP_C_AmbientTemp INP_C_CompOutTemp INP_C_CoolantTemp INP_C_ExhaustTemp INP_C_FuelTemp INP_C_ManifoldTemp INP_C_OilTemp INP_L_TotalFuelLevel_L INP_NU_APP1_Raw INP_NU_APP2_Raw INP_NU_SpiCtrlCnts_A INP_NU_SpiCtrlCnts_B INP_NU_TP1_Raw INP_NU_TP2_Raw INP_RPM_CrankSpd INP_RPM_EngSpd INP_V_EGO11 INP_V_EGO21 INP_V_FuelLevel1 INP_V_FuelLevel2 INP_V_VBatt INP_b_AC_PressSw INP_b_AC_Rqst INP_b_CamWheelMvmt INP_b_CrankAngValid INP_b_CrankMvmt INP_b_EngAngValid INP_b_EngSync INP_b_Ign INP_b_OilPrSw INP_b_XG4 INP_bar_FuelPress INP_cnt_IgnCount INP_cnt_count_1 INP_cnt_count_2 INP_cnt_count_3 INP_cnt_count_4 INP_deg_CrankAng INP_deg_EngAng INP_e_TransGear INP_gps_MAF INP_kPa_Baro INP_kPa_CompOutPress INP_kPa_MAP INP_kPa_OilPress INP_kph_VehSpd INP_lam_UEGO1 INP_lam_UEGO2 INP_pct_AltLoad INP_pct_Cylinder1_Knock INP_pct_Cylinder2_Knock INP_pct_Cylinder3_Knock INP_pct_Cylinder4_Knock INP_pct_EstimatedGearRatio INP_pct_GLPLevel1 INP_pct_GLPLevel2 INP_pct_PrefiltTotalFuelLevel INP_pct_TotalFuelLevel INP_ret_VCP_Pos INP_rpm_EngSpdPre_ang_1 INP_rpm_EngSpdPre_ang_2 INP_rpm_EngSpdPre_ang_3 INP_rpm_EngSpdPre_ang_4 INP_rpm_EngSpdPst_ang_1 INP_rpm_EngSpdPst_ang_2 INP_rpm_EngSpdPst_ang_3 INP_rpm_EngSpdPst_ang_4 KNK_NU_EngSpdCorr KNK_b_EnrichFuel KNK_b_NewKnockEvent KNK_lam_AFR_Lim KNK_ret_SensorBased KNK_ret_SparkMod KNK_ret_TempBased LAM_NU_AmpFactor_A LAM_NU_AmpFactor_B LAM_NU_Lambda_A LAM_NU_Lambda_B LAM_b_AmpFactorFlag_A LAM_b_AmpFactorFlag_B LAM_b_LambdaValidFlag_A LAM_b_LambdaValidFlag_B LAM_mA_Ip_A LAM_mA_Ip_B LOG_NU_ManualPump LOG_NU_TqCvLuEngg LOG_NU_TransDrvEngg LOG_NU_TransShftPrcs LOG_PWM_BLOWER LOG_PWM_PUMP LOG_b_EC1_state LOG_b_ENBOBD LOG_b_RelePump1 LOG_b_RelePump2 LOG_b_ZF_Auto LOG_pct_PercentClutchSlip LOG_s_EC1_counter Log_b_TPDT1 Log_b_TPDT2 Log_b_TPDT3 Log_b_TPDT4 Log_b_TPDT5 Log_b_TPDT6 NVM_NU_EngRunTime OUT_C_FAN_ZF OUT_Hz_EngSpd OUT_Hz_FreqUEGOA OUT_Hz_VhSpd OUT_NU_BankA_Faults OUT_NU_DM19CVN OUT_NU_FCV_Faults OUT_NU_INJ_A1_Faults OUT_NU_INJ_A2_Faults OUT_NU_INJ_A3_Faults OUT_NU_INJ_A4_Faults OUT_b_18F00000_ena OUT_b_18F0010B_ena OUT_b_18FDC40B_ena OUT_b_18FE6E00_ena OUT_b_18FEE100_ena OUT_b_18FEE600_ena OUT_b_18FEEE00_ena OUT_b_24V_WarmupA OUT_b_BCM_ZF_ena OUT_b_BCM_ena OUT_b_BankA_Enbld OUT_b_BankB_Enbld OUT_b_CombustionAllCyls OUT_b_DM19Request OUT_b_FCV_OC OUT_b_FlashChecksum OUT_b_HEGO11_Heater_OC OUT_b_HEGO12_Heater_OC OUT_b_HEGO21_Heater_OC OUT_b_HighsideY1 OUT_b_HighsideY5 OUT_b_Inj1_LSD_Active OUT_b_Inj2_LSD_Active OUT_b_Inj3_LSD_Active OUT_b_Inj4_LSD_Active OUT_b_InjHighsideOC OUT_b_MIL_LED OUT_b_PT_Relay OUT_b_PT_RelayEnergized OUT_b_RAM_Checksum OUT_b_Spk1_Active OUT_b_Spk2_Active OUT_b_Spk3_Active OUT_b_Spk4_Active OUT_b_Spk5_Active OUT_b_Spk6_Active OUT_b_Spk7_Active OUT_b_Spk8_Active OUT_b_TCO_ena OUT_b_UEGOB_Heater_OC OUT_b_VISCO_1st OUT_b_VISCO_2nd OUT_b_VentiladorZF OUT_b_Y1_OC OUT_b_Y5_OC OUT_cnt_BankA_SPI_Flts OUT_cnt_BankB_SPI_Flts OUT_pct_UEGO_HTR_DC_A PIDEffort PID_NU_DTerm PID_NU_ITerm PID_NU_PTerm REM_Nm_TqLimit REM_b_StopCombustion REM_e_TurbineState REM_pct_OvertempThrottleLimit RFC_b_Active RFC_mg_FuelRqstDelta RFC_mg_Inj1 RFC_mg_Inj2 RFC_mg_Inj3 RFC_mg_Inj4 RFC_pct_PfInvCyl1 RFC_pct_PfInvCyl2 RFC_pct_PfInvCyl3 RFC_pct_PfInvCyl4 RFC_pct_RelativePfInv RFC_pct_WallWetFraction RFC_s_DbncTimer RFC_s_ExpTimer RFC_s_PuddleVapTime SAR_adv_SparkAng SAR_ret_ArbitratedRetardRqst SOV_b_OpenValve1 SOV_b_OpenValve2 SPT_adv_CoilOffAng SPT_adv_CoilOnAng SPT_deg_DwellTime SPT_ms_DwellTime SPT_ms_DwellTimeRaw SPT_ms_MaxDwellTime STR_b_ManualStarter SYS_EngSpedDelta1 SYS_EngSpedDelta1_after SYS_EngSpedDelta2 SYS_EngSpedDelta2_after SYS_EngSpedDelta3 SYS_EngSpedDelta3_after SYS_EngSpedDelta4 SYS_EngSpedDelta4_after SYS_NU_CrankWheelDecodeErr SYS_NU_CrankWheelDecodeStat SYS_NU_CurrCyl SYS_NU_EngSyncReq SYS_NU_EngToothOfst SYS_NU_ResetType SYS_b_CrankAngValid SYS_b_CrankSync SYS_b_CurrCylValid SYS_b_EngSync SYS_b_SyncInPhase SYS_b_SyncOutBy360 SYS_b_TwoTeethMeas SYS_cnt_LoopCounter SYS_cnt_NumAngularFuncCalls SYS_deg_CamTooth1 SYS_deg_CamTooth2 SYS_deg_CamTooth3 SYS_deg_CamTooth4 SYS_deg_CrankAng SYS_deg_EngAngOfst SYS_deg_EngAngOfstReq SYS_e_CAN0_State SYS_e_CAN1_State SYS_e_CAN3_State SYS_e_EngSync SYS_s_BootDuration SYS_us_LoopA_Task SYS_us_LoopA_TaskMax TAR_Nm_EEC1Tq TAR_Nm_EEC1Tqt TAR_Nm_EngDmnd TAR_Nm_J1939DrvrDmndTq TAR_Nm_MaxTqTable TAR_Nm_RawArbTqRqst TAR_Nm_TqFromAir TAR_Nm_TqFromMAP TAR_Nm_TqFromMAP_Idle TAR_Nm_TqRqst TAR_Nm_TqiFromMAP_Idle TAR_Nm_TqiFromModel TAR_b_DTC_TqLimit TAR_b_LimpHome TAR_b_TqFromMAP_act TRF_Nm_TqHPF TRF_b_Actv TRF_b_Transient TRF_lam_EnrichmentRqst TRF_lam_Trim TRS_Nm_TqHPF TRS_Nm_TqHPF_Peak TRS_b_Transient TRS_ret_SparkRqst TRS_ret_SparkRqstRaw TSS_b_OBDtimeOK /end LOC_MEASUREMENT
/end FUNCTION
/end MODULE
/end PROJECT
