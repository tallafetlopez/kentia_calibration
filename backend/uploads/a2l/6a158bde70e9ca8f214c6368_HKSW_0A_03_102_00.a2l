ASAP2_VERSION 1 31
/begin PROJECT M670_Engine_Control_1.2.0_M670_000 "BeGas B430LG Turbocharged engine"
/begin HEADER "Begas Motor 2017-2022 (c)" VERSION "1_2_0" /end HEADER
/begin MODULE OpenECU_M670_000 ""
/* Scalar calibration for DDE 'CLFc_s_UEGO1_Dbnc'. */
/begin CHARACTERISTIC CLFc_s_UEGO1_Dbnc "Enablement delay for sensor in-range" VALUE 0x835d8 RL_CLFC_S_UEGO1_DBNC 9.990000 CU_CLFC_S_UEGO1_DBNC 0.010000 10.000000 BYTE_ORDER MSB_FIRST /end CHARACTERISTIC
/begin RECORD_LAYOUT RL_CLFC_S_UEGO1_DBNC FNC_VALUES 1 FLOAT32_IEEE COLUMN_DIR DIRECT /end RECORD_LAYOUT
/begin COMPU_METHOD CU_CLFC_S_UEGO1_DBNC "Conversion method for CLFc_s_UEGO1_Dbnc" RAT_FUNC "%10.2" "s" COEFFS 0.000000 1.000000 0.000000 0.000000 0.000000 1.000000 /end COMPU_METHOD
/* Scalar calibration for DDE 'CLFc_s_UEGO2_Dbnc'. */
/begin CHARACTERISTIC CLFc_s_UEGO2_Dbnc "Enablement delay for sensor in-range" VALUE 0x83e34 RL_CLFC_S_UEGO2_DBNC 9.990000 CU_CLFC_S_UEGO2_DBNC 0.010000 10.000000 BYTE_ORDER MSB_FIRST /end CHARACTERISTIC
/begin RECORD_LAYOUT RL_CLFC_S_UEGO2_DBNC FNC_VALUES 1 FLOAT32_IEEE COLUMN_DIR DIRECT /end RECORD_LAYOUT
/begin COMPU_METHOD CU_CLFC_S_UEGO2_DBNC "Conversion method for CLFc_s_UEGO2_Dbnc" RAT_FUNC "%10.2" "s" COEFFS 0.000000 1.000000 0.000000 0.000000 0.000000 1.000000 /end COMPU_METHOD
/* Map (2d) calibration for DDE 'CLFm_NU_DGainFast_z'. */
/begin CHARACTERISTIC CLFm_NU_DGainFast_z "PID gain" MAP 0x83964 RL_CLFM_NU_DGAINFAST_Z 100.000000 CU_CLFM_NU_DGAINFAST_Z 0.000000 100.000000
 /begin AXIS_DESCR COM_AXIS NO_INPUT_QUANTITY CU_CLFM_NU_DGAINFAST_X 8 0.000000 10000.000000 AXIS_PTS_REF APD_CLFM_NU_DGAINFAST_X /end AXIS_DESCR
 /begin AXIS_DESCR COM_AXIS NO_INPUT_QUANTITY CU_CLFM_NU_DGAINFAST_Y 8 0.000000 3.000000 AXIS_PTS_REF APD_CLFM_NU_DGAINFAST_Y /end AXIS_DESCR
 BYTE_ORDER MSB_FIRST /end CHARACTERISTIC
/begin RECORD_LAYOUT RL_CLFM_NU_DGAINFAST_Z FNC_VALUES 1 FLOAT32_IEEE COLUMN_DIR DIRECT /end RECORD_LAYOUT
/begin COMPU_METHOD CU_CLFM_NU_DGAINFAST_Z "Conversion method for CLFm_NU_DGainFast_z" RAT_FUNC "%10.4" "NU" COEFFS 0.000000 1.000000 0.000000 0.000000 0.000000 1.000000 /end COMPU_METHOD
/begin AXIS_PTS APD_CLFM_NU_DGAINFAST_X "(RPM) PID gain x-lookup" 0x83924 NO_INPUT_QUANTITY RL_CLFM_NU_DGAINFAST_X 10000.000000 CU_CLFM_NU_DGAINFAST_X 8 0.0 10000.0 BYTE_ORDER MSB_FIRST /end AXIS_PTS
/begin RECORD_LAYOUT RL_CLFM_NU_DGAINFAST_X AXIS_PTS_X 1 FLOAT32_IEEE INDEX_INCR DIRECT /end RECORD_LAYOUT
/begin COMPU_METHOD CU_CLFM_NU_DGAINFAST_X "Conversion method for CLFm_NU_DGainFast_x" RAT_FUNC "%10.0" "RPM" COEFFS 0.000000 1.000000 0.000000 0.000000 0.000000 1.000000 /end COMPU_METHOD
/begin AXIS_PTS APD_CLFM_NU_DGAINFAST_Y "(pct load) PID gain y-lookup" 0x83944 NO_INPUT_QUANTITY RL_CLFM_NU_DGAINFAST_Y 3.000000 CU_CLFM_NU_DGAINFAST_Y 8 0.0 3.0 BYTE_ORDER MSB_FIRST /end AXIS_PTS
/begin RECORD_LAYOUT RL_CLFM_NU_DGAINFAST_Y AXIS_PTS_X 1 FLOAT32_IEEE INDEX_INCR DIRECT /end RECORD_LAYOUT
/begin COMPU_METHOD CU_CLFM_NU_DGAINFAST_Y "Conversion method for CLFm_NU_DGainFast_y" RAT_FUNC "%10.2" "pct" COEFFS 0.000000 1.000000 0.000000 0.000000 0.000000 1.000000 /end COMPU_METHOD
/* Map (2d) calibration for DDE 'CLFm_NU_DGainSlow_z'. */
/begin CHARACTERISTIC CLFm_NU_DGainSlow_z "PID gain" MAP 0x83d24 RL_CLFM_NU_DGAINSLOW_Z 100.000000 CU_CLFM_NU_DGAINSLOW_Z 0.000000 100.000000
 /begin AXIS_DESCR COM_AXIS NO_INPUT_QUANTITY CU_CLFM_NU_DGAINSLOW_X 8 0.000000 10000.000000 AXIS_PTS_REF APD_CLFM_NU_DGAINSLOW_X /end AXIS_DESCR
 /begin AXIS_DESCR COM_AXIS NO_INPUT_QUANTITY CU_CLFM_NU_DGAINSLOW_Y 8 0.000000 3.000000 AXIS_PTS_REF APD_CLFM_NU_DGAINSLOW_Y /end AXIS_DESCR
 BYTE_ORDER MSB_FIRST /end CHARACTERISTIC
/begin RECORD_LAYOUT RL_CLFM_NU_DGAINSLOW_Z FNC_VALUES 1 FLOAT32_IEEE COLUMN_DIR DIRECT /end RECORD_LAYOUT
/begin COMPU_METHOD CU_CLFM_NU_DGAINSLOW_Z "Conversion method for CLFm_NU_DGainSlow_z" RAT_FUNC "%10.4" "NU" COEFFS 0.000000 1.000000 0.000000 0.000000 0.000000 1.000000 /end COMPU_METHOD
/begin AXIS_PTS APD_CLFM_NU_DGAINSLOW_X "(RPM) PID gain x-lookup" 0x83ce4 NO_INPUT_QUANTITY RL_CLFM_NU_DGAINSLOW_X 10000.000000 CU_CLFM_NU_DGAINSLOW_X 8 0.0 10000.0 BYTE_ORDER MSB_FIRST /end AXIS_PTS
/begin RECORD_LAYOUT RL_CLFM_NU_DGAINSLOW_X AXIS_PTS_X 1 FLOAT32_IEEE INDEX_INCR DIRECT /end RECORD_LAYOUT
/begin COMPU_METHOD CU_CLFM_NU_DGAINSLOW_X "Conversion method for CLFm_NU_DGainSlow_x" RAT_FUNC "%10.0" "RPM" COEFFS 0.000000 1.000000 0.000000 0.000000 0.000000 1.000000 /end COMPU_METHOD
/begin AXIS_PTS APD_CLFM_NU_DGAINSLOW_Y "(pct load) PID gain y-lookup" 0x83d04 NO_INPUT_QUANTITY RL_CLFM_NU_DGAINSLOW_Y 3.000000 CU_CLFM_NU_DGAINSLOW_Y 8 0.0 3.0 BYTE_ORDER MSB_FIRST /end AXIS_PTS
/begin RECORD_LAYOUT RL_CLFM_NU_DGAINSLOW_Y AXIS_PTS_X 1 FLOAT32_IEEE INDEX_INCR DIRECT /end RECORD_LAYOUT
/begin COMPU_METHOD CU_CLFM_NU_DGAINSLOW_Y "Conversion method for CLFm_NU_DGainSlow_y" RAT_FUNC "%10.2" "pct" COEFFS 0.000000 1.000000 0.000000 0.000000 0.000000 1.000000 /end COMPU_METHOD
/* Map (2d) calibration for DDE 'CLFm_NU_DitherLeanFirings_z'. */
/begin CHARACTERISTIC CLFm_NU_DitherLeanFirings_z "Number of firing events to apply lean dither step" MAP 0x87044 RL_CLFM_NU_DITHERLEANFIRINGS_Z 254.000000 CU_CLFM_NU_DITHERLEANFIRINGS_Z 1.000000 255.000000
 /begin AXIS_DESCR COM_AXIS NO_INPUT_QUANTITY CU_CLFM_NU_DITHERLEANFIRINGS_X 16 0.000000 10000.000000 AXIS_PTS_REF APD_CLFM_NU_DITHERLEANFIRINGS_X /end AXIS_DESCR
 /begin AXIS_DESCR COM_AXIS NO_INPUT_QUANTITY CU_CLFM_NU_DITHERLEANFIRINGS_Y 16 0.000000 3.000000 AXIS_PTS_REF APD_CLFM_NU_DITHERLEANFIRINGS_Y /end AXIS_DESCR
 BYTE_ORDER MSB_FIRST /end CHARACTERISTIC
/begin RECORD_LAYOUT RL_CLFM_NU_DITHERLEANFIRINGS_Z FNC_VALUES 1 FLOAT32_IEEE COLUMN_DIR DIRECT /end RECORD_LAYOUT
/begin COMPU_METHOD CU_CLFM_NU_DITHERLEANFIRINGS_Z "Conversion method for CLFm_NU_DitherLeanFirings_z" RAT_FUNC "%10.0" "NU" COEFFS 0.000000 1.000000 0.000000 0.000000 0.000000 1.000000 /end COMPU_METHOD
/begin AXIS_PTS APD_CLFM_NU_DITHERLEANFIRINGS_X "(RPM) dither duration x-lookup" 0x86fc4 NO_INPUT_QUANTITY RL_CLFM_NU_DITHERLEANFIRINGS_X 10000.000000 CU_CLFM_NU_DITHERLEANFIRINGS_X 16 0.0 10000.0 BYTE_ORDER MSB_FIRST /end AXIS_PTS
/begin RECORD_LAYOUT RL_CLFM_NU_DITHERLEANFIRINGS_X AXIS_PTS_X 1 FLOAT32_IEEE INDEX_INCR DIRECT /end RECORD_LAYOUT
/begin COMPU_METHOD CU_CLFM_NU_DITHERLEANFIRINGS_X "Conversion method for CLFm_NU_DitherLeanFirings_x" RAT_FUNC "%10.0" "RPM" COEFFS 0.000000 1.000000 0.000000 0.000000 0.000000 1.000000 /end COMPU_METHOD
/begin AXIS_PTS APD_CLFM_NU_DITHERLEANFIRINGS_Y "(pct load) dither duration y-lookup" 0x87004 NO_INPUT_QUANTITY RL_CLFM_NU_DITHERLEANFIRINGS_Y 3.000000 CU_CLFM_NU_DITHERLEANFIRINGS_Y 16 0.0 3.0 BYTE_ORDER MSB_FIRST /end AXIS_PTS
/begin RECORD_LAYOUT RL_CLFM_NU_DITHERLEANFIRINGS_Y AXIS_PTS_X 1 FLOAT32_IEEE INDEX_INCR DIRECT /end RECORD_LAYOUT
/begin COMPU_METHOD CU_CLFM_NU_DITHERLEANFIRINGS_Y "Conversion method for CLFm_NU_DitherLeanFirings_y" RAT_FUNC "%10.2" "pct" COEFFS 0.000000 1.000000 0.000000 0.000000 0.000000 1.000000 /end COMPU_METHOD
/* Map (2d) calibration for DDE 'CLFm_NU_DitherRichFirings_z'. */
/begin CHARACTERISTIC CLFm_NU_DitherRichFirings_z "Number of firing events to apply rich dither step" MAP 0x874c4 RL_CLFM_NU_DITHERRICHFIRINGS_Z 254.000000 CU_CLFM_NU_DITHERRICHFIRINGS_Z 1.000000 255.000000
 /begin AXIS_DESCR COM_AXIS NO_INPUT_QUANTITY CU_CLFM_NU_DITHERRICHFIRINGS_X 16 0.000000 10000.000000 AXIS_PTS_REF APD_CLFM_NU_DITHERRICHFIRINGS_X /end AXIS_DESCR
 /begin AXIS_DESCR COM_AXIS NO_INPUT_QUANTITY CU_CLFM_NU_DITHERRICHFIRINGS_Y 16 0.000000 3.000000 AXIS_PTS_REF APD_CLFM_NU_DITHERRICHFIRINGS_Y /end AXIS_DESCR
 BYTE_ORDER MSB_FIRST /end CHARACTERISTIC
/begin RECORD_LAYOUT RL_CLFM_NU_DITHERRICHFIRINGS_Z FNC_VALUES 1 FLOAT32_IEEE COLUMN_DIR DIRECT /end RECORD_LAYOUT
/begin COMPU_METHOD CU_CLFM_NU_DITHERRICHFIRINGS_Z "Conversion method for CLFm_NU_DitherRichFirings_z" RAT_FUNC "%10.0" "NU" COEFFS 0.000000 1.000000 0.000000 0.000000 0.000000 1.000000 /end COMPU_METHOD
/begin AXIS_PTS APD_CLFM_NU_DITHERRICHFIRINGS_X "(RPM) dither duration x-lookup" 0x87444 NO_INPUT_QUANTITY RL_CLFM_NU_DITHERRICHFIRINGS_X 10000.000000 CU_CLFM_NU_DITHERRICHFIRINGS_X 16 0.0 10000.0 BYTE_ORDER MSB_FIRST /end AXIS_PTS
/begin RECORD_LAYOUT RL_CLFM_NU_DITHERRICHFIRINGS_X AXIS_PTS_X 1 FLOAT32_IEEE INDEX_INCR DIRECT /end RECORD_LAYOUT
/begin COMPU_METHOD CU_CLFM_NU_DITHERRICHFIRINGS_X "Conversion method for CLFm_NU_DitherRichFirings_x" RAT_FUNC "%10.0" "RPM" COEFFS 0.000000 1.000000 0.000000 0.000000 0.000000 1.000000 /end COMPU_METHOD
/begin AXIS_PTS APD_CLFM_NU_DITHERRICHFIRINGS_Y "(pct load) dither duration y-lookup" 0x87484 NO_INPUT_QUANTITY RL_CLFM_NU_DITHERRICHFIRINGS_Y 3.000000 CU_CLFM_NU_DITHERRICHFIRINGS_Y 16 0.0 3.0 BYTE_ORDER MSB_FIRST /end AXIS_PTS
/begin RECORD_LAYOUT RL_CLFM_NU_DITHERRICHFIRINGS_Y AXIS_PTS_X 1 FLOAT32_IEEE INDEX_INCR DIRECT /end RECORD_LAYOUT
/begin COMPU_METHOD CU_CLFM_NU_DITHERRICHFIRINGS_Y "Conversion method for CLFm_NU_DitherRichFirings_y" RAT_FUNC "%10.2" "pct" COEFFS 0.000000 1.000000 0.000000 0.000000 0.000000 1.000000 /end COMPU_METHOD
/* Map (2d) calibration for DDE 'CLFm_NU_IGainFast_z'. */
/begin CHARACTERISTIC CLFm_NU_IGainFast_z "PID gain" MAP 0x83824 RL_CLFM_NU_IGAINFAST_Z 100.000000 CU_CLFM_NU_IGAINFAST_Z 0.000000 100.000000
 /begin AXIS_DESCR COM_AXIS NO_INPUT_QUANTITY CU_CLFM_NU_IGAINFAST_X 8 0.000000 10000.000000 AXIS_PTS_REF APD_CLFM_NU_IGAINFAST_X /end AXIS_DESCR
 /begin AXIS_DESCR COM_AXIS NO_INPUT_QUANTITY CU_CLFM_NU_IGAINFAST_Y 8 0.000000 3.000000 AXIS_PTS_REF APD_CLFM_NU_IGAINFAST_Y /end AXIS_DESCR
 BYTE_ORDER MSB_FIRST /end CHARACTERISTIC
/begin RECORD_LAYOUT RL_CLFM_NU_IGAINFAST_Z FNC_VALUES 1 FLOAT32_IEEE COLUMN_DIR DIRECT /end RECORD_LAYOUT
/begin COMPU_METHOD CU_CLFM_NU_IGAINFAST_Z "Conversion method for CLFm_NU_IGainFast_z" RAT_FUNC "%10.4" "NU" COEFFS 0.000000 1.000000 0.000000 0.000000 0.000000 1.000000 /end COMPU_METHOD
/begin AXIS_PTS APD_CLFM_NU_IGAINFAST_X "(RPM) PID gain x-lookup" 0x837e4 NO_INPUT_QUANTITY RL_CLFM_NU_IGAINFAST_X 10000.000000 CU_CLFM_NU_IGAINFAST_X 8 0.0 10000.0 BYTE_ORDER MSB_FIRST /end AXIS_PTS
/begin RECORD_LAYOUT RL_CLFM_NU_IGAINFAST_X AXIS_PTS_X 1 FLOAT32_IEEE INDEX_INCR DIRECT /end RECORD_LAYOUT
/begin COMPU_METHOD CU_CLFM_NU_IGAINFAST_X "Conversion method for CLFm_NU_IGainFast_x" RAT_FUNC "%10.0" "RPM" COEFFS 0.000000 1.000000 0.000000 0.000000 0.000000 1.000000 /end COMPU_METHOD
/begin AXIS_PTS APD_CLFM_NU_IGAINFAST_Y "(pct load) PID gain y-lookup" 0x83804 NO_INPUT_QUANTITY RL_CLFM_NU_IGAINFAST_Y 3.000000 CU_CLFM_NU_IGAINFAST_Y 8 0.0 3.0 BYTE_ORDER MSB_FIRST /end AXIS_PTS
/begin RECORD_LAYOUT RL_CLFM_NU_IGAINFAST_Y AXIS_PTS_X 1 FLOAT32_IEEE INDEX_INCR DIRECT /end RECORD_LAYOUT
/begin COMPU_METHOD CU_CLFM_NU_IGAINFAST_Y "Conversion method for CLFm_NU_IGainFast_y" RAT_FUNC "%10.2" "pct" COEFFS 0.000000 1.000000 0.000000 0.000000 0.000000 1.000000 /end COMPU_METHOD
/* Map (2d) calibration for DDE 'CLFm_NU_IGainSlow_z'. */
/begin CHARACTERISTIC CLFm_NU_IGainSlow_z "PID gain" MAP 0x83be4 RL_CLFM_NU_IGAINSLOW_Z 100.000000 CU_CLFM_NU_IGAINSLOW_Z 0.000000 100.000000
 /begin AXIS_DESCR COM_AXIS NO_INPUT_QUANTITY CU_CLFM_NU_IGAINSLOW_X 8 0.000000 10000.000000 AXIS_PTS_REF APD_CLFM_NU_IGAINSLOW_X /end AXIS_DESCR
 /begin AXIS_DESCR COM_AXIS NO_INPUT_QUANTITY CU_CLFM_NU_IGAINSLOW_Y 8 0.000000 3.000000 AXIS_PTS_REF APD_CLFM_NU_IGAINSLOW_Y /end AXIS_DESCR
 BYTE_ORDER MSB_FIRST /end CHARACTERISTIC
/begin RECORD_LAYOUT RL_CLFM_NU_IGAINSLOW_Z FNC_VALUES 1 FLOAT32_IEEE COLUMN_DIR DIRECT /end RECORD_LAYOUT
/begin COMPU_METHOD CU_CLFM_NU_IGAINSLOW_Z "Conversion method for CLFm_NU_IGainSlow_z" RAT_FUNC "%10.4" "NU" COEFFS 0.000000 1.000000 0.000000 0.000000 0.000000 1.000000 /end COMPU_METHOD
/begin AXIS_PTS APD_CLFM_NU_IGAINSLOW_X "(RPM) PID gain x-lookup" 0x83ba4 NO_INPUT_QUANTITY RL_CLFM_NU_IGAINSLOW_X 10000.000000 CU_CLFM_NU_IGAINSLOW_X 8 0.0 10000.0 BYTE_ORDER MSB_FIRST /end AXIS_PTS
/begin RECORD_LAYOUT RL_CLFM_NU_IGAINSLOW_X AXIS_PTS_X 1 FLOAT32_IEEE INDEX_INCR DIRECT /end RECORD_LAYOUT
/begin COMPU_METHOD CU_CLFM_NU_IGAINSLOW_X "Conversion method for CLFm_NU_IGainSlow_x" RAT_FUNC "%10.0" "RPM" COEFFS 0.000000 1.000000 0.000000 0.000000 0.000000 1.000000 /end COMPU_METHOD
/begin AXIS_PTS APD_CLFM_NU_IGAINSLOW_Y "(pct load) PID gain y-lookup" 0x83bc4 NO_INPUT_QUANTITY RL_CLFM_NU_IGAINSLOW_Y 3.000000 CU_CLFM_NU_IGAINSLOW_Y 8 0.0 3.0 BYTE_ORDER MSB_FIRST /end AXIS_PTS
/begin RECORD_LAYOUT RL_CLFM_NU_IGAINSLOW_Y AXIS_PTS_X 1 FLOAT32_IEEE INDEX_INCR DIRECT /end RECORD_LAYOUT
/begin COMPU_METHOD CU_CLFM_NU_IGAINSLOW_Y "Conversion method for CLFm_NU_IGainSlow_y" RAT_FUNC "%10.2" "pct" COEFFS 0.000000 1.000000 0.000000 0.000000 0.000000 1.000000 /end COMPU_METHOD
/* Map (2d) calibration for DDE 'CLFm_NU_LTFT_z'. */
/begin CHARACTERISTIC CLFm_NU_LTFT_z "(delta-lambda) LTFT NVM table output" MAP 0x918fc RL_CLFM_NU_LTFT_Z 0.600000 CU_CLFM_NU_LTFT_Z -0.300000 0.300000
 /begin AXIS_DESCR COM_AXIS NO_INPUT_QUANTITY CU_CLFM_NU_LTFT_X 16 0.000000 10000.000000 AXIS_PTS_REF APD_CLFM_NU_LTFT_X /end AXIS_DESCR
 /begin AXIS_DESCR COM_AXIS NO_INPUT_QUANTITY CU_CLFM_NU_LTFT_Y 16 0.000000 3.000000 AXIS_PTS_REF APD_CLFM_NU_LTFT_Y /end AXIS_DESCR
 BYTE_ORDER MSB_FIRST /end CHARACTERISTIC
/begin RECORD_LAYOUT RL_CLFM_NU_LTFT_Z FNC_VALUES 1 FLOAT32_IEEE COLUMN_DIR DIRECT /end RECORD_LAYOUT
/begin COMPU_METHOD CU_CLFM_NU_LTFT_Z "Conversion method for CLFm_NU_LTFT_z" RAT_FUNC "%10.3" "lam" COEFFS 0.000000 1.000000 0.000000 0.000000 0.000000 1.000000 /end COMPU_METHOD
/begin AXIS_PTS APD_CLFM_NU_LTFT_X "(RPM) LTFT x-lookup" 0x83614 NO_INPUT_QUANTITY RL_CLFM_NU_LTFT_X 10000.000000 CU_CLFM_NU_LTFT_X 16 0.0 10000.0 BYTE_ORDER MSB_FIRST /end AXIS_PTS
/begin RECORD_LAYOUT RL_CLFM_NU_LTFT_X AXIS_PTS_X 1 FLOAT32_IEEE INDEX_INCR DIRECT /end RECORD_LAYOUT
/begin COMPU_METHOD CU_CLFM_NU_LTFT_X "Conversion method for CLFm_NU_LTFT_x" RAT_FUNC "%10.0" "RPM" COEFFS 0.000000 1.000000 0.000000 0.000000 0.000000 1.000000 /end COMPU_METHOD
/begin AXIS_PTS APD_CLFM_NU_LTFT_Y "(pct load) LTFT y-lookup" 0x83654 NO_INPUT_QUANTITY RL_CLFM_NU_LTFT_Y 3.000000 CU_CLFM_NU_LTFT_Y 16 0.0 3.0 BYTE_ORDER MSB_FIRST /end AXIS_PTS
/begin RECORD_LAYOUT RL_CLFM_NU_LTFT_Y AXIS_PTS_X 1 FLOAT32_IEEE INDEX_INCR DIRECT /end RECORD_LAYOUT
/begin COMPU_METHOD CU_CLFM_NU_LTFT_Y "Conversion method for CLFm_NU_LTFT_y" RAT_FUNC "%10.2" "pct" COEFFS 0.000000 1.000000 0.000000 0.000000 0.000000 1.000000 /end COMPU_METHOD
/* Map (2d) calibration for DDE 'CLFm_NU_PGainFast_z'. */
/begin CHARACTERISTIC CLFm_NU_PGainFast_z "PID gain" MAP 0x836e4 RL_CLFM_NU_PGAINFAST_Z 100.000000 CU_CLFM_NU_PGAINFAST_Z 0.000000 100.000000
 /begin AXIS_DESCR COM_AXIS NO_INPUT_QUANTITY CU_CLFM_NU_PGAINFAST_X 8 0.000000 10000.000000 AXIS_PTS_REF APD_CLFM_NU_PGAINFAST_X /end AXIS_DESCR
 /begin AXIS_DESCR COM_AXIS NO_INPUT_QUANTITY CU_CLFM_NU_PGAINFAST_Y 8 0.000000 3.000000 AXIS_PTS_REF APD_CLFM_NU_PGAINFAST_Y /end AXIS_DESCR
 BYTE_ORDER MSB_FIRST /end CHARACTERISTIC
/begin RECORD_LAYOUT RL_CLFM_NU_PGAINFAST_Z FNC_VALUES 1 FLOAT32_IEEE COLUMN_DIR DIRECT /end RECORD_LAYOUT
/begin COMPU_METHOD CU_CLFM_NU_PGAINFAST_Z "Conversion method for CLFm_NU_PGainFast_z" RAT_FUNC "%10.4" "NU" COEFFS 0.000000 1.000000 0.000000 0.000000 0.000000 1.000000 /end COMPU_METHOD
/begin AXIS_PTS APD_CLFM_NU_PGAINFAST_X "(RPM) PID gain x-lookup" 0x836a4 NO_INPUT_QUANTITY RL_CLFM_NU_PGAINFAST_X 10000.000000 CU_CLFM_NU_PGAINFAST_X 8 0.0 10000.0 BYTE_ORDER MSB_FIRST /end AXIS_PTS
/begin RECORD_LAYOUT RL_CLFM_NU_PGAINFAST_X AXIS_PTS_X 1 FLOAT32_IEEE INDEX_INCR DIRECT /end RECORD_LAYOUT
/begin COMPU_METHOD CU_CLFM_NU_PGAINFAST_X "Conversion method for CLFm_NU_PGainFast_x" RAT_FUNC "%10.0" "RPM" COEFFS 0.000000 1.000000 0.000000 0.000000 0.000000 1.000000 /end COMPU_METHOD
/begin AXIS_PTS APD_CLFM_NU_PGAINFAST_Y "(pct load) PID gain y-lookup" 0x836c4 NO_INPUT_QUANTITY RL_CLFM_NU_PGAINFAST_Y 3.000000 CU_CLFM_NU_PGAINFAST_Y 8 0.0 3.0 BYTE_ORDER MSB_FIRST /end AXIS_PTS
/begin RECORD_LAYOUT RL_CLFM_NU_PGAINFAST_Y AXIS_PTS_X 1 FLOAT32_IEEE INDEX_INCR DIRECT /end RECORD_LAYOUT
/begin COMPU_METHOD CU_CLFM_NU_PGAINFAST_Y "Conversion method for CLFm_NU_PGainFast_y" RAT_FUNC "%10.2" "pct" COEFFS 0.000000 1.000000 0.000000 0.000000 0.000000 1.000000 /end COMPU_METHOD
/* Map (2d) calibration for DDE 'CLFm_NU_PGainSlow_z'. */
/begin CHARACTERISTIC CLFm_NU_PGainSlow_z "PID gain" MAP 0x83aa4 RL_CLFM_NU_PGAINSLOW_Z 100.000000 CU_CLFM_NU_PGAINSLOW_Z 0.000000 100.000000
 /begin AXIS_DESCR COM_AXIS NO_INPUT_QUANTITY CU_CLFM_NU_PGAINSLOW_X 8 0.000000 10000.000000 AXIS_PTS_REF APD_CLFM_NU_PGAINSLOW_X /end AXIS_DESCR
 /begin AXIS_DESCR COM_AXIS NO_INPUT_QUANTITY CU_CLFM_NU_PGAINSLOW_Y 8 0.000000 3.000000 AXIS_PTS_REF APD_CLFM_NU_PGAINSLOW_Y /end AXIS_DESCR
 BYTE_ORDER MSB_FIRST /end CHARACTERISTIC
/begin RECORD_LAYOUT RL_CLFM_NU_PGAINSLOW_Z FNC_VALUES 1 FLOAT32_IEEE COLUMN_DIR DIRECT /end RECORD_LAYOUT
/begin COMPU_METHOD CU_CLFM_NU_PGAINSLOW_Z "Conversion method for CLFm_NU_PGainSlow_z" RAT_FUNC "%10.4" "NU" COEFFS 0.000000 1.000000 0.000000 0.000000 0.000000 1.000000 /end COMPU_METHOD
/begin AXIS_PTS APD_CLFM_NU_PGAINSLOW_X "(RPM) PID gain x-lookup" 0x83a64 NO_INPUT_QUANTITY RL_CLFM_NU_PGAINSLOW_X 10000.000000 CU_CLFM_NU_PGAINSLOW_X 8 0.0 10000.0 BYTE_ORDER MSB_FIRST /end AXIS_PTS
/begin RECORD_LAYOUT RL_CLFM_NU_PGAINSLOW_X AXIS_PTS_X 1 FLOAT32_IEEE INDEX_INCR DIRECT /end RECORD_LAYOUT
/begin COMPU_METHOD CU_CLFM_NU_PGAINSLOW_X "Conversion method for CLFm_NU_PGainSlow_x" RAT_FUNC "%10.0" "RPM" COEFFS 0.000000 1.000000 0.000000 0.000000 0.000000 1.000000 /end COMPU_METHOD
/begin AXIS_PTS APD_CLFM_NU_PGAINSLOW_Y "(pct load) PID gain y-lookup" 0x83a84 NO_INPUT_QUANTITY RL_CLFM_NU_PGAINSLOW_Y 3.000000 CU_CLFM_NU_PGAINSLOW_Y 8 0.0 3.0 BYTE_ORDER MSB_FIRST /end AXIS_PTS
/begin RECORD_LAYOUT RL_CLFM_NU_PGAINSLOW_Y AXIS_PTS_X 1 FLOAT32_IEEE INDEX_INCR DIRECT /end RECORD_LAYOUT
/begin COMPU_METHOD CU_CLFM_NU_PGAINSLOW_Y "Conversion method for CLFm_NU_PGainSlow_y" RAT_FUNC "%10.2" "pct" COEFFS 0.000000 1.000000 0.000000 0.000000 0.000000 1.000000 /end COMPU_METHOD
/* Map (2d) calibration for DDE 'CLFma_NU_LTFT_z'. */
/begin CHARACTERISTIC CLFma_NU_LTFT_z "(delta-lambda) LTFT NVM table output" MAP 0x4000f488 RL_CLFMA_NU_LTFT_Z 0.600000 CU_CLFMA_NU_LTFT_Z -0.300000 0.300000
 /begin AXIS_DESCR COM_AXIS NO_INPUT_QUANTITY CU_CLFM_NU_LTFT_X 16 0.000000 10000.000000 AXIS_PTS_REF APD_CLFM_NU_LTFT_X /end AXIS_DESCR
 /begin AXIS_DESCR COM_AXIS NO_INPUT_QUANTITY CU_CLFM_NU_LTFT_Y 16 0.000000 3.000000 AXIS_PTS_REF APD_CLFM_NU_LTFT_Y /end AXIS_DESCR
 BYTE_ORDER MSB_FIRST /end CHARACTERISTIC
/begin RECORD_LAYOUT RL_CLFMA_NU_LTFT_Z FNC_VALUES 1 FLOAT32_IEEE COLUMN_DIR DIRECT /end RECORD_LAYOUT
/begin COMPU_METHOD CU_CLFMA_NU_LTFT_Z "Conversion method for CLFma_NU_LTFT_z" RAT_FUNC "%10.3" "lam" COEFFS 0.000000 1.000000 0.000000 0.000000 0.000000 1.000000 /end COMPU_METHOD
/* Scalar calibration for DDE 'CPLc_NU_RetardPGain'. */
/begin CHARACTERISTIC CPLc_NU_RetardPGain "(ret/kPa) Spark retard is calculated by applying this gain to the BoostDelta" VALUE 0x84f44 RL_CPLC_NU_RETARDPGAIN 10.000000 CU_CPLC_NU_RETARDPGAIN 0.000000 10.000000 BYTE_ORDER MSB_FIRST /end CHARACTERISTIC
/begin RECORD_LAYOUT RL_CPLC_NU_RETARDPGAIN FNC_VALUES 1 FLOAT32_IEEE COLUMN_DIR DIRECT /end RECORD_LAYOUT
/begin COMPU_METHOD CU_CPLC_NU_RETARDPGAIN "Conversion method for CPLc_NU_RetardPGain" RAT_FUNC "%10.3" "NU" COEFFS 0.000000 1.000000 0.000000 0.000000 0.000000 1.000000 /end COMPU_METHOD
/* Scalar calibration for DDE 'CPLc_b_CutSpark'. */
/begin CHARACTERISTIC CPLc_b_CutSpark "Override value" VALUE 0x8b857 RL_CPLC_B_CUTSPARK 1.000000 CU_CPLC_B_CUTSPARK 0.000000 1.000000 BYTE_ORDER MSB_FIRST /end CHARACTERISTIC
/begin RECORD_LAYOUT RL_CPLC_B_CUTSPARK FNC_VALUES 1 UBYTE COLUMN_DIR DIRECT /end RECORD_LAYOUT
/begin COMPU_METHOD CU_CPLC_B_CUTSPARK "Conversion method for CPLc_b_CutSpark" RAT_FUNC "%10.0" "b" COEFFS 0.000000 1.000000 0.000000 0.000000 0.000000 1.000000 /end COMPU_METHOD
/* Scalar calibration for DDE 'CPLc_kPa_SparkCutOfst'. */
/begin CHARACTERISTIC CPLc_kPa_SparkCutOfst "If MAP exceeds the boost limit value by this amount spark will be disabled" VALUE 0x84f38 RL_CPLC_KPA_SPARKCUTOFST 500.000000 CU_CPLC_KPA_SPARKCUTOFST 0.000000 500.000000 BYTE_ORDER MSB_FIRST /end CHARACTERISTIC
/begin RECORD_LAYOUT RL_CPLC_KPA_SPARKCUTOFST FNC_VALUES 1 FLOAT32_IEEE COLUMN_DIR DIRECT /end RECORD_LAYOUT
/begin COMPU_METHOD CU_CPLC_KPA_SPARKCUTOFST "Conversion method for CPLc_kPa_SparkCutOfst" RAT_FUNC "%10.0" "kPa" COEFFS 0.000000 1.000000 0.000000 0.000000 0.000000 1.000000 /end COMPU_METHOD
/* Scalar calibration for DDE 'CPLc_o_CutSpark'. */
/begin CHARACTERISTIC CPLc_o_CutSpark "Override flag" VALUE 0x8b856 RL_CPLC_O_CUTSPARK 1.000000 CU_CPLC_O_CUTSPARK 0.000000 1.000000 BYTE_ORDER MSB_FIRST /end CHARACTERISTIC
/begin RECORD_LAYOUT RL_CPLC_O_CUTSPARK FNC_VALUES 1 UBYTE COLUMN_DIR DIRECT /end RECORD_LAYOUT
/begin COMPU_METHOD CU_CPLC_O_CUTSPARK "Conversion method for CPLc_o_CutSpark" RAT_FUNC "%10.0" "o" COEFFS 0.000000 1.000000 0.000000 0.000000 0.000000 1.000000 /end COMPU_METHOD
/* Scalar calibration for DDE 'CPLc_o_SparkRetardRqst'. */
/begin CHARACTERISTIC CPLc_o_SparkRetardRqst "Override flag" VALUE 0x84f3c RL_CPLC_O_SPARKRETARDRQST 1.000000 CU_CPLC_O_SPARKRETARDRQST 0.000000 1.000000 BYTE_ORDER MSB_FIRST /end CHARACTERISTIC
/begin RECORD_LAYOUT RL_CPLC_O_SPARKRETARDRQST FNC_VALUES 1 UBYTE COLUMN_DIR DIRECT /end RECORD_LAYOUT
/begin COMPU_METHOD CU_CPLC_O_SPARKRETARDRQST "Conversion method for CPLc_o_SparkRetardRqst" RAT_FUNC "%10.0" "o" COEFFS 0.000000 1.000000 0.000000 0.000000 0.000000 1.000000 /end COMPU_METHOD
/* Scalar calibration for DDE 'CPLc_ret_RetardMax'. */
/begin CHARACTERISTIC CPLc_ret_RetardMax "Spark retard request will be limited to this magnitude" VALUE 0x84f48 RL_CPLC_RET_RETARDMAX 90.000000 CU_CPLC_RET_RETARDMAX 0.000000 90.000000 BYTE_ORDER MSB_FIRST /end CHARACTERISTIC
/begin RECORD_LAYOUT RL_CPLC_RET_RETARDMAX FNC_VALUES 1 FLOAT32_IEEE COLUMN_DIR DIRECT /end RECORD_LAYOUT
/begin COMPU_METHOD CU_CPLC_RET_RETARDMAX "Conversion method for CPLc_ret_RetardMax" RAT_FUNC "%10.0" "ret" COEFFS 0.000000 1.000000 0.000000 0.000000 0.000000 1.000000 /end COMPU_METHOD
/* Scalar calibration for DDE 'CPLc_ret_SparkRetardRqst'. */
/begin CHARACTERISTIC CPLc_ret_SparkRetardRqst "Override value" VALUE 0x84f40 RL_CPLC_RET_SPARKRETARDRQST 40.000000 CU_CPLC_RET_SPARKRETARDRQST 0.000000 40.000000 BYTE_ORDER MSB_FIRST /end CHARACTERISTIC
/begin RECORD_LAYOUT RL_CPLC_RET_SPARKRETARDRQST FNC_VALUES 1 FLOAT32_IEEE COLUMN_DIR DIRECT /end RECORD_LAYOUT
/begin COMPU_METHOD CU_CPLC_RET_SPARKRETARDRQST "Conversion method for CPLc_ret_SparkRetardRqst" RAT_FUNC "%10.1" "ret" COEFFS 0.000000 1.000000 0.000000 0.000000 0.000000 1.000000 /end COMPU_METHOD
/* Map (1d) calibration for DDE 'CPLm_NU_BoostLimit_z'. */
/begin CHARACTERISTIC CPLm_NU_BoostLimit_z "(kPa) Manifold pressure threshold to begin spark retard" CURVE 0x84f14 RL_CPLM_NU_BOOSTLIMIT_Z 100.000000 CU_CPLM_NU_BOOSTLIMIT_Z 100.000000 200.000000
 /begin AXIS_DESCR COM_AXIS NO_INPUT_QUANTITY CU_CPLM_NU_BOOSTLIMIT_X 9 0.000000 10000.000000 AXIS_PTS_REF APD_CPLM_NU_BOOSTLIMIT_X /end AXIS_DESCR
 BYTE_ORDER MSB_FIRST /end CHARACTERISTIC
/begin RECORD_LAYOUT RL_CPLM_NU_BOOSTLIMIT_Z FNC_VALUES 1 FLOAT32_IEEE COLUMN_DIR DIRECT /end RECORD_LAYOUT
/begin COMPU_METHOD CU_CPLM_NU_BOOSTLIMIT_Z "Conversion method for CPLm_NU_BoostLimit_z" RAT_FUNC "%10.0" "kPa" COEFFS 0.000000 1.000000 0.000000 0.000000 0.000000 1.000000 /end COMPU_METHOD
/begin AXIS_PTS APD_CPLM_NU_BOOSTLIMIT_X "(RPM) boost limit engine speed lookup" 0x84ef0 NO_INPUT_QUANTITY RL_CPLM_NU_BOOSTLIMIT_X 10000.000000 CU_CPLM_NU_BOOSTLIMIT_X 9 0.0 10000.0 BYTE_ORDER MSB_FIRST /end AXIS_PTS
/begin RECORD_LAYOUT RL_CPLM_NU_BOOSTLIMIT_X AXIS_PTS_X 1 FLOAT32_IEEE INDEX_INCR DIRECT /end RECORD_LAYOUT
/begin COMPU_METHOD CU_CPLM_NU_BOOSTLIMIT_X "Conversion method for CPLm_NU_BoostLimit_x" RAT_FUNC "%10.0" "RPM" COEFFS 0.000000 1.000000 0.000000 0.000000 0.000000 1.000000 /end COMPU_METHOD
/* Scalar calibration for DDE 'CRUc_NU_Calib'. */
/begin CHARACTERISTIC CRUc_NU_Calib "(not defined)" VALUE 0x81d4c RL_CRUC_NU_CALIB 2000.000000 CU_CRUC_NU_CALIB -1000.000000 1000.000000 BYTE_ORDER MSB_FIRST /end CHARACTERISTIC
/begin RECORD_LAYOUT RL_CRUC_NU_CALIB FNC_VALUES 1 FLOAT32_IEEE COLUMN_DIR DIRECT /end RECORD_LAYOUT
/begin COMPU_METHOD CU_CRUC_NU_CALIB "Conversion method for CRUc_NU_Calib" RAT_FUNC "%10.3" "NU" COEFFS 0.000000 1.000000 0.000000 0.000000 0.000000 1.000000 /end COMPU_METHOD
/* Scalar calibration for DDE 'CRUc_NU_CurrSpeed'. */
/begin CHARACTERISTIC CRUc_NU_CurrSpeed "(not defined)" VALUE 0x81d24 RL_CRUC_NU_CURRSPEED 250.000000 CU_CRUC_NU_CURRSPEED 0.000000 250.000000 BYTE_ORDER MSB_FIRST /end CHARACTERISTIC
/begin RECORD_LAYOUT RL_CRUC_NU_CURRSPEED FNC_VALUES 1 FLOAT32_IEEE COLUMN_DIR DIRECT /end RECORD_LAYOUT
/begin COMPU_METHOD CU_CRUC_NU_CURRSPEED "Conversion method for CRUc_NU_CurrSpeed" RAT_FUNC "%10.0" "NU" COEFFS 0.000000 1.000000 0.000000 0.000000 0.000000 1.000000 /end COMPU_METHOD
/* Scalar calibration for DDE 'CRUc_NU_DGain'. */
/begin CHARACTERISTIC CRUc_NU_DGain "(not defined)" VALUE 0x8bf74 RL_CRUC_NU_DGAIN 2000.000000 CU_CRUC_NU_DGAIN -1000.000000 1000.000000 BYTE_ORDER MSB_FIRST /end CHARACTERISTIC
/begin RECORD_LAYOUT RL_CRUC_NU_DGAIN FNC_VALUES 1 FLOAT32_IEEE COLUMN_DIR DIRECT /end RECORD_LAYOUT
/begin COMPU_METHOD CU_CRUC_NU_DGAIN "Conversion method for CRUc_NU_DGain" RAT_FUNC "%10.3" "NU" COEFFS 0.000000 1.000000 0.000000 0.000000 0.000000 1.000000 /end COMPU_METHOD
/* Scalar calibration for DDE 'CRUc_NU_IGain'. */
/begin CHARACTERISTIC CRUc_NU_IGain "(not defined)" VALUE 0x81d54 RL_CRUC_NU_IGAIN 2000.000000 CU_CRUC_NU_IGAIN -1000.000000 1000.000000 BYTE_ORDER MSB_FIRST /end CHARACTERISTIC
/begin RECORD_LAYOUT RL_CRUC_NU_IGAIN FNC_VALUES 1 FLOAT32_IEEE COLUMN_DIR DIRECT /end RECORD_LAYOUT
/begin COMPU_METHOD CU_CRUC_NU_IGAIN "Conversion method for CRUc_NU_IGain" RAT_FUNC "%10.3" "NU" COEFFS 0.000000 1.000000 0.000000 0.000000 0.000000 1.000000 /end COMPU_METHOD
/* Scalar calibration for DDE 'CRUc_NU_LimSpeed'. */
/begin CHARACTERISTIC CRUc_NU_LimSpeed "(not defined)" VALUE 0x81d3c RL_CRUC_NU_LIMSPEED 250.000000 CU_CRUC_NU_LIMSPEED 0.000000 250.000000 BYTE_ORDER MSB_FIRST /end CHARACTERISTIC
/begin RECORD_LAYOUT RL_CRUC_NU_LIMSPEED FNC_VALUES 1 FLOAT32_IEEE COLUMN_DIR DIRECT /end RECORD_LAYOUT
/begin COMPU_METHOD CU_CRUC_NU_LIMSPEED "Conversion method for CRUc_NU_LimSpeed" RAT_FUNC "%10.0" "NU" COEFFS 0.000000 1.000000 0.000000 0.000000 0.000000 1.000000 /end COMPU_METHOD
/* Scalar calibration for DDE 'CRUc_NU_PGain'. */
/begin CHARACTERISTIC CRUc_NU_PGain "(not defined)" VALUE 0x81d50 RL_CRUC_NU_PGAIN 2000.000000 CU_CRUC_NU_PGAIN -1000.000000 1000.000000 BYTE_ORDER MSB_FIRST /end CHARACTERISTIC
/begin RECORD_LAYOUT RL_CRUC_NU_PGAIN FNC_VALUES 1 FLOAT32_IEEE COLUMN_DIR DIRECT /end RECORD_LAYOUT
/begin COMPU_METHOD CU_CRUC_NU_PGAIN "Conversion method for CRUc_NU_PGain" RAT_FUNC "%10.3" "NU" COEFFS 0.000000 1.000000 0.000000 0.000000 0.000000 1.000000 /end COMPU_METHOD
/* Scalar calibration for DDE 'CRUc_NU_TargetSpeed'. */
/begin CHARACTERISTIC CRUc_NU_TargetSpeed "(not defined)" VALUE 0x81d44 RL_CRUC_NU_TARGETSPEED 250.000000 CU_CRUC_NU_TARGETSPEED 0.000000 250.000000 BYTE_ORDER MSB_FIRST /end CHARACTERISTIC
/begin RECORD_LAYOUT RL_CRUC_NU_TARGETSPEED FNC_VALUES 1 FLOAT32_IEEE COLUMN_DIR DIRECT /end RECORD_LAYOUT
/begin COMPU_METHOD CU_CRUC_NU_TARGETSPEED "Conversion method for CRUc_NU_TargetSpeed" RAT_FUNC "%10.0" "NU" COEFFS 0.000000 1.000000 0.000000 0.000000 0.000000 1.000000 /end COMPU_METHOD
/* Scalar calibration for DDE 'CRUc_NU_VehSpeed_Gain'. */
/begin CHARACTERISTIC CRUc_NU_VehSpeed_Gain "(not defined)" VALUE 0x878e8 RL_CRUC_NU_VEHSPEED_GAIN 2000.000000 CU_CRUC_NU_VEHSPEED_GAIN -1000.000000 1000.000000 BYTE_ORDER MSB_FIRST /end CHARACTERISTIC
/begin RECORD_LAYOUT RL_CRUC_NU_VEHSPEED_GAIN FNC_VALUES 1 FLOAT32_IEEE COLUMN_DIR DIRECT /end RECORD_LAYOUT
/begin COMPU_METHOD CU_CRUC_NU_VEHSPEED_GAIN "Conversion method for CRUc_NU_VehSpeed_Gain" RAT_FUNC "%10.3" "NU" COEFFS 0.000000 1.000000 0.000000 0.000000 0.000000 1.000000 /end COMPU_METHOD
/* Scalar calibration for DDE 'CRUc_NU_VehSpeed_Ofst'. */
/begin CHARACTERISTIC CRUc_NU_VehSpeed_Ofst "(not defined)" VALUE 0x878ec RL_CRUC_NU_VEHSPEED_OFST 2000.000000 CU_CRUC_NU_VEHSPEED_OFST -1000.000000 1000.000000 BYTE_ORDER MSB_FIRST /end CHARACTERISTIC
/begin RECORD_LAYOUT RL_CRUC_NU_VEHSPEED_OFST FNC_VALUES 1 FLOAT32_IEEE COLUMN_DIR DIRECT /end RECORD_LAYOUT
/begin COMPU_METHOD CU_CRUC_NU_VEHSPEED_OFST "Conversion method for CRUc_NU_VehSpeed_Ofst" RAT_FUNC "%10.3" "NU" COEFFS 0.000000 1.000000 0.000000 0.000000 0.000000 1.000000 /end COMPU_METHOD
/* Scalar calibration for DDE 'CRUc_V_CruiserSET'. */
/begin CHARACTERISTIC CRUc_V_CruiserSET "(not defined)" VALUE 0x81d30 RL_CRUC_V_CRUISERSET 5.000000 CU_CRUC_V_CRUISERSET 0.000000 5.000000 BYTE_ORDER MSB_FIRST /end CHARACTERISTIC
/begin RECORD_LAYOUT RL_CRUC_V_CRUISERSET FNC_VALUES 1 FLOAT32_IEEE COLUMN_DIR DIRECT /end RECORD_LAYOUT
/begin COMPU_METHOD CU_CRUC_V_CRUISERSET "Conversion method for CRUc_V_CruiserSET" RAT_FUNC "%10.2" "V" COEFFS 0.000000 1.000000 0.000000 0.000000 0.000000 1.000000 /end COMPU_METHOD
/* Scalar calibration for DDE 'CRUc_b_Active'. */
/begin CHARACTERISTIC CRUc_b_Active "(not defined)" VALUE 0x81d29 RL_CRUC_B_ACTIVE 1.000000 CU_CRUC_B_ACTIVE 0.000000 1.000000 BYTE_ORDER MSB_FIRST /end CHARACTERISTIC
/begin RECORD_LAYOUT RL_CRUC_B_ACTIVE FNC_VALUES 1 UBYTE COLUMN_DIR DIRECT /end RECORD_LAYOUT
/begin COMPU_METHOD CU_CRUC_B_ACTIVE "Conversion method for CRUc_b_Active" RAT_FUNC "%10.0" "NU" COEFFS 0.000000 1.000000 0.000000 0.000000 0.000000 1.000000 /end COMPU_METHOD
/* Scalar calibration for DDE 'CRUc_b_BrakeON'. */
/begin CHARACTERISTIC CRUc_b_BrakeON "(not defined)" VALUE 0x81d2b RL_CRUC_B_BRAKEON 1.000000 CU_CRUC_B_BRAKEON 0.000000 1.000000 BYTE_ORDER MSB_FIRST /end CHARACTERISTIC
/begin RECORD_LAYOUT RL_CRUC_B_BRAKEON FNC_VALUES 1 UBYTE COLUMN_DIR DIRECT /end RECORD_LAYOUT
/begin COMPU_METHOD CU_CRUC_B_BRAKEON "Conversion method for CRUc_b_BrakeON" RAT_FUNC "%10.0" "NU" COEFFS 0.000000 1.000000 0.000000 0.000000 0.000000 1.000000 /end COMPU_METHOD
/* Scalar calibration for DDE 'CRUc_b_Cancel'. */
/begin CHARACTERISTIC CRUc_b_Cancel "(not defined)" VALUE 0x81d35 RL_CRUC_B_CANCEL 1.000000 CU_CRUC_B_CANCEL 0.000000 1.000000 BYTE_ORDER MSB_FIRST /end CHARACTERISTIC
/begin RECORD_LAYOUT RL_CRUC_B_CANCEL FNC_VALUES 1 UBYTE COLUMN_DIR DIRECT /end RECORD_LAYOUT
/begin COMPU_METHOD CU_CRUC_B_CANCEL "Conversion method for CRUc_b_Cancel" RAT_FUNC "%10.0" "NU" COEFFS 0.000000 1.000000 0.000000 0.000000 0.000000 1.000000 /end COMPU_METHOD
/* Scalar calibration for DDE 'CRUc_b_ClunchON'. */
/begin CHARACTERISTIC CRUc_b_ClunchON "(not defined)" VALUE 0x81d2d RL_CRUC_B_CLUNCHON 1.000000 CU_CRUC_B_CLUNCHON 0.000000 1.000000 BYTE_ORDER MSB_FIRST /end CHARACTERISTIC
/begin RECORD_LAYOUT RL_CRUC_B_CLUNCHON FNC_VALUES 1 UBYTE COLUMN_DIR DIRECT /end RECORD_LAYOUT
/begin COMPU_METHOD CU_CRUC_B_CLUNCHON "Conversion method for CRUc_b_ClunchON" RAT_FUNC "%10.0" "NU" COEFFS 0.000000 1.000000 0.000000 0.000000 0.000000 1.000000 /end COMPU_METHOD
/* Scalar calibration for DDE 'CRUc_b_DownSpeed'. */
/begin CHARACTERISTIC CRUc_b_DownSpeed "(not defined)" VALUE 0x81d39 RL_CRUC_B_DOWNSPEED 1.000000 CU_CRUC_B_DOWNSPEED 0.000000 1.000000 BYTE_ORDER MSB_FIRST /end CHARACTERISTIC
/begin RECORD_LAYOUT RL_CRUC_B_DOWNSPEED FNC_VALUES 1 UBYTE COLUMN_DIR DIRECT /end RECORD_LAYOUT
/begin COMPU_METHOD CU_CRUC_B_DOWNSPEED "Conversion method for CRUc_b_DownSpeed" RAT_FUNC "%10.0" "NU" COEFFS 0.000000 1.000000 0.000000 0.000000 0.000000 1.000000 /end COMPU_METHOD
/* Scalar calibration for DDE 'CRUc_b_Enable'. */
/begin CHARACTERISTIC CRUc_b_Enable "(not defined)" VALUE 0x81d49 RL_CRUC_B_ENABLE 1.000000 CU_CRUC_B_ENABLE 0.000000 1.000000 BYTE_ORDER MSB_FIRST /end CHARACTERISTIC
/begin RECORD_LAYOUT RL_CRUC_B_ENABLE FNC_VALUES 1 UBYTE COLUMN_DIR DIRECT /end RECORD_LAYOUT
/begin COMPU_METHOD CU_CRUC_B_ENABLE "Conversion method for CRUc_b_Enable" RAT_FUNC "%10.0" "NU" COEFFS 0.000000 1.000000 0.000000 0.000000 0.000000 1.000000 /end COMPU_METHOD
/* Scalar calibration for DDE 'CRUc_b_FootBrake'. */
/begin CHARACTERISTIC CRUc_b_FootBrake "(not defined)" VALUE 0x878e3 RL_CRUC_B_FOOTBRAKE 1.000000 CU_CRUC_B_FOOTBRAKE 0.000000 1.000000 BYTE_ORDER MSB_FIRST /end CHARACTERISTIC
/begin RECORD_LAYOUT RL_CRUC_B_FOOTBRAKE FNC_VALUES 1 UBYTE COLUMN_DIR DIRECT /end RECORD_LAYOUT
/begin COMPU_METHOD CU_CRUC_B_FOOTBRAKE "Conversion method for CRUc_b_FootBrake" RAT_FUNC "%10.0" "NU" COEFFS 0.000000 1.000000 0.000000 0.000000 0.000000 1.000000 /end COMPU_METHOD
/* Scalar calibration for DDE 'CRUc_b_ParkingBrake'. */
/begin CHARACTERISTIC CRUc_b_ParkingBrake "(not defined)" VALUE 0x878e1 RL_CRUC_B_PARKINGBRAKE 1.000000 CU_CRUC_B_PARKINGBRAKE 0.000000 1.000000 BYTE_ORDER MSB_FIRST /end CHARACTERISTIC
/begin RECORD_LAYOUT RL_CRUC_B_PARKINGBRAKE FNC_VALUES 1 UBYTE COLUMN_DIR DIRECT /end RECORD_LAYOUT
/begin COMPU_METHOD CU_CRUC_B_PARKINGBRAKE "Conversion method for CRUc_b_ParkingBrake" RAT_FUNC "%10.0" "NU" COEFFS 0.000000 1.000000 0.000000 0.000000 0.000000 1.000000 /end COMPU_METHOD
/* Scalar calibration for DDE 'CRUc_b_UpSpeed'. */
/begin CHARACTERISTIC CRUc_b_UpSpeed "(not defined)" VALUE 0x81d37 RL_CRUC_B_UPSPEED 1.000000 CU_CRUC_B_UPSPEED 0.000000 1.000000 BYTE_ORDER MSB_FIRST /end CHARACTERISTIC
/begin RECORD_LAYOUT RL_CRUC_B_UPSPEED FNC_VALUES 1 UBYTE COLUMN_DIR DIRECT /end RECORD_LAYOUT
/begin COMPU_METHOD CU_CRUC_B_UPSPEED "Conversion method for CRUc_b_UpSpeed" RAT_FUNC "%10.0" "NU" COEFFS 0.000000 1.000000 0.000000 0.000000 0.000000 1.000000 /end COMPU_METHOD
/* Scalar calibration for DDE 'CRUc_o_Active'. */
/begin CHARACTERISTIC CRUc_o_Active "Cruiser ON" VALUE 0x81d28 RL_CRUC_O_ACTIVE 1.000000 CU_CRUC_O_ACTIVE 0.000000 1.000000 BYTE_ORDER MSB_FIRST /end CHARACTERISTIC
/begin RECORD_LAYOUT RL_CRUC_O_ACTIVE FNC_VALUES 1 UBYTE COLUMN_DIR DIRECT /end RECORD_LAYOUT
/begin COMPU_METHOD CU_CRUC_O_ACTIVE "Conversion method for CRUc_o_Active" RAT_FUNC "%10.0" "o" COEFFS 0.000000 1.000000 0.000000 0.000000 0.000000 1.000000 /end COMPU_METHOD
/* Scalar calibration for DDE 'CRUc_o_BrakeON'. */
/begin CHARACTERISTIC CRUc_o_BrakeON "Brake ON" VALUE 0x81d2a RL_CRUC_O_BRAKEON 1.000000 CU_CRUC_O_BRAKEON 0.000000 1.000000 BYTE_ORDER MSB_FIRST /end CHARACTERISTIC
/begin RECORD_LAYOUT RL_CRUC_O_BRAKEON FNC_VALUES 1 UBYTE COLUMN_DIR DIRECT /end RECORD_LAYOUT
/begin COMPU_METHOD CU_CRUC_O_BRAKEON "Conversion method for CRUc_o_BrakeON" RAT_FUNC "%10.0" "o" COEFFS 0.000000 1.000000 0.000000 0.000000 0.000000 1.000000 /end COMPU_METHOD
/* Scalar calibration for DDE 'CRUc_o_Cancel'. */
/begin CHARACTERISTIC CRUc_o_Cancel "Cancel ON" VALUE 0x81d34 RL_CRUC_O_CANCEL 1.000000 CU_CRUC_O_CANCEL 0.000000 1.000000 BYTE_ORDER MSB_FIRST /end CHARACTERISTIC
/begin RECORD_LAYOUT RL_CRUC_O_CANCEL FNC_VALUES 1 UBYTE COLUMN_DIR DIRECT /end RECORD_LAYOUT
/begin COMPU_METHOD CU_CRUC_O_CANCEL "Conversion method for CRUc_o_Cancel" RAT_FUNC "%10.0" "o" COEFFS 0.000000 1.000000 0.000000 0.000000 0.000000 1.000000 /end COMPU_METHOD
/* Scalar calibration for DDE 'CRUc_o_ClunchON'. */
/begin CHARACTERISTIC CRUc_o_ClunchON "Clunch ON" VALUE 0x81d2c RL_CRUC_O_CLUNCHON 1.000000 CU_CRUC_O_CLUNCHON 0.000000 1.000000 BYTE_ORDER MSB_FIRST /end CHARACTERISTIC
/begin RECORD_LAYOUT RL_CRUC_O_CLUNCHON FNC_VALUES 1 UBYTE COLUMN_DIR DIRECT /end RECORD_LAYOUT
/begin COMPU_METHOD CU_CRUC_O_CLUNCHON "Conversion method for CRUc_o_ClunchON" RAT_FUNC "%10.0" "o" COEFFS 0.000000 1.000000 0.000000 0.000000 0.000000 1.000000 /end COMPU_METHOD
/* Scalar calibration for DDE 'CRUc_o_CruiserSET'. */
/begin CHARACTERISTIC CRUc_o_CruiserSET "(not defined)" VALUE 0x81d2e RL_CRUC_O_CRUISERSET 1.000000 CU_CRUC_O_CRUISERSET 0.000000 1.000000 BYTE_ORDER MSB_FIRST /end CHARACTERISTIC
/begin RECORD_LAYOUT RL_CRUC_O_CRUISERSET FNC_VALUES 1 UBYTE COLUMN_DIR DIRECT /end RECORD_LAYOUT
/begin COMPU_METHOD CU_CRUC_O_CRUISERSET "Conversion method for CRUc_o_CruiserSET" RAT_FUNC "%10.0" "o" COEFFS 0.000000 1.000000 0.000000 0.000000 0.000000 1.000000 /end COMPU_METHOD
/* Scalar calibration for DDE 'CRUc_o_CurrSpeed'. */
/begin CHARACTERISTIC CRUc_o_CurrSpeed "Current Speed" VALUE 0x81d20 RL_CRUC_O_CURRSPEED 1.000000 CU_CRUC_O_CURRSPEED 0.000000 1.000000 BYTE_ORDER MSB_FIRST /end CHARACTERISTIC
/begin RECORD_LAYOUT RL_CRUC_O_CURRSPEED FNC_VALUES 1 UBYTE COLUMN_DIR DIRECT /end RECORD_LAYOUT
/begin COMPU_METHOD CU_CRUC_O_CURRSPEED "Conversion method for CRUc_o_CurrSpeed" RAT_FUNC "%10.0" "o" COEFFS 0.000000 1.000000 0.000000 0.000000 0.000000 1.000000 /end COMPU_METHOD
/* Scalar calibration for DDE 'CRUc_o_DownSpeed'. */
/begin CHARACTERISTIC CRUc_o_DownSpeed "Speed Down" VALUE 0x81d38 RL_CRUC_O_DOWNSPEED 1.000000 CU_CRUC_O_DOWNSPEED 0.000000 1.000000 BYTE_ORDER MSB_FIRST /end CHARACTERISTIC
/begin RECORD_LAYOUT RL_CRUC_O_DOWNSPEED FNC_VALUES 1 UBYTE COLUMN_DIR DIRECT /end RECORD_LAYOUT
/begin COMPU_METHOD CU_CRUC_O_DOWNSPEED "Conversion method for CRUc_o_DownSpeed" RAT_FUNC "%10.0" "o" COEFFS 0.000000 1.000000 0.000000 0.000000 0.000000 1.000000 /end COMPU_METHOD
/* Scalar calibration for DDE 'CRUc_o_Enable'. */
/begin CHARACTERISTIC CRUc_o_Enable "Enable" VALUE 0x81d48 RL_CRUC_O_ENABLE 1.000000 CU_CRUC_O_ENABLE 0.000000 1.000000 BYTE_ORDER MSB_FIRST /end CHARACTERISTIC
/begin RECORD_LAYOUT RL_CRUC_O_ENABLE FNC_VALUES 1 UBYTE COLUMN_DIR DIRECT /end RECORD_LAYOUT
/begin COMPU_METHOD CU_CRUC_O_ENABLE "Conversion method for CRUc_o_Enable" RAT_FUNC "%10.0" "o" COEFFS 0.000000 1.000000 0.000000 0.000000 0.000000 1.000000 /end COMPU_METHOD
/* Scalar calibration for DDE 'CRUc_o_FootBrake'. */
/begin CHARACTERISTIC CRUc_o_FootBrake "Parking ON" VALUE 0x878e2 RL_CRUC_O_FOOTBRAKE 1.000000 CU_CRUC_O_FOOTBRAKE 0.000000 1.000000 BYTE_ORDER MSB_FIRST /end CHARACTERISTIC
/begin RECORD_LAYOUT RL_CRUC_O_FOOTBRAKE FNC_VALUES 1 UBYTE COLUMN_DIR DIRECT /end RECORD_LAYOUT
/begin COMPU_METHOD CU_CRUC_O_FOOTBRAKE "Conversion method for CRUc_o_FootBrake" RAT_FUNC "%10.0" "o" COEFFS 0.000000 1.000000 0.000000 0.000000 0.000000 1.000000 /end COMPU_METHOD
/* Scalar calibration for DDE 'CRUc_o_LimSpeed'. */
/begin CHARACTERISTIC CRUc_o_LimSpeed "Limited speed" VALUE 0x81d3a RL_CRUC_O_LIMSPEED 1.000000 CU_CRUC_O_LIMSPEED 0.000000 1.000000 BYTE_ORDER MSB_FIRST /end CHARACTERISTIC
/begin RECORD_LAYOUT RL_CRUC_O_LIMSPEED FNC_VALUES 1 UBYTE COLUMN_DIR DIRECT /end RECORD_LAYOUT
/begin COMPU_METHOD CU_CRUC_O_LIMSPEED "Conversion method for CRUc_o_LimSpeed" RAT_FUNC "%10.0" "o" COEFFS 0.000000 1.000000 0.000000 0.000000 0.000000 1.000000 /end COMPU_METHOD
/* Scalar calibration for DDE 'CRUc_o_ParkingBrake'. */
/begin CHARACTERISTIC CRUc_o_ParkingBrake "Parking ON" VALUE 0x878e0 RL_CRUC_O_PARKINGBRAKE 1.000000 CU_CRUC_O_PARKINGBRAKE 0.000000 1.000000 BYTE_ORDER MSB_FIRST /end CHARACTERISTIC
/begin RECORD_LAYOUT RL_CRUC_O_PARKINGBRAKE FNC_VALUES 1 UBYTE COLUMN_DIR DIRECT /end RECORD_LAYOUT
/begin COMPU_METHOD CU_CRUC_O_PARKINGBRAKE "Conversion method for CRUc_o_ParkingBrake" RAT_FUNC "%10.0" "o" COEFFS 0.000000 1.000000 0.000000 0.000000 0.000000 1.000000 /end COMPU_METHOD
/* Scalar calibration for DDE 'CRUc_o_TargetSpeed'. */
/begin CHARACTERISTIC CRUc_o_TargetSpeed "Target Speed" VALUE 0x81d40 RL_CRUC_O_TARGETSPEED 1.000000 CU_CRUC_O_TARGETSPEED 0.000000 1.000000 BYTE_ORDER MSB_FIRST /end CHARACTERISTIC
/begin RECORD_LAYOUT RL_CRUC_O_TARGETSPEED FNC_VALUES 1 UBYTE COLUMN_DIR DIRECT /end RECORD_LAYOUT
/begin COMPU_METHOD CU_CRUC_O_TARGETSPEED "Conversion method for CRUc_o_TargetSpeed" RAT_FUNC "%10.0" "o" COEFFS 0.000000 1.000000 0.000000 0.000000 0.000000 1.000000 /end COMPU_METHOD
/* Scalar calibration for DDE 'CRUc_o_UpSpeed'. */
/begin CHARACTERISTIC CRUc_o_UpSpeed "Speed UP" VALUE 0x81d36 RL_CRUC_O_UPSPEED 1.000000 CU_CRUC_O_UPSPEED 0.000000 1.000000 BYTE_ORDER MSB_FIRST /end CHARACTERISTIC
/begin RECORD_LAYOUT RL_CRUC_O_UPSPEED FNC_VALUES 1 UBYTE COLUMN_DIR DIRECT /end RECORD_LAYOUT
/begin COMPU_METHOD CU_CRUC_O_UPSPEED "Conversion method for CRUc_o_UpSpeed" RAT_FUNC "%10.0" "o" COEFFS 0.000000 1.000000 0.000000 0.000000 0.000000 1.000000 /end COMPU_METHOD
/* Map (1d) calibration for DDE 'CRUm_NU_Effort_Torque_z'. */
/begin CHARACTERISTIC CRUm_NU_Effort_Torque_z "(not defined)" CURVE 0x81d7c RL_CRUM_NU_EFFORT_TORQUE_Z 2000.000000 CU_CRUM_NU_EFFORT_TORQUE_Z -1000.000000 1000.000000
 /begin AXIS_DESCR COM_AXIS PIDEffort CU_CRUM_NU_EFFORT_TORQUE_X 9 -8000.000000 8000.000000 AXIS_PTS_REF APD_CRUM_NU_EFFORT_TORQUE_X /end AXIS_DESCR
 BYTE_ORDER MSB_FIRST /end CHARACTERISTIC
/begin RECORD_LAYOUT RL_CRUM_NU_EFFORT_TORQUE_Z FNC_VALUES 1 FLOAT32_IEEE COLUMN_DIR DIRECT /end RECORD_LAYOUT
/begin COMPU_METHOD CU_CRUM_NU_EFFORT_TORQUE_Z "Conversion method for CRUm_NU_Effort_Torque_z" RAT_FUNC "%10.2" "NU" COEFFS 0.000000 1.000000 0.000000 0.000000 0.000000 1.000000 /end COMPU_METHOD
/begin AXIS_PTS APD_CRUM_NU_EFFORT_TORQUE_X "(not defined)" 0x81d58 PIDEffort RL_CRUM_NU_EFFORT_TORQUE_X 16000.000000 CU_CRUM_NU_EFFORT_TORQUE_X 9 -8000.0 8000.0 BYTE_ORDER MSB_FIRST /end AXIS_PTS
/begin RECORD_LAYOUT RL_CRUM_NU_EFFORT_TORQUE_X AXIS_PTS_X 1 FLOAT32_IEEE INDEX_INCR DIRECT /end RECORD_LAYOUT
/begin COMPU_METHOD CU_CRUM_NU_EFFORT_TORQUE_X "Conversion method for CRUm_NU_Effort_Torque_x" RAT_FUNC "%10.2" "NU" COEFFS 0.000000 1.000000 0.000000 0.000000 0.000000 1.000000 /end COMPU_METHOD
/* Scalar calibration for DDE 'CTCc_b_UseEngineTemp'. */
/begin CHARACTERISTIC CTCc_b_UseEngineTemp "Select between (0) AME Charge Temp estimate and (1) INP Engine Temp input to use as Y-axis lookup for CTC spark and fuel tables." VALUE 0x83f81 RL_CTCC_B_USEENGINETEMP 1.000000 CU_CTCC_B_USEENGINETEMP 0.000000 1.000000 BYTE_ORDER MSB_FIRST /end CHARACTERISTIC
/begin RECORD_LAYOUT RL_CTCC_B_USEENGINETEMP FNC_VALUES 1 UBYTE COLUMN_DIR DIRECT /end RECORD_LAYOUT
/begin COMPU_METHOD CU_CTCC_B_USEENGINETEMP "Conversion method for CTCc_b_UseEngineTemp" RAT_FUNC "%10.0" "b" COEFFS 0.000000 1.000000 0.000000 0.000000 0.000000 1.000000 /end COMPU_METHOD
/* Scalar calibration for DDE 'CTCc_b_UseExhaustTemp'. */
/begin CHARACTERISTIC CTCc_b_UseExhaustTemp "Select between (1) INP Exhaust temp and (0) INP Engine Temp input to use as Y-axis lookup for CTC spark and fuel tables." VALUE 0x83f80 RL_CTCC_B_USEEXHAUSTTEMP 1.000000 CU_CTCC_B_USEEXHAUSTTEMP 0.000000 1.000000 BYTE_ORDER MSB_FIRST /end CHARACTERISTIC
/begin RECORD_LAYOUT RL_CTCC_B_USEEXHAUSTTEMP FNC_VALUES 1 UBYTE COLUMN_DIR DIRECT /end RECORD_LAYOUT
/begin COMPU_METHOD CU_CTCC_B_USEEXHAUSTTEMP "Conversion method for CTCc_b_UseExhaustTemp" RAT_FUNC "%10.0" "b" COEFFS 0.000000 1.000000 0.000000 0.000000 0.000000 1.000000 /end COMPU_METHOD
/* Scalar calibration for DDE 'CTCc_lam_FuelOfst'. */
/begin CHARACTERISTIC CTCc_lam_FuelOfst "Charge temp modifier override value" VALUE 0x84048 RL_CTCC_LAM_FUELOFST 1.000000 CU_CTCC_LAM_FUELOFST 0.000000 1.000000 BYTE_ORDER MSB_FIRST /end CHARACTERISTIC
/begin RECORD_LAYOUT RL_CTCC_LAM_FUELOFST FNC_VALUES 1 FLOAT32_IEEE COLUMN_DIR DIRECT /end RECORD_LAYOUT
/begin COMPU_METHOD CU_CTCC_LAM_FUELOFST "Conversion method for CTCc_lam_FuelOfst" RAT_FUNC "%10.3" "lam" COEFFS 0.000000 1.000000 0.000000 0.000000 0.000000 1.000000 /end COMPU_METHOD
/* Scalar calibration for DDE 'CTCc_lam_FuelOfstMin'. */
/begin CHARACTERISTIC CTCc_lam_FuelOfstMin "Magnitude limit for mixture offset" VALUE 0x8404c RL_CTCC_LAM_FUELOFSTMIN 0.900000 CU_CTCC_LAM_FUELOFSTMIN -0.900000 0.000000 BYTE_ORDER MSB_FIRST /end CHARACTERISTIC
/begin RECORD_LAYOUT RL_CTCC_LAM_FUELOFSTMIN FNC_VALUES 1 FLOAT32_IEEE COLUMN_DIR DIRECT /end RECORD_LAYOUT
/begin COMPU_METHOD CU_CTCC_LAM_FUELOFSTMIN "Conversion method for CTCc_lam_FuelOfstMin" RAT_FUNC "%10.2" "lam" COEFFS 0.000000 1.000000 0.000000 0.000000 0.000000 1.000000 /end COMPU_METHOD
/* Scalar calibration for DDE 'CTCc_o_FuelOfst'. */
/begin CHARACTERISTIC CTCc_o_FuelOfst "Charge temp fuel modifier override flag" VALUE 0x84044 RL_CTCC_O_FUELOFST 1.000000 CU_CTCC_O_FUELOFST 0.000000 1.000000 BYTE_ORDER MSB_FIRST /end CHARACTERISTIC
/begin RECORD_LAYOUT RL_CTCC_O_FUELOFST FNC_VALUES 1 UBYTE COLUMN_DIR DIRECT /end RECORD_LAYOUT
/begin COMPU_METHOD CU_CTCC_O_FUELOFST "Conversion method for CTCc_o_FuelOfst" RAT_FUNC "%10.0" "b" COEFFS 0.000000 1.000000 0.000000 0.000000 0.000000 1.000000 /end COMPU_METHOD
/* Scalar calibration for DDE 'CTCc_o_SparkRqst'. */
/begin CHARACTERISTIC CTCc_o_SparkRqst "Charge temp spark modifier angle override flag" VALUE 0x84cc8 RL_CTCC_O_SPARKRQST 1.000000 CU_CTCC_O_SPARKRQST 0.000000 1.000000 BYTE_ORDER MSB_FIRST /end CHARACTERISTIC
/begin RECORD_LAYOUT RL_CTCC_O_SPARKRQST FNC_VALUES 1 UBYTE COLUMN_DIR DIRECT /end RECORD_LAYOUT
/begin COMPU_METHOD CU_CTCC_O_SPARKRQST "Conversion method for CTCc_o_SparkRqst" RAT_FUNC "%10.0" "b" COEFFS 0.000000 1.000000 0.000000 0.000000 0.000000 1.000000 /end COMPU_METHOD
/* Scalar calibration for DDE 'CTCc_ret_SparkRqst'. */
/begin CHARACTERISTIC CTCc_ret_SparkRqst "Charge temp spark modifier angle override value" VALUE 0x84ccc RL_CTCC_RET_SPARKRQST 40.000000 CU_CTCC_RET_SPARKRQST 0.000000 40.000000 BYTE_ORDER MSB_FIRST /end CHARACTERISTIC
/begin RECORD_LAYOUT RL_CTCC_RET_SPARKRQST FNC_VALUES 1 FLOAT32_IEEE COLUMN_DIR DIRECT /end RECORD_LAYOUT
/begin COMPU_METHOD CU_CTCC_RET_SPARKRQST "Conversion method for CTCc_ret_SparkRqst" RAT_FUNC "%10.2" "ret" COEFFS 0.000000 1.000000 0.000000 0.000000 0.000000 1.000000 /end COMPU_METHOD
/* Scalar calibration for DDE 'CTCc_ret_SparkRqstMax'. */
/begin CHARACTERISTIC CTCc_ret_SparkRqstMax "Magnitude limit for spark offset" VALUE 0x84cd0 RL_CTCC_RET_SPARKRQSTMAX 60.000000 CU_CTCC_RET_SPARKRQSTMAX 0.000000 60.000000 BYTE_ORDER MSB_FIRST /end CHARACTERISTIC
/begin RECORD_LAYOUT RL_CTCC_RET_SPARKRQSTMAX FNC_VALUES 1 FLOAT32_IEEE COLUMN_DIR DIRECT /end RECORD_LAYOUT
/begin COMPU_METHOD CU_CTCC_RET_SPARKRQSTMAX "Conversion method for CTCc_ret_SparkRqstMax" RAT_FUNC "%10.0" "ret" COEFFS 0.000000 1.000000 0.000000 0.000000 0.000000 1.000000 /end COMPU_METHOD
/* Map (2d) calibration for DDE 'CTCm_NU_FuelEnrichment_z'. */
/begin CHARACTERISTIC CTCm_NU_FuelEnrichment_z "Charge temp fuel modifier table data" MAP 0x83fb4 RL_CTCM_NU_FUELENRICHMENT_Z 1.000000 CU_CTCM_NU_FUELENRICHMENT_Z 0.000000 1.000000
 /begin AXIS_DESCR COM_AXIS NO_INPUT_QUANTITY CU_CTCM_NU_FUELENRICHMENT_X 6 0.000000 100000.000000 AXIS_PTS_REF APD_CTCM_NU_FUELENRICHMENT_X /end AXIS_DESCR
 /begin AXIS_DESCR COM_AXIS NO_INPUT_QUANTITY CU_CTCM_NU_FUELENRICHMENT_Y 6 -40.000000 1000.000000 AXIS_PTS_REF APD_CTCM_NU_FUELENRICHMENT_Y /end AXIS_DESCR
 BYTE_ORDER MSB_FIRST /end CHARACTERISTIC
/begin RECORD_LAYOUT RL_CTCM_NU_FUELENRICHMENT_Z FNC_VALUES 1 FLOAT32_IEEE COLUMN_DIR DIRECT /end RECORD_LAYOUT
/begin COMPU_METHOD CU_CTCM_NU_FUELENRICHMENT_Z "Conversion method for CTCm_NU_FuelEnrichment_z" RAT_FUNC "%10.3" "NU" COEFFS 0.000000 1.000000 0.000000 0.000000 0.000000 1.000000 /end COMPU_METHOD
/begin AXIS_PTS APD_CTCM_NU_FUELENRICHMENT_X "Charge temp fuel modifier table engine speed axis" 0x83f84 NO_INPUT_QUANTITY RL_CTCM_NU_FUELENRICHMENT_X 100000.000000 CU_CTCM_NU_FUELENRICHMENT_X 6 0.0 100000.0 BYTE_ORDER MSB_FIRST /end AXIS_PTS
/begin RECORD_LAYOUT RL_CTCM_NU_FUELENRICHMENT_X AXIS_PTS_X 1 FLOAT32_IEEE INDEX_INCR DIRECT /end RECORD_LAYOUT
/begin COMPU_METHOD CU_CTCM_NU_FUELENRICHMENT_X "Conversion method for CTCm_NU_FuelEnrichment_x" RAT_FUNC "%10.0" "RPM" COEFFS 0.000000 1.000000 0.000000 0.000000 0.000000 1.000000 /end COMPU_METHOD
/begin AXIS_PTS APD_CTCM_NU_FUELENRICHMENT_Y "Temp fuel modifier table charge temp axis" 0x83f9c NO_INPUT_QUANTITY RL_CTCM_NU_FUELENRICHMENT_Y 1040.000000 CU_CTCM_NU_FUELENRICHMENT_Y 6 -40.0 1000.0 BYTE_ORDER MSB_FIRST /end AXIS_PTS
/begin RECORD_LAYOUT RL_CTCM_NU_FUELENRICHMENT_Y AXIS_PTS_X 1 FLOAT32_IEEE INDEX_INCR DIRECT /end RECORD_LAYOUT
/begin COMPU_METHOD CU_CTCM_NU_FUELENRICHMENT_Y "Conversion method for CTCm_NU_FuelEnrichment_y" RAT_FUNC "%10.0" "C" COEFFS 0.000000 1.000000 0.000000 0.000000 0.000000 1.000000 /end COMPU_METHOD
/* Map (2d) calibration for DDE 'CTCm_NU_SparkRqst_z'. */
/begin CHARACTERISTIC CTCm_NU_SparkRqst_z "Charge temp spark modifier table data" MAP 0x84c38 RL_CTCM_NU_SPARKRQST_Z 100.000000 CU_CTCM_NU_SPARKRQST_Z -50.000000 50.000000
 /begin AXIS_DESCR COM_AXIS NO_INPUT_QUANTITY CU_CTCM_NU_SPARKRQST_X 6 0.000000 100000.000000 AXIS_PTS_REF APD_CTCM_NU_SPARKRQST_X /end AXIS_DESCR
 /begin AXIS_DESCR COM_AXIS NO_INPUT_QUANTITY CU_CTCM_NU_SPARKRQST_Y 6 -40.000000 1000.000000 AXIS_PTS_REF APD_CTCM_NU_SPARKRQST_Y /end AXIS_DESCR
 BYTE_ORDER MSB_FIRST /end CHARACTERISTIC
/begin RECORD_LAYOUT RL_CTCM_NU_SPARKRQST_Z FNC_VALUES 1 FLOAT32_IEEE COLUMN_DIR DIRECT /end RECORD_LAYOUT
/begin COMPU_METHOD CU_CTCM_NU_SPARKRQST_Z "Conversion method for CTCm_NU_SparkRqst_z" RAT_FUNC "%10.2" "ret" COEFFS 0.000000 1.000000 0.000000 0.000000 0.000000 1.000000 /end COMPU_METHOD
/begin AXIS_PTS APD_CTCM_NU_SPARKRQST_X "Charge temp spark modifier table engine speed axis" 0x84c08 NO_INPUT_QUANTITY RL_CTCM_NU_SPARKRQST_X 100000.000000 CU_CTCM_NU_SPARKRQST_X 6 0.0 100000.0 BYTE_ORDER MSB_FIRST /end AXIS_PTS
/begin RECORD_LAYOUT RL_CTCM_NU_SPARKRQST_X AXIS_PTS_X 1 FLOAT32_IEEE INDEX_INCR DIRECT /end RECORD_LAYOUT
/begin COMPU_METHOD CU_CTCM_NU_SPARKRQST_X "Conversion method for CTCm_NU_SparkRqst_x" RAT_FUNC "%10.0" "RPM" COEFFS 0.000000 1.000000 0.000000 0.000000 0.000000 1.000000 /end COMPU_METHOD
/begin AXIS_PTS APD_CTCM_NU_SPARKRQST_Y "Temp spark modifier table charge temp axis" 0x84c20 NO_INPUT_QUANTITY RL_CTCM_NU_SPARKRQST_Y 1040.000000 CU_CTCM_NU_SPARKRQST_Y 6 -40.0 1000.0 BYTE_ORDER MSB_FIRST /end AXIS_PTS
/begin RECORD_LAYOUT RL_CTCM_NU_SPARKRQST_Y AXIS_PTS_X 1 FLOAT32_IEEE INDEX_INCR DIRECT /end RECORD_LAYOUT
/begin COMPU_METHOD CU_CTCM_NU_SPARKRQST_Y "Conversion method for CTCm_NU_SparkRqst_y" RAT_FUNC "%10.0" "C" COEFFS 0.000000 1.000000 0.000000 0.000000 0.000000 1.000000 /end COMPU_METHOD
/* Scalar calibration for DDE 'DFCc_C_MinEngTemp'. */
/begin CHARACTERISTIC DFCc_C_MinEngTemp "DFC enable coolant temp threhold" VALUE 0x83514 RL_DFCC_C_MINENGTEMP 200.000000 CU_DFCC_C_MINENGTEMP -50.000000 150.000000 BYTE_ORDER MSB_FIRST /end CHARACTERISTIC
/begin RECORD_LAYOUT RL_DFCC_C_MINENGTEMP FNC_VALUES 1 FLOAT32_IEEE COLUMN_DIR DIRECT /end RECORD_LAYOUT
/begin COMPU_METHOD CU_DFCC_C_MINENGTEMP "Conversion method for DFCc_C_MinEngTemp" RAT_FUNC "%10.0" "C" COEFFS 0.000000 1.000000 0.000000 0.000000 0.000000 1.000000 /end COMPU_METHOD
/* Scalar calibration for DDE 'DFCc_Hz_TqHPF_TC'. */
/begin CHARACTERISTIC DFCc_Hz_TqHPF_TC "HPF filter time-constant for DFC" VALUE 0x834f4 RL_DFCC_HZ_TQHPF_TC 500.000000 CU_DFCC_HZ_TQHPF_TC 0.000000 500.000000 BYTE_ORDER MSB_FIRST /end CHARACTERISTIC
/begin RECORD_LAYOUT RL_DFCC_HZ_TQHPF_TC FNC_VALUES 1 FLOAT32_IEEE COLUMN_DIR DIRECT /end RECORD_LAYOUT
/begin COMPU_METHOD CU_DFCC_HZ_TQHPF_TC "Conversion method for DFCc_Hz_TqHPF_TC" RAT_FUNC "%10.2" "Hz" COEFFS 0.000000 1.000000 0.000000 0.000000 0.000000 1.000000 /end COMPU_METHOD
/* Scalar calibration for DDE 'DFCc_Nm_TqEntryThrsh'. */
/begin CHARACTERISTIC DFCc_Nm_TqEntryThrsh "Torque threshold for entering DFC event" VALUE 0x8350c RL_DFCC_NM_TQENTRYTHRSH 400.000000 CU_DFCC_NM_TQENTRYTHRSH -200.000000 200.000000 BYTE_ORDER MSB_FIRST /end CHARACTERISTIC
/begin RECORD_LAYOUT RL_DFCC_NM_TQENTRYTHRSH FNC_VALUES 1 FLOAT32_IEEE COLUMN_DIR DIRECT /end RECORD_LAYOUT
/begin COMPU_METHOD CU_DFCC_NM_TQENTRYTHRSH "Conversion method for DFCc_Nm_TqEntryThrsh" RAT_FUNC "%10.1" "Nm" COEFFS 0.000000 1.000000 0.000000 0.000000 0.000000 1.000000 /end COMPU_METHOD
/* Scalar calibration for DDE 'DFCc_Nm_TqExitThrsh'. */
/begin CHARACTERISTIC DFCc_Nm_TqExitThrsh "Torque threshold for exiting DFC event" VALUE 0x83504 RL_DFCC_NM_TQEXITTHRSH 400.000000 CU_DFCC_NM_TQEXITTHRSH -200.000000 200.000000 BYTE_ORDER MSB_FIRST /end CHARACTERISTIC
/begin RECORD_LAYOUT RL_DFCC_NM_TQEXITTHRSH FNC_VALUES 1 FLOAT32_IEEE COLUMN_DIR DIRECT /end RECORD_LAYOUT
/begin COMPU_METHOD CU_DFCC_NM_TQEXITTHRSH "Conversion method for DFCc_Nm_TqExitThrsh" RAT_FUNC "%10.1" "Nm" COEFFS 0.000000 1.000000 0.000000 0.000000 0.000000 1.000000 /end COMPU_METHOD
/* Scalar calibration for DDE 'DFCc_Nm_TqHPF_Thrsh'. */
/begin CHARACTERISTIC DFCc_Nm_TqHPF_Thrsh "Torque HPF threshold to enable DFC extra burning" VALUE 0x834f8 RL_DFCC_NM_TQHPF_THRSH 2000.000000 CU_DFCC_NM_TQHPF_THRSH -1000.000000 1000.000000 BYTE_ORDER MSB_FIRST /end CHARACTERISTIC
/begin RECORD_LAYOUT RL_DFCC_NM_TQHPF_THRSH FNC_VALUES 1 FLOAT32_IEEE COLUMN_DIR DIRECT /end RECORD_LAYOUT
/begin COMPU_METHOD CU_DFCC_NM_TQHPF_THRSH "Conversion method for DFCc_Nm_TqHPF_Thrsh" RAT_FUNC "%10.1" "Nm" COEFFS 0.000000 1.000000 0.000000 0.000000 0.000000 1.000000 /end COMPU_METHOD
/* Scalar calibration for DDE 'DFCc_b_DTC_Condition'. */
/begin CHARACTERISTIC DFCc_b_DTC_Condition "Override value" VALUE 0x834fd RL_DFCC_B_DTC_CONDITION 1.000000 CU_DFCC_B_DTC_CONDITION 0.000000 1.000000 BYTE_ORDER MSB_FIRST /end CHARACTERISTIC
/begin RECORD_LAYOUT RL_DFCC_B_DTC_CONDITION FNC_VALUES 1 UBYTE COLUMN_DIR DIRECT /end RECORD_LAYOUT
/begin COMPU_METHOD CU_DFCC_B_DTC_CONDITION "Conversion method for DFCc_b_DTC_Condition" RAT_FUNC "%10.0" "b" COEFFS 0.000000 1.000000 0.000000 0.000000 0.000000 1.000000 /end COMPU_METHOD
/* Scalar calibration for DDE 'DFCc_b_FuelCut'. */
/begin CHARACTERISTIC DFCc_b_FuelCut "Override value" VALUE 0x8351d RL_DFCC_B_FUELCUT 1.000000 CU_DFCC_B_FUELCUT 0.000000 1.000000 BYTE_ORDER MSB_FIRST /end CHARACTERISTIC
/begin RECORD_LAYOUT RL_DFCC_B_FUELCUT FNC_VALUES 1 UBYTE COLUMN_DIR DIRECT /end RECORD_LAYOUT
/begin COMPU_METHOD CU_DFCC_B_FUELCUT "Conversion method for DFCc_b_FuelCut" RAT_FUNC "%10.0" "b" COEFFS 0.000000 1.000000 0.000000 0.000000 0.000000 1.000000 /end COMPU_METHOD
/* Scalar calibration for DDE 'DFCc_deg_MaxSparkRetard'. */
/begin CHARACTERISTIC DFCc_deg_MaxSparkRetard "Maximum spark retard before fuel is cut when DFC is active" VALUE 0x83508 RL_DFCC_DEG_MAXSPARKRETARD 50.000000 CU_DFCC_DEG_MAXSPARKRETARD 0.000000 50.000000 BYTE_ORDER MSB_FIRST /end CHARACTERISTIC
/begin RECORD_LAYOUT RL_DFCC_DEG_MAXSPARKRETARD FNC_VALUES 1 FLOAT32_IEEE COLUMN_DIR DIRECT /end RECORD_LAYOUT
/begin COMPU_METHOD CU_DFCC_DEG_MAXSPARKRETARD "Conversion method for DFCc_deg_MaxSparkRetard" RAT_FUNC "%10.0" "deg" COEFFS 0.000000 1.000000 0.000000 0.000000 0.000000 1.000000 /end COMPU_METHOD
/* Scalar calibration for DDE 'DFCc_o_DTC_Condition'. */
/begin CHARACTERISTIC DFCc_o_DTC_Condition "Override flag" VALUE 0x834fc RL_DFCC_O_DTC_CONDITION 1.000000 CU_DFCC_O_DTC_CONDITION 0.000000 1.000000 BYTE_ORDER MSB_FIRST /end CHARACTERISTIC
/begin RECORD_LAYOUT RL_DFCC_O_DTC_CONDITION FNC_VALUES 1 UBYTE COLUMN_DIR DIRECT /end RECORD_LAYOUT
/begin COMPU_METHOD CU_DFCC_O_DTC_CONDITION "Conversion method for DFCc_o_DTC_Condition" RAT_FUNC "%10.0" "o" COEFFS 0.000000 1.000000 0.000000 0.000000 0.000000 1.000000 /end COMPU_METHOD
/* Scalar calibration for DDE 'DFCc_o_FuelCut'. */
/begin CHARACTERISTIC DFCc_o_FuelCut "Override flag" VALUE 0x8351c RL_DFCC_O_FUELCUT 1.000000 CU_DFCC_O_FUELCUT 0.000000 1.000000 BYTE_ORDER MSB_FIRST /end CHARACTERISTIC
/begin RECORD_LAYOUT RL_DFCC_O_FUELCUT FNC_VALUES 1 UBYTE COLUMN_DIR DIRECT /end RECORD_LAYOUT
/begin COMPU_METHOD CU_DFCC_O_FUELCUT "Conversion method for DFCc_o_FuelCut" RAT_FUNC "%10.0" "o" COEFFS 0.000000 1.000000 0.000000 0.000000 0.000000 1.000000 /end COMPU_METHOD
/* Scalar calibration for DDE 'DFCc_o_SparkRetard'. */
/begin CHARACTERISTIC DFCc_o_SparkRetard "Override flag" VALUE 0x84f7c RL_DFCC_O_SPARKRETARD 1.000000 CU_DFCC_O_SPARKRETARD 0.000000 1.000000 BYTE_ORDER MSB_FIRST /end CHARACTERISTIC
/begin RECORD_LAYOUT RL_DFCC_O_SPARKRETARD FNC_VALUES 1 UBYTE COLUMN_DIR DIRECT /end RECORD_LAYOUT
/begin COMPU_METHOD CU_DFCC_O_SPARKRETARD "Conversion method for DFCc_o_SparkRetard" RAT_FUNC "%10.0" "o" COEFFS 0.000000 1.000000 0.000000 0.000000 0.000000 1.000000 /end COMPU_METHOD
/* Scalar calibration for DDE 'DFCc_ret_SparkRetard'. */
/begin CHARACTERISTIC DFCc_ret_SparkRetard "Override value" VALUE 0x84f80 RL_DFCC_RET_SPARKRETARD 40.000000 CU_DFCC_RET_SPARKRETARD 0.000000 40.000000 BYTE_ORDER MSB_FIRST /end CHARACTERISTIC
/begin RECORD_LAYOUT RL_DFCC_RET_SPARKRETARD FNC_VALUES 1 FLOAT32_IEEE COLUMN_DIR DIRECT /end RECORD_LAYOUT
/begin COMPU_METHOD CU_DFCC_RET_SPARKRETARD "Conversion method for DFCc_ret_SparkRetard" RAT_FUNC "%10.1" "ret" COEFFS 0.000000 1.000000 0.000000 0.000000 0.000000 1.000000 /end COMPU_METHOD
/* Scalar calibration for DDE 'DFCc_s_BurningDelay'. */
/begin CHARACTERISTIC DFCc_s_BurningDelay "DFC burning delay" VALUE 0x83500 RL_DFCC_S_BURNINGDELAY 200.000000 CU_DFCC_S_BURNINGDELAY 0.000000 200.000000 BYTE_ORDER MSB_FIRST /end CHARACTERISTIC
/begin RECORD_LAYOUT RL_DFCC_S_BURNINGDELAY FNC_VALUES 1 FLOAT32_IEEE COLUMN_DIR DIRECT /end RECORD_LAYOUT
/begin COMPU_METHOD CU_DFCC_S_BURNINGDELAY "Conversion method for DFCc_s_BurningDelay" RAT_FUNC "%10.2" "s" COEFFS 0.000000 1.000000 0.000000 0.000000 0.000000 1.000000 /end COMPU_METHOD
/* Scalar calibration for DDE 'DFCc_s_FuelRampOutDelay'. */
/begin CHARACTERISTIC DFCc_s_FuelRampOutDelay "Fuel ramp out delay" VALUE 0x83518 RL_DFCC_S_FUELRAMPOUTDELAY 3.000000 CU_DFCC_S_FUELRAMPOUTDELAY 0.000000 3.000000 BYTE_ORDER MSB_FIRST /end CHARACTERISTIC
/begin RECORD_LAYOUT RL_DFCC_S_FUELRAMPOUTDELAY FNC_VALUES 1 FLOAT32_IEEE COLUMN_DIR DIRECT /end RECORD_LAYOUT
/begin COMPU_METHOD CU_DFCC_S_FUELRAMPOUTDELAY "Conversion method for DFCc_s_FuelRampOutDelay" RAT_FUNC "%10.2" "s" COEFFS 0.000000 1.000000 0.000000 0.000000 0.000000 1.000000 /end COMPU_METHOD
/* Scalar calibration for DDE 'DFCc_s_StartupDelay'. */
/begin CHARACTERISTIC DFCc_s_StartupDelay "DFC enable engine time since start threshold" VALUE 0x83510 RL_DFCC_S_STARTUPDELAY 300.000000 CU_DFCC_S_STARTUPDELAY 0.000000 300.000000 BYTE_ORDER MSB_FIRST /end CHARACTERISTIC
/begin RECORD_LAYOUT RL_DFCC_S_STARTUPDELAY FNC_VALUES 1 FLOAT32_IEEE COLUMN_DIR DIRECT /end RECORD_LAYOUT
/begin COMPU_METHOD CU_DFCC_S_STARTUPDELAY "Conversion method for DFCc_s_StartupDelay" RAT_FUNC "%10.0" "s" COEFFS 0.000000 1.000000 0.000000 0.000000 0.000000 1.000000 /end COMPU_METHOD
/* Map (1d) calibration for DDE 'DFCm_NU_EntryThrsh_z'. */
/begin CHARACTERISTIC DFCm_NU_EntryThrsh_z "DFC enable engine speed threshold map" CURVE 0x834a0 RL_DFCM_NU_ENTRYTHRSH_Z 10000.000000 CU_DFCM_NU_ENTRYTHRSH_Z 0.000000 10000.000000
 /begin AXIS_DESCR COM_AXIS NO_INPUT_QUANTITY CU_DFCM_NU_ENTRYTHRSH_X 7 0.000000 6.000000 AXIS_PTS_REF APD_DFCM_NU_ENTRYTHRSH_X /end AXIS_DESCR
 BYTE_ORDER MSB_FIRST /end CHARACTERISTIC
/begin RECORD_LAYOUT RL_DFCM_NU_ENTRYTHRSH_Z FNC_VALUES 1 FLOAT32_IEEE COLUMN_DIR DIRECT /end RECORD_LAYOUT
/begin COMPU_METHOD CU_DFCM_NU_ENTRYTHRSH_Z "Conversion method for DFCm_NU_EntryThrsh_z" RAT_FUNC "%10.0" "RPM" COEFFS 0.000000 1.000000 0.000000 0.000000 0.000000 1.000000 /end COMPU_METHOD
/begin AXIS_PTS APD_DFCM_NU_ENTRYTHRSH_X "(gear) DFC enable engine speed threshold map trans gear axis" 0x83484 NO_INPUT_QUANTITY RL_DFCM_NU_ENTRYTHRSH_X 6.000000 CU_DFCM_NU_ENTRYTHRSH_X 7 0.0 6.0 BYTE_ORDER MSB_FIRST /end AXIS_PTS
/begin RECORD_LAYOUT RL_DFCM_NU_ENTRYTHRSH_X AXIS_PTS_X 1 FLOAT32_IEEE INDEX_INCR DIRECT /end RECORD_LAYOUT
/begin COMPU_METHOD CU_DFCM_NU_ENTRYTHRSH_X "Conversion method for DFCm_NU_EntryThrsh_x" RAT_FUNC "%10.0" "e" COEFFS 0.000000 1.000000 0.000000 0.000000 0.000000 1.000000 /end COMPU_METHOD
/* Map (1d) calibration for DDE 'DFCm_NU_ExitThrsh_z'. */
/begin CHARACTERISTIC DFCm_NU_ExitThrsh_z "DFC disable engine speed threshold map" CURVE 0x834d8 RL_DFCM_NU_EXITTHRSH_Z 10000.000000 CU_DFCM_NU_EXITTHRSH_Z 0.000000 10000.000000
 /begin AXIS_DESCR COM_AXIS NO_INPUT_QUANTITY CU_DFCM_NU_EXITTHRSH_X 7 0.000000 6.000000 AXIS_PTS_REF APD_DFCM_NU_EXITTHRSH_X /end AXIS_DESCR
 BYTE_ORDER MSB_FIRST /end CHARACTERISTIC
/begin RECORD_LAYOUT RL_DFCM_NU_EXITTHRSH_Z FNC_VALUES 1 FLOAT32_IEEE COLUMN_DIR DIRECT /end RECORD_LAYOUT
/begin COMPU_METHOD CU_DFCM_NU_EXITTHRSH_Z "Conversion method for DFCm_NU_ExitThrsh_z" RAT_FUNC "%10.0" "RPM" COEFFS 0.000000 1.000000 0.000000 0.000000 0.000000 1.000000 /end COMPU_METHOD
/begin AXIS_PTS APD_DFCM_NU_EXITTHRSH_X "(gear) DFC disable engine speed threshold map trans gear axis" 0x834bc NO_INPUT_QUANTITY RL_DFCM_NU_EXITTHRSH_X 6.000000 CU_DFCM_NU_EXITTHRSH_X 7 0.0 6.0 BYTE_ORDER MSB_FIRST /end AXIS_PTS
/begin RECORD_LAYOUT RL_DFCM_NU_EXITTHRSH_X AXIS_PTS_X 1 FLOAT32_IEEE INDEX_INCR DIRECT /end RECORD_LAYOUT
/begin COMPU_METHOD CU_DFCM_NU_EXITTHRSH_X "Conversion method for DFCm_NU_ExitThrsh_x" RAT_FUNC "%10.0" "e" COEFFS 0.000000 1.000000 0.000000 0.000000 0.000000 1.000000 /end COMPU_METHOD
/* Scalar calibration for DDE 'DIAc_NU_SpiCtrlCntsThresh'. */
/begin CHARACTERISTIC DIAc_NU_SpiCtrlCntsThresh "Threshold to set SPI CTRL fault" VALUE 0x8d93c RL_DIAC_NU_SPICTRLCNTSTHRESH 100.000000 CU_DIAC_NU_SPICTRLCNTSTHRESH 0.000000 100.000000 BYTE_ORDER MSB_FIRST /end CHARACTERISTIC
/begin RECORD_LAYOUT RL_DIAC_NU_SPICTRLCNTSTHRESH FNC_VALUES 1 FLOAT32_IEEE COLUMN_DIR DIRECT /end RECORD_LAYOUT
/begin COMPU_METHOD CU_DIAC_NU_SPICTRLCNTSTHRESH "Conversion method for DIAc_NU_SpiCtrlCntsThresh" RAT_FUNC "%10.2" "NU" COEFFS 0.000000 1.000000 0.000000 0.000000 0.000000 1.000000 /end COMPU_METHOD
/* Scalar calibration for DDE 'DIAc_V_HtrNoRspnsURRstThrsh_A'. */
/begin CHARACTERISTIC DIAc_V_HtrNoRspnsURRstThrsh_A "UR threshold to clear Htr No Response fault" VALUE 0x8d938 RL_DIAC_V_HTRNORSPNSURRSTTHRSH0 100.000000 CU_DIAC_V_HTRNORSPNSURRSTTHRSH0 0.000000 100.000000 BYTE_ORDER MSB_FIRST /end CHARACTERISTIC
/begin RECORD_LAYOUT RL_DIAC_V_HTRNORSPNSURRSTTHRSH0 FNC_VALUES 1 FLOAT32_IEEE COLUMN_DIR DIRECT /end RECORD_LAYOUT
/begin COMPU_METHOD CU_DIAC_V_HTRNORSPNSURRSTTHRSH0 "Conversion method for DIAc_V_HtrNoRspnsURRstThrsh_A" RAT_FUNC "%10.2" "V" COEFFS 0.000000 1.000000 0.000000 0.000000 0.000000 1.000000 /end COMPU_METHOD
/* Scalar calibration for DDE 'DIAc_V_HtrNoRspnsURRstThrsh_B'. */
/begin CHARACTERISTIC DIAc_V_HtrNoRspnsURRstThrsh_B "UR threshold to clear Htr No Response fault" VALUE 0x8d934 RL_DIAC_V_HTRNORSPNSURRSTTHRSH1 100.000000 CU_DIAC_V_HTRNORSPNSURRSTTHRSH1 0.000000 100.000000 BYTE_ORDER MSB_FIRST /end CHARACTERISTIC
/begin RECORD_LAYOUT RL_DIAC_V_HTRNORSPNSURRSTTHRSH1 FNC_VALUES 1 FLOAT32_IEEE COLUMN_DIR DIRECT /end RECORD_LAYOUT
/begin COMPU_METHOD CU_DIAC_V_HTRNORSPNSURRSTTHRSH1 "Conversion method for DIAc_V_HtrNoRspnsURRstThrsh_B" RAT_FUNC "%10.2" "V" COEFFS 0.000000 1.000000 0.000000 0.000000 0.000000 1.000000 /end COMPU_METHOD
/* Scalar calibration for DDE 'DIAc_V_HtrNoRspnsURThrsh_A'. */
/begin CHARACTERISTIC DIAc_V_HtrNoRspnsURThrsh_A "UR threshold for Htr No Response fault" VALUE 0x8d930 RL_DIAC_V_HTRNORSPNSURTHRSH_A 100.000000 CU_DIAC_V_HTRNORSPNSURTHRSH_A 0.000000 100.000000 BYTE_ORDER MSB_FIRST /end CHARACTERISTIC
/begin RECORD_LAYOUT RL_DIAC_V_HTRNORSPNSURTHRSH_A FNC_VALUES 1 FLOAT32_IEEE COLUMN_DIR DIRECT /end RECORD_LAYOUT
/begin COMPU_METHOD CU_DIAC_V_HTRNORSPNSURTHRSH_A "Conversion method for DIAc_V_HtrNoRspnsURThrsh_A" RAT_FUNC "%10.2" "V" COEFFS 0.000000 1.000000 0.000000 0.000000 0.000000 1.000000 /end COMPU_METHOD
/* Scalar calibration for DDE 'DIAc_V_HtrNoRspnsURThrsh_B'. */
/begin CHARACTERISTIC DIAc_V_HtrNoRspnsURThrsh_B "UR threshold for Htr No Response fault" VALUE 0x8d92c RL_DIAC_V_HTRNORSPNSURTHRSH_B 100.000000 CU_DIAC_V_HTRNORSPNSURTHRSH_B 0.000000 100.000000 BYTE_ORDER MSB_FIRST /end CHARACTERISTIC
/begin RECORD_LAYOUT RL_DIAC_V_HTRNORSPNSURTHRSH_B FNC_VALUES 1 FLOAT32_IEEE COLUMN_DIR DIRECT /end RECORD_LAYOUT
/begin COMPU_METHOD CU_DIAC_V_HTRNORSPNSURTHRSH_B "Conversion method for DIAc_V_HtrNoRspnsURThrsh_B" RAT_FUNC "%10.2" "V" COEFFS 0.000000 1.000000 0.000000 0.000000 0.000000 1.000000 /end COMPU_METHOD
/* Scalar calibration for DDE 'DIAc_V_UA_OORHi'. */
/begin CHARACTERISTIC DIAc_V_UA_OORHi "UA OOR hi fault detection threshold" VALUE 0x8d928 RL_DIAC_V_UA_OORHI 100.000000 CU_DIAC_V_UA_OORHI 0.000000 100.000000 BYTE_ORDER MSB_FIRST /end CHARACTERISTIC
/begin RECORD_LAYOUT RL_DIAC_V_UA_OORHI FNC_VALUES 1 FLOAT32_IEEE COLUMN_DIR DIRECT /end RECORD_LAYOUT
/begin COMPU_METHOD CU_DIAC_V_UA_OORHI "Conversion method for DIAc_V_UA_OORHi" RAT_FUNC "%10.2" "V" COEFFS 0.000000 1.000000 0.000000 0.000000 0.000000 1.000000 /end COMPU_METHOD
/* Scalar calibration for DDE 'DIAc_V_UA_OORLo'. */
/begin CHARACTERISTIC DIAc_V_UA_OORLo "UA OOR lo fault detection threshold" VALUE 0x8d924 RL_DIAC_V_UA_OORLO 100.000000 CU_DIAC_V_UA_OORLO 0.000000 100.000000 BYTE_ORDER MSB_FIRST /end CHARACTERISTIC
/begin RECORD_LAYOUT RL_DIAC_V_UA_OORLO FNC_VALUES 1 FLOAT32_IEEE COLUMN_DIR DIRECT /end RECORD_LAYOUT
/begin COMPU_METHOD CU_DIAC_V_UA_OORLO "Conversion method for DIAc_V_UA_OORLo" RAT_FUNC "%10.2" "V" COEFFS 0.000000 1.000000 0.000000 0.000000 0.000000 1.000000 /end COMPU_METHOD
/* Scalar calibration for DDE 'DIAc_V_UR_OORHi'. */
/begin CHARACTERISTIC DIAc_V_UR_OORHi "UR OOR hi fault detection threshold" VALUE 0x8d920 RL_DIAC_V_UR_OORHI 100.000000 CU_DIAC_V_UR_OORHI 0.000000 100.000000 BYTE_ORDER MSB_FIRST /end CHARACTERISTIC
/begin RECORD_LAYOUT RL_DIAC_V_UR_OORHI FNC_VALUES 1 FLOAT32_IEEE COLUMN_DIR DIRECT /end RECORD_LAYOUT
/begin COMPU_METHOD CU_DIAC_V_UR_OORHI "Conversion method for DIAc_V_UR_OORHi" RAT_FUNC "%10.2" "V" COEFFS 0.000000 1.000000 0.000000 0.000000 0.000000 1.000000 /end COMPU_METHOD
/* Scalar calibration for DDE 'DIAc_V_UR_OORLo'. */
/begin CHARACTERISTIC DIAc_V_UR_OORLo "UR OOR lo fault detection threshold" VALUE 0x8d91c RL_DIAC_V_UR_OORLO 100.000000 CU_DIAC_V_UR_OORLO 0.000000 100.000000 BYTE_ORDER MSB_FIRST /end CHARACTERISTIC
/begin RECORD_LAYOUT RL_DIAC_V_UR_OORLO FNC_VALUES 1 FLOAT32_IEEE COLUMN_DIR DIRECT /end RECORD_LAYOUT
/begin COMPU_METHOD CU_DIAC_V_UR_OORLO "Conversion method for DIAc_V_UR_OORLo" RAT_FUNC "%10.2" "V" COEFFS 0.000000 1.000000 0.000000 0.000000 0.000000 1.000000 /end COMPU_METHOD
/* Scalar calibration for DDE 'DIAc_pct_HtrNoRspnsPWMThrsh'. */
/begin CHARACTERISTIC DIAc_pct_HtrNoRspnsPWMThrsh "Heater PWM threshold to monitor probe temperature for no response fault" VALUE 0x8d918 RL_DIAC_PCT_HTRNORSPNSPWMTHRSH 100.000000 CU_DIAC_PCT_HTRNORSPNSPWMTHRSH 0.000000 100.000000 BYTE_ORDER MSB_FIRST /end CHARACTERISTIC
/begin RECORD_LAYOUT RL_DIAC_PCT_HTRNORSPNSPWMTHRSH FNC_VALUES 1 FLOAT32_IEEE COLUMN_DIR DIRECT /end RECORD_LAYOUT
/begin COMPU_METHOD CU_DIAC_PCT_HTRNORSPNSPWMTHRSH "Conversion method for DIAc_pct_HtrNoRspnsPWMThrsh" RAT_FUNC "%10.2" "pct" COEFFS 0.000000 1.000000 0.000000 0.000000 0.000000 1.000000 /end COMPU_METHOD
/* Scalar calibration for DDE 'DIAc_pct_SpiCtrl_BucketFallWgt'. */
/begin CHARACTERISTIC DIAc_pct_SpiCtrl_BucketFallWgt "Fall weight for SPI CTRL fault leaky bucket counter" VALUE 0x8d914 RL_DIAC_PCT_SPICTRL_BUCKETFALL0 100.000000 CU_DIAC_PCT_SPICTRL_BUCKETFALL0 0.000000 100.000000 BYTE_ORDER MSB_FIRST /end CHARACTERISTIC
/begin RECORD_LAYOUT RL_DIAC_PCT_SPICTRL_BUCKETFALL0 FNC_VALUES 1 FLOAT32_IEEE COLUMN_DIR DIRECT /end RECORD_LAYOUT
/begin COMPU_METHOD CU_DIAC_PCT_SPICTRL_BUCKETFALL0 "Conversion method for DIAc_pct_SpiCtrl_BucketFallWgt" RAT_FUNC "%10.2" "pct" COEFFS 0.000000 1.000000 0.000000 0.000000 0.000000 1.000000 /end COMPU_METHOD
/* Scalar calibration for DDE 'DIAc_pct_SpiCtrl_BucketRiseWgt'. */
/begin CHARACTERISTIC DIAc_pct_SpiCtrl_BucketRiseWgt "Rise weight for SPI CTRL fault leaky bucket counter" VALUE 0x8d910 RL_DIAC_PCT_SPICTRL_BUCKETRISE0 100.000000 CU_DIAC_PCT_SPICTRL_BUCKETRISE0 0.000000 100.000000 BYTE_ORDER MSB_FIRST /end CHARACTERISTIC
/begin RECORD_LAYOUT RL_DIAC_PCT_SPICTRL_BUCKETRISE0 FNC_VALUES 1 FLOAT32_IEEE COLUMN_DIR DIRECT /end RECORD_LAYOUT
/begin COMPU_METHOD CU_DIAC_PCT_SPICTRL_BUCKETRISE0 "Conversion method for DIAc_pct_SpiCtrl_BucketRiseWgt" RAT_FUNC "%10.2" "pct" COEFFS 0.000000 1.000000 0.000000 0.000000 0.000000 1.000000 /end COMPU_METHOD
/* Scalar calibration for DDE 'DIAc_s_HtrNoResponseDbnc'. */
/begin CHARACTERISTIC DIAc_s_HtrNoResponseDbnc "Debounce time to set Htr No Response fault when Htr PWM and UR exceed thresholds" VALUE 0x8d90c RL_DIAC_S_HTRNORESPONSEDBNC 100.000000 CU_DIAC_S_HTRNORESPONSEDBNC 0.000000 100.000000 BYTE_ORDER MSB_FIRST /end CHARACTERISTIC
/begin RECORD_LAYOUT RL_DIAC_S_HTRNORESPONSEDBNC FNC_VALUES 1 FLOAT32_IEEE COLUMN_DIR DIRECT /end RECORD_LAYOUT
/begin COMPU_METHOD CU_DIAC_S_HTRNORESPONSEDBNC "Conversion method for DIAc_s_HtrNoResponseDbnc" RAT_FUNC "%10.0" "s" COEFFS 0.000000 1.000000 0.000000 0.000000 0.000000 1.000000 /end COMPU_METHOD
/* Scalar calibration for DDE 'DIAc_s_HtrNoResponseRstDbnc'. */
/begin CHARACTERISTIC DIAc_s_HtrNoResponseRstDbnc "Debounce time to reset Htr No Response fault when UR exceeds threshold" VALUE 0x8d908 RL_DIAC_S_HTRNORESPONSERSTDBNC 100.000000 CU_DIAC_S_HTRNORESPONSERSTDBNC 0.000000 100.000000 BYTE_ORDER MSB_FIRST /end CHARACTERISTIC
/begin RECORD_LAYOUT RL_DIAC_S_HTRNORESPONSERSTDBNC FNC_VALUES 1 FLOAT32_IEEE COLUMN_DIR DIRECT /end RECORD_LAYOUT
/begin COMPU_METHOD CU_DIAC_S_HTRNORESPONSERSTDBNC "Conversion method for DIAc_s_HtrNoResponseRstDbnc" RAT_FUNC "%10.1" "s" COEFFS 0.000000 1.000000 0.000000 0.000000 0.000000 1.000000 /end COMPU_METHOD
/* Scalar calibration for DDE 'DIAc_s_OORHiDbnc'. */
/begin CHARACTERISTIC DIAc_s_OORHiDbnc "Debounce time to set OOR hi fault" VALUE 0x8d904 RL_DIAC_S_OORHIDBNC 100.000000 CU_DIAC_S_OORHIDBNC 0.000000 100.000000 BYTE_ORDER MSB_FIRST /end CHARACTERISTIC
/begin RECORD_LAYOUT RL_DIAC_S_OORHIDBNC FNC_VALUES 1 FLOAT32_IEEE COLUMN_DIR DIRECT /end RECORD_LAYOUT
/begin COMPU_METHOD CU_DIAC_S_OORHIDBNC "Conversion method for DIAc_s_OORHiDbnc" RAT_FUNC "%10.2" "s" COEFFS 0.000000 1.000000 0.000000 0.000000 0.000000 1.000000 /end COMPU_METHOD
/* Scalar calibration for DDE 'DIAc_s_OORLoDbnc'. */
/begin CHARACTERISTIC DIAc_s_OORLoDbnc "Debounce time to set OOR lo fault" VALUE 0x8d900 RL_DIAC_S_OORLODBNC 100.000000 CU_DIAC_S_OORLODBNC 0.000000 100.000000 BYTE_ORDER MSB_FIRST /end CHARACTERISTIC
/begin RECORD_LAYOUT RL_DIAC_S_OORLODBNC FNC_VALUES 1 FLOAT32_IEEE COLUMN_DIR DIRECT /end RECORD_LAYOUT
/begin COMPU_METHOD CU_DIAC_S_OORLODBNC "Conversion method for DIAc_s_OORLoDbnc" RAT_FUNC "%10.2" "s" COEFFS 0.000000 1.000000 0.000000 0.000000 0.000000 1.000000 /end COMPU_METHOD
/* Scalar calibration for DDE 'DINc_Hz_EngSpdLPF'. */
/begin CHARACTERISTIC DINc_Hz_EngSpdLPF "Filter for engine speed signal" VALUE 0x8c4e4 RL_DINC_HZ_ENGSPDLPF 9999.900000 CU_DINC_HZ_ENGSPDLPF 0.100000 10000.000000 BYTE_ORDER MSB_FIRST /end CHARACTERISTIC
/begin RECORD_LAYOUT RL_DINC_HZ_ENGSPDLPF FNC_VALUES 1 FLOAT32_IEEE COLUMN_DIR DIRECT /end RECORD_LAYOUT
/begin COMPU_METHOD CU_DINC_HZ_ENGSPDLPF "Conversion method for DINc_Hz_EngSpdLPF" RAT_FUNC "%10.1" "Hz" COEFFS 0.000000 1.000000 0.000000 0.000000 0.000000 1.000000 /end COMPU_METHOD
/* Scalar calibration for DDE 'DINc_Hz_MAF_To'. */
/begin CHARACTERISTIC DINc_Hz_MAF_To "Timeout value" VALUE 0x8c51c RL_DINC_HZ_MAF_TO 15000.000000 CU_DINC_HZ_MAF_TO 0.000000 15000.000000 BYTE_ORDER MSB_FIRST /end CHARACTERISTIC
/begin RECORD_LAYOUT RL_DINC_HZ_MAF_TO FNC_VALUES 1 FLOAT32_IEEE COLUMN_DIR DIRECT /end RECORD_LAYOUT
/begin COMPU_METHOD CU_DINC_HZ_MAF_TO "Conversion method for DINc_Hz_MAF_To" RAT_FUNC "%10.3" "Hz" COEFFS 0.000000 1.000000 0.000000 0.000000 0.000000 1.000000 /end COMPU_METHOD
/* Scalar calibration for DDE 'DINc_NU_Gear'. */
/begin CHARACTERISTIC DINc_NU_Gear "Override value" VALUE 0x8c4fc RL_DINC_NU_GEAR 1000.000000 CU_DINC_NU_GEAR 0.000000 1000.000000 BYTE_ORDER MSB_FIRST /end CHARACTERISTIC
/begin RECORD_LAYOUT RL_DINC_NU_GEAR FNC_VALUES 1 FLOAT32_IEEE COLUMN_DIR DIRECT /end RECORD_LAYOUT
/begin COMPU_METHOD CU_DINC_NU_GEAR "Conversion method for DINc_NU_Gear" RAT_FUNC "%10.0" "NU" COEFFS 0.000000 1.000000 0.000000 0.000000 0.000000 1.000000 /end COMPU_METHOD
/* Scalar calibration for DDE 'DINc_NU_MAF_FallRate'. */
/begin CHARACTERISTIC DINc_NU_MAF_FallRate "(gps/s) slew rate limit" VALUE 0x8c840 RL_DINC_NU_MAF_FALLRATE 1000.000000 CU_DINC_NU_MAF_FALLRATE -1000.000000 0.000000 BYTE_ORDER MSB_FIRST /end CHARACTERISTIC
/begin RECORD_LAYOUT RL_DINC_NU_MAF_FALLRATE FNC_VALUES 1 FLOAT32_IEEE COLUMN_DIR DIRECT /end RECORD_LAYOUT
/begin COMPU_METHOD CU_DINC_NU_MAF_FALLRATE "Conversion method for DINc_NU_MAF_FallRate" RAT_FUNC "%10.0" "NU" COEFFS 0.000000 1.000000 0.000000 0.000000 0.000000 1.000000 /end COMPU_METHOD
/* Scalar calibration for DDE 'DINc_NU_MAF_RiseRate'. */
/begin CHARACTERISTIC DINc_NU_MAF_RiseRate "(gps/s) slew rate limit" VALUE 0x8c844 RL_DINC_NU_MAF_RISERATE 1000.000000 CU_DINC_NU_MAF_RISERATE 0.000000 1000.000000 BYTE_ORDER MSB_FIRST /end CHARACTERISTIC
/begin RECORD_LAYOUT RL_DINC_NU_MAF_RISERATE FNC_VALUES 1 FLOAT32_IEEE COLUMN_DIR DIRECT /end RECORD_LAYOUT
/begin COMPU_METHOD CU_DINC_NU_MAF_RISERATE "Conversion method for DINc_NU_MAF_RiseRate" RAT_FUNC "%10.0" "NU" COEFFS 0.000000 1.000000 0.000000 0.000000 0.000000 1.000000 /end COMPU_METHOD
/* Scalar calibration for DDE 'DINc_RPM_EngSpd'. */
/begin CHARACTERISTIC DINc_RPM_EngSpd "Override value" VALUE 0x8c4ec RL_DINC_RPM_ENGSPD 10000.000000 CU_DINC_RPM_ENGSPD 0.000000 10000.000000 BYTE_ORDER MSB_FIRST /end CHARACTERISTIC
/begin RECORD_LAYOUT RL_DINC_RPM_ENGSPD FNC_VALUES 1 FLOAT32_IEEE COLUMN_DIR DIRECT /end RECORD_LAYOUT
/begin COMPU_METHOD CU_DINC_RPM_ENGSPD "Conversion method for DINc_RPM_EngSpd" RAT_FUNC "%10.0" "RPM" COEFFS 0.000000 1.000000 0.000000 0.000000 0.000000 1.000000 /end COMPU_METHOD
/* Scalar calibration for DDE 'DINc_RPM_TOSS'. */
/begin CHARACTERISTIC DINc_RPM_TOSS "Override value" VALUE 0x8c870 RL_DINC_RPM_TOSS 10000.000000 CU_DINC_RPM_TOSS 0.000000 10000.000000 BYTE_ORDER MSB_FIRST /end CHARACTERISTIC
/begin RECORD_LAYOUT RL_DINC_RPM_TOSS FNC_VALUES 1 FLOAT32_IEEE COLUMN_DIR DIRECT /end RECORD_LAYOUT
/begin COMPU_METHOD CU_DINC_RPM_TOSS "Conversion method for DINc_RPM_TOSS" RAT_FUNC "%10.0" "RPM" COEFFS 0.000000 1.000000 0.000000 0.000000 0.000000 1.000000 /end COMPU_METHOD
/* Scalar calibration for DDE 'DINc_V_L12SG'. */
/begin CHARACTERISTIC DINc_V_L12SG "Short to ground" VALUE 0x8c09c RL_DINC_V_L12SG 15.000000 CU_DINC_V_L12SG 0.000000 15.000000 BYTE_ORDER MSB_FIRST /end CHARACTERISTIC
/begin RECORD_LAYOUT RL_DINC_V_L12SG FNC_VALUES 1 FLOAT32_IEEE COLUMN_DIR DIRECT /end RECORD_LAYOUT
/begin COMPU_METHOD CU_DINC_V_L12SG "Conversion method for DINc_V_L12SG" RAT_FUNC "%10.3" "V" COEFFS 0.000000 1.000000 0.000000 0.000000 0.000000 1.000000 /end COMPU_METHOD
/* Scalar calibration for DDE 'DINc_b_AC_PressSw'. */
/begin CHARACTERISTIC DINc_b_AC_PressSw "Override value" VALUE 0x8c86b RL_DINC_B_AC_PRESSSW 1.000000 CU_DINC_B_AC_PRESSSW 0.000000 1.000000 BYTE_ORDER MSB_FIRST /end CHARACTERISTIC
/begin RECORD_LAYOUT RL_DINC_B_AC_PRESSSW FNC_VALUES 1 UBYTE COLUMN_DIR DIRECT /end RECORD_LAYOUT
/begin COMPU_METHOD CU_DINC_B_AC_PRESSSW "Conversion method for DINc_b_AC_PressSw" RAT_FUNC "%10.0" "b" COEFFS 0.000000 1.000000 0.000000 0.000000 0.000000 1.000000 /end COMPU_METHOD
/* Scalar calibration for DDE 'DINc_b_AC_ReqSw'. */
/begin CHARACTERISTIC DINc_b_AC_ReqSw "Override value" VALUE 0x8c86d RL_DINC_B_AC_REQSW 1.000000 CU_DINC_B_AC_REQSW 0.000000 1.000000 BYTE_ORDER MSB_FIRST /end CHARACTERISTIC
/begin RECORD_LAYOUT RL_DINC_B_AC_REQSW FNC_VALUES 1 UBYTE COLUMN_DIR DIRECT /end RECORD_LAYOUT
/begin COMPU_METHOD CU_DINC_B_AC_REQSW "Conversion method for DINc_b_AC_ReqSw" RAT_FUNC "%10.0" "b" COEFFS 0.000000 1.000000 0.000000 0.000000 0.000000 1.000000 /end COMPU_METHOD
/* Scalar calibration for DDE 'DINc_b_Belt'. */
/begin CHARACTERISTIC DINc_b_Belt "Override" VALUE 0x8c877 RL_DINC_B_BELT 1.000000 CU_DINC_B_BELT 0.000000 1.000000 BYTE_ORDER MSB_FIRST /end CHARACTERISTIC
/begin RECORD_LAYOUT RL_DINC_B_BELT FNC_VALUES 1 UBYTE COLUMN_DIR DIRECT /end RECORD_LAYOUT
/begin COMPU_METHOD CU_DINC_B_BELT "Conversion method for DINc_b_Belt" RAT_FUNC "%10.0" "b" COEFFS 0.000000 1.000000 0.000000 0.000000 0.000000 1.000000 /end COMPU_METHOD
/* Scalar calibration for DDE 'DINc_b_CamPhaseValid'. */
/begin CHARACTERISTIC DINc_b_CamPhaseValid "Override value" VALUE 0x8c4e1 RL_DINC_B_CAMPHASEVALID 1.000000 CU_DINC_B_CAMPHASEVALID 0.000000 1.000000 BYTE_ORDER MSB_FIRST /end CHARACTERISTIC
/begin RECORD_LAYOUT RL_DINC_B_CAMPHASEVALID FNC_VALUES 1 UBYTE COLUMN_DIR DIRECT /end RECORD_LAYOUT
/begin COMPU_METHOD CU_DINC_B_CAMPHASEVALID "Conversion method for DINc_b_CamPhaseValid" RAT_FUNC "%10.0" "b" COEFFS 0.000000 1.000000 0.000000 0.000000 0.000000 1.000000 /end COMPU_METHOD
/* Scalar calibration for DDE 'DINc_b_Door'. */
/begin CHARACTERISTIC DINc_b_Door "Override" VALUE 0x8c879 RL_DINC_B_DOOR 1.000000 CU_DINC_B_DOOR 0.000000 1.000000 BYTE_ORDER MSB_FIRST /end CHARACTERISTIC
/begin RECORD_LAYOUT RL_DINC_B_DOOR FNC_VALUES 1 UBYTE COLUMN_DIR DIRECT /end RECORD_LAYOUT
/begin COMPU_METHOD CU_DINC_B_DOOR "Conversion method for DINc_b_Door" RAT_FUNC "%10.0" "b" COEFFS 0.000000 1.000000 0.000000 0.000000 0.000000 1.000000 /end COMPU_METHOD
/* Scalar calibration for DDE 'DINc_b_EngSync'. */
/begin CHARACTERISTIC DINc_b_EngSync "Override value" VALUE 0x8c889 RL_DINC_B_ENGSYNC 1.000000 CU_DINC_B_ENGSYNC 0.000000 1.000000 BYTE_ORDER MSB_FIRST /end CHARACTERISTIC
/begin RECORD_LAYOUT RL_DINC_B_ENGSYNC FNC_VALUES 1 UBYTE COLUMN_DIR DIRECT /end RECORD_LAYOUT
/begin COMPU_METHOD CU_DINC_B_ENGSYNC "Conversion method for DINc_b_EngSync" RAT_FUNC "%10.0" "b" COEFFS 0.000000 1.000000 0.000000 0.000000 0.000000 1.000000 /end COMPU_METHOD
/* Scalar calibration for DDE 'DINc_b_Ign'. */
/begin CHARACTERISTIC DINc_b_Ign "Override value" VALUE 0x8c4d1 RL_DINC_B_IGN 1.000000 CU_DINC_B_IGN 0.000000 1.000000 BYTE_ORDER MSB_FIRST /end CHARACTERISTIC
/begin RECORD_LAYOUT RL_DINC_B_IGN FNC_VALUES 1 UBYTE COLUMN_DIR DIRECT /end RECORD_LAYOUT
/begin COMPU_METHOD CU_DINC_B_IGN "Conversion method for DINc_b_Ign" RAT_FUNC "%10.0" "b" COEFFS 0.000000 1.000000 0.000000 0.000000 0.000000 1.000000 /end COMPU_METHOD
/* Scalar calibration for DDE 'DINc_b_OilPrSw'. */
/begin CHARACTERISTIC DINc_b_OilPrSw "Override" VALUE 0x8c869 RL_DINC_B_OILPRSW 1.000000 CU_DINC_B_OILPRSW 0.000000 1.000000 BYTE_ORDER MSB_FIRST /end CHARACTERISTIC
/begin RECORD_LAYOUT RL_DINC_B_OILPRSW FNC_VALUES 1 UBYTE COLUMN_DIR DIRECT /end RECORD_LAYOUT
/begin COMPU_METHOD CU_DINC_B_OILPRSW "Conversion method for DINc_b_OilPrSw" RAT_FUNC "%10.0" "b" COEFFS 0.000000 1.000000 0.000000 0.000000 0.000000 1.000000 /end COMPU_METHOD
/* Scalar calibration for DDE 'DINc_b_ParkingBrake'. */
/begin CHARACTERISTIC DINc_b_ParkingBrake "Override" VALUE 0x8c881 RL_DINC_B_PARKINGBRAKE 1.000000 CU_DINC_B_PARKINGBRAKE 0.000000 1.000000 BYTE_ORDER MSB_FIRST /end CHARACTERISTIC
/begin RECORD_LAYOUT RL_DINC_B_PARKINGBRAKE FNC_VALUES 1 UBYTE COLUMN_DIR DIRECT /end RECORD_LAYOUT
/begin COMPU_METHOD CU_DINC_B_PARKINGBRAKE "Conversion method for DINc_b_ParkingBrake" RAT_FUNC "%10.0" "b" COEFFS 0.000000 1.000000 0.000000 0.000000 0.000000 1.000000 /end COMPU_METHOD
/* Scalar calibration for DDE 'DINc_b_PedalBrake'. */
/begin CHARACTERISTIC DINc_b_PedalBrake "Override" VALUE 0x8c875 RL_DINC_B_PEDALBRAKE 1.000000 CU_DINC_B_PEDALBRAKE 0.000000 1.000000 BYTE_ORDER MSB_FIRST /end CHARACTERISTIC
/begin RECORD_LAYOUT RL_DINC_B_PEDALBRAKE FNC_VALUES 1 UBYTE COLUMN_DIR DIRECT /end RECORD_LAYOUT
/begin COMPU_METHOD CU_DINC_B_PEDALBRAKE "Conversion method for DINc_b_PedalBrake" RAT_FUNC "%10.0" "b" COEFFS 0.000000 1.000000 0.000000 0.000000 0.000000 1.000000 /end COMPU_METHOD
/* Scalar calibration for DDE 'DINc_b_RearGear'. */
/begin CHARACTERISTIC DINc_b_RearGear "Override value" VALUE 0x8c501 RL_DINC_B_REARGEAR 1.000000 CU_DINC_B_REARGEAR 0.000000 1.000000 BYTE_ORDER MSB_FIRST /end CHARACTERISTIC
/begin RECORD_LAYOUT RL_DINC_B_REARGEAR FNC_VALUES 1 UBYTE COLUMN_DIR DIRECT /end RECORD_LAYOUT
/begin COMPU_METHOD CU_DINC_B_REARGEAR "Conversion method for DINc_b_RearGear" RAT_FUNC "%10.0" "b" COEFFS 0.000000 1.000000 0.000000 0.000000 0.000000 1.000000 /end COMPU_METHOD
/* Scalar calibration for DDE 'DINc_deg_Tooth2AngHi'. */
/begin CHARACTERISTIC DINc_deg_Tooth2AngHi "Tooth 2 interval hi limit" VALUE 0x8c508 RL_DINC_DEG_TOOTH2ANGHI 1440.000000 CU_DINC_DEG_TOOTH2ANGHI -720.000000 720.000000 BYTE_ORDER MSB_FIRST /end CHARACTERISTIC
/begin RECORD_LAYOUT RL_DINC_DEG_TOOTH2ANGHI FNC_VALUES 1 FLOAT32_IEEE COLUMN_DIR DIRECT /end RECORD_LAYOUT
/begin COMPU_METHOD CU_DINC_DEG_TOOTH2ANGHI "Conversion method for DINc_deg_Tooth2AngHi" RAT_FUNC "%10.2" "deg" COEFFS 0.000000 1.000000 0.000000 0.000000 0.000000 1.000000 /end COMPU_METHOD
/* Scalar calibration for DDE 'DINc_deg_Tooth2AngLo'. */
/begin CHARACTERISTIC DINc_deg_Tooth2AngLo "Tooth 2 interval lo limit" VALUE 0x8c504 RL_DINC_DEG_TOOTH2ANGLO 1440.000000 CU_DINC_DEG_TOOTH2ANGLO -720.000000 720.000000 BYTE_ORDER MSB_FIRST /end CHARACTERISTIC
/begin RECORD_LAYOUT RL_DINC_DEG_TOOTH2ANGLO FNC_VALUES 1 FLOAT32_IEEE COLUMN_DIR DIRECT /end RECORD_LAYOUT
/begin COMPU_METHOD CU_DINC_DEG_TOOTH2ANGLO "Conversion method for DINc_deg_Tooth2AngLo" RAT_FUNC "%10.2" "deg" COEFFS 0.000000 1.000000 0.000000 0.000000 0.000000 1.000000 /end COMPU_METHOD
/* Scalar calibration for DDE 'DINc_deg_Tooth2BaseAng'. */
/begin CHARACTERISTIC DINc_deg_Tooth2BaseAng "Tooth 2 base position" VALUE 0x8c50c RL_DINC_DEG_TOOTH2BASEANG 1440.000000 CU_DINC_DEG_TOOTH2BASEANG -720.000000 720.000000 BYTE_ORDER MSB_FIRST /end CHARACTERISTIC
/begin RECORD_LAYOUT RL_DINC_DEG_TOOTH2BASEANG FNC_VALUES 1 FLOAT32_IEEE COLUMN_DIR DIRECT /end RECORD_LAYOUT
/begin COMPU_METHOD CU_DINC_DEG_TOOTH2BASEANG "Conversion method for DINc_deg_Tooth2BaseAng" RAT_FUNC "%10.2" "deg" COEFFS 0.000000 1.000000 0.000000 0.000000 0.000000 1.000000 /end COMPU_METHOD
/* Scalar calibration for DDE 'DINc_deg_Tooth3BaseAng'. */
/begin CHARACTERISTIC DINc_deg_Tooth3BaseAng "Tooth 3 base position" VALUE 0x8c510 RL_DINC_DEG_TOOTH3BASEANG 1440.000000 CU_DINC_DEG_TOOTH3BASEANG -720.000000 720.000000 BYTE_ORDER MSB_FIRST /end CHARACTERISTIC
/begin RECORD_LAYOUT RL_DINC_DEG_TOOTH3BASEANG FNC_VALUES 1 FLOAT32_IEEE COLUMN_DIR DIRECT /end RECORD_LAYOUT
/begin COMPU_METHOD CU_DINC_DEG_TOOTH3BASEANG "Conversion method for DINc_deg_Tooth3BaseAng" RAT_FUNC "%10.0" "deg" COEFFS 0.000000 1.000000 0.000000 0.000000 0.000000 1.000000 /end COMPU_METHOD
/* Scalar calibration for DDE 'DINc_deg_ValidCamDelta'. */
/begin CHARACTERISTIC DINc_deg_ValidCamDelta "Tooth delta below this threshold will be considered invalid ie: no cam data" VALUE 0x8c4d4 RL_DINC_DEG_VALIDCAMDELTA 100.000000 CU_DINC_DEG_VALIDCAMDELTA 0.000000 100.000000 BYTE_ORDER MSB_FIRST /end CHARACTERISTIC
/begin RECORD_LAYOUT RL_DINC_DEG_VALIDCAMDELTA FNC_VALUES 1 FLOAT32_IEEE COLUMN_DIR DIRECT /end RECORD_LAYOUT
/begin COMPU_METHOD CU_DINC_DEG_VALIDCAMDELTA "Conversion method for DINc_deg_ValidCamDelta" RAT_FUNC "%10.0" "deg" COEFFS 0.000000 1.000000 0.000000 0.000000 0.000000 1.000000 /end COMPU_METHOD
/* Scalar calibration for DDE 'DINc_gps_MAF'. */
/begin CHARACTERISTIC DINc_gps_MAF "Override value" VALUE 0x8c884 RL_DINC_GPS_MAF 1000.000000 CU_DINC_GPS_MAF 0.000000 1000.000000 BYTE_ORDER MSB_FIRST /end CHARACTERISTIC
/begin RECORD_LAYOUT RL_DINC_GPS_MAF FNC_VALUES 1 FLOAT32_IEEE COLUMN_DIR DIRECT /end RECORD_LAYOUT
/begin COMPU_METHOD CU_DINC_GPS_MAF "Conversion method for DINc_gps_MAF" RAT_FUNC "%10.0" "gps" COEFFS 0.000000 1.000000 0.000000 0.000000 0.000000 1.000000 /end COMPU_METHOD
/* Scalar calibration for DDE 'DINc_kph_VehSpd'. */
/begin CHARACTERISTIC DINc_kph_VehSpd "Override value" VALUE 0x8c864 RL_DINC_KPH_VEHSPD 1000.000000 CU_DINC_KPH_VEHSPD 0.000000 1000.000000 BYTE_ORDER MSB_FIRST /end CHARACTERISTIC
/begin RECORD_LAYOUT RL_DINC_KPH_VEHSPD FNC_VALUES 1 FLOAT32_IEEE COLUMN_DIR DIRECT /end RECORD_LAYOUT
/begin COMPU_METHOD CU_DINC_KPH_VEHSPD "Conversion method for DINc_kph_VehSpd" RAT_FUNC "%10.0" "kph" COEFFS 0.000000 1.000000 0.000000 0.000000 0.000000 1.000000 /end COMPU_METHOD
/* Scalar calibration for DDE 'DINc_o_AC_PressSw'. */
/begin CHARACTERISTIC DINc_o_AC_PressSw "Override flag" VALUE 0x8c86a RL_DINC_O_AC_PRESSSW 1.000000 CU_DINC_O_AC_PRESSSW 0.000000 1.000000 BYTE_ORDER MSB_FIRST /end CHARACTERISTIC
/begin RECORD_LAYOUT RL_DINC_O_AC_PRESSSW FNC_VALUES 1 UBYTE COLUMN_DIR DIRECT /end RECORD_LAYOUT
/begin COMPU_METHOD CU_DINC_O_AC_PRESSSW "Conversion method for DINc_o_AC_PressSw" RAT_FUNC "%10.0" "o" COEFFS 0.000000 1.000000 0.000000 0.000000 0.000000 1.000000 /end COMPU_METHOD
/* Scalar calibration for DDE 'DINc_o_AC_ReqSw'. */
/begin CHARACTERISTIC DINc_o_AC_ReqSw "Override flag" VALUE 0x8c86c RL_DINC_O_AC_REQSW 1.000000 CU_DINC_O_AC_REQSW 0.000000 1.000000 BYTE_ORDER MSB_FIRST /end CHARACTERISTIC
/begin RECORD_LAYOUT RL_DINC_O_AC_REQSW FNC_VALUES 1 UBYTE COLUMN_DIR DIRECT /end RECORD_LAYOUT
/begin COMPU_METHOD CU_DINC_O_AC_REQSW "Conversion method for DINc_o_AC_ReqSw" RAT_FUNC "%10.0" "o" COEFFS 0.000000 1.000000 0.000000 0.000000 0.000000 1.000000 /end COMPU_METHOD
/* Scalar calibration for DDE 'DINc_o_AltLoad'. */
/begin CHARACTERISTIC DINc_o_AltLoad "Override flag" VALUE 0x8c88a RL_DINC_O_ALTLOAD 1.000000 CU_DINC_O_ALTLOAD 0.000000 1.000000 BYTE_ORDER MSB_FIRST /end CHARACTERISTIC
/begin RECORD_LAYOUT RL_DINC_O_ALTLOAD FNC_VALUES 1 UBYTE COLUMN_DIR DIRECT /end RECORD_LAYOUT
/begin COMPU_METHOD CU_DINC_O_ALTLOAD "Conversion method for DINc_o_AltLoad" RAT_FUNC "%10.0" "o" COEFFS 0.000000 1.000000 0.000000 0.000000 0.000000 1.000000 /end COMPU_METHOD
/* Scalar calibration for DDE 'DINc_o_Belt'. */
/begin CHARACTERISTIC DINc_o_Belt "Override" VALUE 0x8c876 RL_DINC_O_BELT 1.000000 CU_DINC_O_BELT 0.000000 1.000000 BYTE_ORDER MSB_FIRST /end CHARACTERISTIC
/begin RECORD_LAYOUT RL_DINC_O_BELT FNC_VALUES 1 UBYTE COLUMN_DIR DIRECT /end RECORD_LAYOUT
/begin COMPU_METHOD CU_DINC_O_BELT "Conversion method for DINc_o_Belt" RAT_FUNC "%10.0" "o" COEFFS 0.000000 1.000000 0.000000 0.000000 0.000000 1.000000 /end COMPU_METHOD
/* Scalar calibration for DDE 'DINc_o_CamPhase'. */
/begin CHARACTERISTIC DINc_o_CamPhase "Override flag" VALUE 0x8c87a RL_DINC_O_CAMPHASE 1.000000 CU_DINC_O_CAMPHASE 0.000000 1.000000 BYTE_ORDER MSB_FIRST /end CHARACTERISTIC
/begin RECORD_LAYOUT RL_DINC_O_CAMPHASE FNC_VALUES 1 UBYTE COLUMN_DIR DIRECT /end RECORD_LAYOUT
/begin COMPU_METHOD CU_DINC_O_CAMPHASE "Conversion method for DINc_o_CamPhase" RAT_FUNC "%10.0" "o" COEFFS 0.000000 1.000000 0.000000 0.000000 0.000000 1.000000 /end COMPU_METHOD
/* Scalar calibration for DDE 'DINc_o_CamPhaseValid'. */
/begin CHARACTERISTIC DINc_o_CamPhaseValid "Override flag" VALUE 0x8c4e0 RL_DINC_O_CAMPHASEVALID 1.000000 CU_DINC_O_CAMPHASEVALID 0.000000 1.000000 BYTE_ORDER MSB_FIRST /end CHARACTERISTIC
/begin RECORD_LAYOUT RL_DINC_O_CAMPHASEVALID FNC_VALUES 1 UBYTE COLUMN_DIR DIRECT /end RECORD_LAYOUT
/begin COMPU_METHOD CU_DINC_O_CAMPHASEVALID "Conversion method for DINc_o_CamPhaseValid" RAT_FUNC "%10.0" "o" COEFFS 0.000000 1.000000 0.000000 0.000000 0.000000 1.000000 /end COMPU_METHOD
/* Scalar calibration for DDE 'DINc_o_Door'. */
/begin CHARACTERISTIC DINc_o_Door "Override" VALUE 0x8c878 RL_DINC_O_DOOR 1.000000 CU_DINC_O_DOOR 0.000000 1.000000 BYTE_ORDER MSB_FIRST /end CHARACTERISTIC
/begin RECORD_LAYOUT RL_DINC_O_DOOR FNC_VALUES 1 UBYTE COLUMN_DIR DIRECT /end RECORD_LAYOUT
/begin COMPU_METHOD CU_DINC_O_DOOR "Conversion method for DINc_o_Door" RAT_FUNC "%10.0" "o" COEFFS 0.000000 1.000000 0.000000 0.000000 0.000000 1.000000 /end COMPU_METHOD
/* Scalar calibration for DDE 'DINc_o_EngSpd'. */
/begin CHARACTERISTIC DINc_o_EngSpd "Override flag" VALUE 0x8c4e8 RL_DINC_O_ENGSPD 1.000000 CU_DINC_O_ENGSPD 0.000000 1.000000 BYTE_ORDER MSB_FIRST /end CHARACTERISTIC
/begin RECORD_LAYOUT RL_DINC_O_ENGSPD FNC_VALUES 1 UBYTE COLUMN_DIR DIRECT /end RECORD_LAYOUT
/begin COMPU_METHOD CU_DINC_O_ENGSPD "Conversion method for DINc_o_EngSpd" RAT_FUNC "%10.0" "o" COEFFS 0.000000 1.000000 0.000000 0.000000 0.000000 1.000000 /end COMPU_METHOD
/* Scalar calibration for DDE 'DINc_o_EngSync'. */
/begin CHARACTERISTIC DINc_o_EngSync "Override flag" VALUE 0x8c888 RL_DINC_O_ENGSYNC 1.000000 CU_DINC_O_ENGSYNC 0.000000 1.000000 BYTE_ORDER MSB_FIRST /end CHARACTERISTIC
/begin RECORD_LAYOUT RL_DINC_O_ENGSYNC FNC_VALUES 1 UBYTE COLUMN_DIR DIRECT /end RECORD_LAYOUT
/begin COMPU_METHOD CU_DINC_O_ENGSYNC "Conversion method for DINc_o_EngSync" RAT_FUNC "%10.0" "o" COEFFS 0.000000 1.000000 0.000000 0.000000 0.000000 1.000000 /end COMPU_METHOD
/* Scalar calibration for DDE 'DINc_o_Gear'. */
/begin CHARACTERISTIC DINc_o_Gear "Override flag" VALUE 0x8c4f8 RL_DINC_O_GEAR 1.000000 CU_DINC_O_GEAR 0.000000 1.000000 BYTE_ORDER MSB_FIRST /end CHARACTERISTIC
/begin RECORD_LAYOUT RL_DINC_O_GEAR FNC_VALUES 1 UBYTE COLUMN_DIR DIRECT /end RECORD_LAYOUT
/begin COMPU_METHOD CU_DINC_O_GEAR "Conversion method for DINc_o_Gear" RAT_FUNC "%10.0" "o" COEFFS 0.000000 1.000000 0.000000 0.000000 0.000000 1.000000 /end COMPU_METHOD
/* Scalar calibration for DDE 'DINc_o_Ign'. */
/begin CHARACTERISTIC DINc_o_Ign "Override flag" VALUE 0x8c4d0 RL_DINC_O_IGN 1.000000 CU_DINC_O_IGN 0.000000 1.000000 BYTE_ORDER MSB_FIRST /end CHARACTERISTIC
/begin RECORD_LAYOUT RL_DINC_O_IGN FNC_VALUES 1 UBYTE COLUMN_DIR DIRECT /end RECORD_LAYOUT
/begin COMPU_METHOD CU_DINC_O_IGN "Conversion method for DINc_o_Ign" RAT_FUNC "%10.0" "o" COEFFS 0.000000 1.000000 0.000000 0.000000 0.000000 1.000000 /end COMPU_METHOD
/* Scalar calibration for DDE 'DINc_o_MAF'. */
/begin CHARACTERISTIC DINc_o_MAF "Override flag" VALUE 0x8c882 RL_DINC_O_MAF 1.000000 CU_DINC_O_MAF 0.000000 1.000000 BYTE_ORDER MSB_FIRST /end CHARACTERISTIC
/begin RECORD_LAYOUT RL_DINC_O_MAF FNC_VALUES 1 UBYTE COLUMN_DIR DIRECT /end RECORD_LAYOUT
/begin COMPU_METHOD CU_DINC_O_MAF "Conversion method for DINc_o_MAF" RAT_FUNC "%10.0" "o" COEFFS 0.000000 1.000000 0.000000 0.000000 0.000000 1.000000 /end COMPU_METHOD
/* Scalar calibration for DDE 'DINc_o_OilPrSw'. */
/begin CHARACTERISTIC DINc_o_OilPrSw "Override" VALUE 0x8c868 RL_DINC_O_OILPRSW 1.000000 CU_DINC_O_OILPRSW 0.000000 1.000000 BYTE_ORDER MSB_FIRST /end CHARACTERISTIC
/begin RECORD_LAYOUT RL_DINC_O_OILPRSW FNC_VALUES 1 UBYTE COLUMN_DIR DIRECT /end RECORD_LAYOUT
/begin COMPU_METHOD CU_DINC_O_OILPRSW "Conversion method for DINc_o_OilPrSw" RAT_FUNC "%10.0" "o" COEFFS 0.000000 1.000000 0.000000 0.000000 0.000000 1.000000 /end COMPU_METHOD
/* Scalar calibration for DDE 'DINc_o_ParkingBrake'. */
/begin CHARACTERISTIC DINc_o_ParkingBrake "Override" VALUE 0x8c880 RL_DINC_O_PARKINGBRAKE 1.000000 CU_DINC_O_PARKINGBRAKE 0.000000 1.000000 BYTE_ORDER MSB_FIRST /end CHARACTERISTIC
/begin RECORD_LAYOUT RL_DINC_O_PARKINGBRAKE FNC_VALUES 1 UBYTE COLUMN_DIR DIRECT /end RECORD_LAYOUT
/begin COMPU_METHOD CU_DINC_O_PARKINGBRAKE "Conversion method for DINc_o_ParkingBrake" RAT_FUNC "%10.0" "o" COEFFS 0.000000 1.000000 0.000000 0.000000 0.000000 1.000000 /end COMPU_METHOD
/* Scalar calibration for DDE 'DINc_o_PedalBrake'. */
/begin CHARACTERISTIC DINc_o_PedalBrake "Override" VALUE 0x8c874 RL_DINC_O_PEDALBRAKE 1.000000 CU_DINC_O_PEDALBRAKE 0.000000 1.000000 BYTE_ORDER MSB_FIRST /end CHARACTERISTIC
/begin RECORD_LAYOUT RL_DINC_O_PEDALBRAKE FNC_VALUES 1 UBYTE COLUMN_DIR DIRECT /end RECORD_LAYOUT
/begin COMPU_METHOD CU_DINC_O_PEDALBRAKE "Conversion method for DINc_o_PedalBrake" RAT_FUNC "%10.0" "o" COEFFS 0.000000 1.000000 0.000000 0.000000 0.000000 1.000000 /end COMPU_METHOD
/* Scalar calibration for DDE 'DINc_o_RearGear'. */
/begin CHARACTERISTIC DINc_o_RearGear "Override flag" VALUE 0x8c500 RL_DINC_O_REARGEAR 1.000000 CU_DINC_O_REARGEAR 0.000000 1.000000 BYTE_ORDER MSB_FIRST /end CHARACTERISTIC
/begin RECORD_LAYOUT RL_DINC_O_REARGEAR FNC_VALUES 1 UBYTE COLUMN_DIR DIRECT /end RECORD_LAYOUT
/begin COMPU_METHOD CU_DINC_O_REARGEAR "Conversion method for DINc_o_RearGear" RAT_FUNC "%10.0" "o" COEFFS 0.000000 1.000000 0.000000 0.000000 0.000000 1.000000 /end COMPU_METHOD
/* Scalar calibration for DDE 'DINc_o_TOSS'. */
/begin CHARACTERISTIC DINc_o_TOSS "Override flag" VALUE 0x8c86e RL_DINC_O_TOSS 1.000000 CU_DINC_O_TOSS 0.000000 1.000000 BYTE_ORDER MSB_FIRST /end CHARACTERISTIC
/begin RECORD_LAYOUT RL_DINC_O_TOSS FNC_VALUES 1 UBYTE COLUMN_DIR DIRECT /end RECORD_LAYOUT
/begin COMPU_METHOD CU_DINC_O_TOSS "Conversion method for DINc_o_TOSS" RAT_FUNC "%10.0" "o" COEFFS 0.000000 1.000000 0.000000 0.000000 0.000000 1.000000 /end COMPU_METHOD
/* Scalar calibration for DDE 'DINc_o_VehSpd'. */
/begin CHARACTERISTIC DINc_o_VehSpd "Override flag" VALUE 0x8c860 RL_DINC_O_VEHSPD 1.000000 CU_DINC_O_VEHSPD 0.000000 1.000000 BYTE_ORDER MSB_FIRST /end CHARACTERISTIC
/begin RECORD_LAYOUT RL_DINC_O_VEHSPD FNC_VALUES 1 UBYTE COLUMN_DIR DIRECT /end RECORD_LAYOUT
/begin COMPU_METHOD CU_DINC_O_VEHSPD "Conversion method for DINc_o_VehSpd" RAT_FUNC "%10.0" "o" COEFFS 0.000000 1.000000 0.000000 0.000000 0.000000 1.000000 /end COMPU_METHOD
/* Scalar calibration for DDE 'DINc_pct_AltLoad'. */
/begin CHARACTERISTIC DINc_pct_AltLoad "Override value" VALUE 0x8c88c RL_DINC_PCT_ALTLOAD 1000.000000 CU_DINC_PCT_ALTLOAD 0.000000 1000.000000 BYTE_ORDER MSB_FIRST /end CHARACTERISTIC
/begin RECORD_LAYOUT RL_DINC_PCT_ALTLOAD FNC_VALUES 1 FLOAT32_IEEE COLUMN_DIR DIRECT /end RECORD_LAYOUT
/begin COMPU_METHOD CU_DINC_PCT_ALTLOAD "Conversion method for DINc_pct_AltLoad" RAT_FUNC "%10.0" "pct" COEFFS 0.000000 1.000000 0.000000 0.000000 0.000000 1.000000 /end COMPU_METHOD
/* Scalar calibration for DDE 'DINc_ret_CamPhase'. */
/begin CHARACTERISTIC DINc_ret_CamPhase "Override value" VALUE 0x8c87c RL_DINC_RET_CAMPHASE 240.000000 CU_DINC_RET_CAMPHASE -120.000000 120.000000 BYTE_ORDER MSB_FIRST /end CHARACTERISTIC
/begin RECORD_LAYOUT RL_DINC_RET_CAMPHASE FNC_VALUES 1 FLOAT32_IEEE COLUMN_DIR DIRECT /end RECORD_LAYOUT
/begin COMPU_METHOD CU_DINC_RET_CAMPHASE "Conversion method for DINc_ret_CamPhase" RAT_FUNC "%10.1" "ret" COEFFS 0.000000 1.000000 0.000000 0.000000 0.000000 1.000000 /end COMPU_METHOD
/* Scalar calibration for DDE 'DINc_ret_CamPhaseMax'. */
/begin CHARACTERISTIC DINc_ret_CamPhaseMax "Rationality limit on cam phasing angle" VALUE 0x8c514 RL_DINC_RET_CAMPHASEMAX 720.000000 CU_DINC_RET_CAMPHASEMAX 0.000000 720.000000 BYTE_ORDER MSB_FIRST /end CHARACTERISTIC
/begin RECORD_LAYOUT RL_DINC_RET_CAMPHASEMAX FNC_VALUES 1 FLOAT32_IEEE COLUMN_DIR DIRECT /end RECORD_LAYOUT
/begin COMPU_METHOD CU_DINC_RET_CAMPHASEMAX "Conversion method for DINc_ret_CamPhaseMax" RAT_FUNC "%10.0" "ret" COEFFS 0.000000 1.000000 0.000000 0.000000 0.000000 1.000000 /end COMPU_METHOD
/* Scalar calibration for DDE 'DINc_s_TimeIgnitionON'. */
/begin CHARACTERISTIC DINc_s_TimeIgnitionON "Bares de presión OFF" VALUE 0x8d068 RL_DINC_S_TIMEIGNITIONON 10000.000000 CU_DINC_S_TIMEIGNITIONON 0.000000 10000.000000 BYTE_ORDER MSB_FIRST /end CHARACTERISTIC
/begin RECORD_LAYOUT RL_DINC_S_TIMEIGNITIONON FNC_VALUES 1 FLOAT32_IEEE COLUMN_DIR DIRECT /end RECORD_LAYOUT
/begin COMPU_METHOD CU_DINC_S_TIMEIGNITIONON "Conversion method for DINc_s_TimeIgnitionON" RAT_FUNC "%10.3" "s" COEFFS 0.000000 1.000000 0.000000 0.000000 0.000000 1.000000 /end COMPU_METHOD
/* Scalar calibration for DDE 'DINc_s_ValidCamDbnc1'. */
/begin CHARACTERISTIC DINc_s_ValidCamDbnc1 "Cam will be declared invalid if no valid delta has been seen for this duration" VALUE 0x8c4d8 RL_DINC_S_VALIDCAMDBNC1 1.000000 CU_DINC_S_VALIDCAMDBNC1 0.000000 1.000000 BYTE_ORDER MSB_FIRST /end CHARACTERISTIC
/begin RECORD_LAYOUT RL_DINC_S_VALIDCAMDBNC1 FNC_VALUES 1 FLOAT32_IEEE COLUMN_DIR DIRECT /end RECORD_LAYOUT
/begin COMPU_METHOD CU_DINC_S_VALIDCAMDBNC1 "Conversion method for DINc_s_ValidCamDbnc1" RAT_FUNC "%10.3" "s" COEFFS 0.000000 1.000000 0.000000 0.000000 0.000000 1.000000 /end COMPU_METHOD
/* Scalar calibration for DDE 'DINc_s_ValidCamDbnc2'. */
/begin CHARACTERISTIC DINc_s_ValidCamDbnc2 "Cam will be declared invalid if no angle change has been seen for this duration" VALUE 0x8c4dc RL_DINC_S_VALIDCAMDBNC2 2.000000 CU_DINC_S_VALIDCAMDBNC2 0.000000 2.000000 BYTE_ORDER MSB_FIRST /end CHARACTERISTIC
/begin RECORD_LAYOUT RL_DINC_S_VALIDCAMDBNC2 FNC_VALUES 1 FLOAT32_IEEE COLUMN_DIR DIRECT /end RECORD_LAYOUT
/begin COMPU_METHOD CU_DINC_S_VALIDCAMDBNC2 "Conversion method for DINc_s_ValidCamDbnc2" RAT_FUNC "%10.3" "s" COEFFS 0.000000 1.000000 0.000000 0.000000 0.000000 1.000000 /end COMPU_METHOD
/* Map (1d) calibration for DDE 'DINm_NU_MAF_z'. */
/begin CHARACTERISTIC DINm_NU_MAF_z "Sensor transfer function lookup output" CURVE 0x8c6b0 RL_DINM_NU_MAF_Z 1000.000000 CU_DINM_NU_MAF_Z 0.000000 1000.000000
 /begin AXIS_DESCR COM_AXIS DIN_Hz_MAF CU_DINM_NU_MAF_X 100 0.000000 15000.000000 AXIS_PTS_REF APD_DINM_NU_MAF_X /end AXIS_DESCR
 BYTE_ORDER MSB_FIRST /end CHARACTERISTIC
/begin RECORD_LAYOUT RL_DINM_NU_MAF_Z FNC_VALUES 1 FLOAT32_IEEE COLUMN_DIR DIRECT /end RECORD_LAYOUT
/begin COMPU_METHOD CU_DINM_NU_MAF_Z "Conversion method for DINm_NU_MAF_z" RAT_FUNC "%10.3" "gps" COEFFS 0.000000 1.000000 0.000000 0.000000 0.000000 1.000000 /end COMPU_METHOD
/begin AXIS_PTS APD_DINM_NU_MAF_X "Sensor transfer function x-axis lookup" 0x8c520 DIN_Hz_MAF RL_DINM_NU_MAF_X 15000.000000 CU_DINM_NU_MAF_X 100 0.0 15000.0 BYTE_ORDER MSB_FIRST /end AXIS_PTS
/begin RECORD_LAYOUT RL_DINM_NU_MAF_X AXIS_PTS_X 1 FLOAT32_IEEE INDEX_INCR DIRECT /end RECORD_LAYOUT
/begin COMPU_METHOD CU_DINM_NU_MAF_X "Conversion method for DINm_NU_MAF_x" RAT_FUNC "%10.3" "Hz" COEFFS 0.000000 1.000000 0.000000 0.000000 0.000000 1.000000 /end COMPU_METHOD
/* Scalar calibration for DDE 'DRLc_b_UseDynoRqst'. */
/begin CHARACTERISTIC DRLc_b_UseDynoRqst "Cal to enable the dyno request to ADM" VALUE 0x85098 RL_DRLC_B_USEDYNORQST 1.000000 CU_DRLC_B_USEDYNORQST 0.000000 1.000000 BYTE_ORDER MSB_FIRST /end CHARACTERISTIC
/begin RECORD_LAYOUT RL_DRLC_B_USEDYNORQST FNC_VALUES 1 UBYTE COLUMN_DIR DIRECT /end RECORD_LAYOUT
/begin COMPU_METHOD CU_DRLC_B_USEDYNORQST "Conversion method for DRLc_b_UseDynoRqst" RAT_FUNC "%10.0" "b" COEFFS 0.000000 1.000000 0.000000 0.000000 0.000000 1.000000 /end COMPU_METHOD
/* Scalar calibration for DDE 'DRLc_gps_DynoAirRqst'. */
/begin CHARACTERISTIC DRLc_gps_DynoAirRqst "Override value" VALUE 0x85094 RL_DRLC_GPS_DYNOAIRRQST 500.000000 CU_DRLC_GPS_DYNOAIRRQST 0.000000 500.000000 BYTE_ORDER MSB_FIRST /end CHARACTERISTIC
/begin RECORD_LAYOUT RL_DRLC_GPS_DYNOAIRRQST FNC_VALUES 1 FLOAT32_IEEE COLUMN_DIR DIRECT /end RECORD_LAYOUT
/begin COMPU_METHOD CU_DRLC_GPS_DYNOAIRRQST "Conversion method for DRLc_gps_DynoAirRqst" RAT_FUNC "%10.1" "gps" COEFFS 0.000000 1.000000 0.000000 0.000000 0.000000 1.000000 /end COMPU_METHOD
/* Scalar calibration for DDE 'DRLc_o_DynoAirRqst'. */
/begin CHARACTERISTIC DRLc_o_DynoAirRqst "Override flag" VALUE 0x85090 RL_DRLC_O_DYNOAIRRQST 1.000000 CU_DRLC_O_DYNOAIRRQST 0.000000 1.000000 BYTE_ORDER MSB_FIRST /end CHARACTERISTIC
/begin RECORD_LAYOUT RL_DRLC_O_DYNOAIRRQST FNC_VALUES 1 UBYTE COLUMN_DIR DIRECT /end RECORD_LAYOUT
/begin COMPU_METHOD CU_DRLC_O_DYNOAIRRQST "Conversion method for DRLc_o_DynoAirRqst" RAT_FUNC "%10.0" "o" COEFFS 0.000000 1.000000 0.000000 0.000000 0.000000 1.000000 /end COMPU_METHOD
/* Map (2d) calibration for DDE 'DRLm_NU_APP_ToADM_z'. */
/begin CHARACTERISTIC DRLm_NU_APP_ToADM_z "(ADM_gps) Conversion from dyno load request to ADM mass flow request" MAP 0x85050 RL_DRLM_NU_APP_TOADM_Z 500.000000 CU_DRLM_NU_APP_TOADM_Z 0.000000 500.000000
 /begin AXIS_DESCR COM_AXIS NO_INPUT_QUANTITY CU_DRLM_NU_APP_TOADM_X 4 0.000000 10000.000000 AXIS_PTS_REF APD_DRLM_NU_APP_TOADM_X /end AXIS_DESCR
 /begin AXIS_DESCR COM_AXIS NO_INPUT_QUANTITY CU_DRLM_NU_APP_TOADM_Y 4 0.000000 5.000000 AXIS_PTS_REF APD_DRLM_NU_APP_TOADM_Y /end AXIS_DESCR
 BYTE_ORDER MSB_FIRST /end CHARACTERISTIC
/begin RECORD_LAYOUT RL_DRLM_NU_APP_TOADM_Z FNC_VALUES 1 FLOAT32_IEEE COLUMN_DIR DIRECT /end RECORD_LAYOUT
/begin COMPU_METHOD CU_DRLM_NU_APP_TOADM_Z "Conversion method for DRLm_NU_APP_ToADM_z" RAT_FUNC "%10.1" "gps" COEFFS 0.000000 1.000000 0.000000 0.000000 0.000000 1.000000 /end COMPU_METHOD
/begin AXIS_PTS APD_DRLM_NU_APP_TOADM_X "(RPM) Conversion from dyno load request to ADM mass flow request" 0x85030 NO_INPUT_QUANTITY RL_DRLM_NU_APP_TOADM_X 10000.000000 CU_DRLM_NU_APP_TOADM_X 4 0.0 10000.0 BYTE_ORDER MSB_FIRST /end AXIS_PTS
/begin RECORD_LAYOUT RL_DRLM_NU_APP_TOADM_X AXIS_PTS_X 1 FLOAT32_IEEE INDEX_INCR DIRECT /end RECORD_LAYOUT
/begin COMPU_METHOD CU_DRLM_NU_APP_TOADM_X "Conversion method for DRLm_NU_APP_ToADM_x" RAT_FUNC "%10.0" "RPM" COEFFS 0.000000 1.000000 0.000000 0.000000 0.000000 1.000000 /end COMPU_METHOD
/begin AXIS_PTS APD_DRLM_NU_APP_TOADM_Y "(raw input value ie: Volts) Conversion from dyno load request to ADM mass flow request" 0x85040 NO_INPUT_QUANTITY RL_DRLM_NU_APP_TOADM_Y 5.000000 CU_DRLM_NU_APP_TOADM_Y 4 0.0 5.0 BYTE_ORDER MSB_FIRST /end AXIS_PTS
/begin RECORD_LAYOUT RL_DRLM_NU_APP_TOADM_Y AXIS_PTS_X 1 FLOAT32_IEEE INDEX_INCR DIRECT /end RECORD_LAYOUT
/begin COMPU_METHOD CU_DRLM_NU_APP_TOADM_Y "Conversion method for DRLm_NU_APP_ToADM_y" RAT_FUNC "%10.3" "NU" COEFFS 0.000000 1.000000 0.000000 0.000000 0.000000 1.000000 /end COMPU_METHOD
/* Scalar calibration for DDE 'DTCc_C_DiagCata_MaxEGT'. */
/begin CHARACTERISTIC DTCc_C_DiagCata_MaxEGT "(not defined)" VALUE 0x8c0d8 RL_DTCC_C_DIAGCATA_MAXEGT 10000.000000 CU_DTCC_C_DIAGCATA_MAXEGT 0.000000 10000.000000 BYTE_ORDER MSB_FIRST /end CHARACTERISTIC
/begin RECORD_LAYOUT RL_DTCC_C_DIAGCATA_MAXEGT FNC_VALUES 1 FLOAT32_IEEE COLUMN_DIR DIRECT /end RECORD_LAYOUT
/begin COMPU_METHOD CU_DTCC_C_DIAGCATA_MAXEGT "Conversion method for DTCc_C_DiagCata_MaxEGT" RAT_FUNC "%10.2" "C" COEFFS 0.000000 1.000000 0.000000 0.000000 0.000000 1.000000 /end COMPU_METHOD
/* Scalar calibration for DDE 'DTCc_C_DiagCata_MinEGT'. */
/begin CHARACTERISTIC DTCc_C_DiagCata_MinEGT "(not defined)" VALUE 0x8c0d4 RL_DTCC_C_DIAGCATA_MINEGT 10000.000000 CU_DTCC_C_DIAGCATA_MINEGT 0.000000 10000.000000 BYTE_ORDER MSB_FIRST /end CHARACTERISTIC
/begin RECORD_LAYOUT RL_DTCC_C_DIAGCATA_MINEGT FNC_VALUES 1 FLOAT32_IEEE COLUMN_DIR DIRECT /end RECORD_LAYOUT
/begin COMPU_METHOD CU_DTCC_C_DIAGCATA_MINEGT "Conversion method for DTCc_C_DiagCata_MinEGT" RAT_FUNC "%10.2" "C" COEFFS 0.000000 1.000000 0.000000 0.000000 0.000000 1.000000 /end COMPU_METHOD
/* Scalar calibration for DDE 'DTCc_NU_CatalystTimeThreshold'. */
/begin CHARACTERISTIC DTCc_NU_CatalystTimeThreshold "(not defined)" VALUE 0x8c0f8 RL_DTCC_NU_CATALYSTTIMETHRESHO0 600.000000 CU_DTCC_NU_CATALYSTTIMETHRESHO0 0.000000 600.000000 BYTE_ORDER MSB_FIRST /end CHARACTERISTIC
/begin RECORD_LAYOUT RL_DTCC_NU_CATALYSTTIMETHRESHO0 FNC_VALUES 1 FLOAT32_IEEE COLUMN_DIR DIRECT /end RECORD_LAYOUT
/begin COMPU_METHOD CU_DTCC_NU_CATALYSTTIMETHRESHO0 "Conversion method for DTCc_NU_CatalystTimeThreshold" RAT_FUNC "%10.2" "s" COEFFS 0.000000 1.000000 0.000000 0.000000 0.000000 1.000000 /end COMPU_METHOD
/* Scalar calibration for DDE 'DTCc_NU_DC'. */
/begin CHARACTERISTIC DTCc_NU_DC "(not defined)" VALUE 0x8ce74 RL_DTCC_NU_DC 400.000000 CU_DTCC_NU_DC 0.000000 400.000000 BYTE_ORDER MSB_FIRST /end CHARACTERISTIC
/begin RECORD_LAYOUT RL_DTCC_NU_DC FNC_VALUES 1 FLOAT32_IEEE COLUMN_DIR DIRECT /end RECORD_LAYOUT
/begin COMPU_METHOD CU_DTCC_NU_DC "Conversion method for DTCc_NU_DC" RAT_FUNC "%10.0" "NU" COEFFS 0.000000 1.000000 0.000000 0.000000 0.000000 1.000000 /end COMPU_METHOD
/* Scalar calibration for DDE 'DTCc_NU_KNKButaneAlarm'. */
/begin CHARACTERISTIC DTCc_NU_KNKButaneAlarm "(not defined)" VALUE 0x8ad8c RL_DTCC_NU_KNKBUTANEALARM 10000.000000 CU_DTCC_NU_KNKBUTANEALARM 0.000000 10000.000000 BYTE_ORDER MSB_FIRST /end CHARACTERISTIC
/begin RECORD_LAYOUT RL_DTCC_NU_KNKBUTANEALARM FNC_VALUES 1 FLOAT32_IEEE COLUMN_DIR DIRECT /end RECORD_LAYOUT
/begin COMPU_METHOD CU_DTCC_NU_KNKBUTANEALARM "Conversion method for DTCc_NU_KNKButaneAlarm" RAT_FUNC "%10.1" "ret" COEFFS 0.000000 1.000000 0.000000 0.000000 0.000000 1.000000 /end COMPU_METHOD
/* Scalar calibration for DDE 'DTCc_NU_KNKButaneThr'. */
/begin CHARACTERISTIC DTCc_NU_KNKButaneThr "(not defined)" VALUE 0x8ad88 RL_DTCC_NU_KNKBUTANETHR 10000.000000 CU_DTCC_NU_KNKBUTANETHR 0.000000 10000.000000 BYTE_ORDER MSB_FIRST /end CHARACTERISTIC
/begin RECORD_LAYOUT RL_DTCC_NU_KNKBUTANETHR FNC_VALUES 1 FLOAT32_IEEE COLUMN_DIR DIRECT /end RECORD_LAYOUT
/begin COMPU_METHOD CU_DTCC_NU_KNKBUTANETHR "Conversion method for DTCc_NU_KNKButaneThr" RAT_FUNC "%10.2" "ret" COEFFS 0.000000 1.000000 0.000000 0.000000 0.000000 1.000000 /end COMPU_METHOD
/* Scalar calibration for DDE 'DTCc_NU_Seconds'. */
/begin CHARACTERISTIC DTCc_NU_Seconds "(not defined)" VALUE 0x8ce78 RL_DTCC_NU_SECONDS 4294967295.000000 CU_DTCC_NU_SECONDS 0.000000 4294967295.000000 BYTE_ORDER MSB_FIRST /end CHARACTERISTIC
/begin RECORD_LAYOUT RL_DTCC_NU_SECONDS FNC_VALUES 1 FLOAT32_IEEE COLUMN_DIR DIRECT /end RECORD_LAYOUT
/begin COMPU_METHOD CU_DTCC_NU_SECONDS "Conversion method for DTCc_NU_Seconds" RAT_FUNC "%10.0" "s" COEFFS 0.000000 1.000000 0.000000 0.000000 0.000000 1.000000 /end COMPU_METHOD
/* Scalar calibration for DDE 'DTCc_NU_TestTime'. */
/begin CHARACTERISTIC DTCc_NU_TestTime "(not defined)" VALUE 0x8c0e4 RL_DTCC_NU_TESTTIME 1000000.000000 CU_DTCC_NU_TESTTIME 0.000000 1000000.000000 BYTE_ORDER MSB_FIRST /end CHARACTERISTIC
/begin RECORD_LAYOUT RL_DTCC_NU_TESTTIME FNC_VALUES 1 FLOAT32_IEEE COLUMN_DIR DIRECT /end RECORD_LAYOUT
/begin COMPU_METHOD CU_DTCC_NU_TESTTIME "Conversion method for DTCc_NU_TestTime" RAT_FUNC "%10.0" "s" COEFFS 0.000000 1.000000 0.000000 0.000000 0.000000 1.000000 /end COMPU_METHOD
/* Scalar calibration for DDE 'DTCc_NU_TimeRichLean'. */
/begin CHARACTERISTIC DTCc_NU_TimeRichLean "(not defined)" VALUE 0x8c0e8 RL_DTCC_NU_TIMERICHLEAN 600.000000 CU_DTCC_NU_TIMERICHLEAN 0.000000 600.000000 BYTE_ORDER MSB_FIRST /end CHARACTERISTIC
/begin RECORD_LAYOUT RL_DTCC_NU_TIMERICHLEAN FNC_VALUES 1 FLOAT32_IEEE COLUMN_DIR DIRECT /end RECORD_LAYOUT
/begin COMPU_METHOD CU_DTCC_NU_TIMERICHLEAN "Conversion method for DTCc_NU_TimeRichLean" RAT_FUNC "%10.0" "s" COEFFS 0.000000 1.000000 0.000000 0.000000 0.000000 1.000000 /end COMPU_METHOD
/* Scalar calibration for DDE 'DTCc_RPM_EntryThrshMisf'. */
/begin CHARACTERISTIC DTCc_RPM_EntryThrshMisf "(not defined)" VALUE 0x8c4ac RL_DTCC_RPM_ENTRYTHRSHMISF 10000.000000 CU_DTCC_RPM_ENTRYTHRSHMISF 0.000000 10000.000000 BYTE_ORDER MSB_FIRST /end CHARACTERISTIC
/begin RECORD_LAYOUT RL_DTCC_RPM_ENTRYTHRSHMISF FNC_VALUES 1 FLOAT32_IEEE COLUMN_DIR DIRECT /end RECORD_LAYOUT
/begin COMPU_METHOD CU_DTCC_RPM_ENTRYTHRSHMISF "Conversion method for DTCc_RPM_EntryThrshMisf" RAT_FUNC "%10.0" "RPM" COEFFS 0.000000 1.000000 0.000000 0.000000 0.000000 1.000000 /end COMPU_METHOD
/* Scalar calibration for DDE 'DTCc_b_1_boostOC'. */
/begin CHARACTERISTIC DTCc_b_1_boostOC "Override flag" VALUE 0x8ccf5 RL_DTCC_B_1_BOOSTOC 1.000000 CU_DTCC_B_1_BOOSTOC 0.000000 1.000000 BYTE_ORDER MSB_FIRST /end CHARACTERISTIC
/begin RECORD_LAYOUT RL_DTCC_B_1_BOOSTOC FNC_VALUES 1 UBYTE COLUMN_DIR DIRECT /end RECORD_LAYOUT
/begin COMPU_METHOD CU_DTCC_B_1_BOOSTOC "Conversion method for DTCc_b_1_boostOC" RAT_FUNC "%10.0" "b" COEFFS 0.000000 1.000000 0.000000 0.000000 0.000000 1.000000 /end COMPU_METHOD
/* Scalar calibration for DDE 'DTCc_b_1_lsol'. */
/begin CHARACTERISTIC DTCc_b_1_lsol "Override flag" VALUE 0x8ccf1 RL_DTCC_B_1_LSOL 1.000000 CU_DTCC_B_1_LSOL 0.000000 1.000000 BYTE_ORDER MSB_FIRST /end CHARACTERISTIC
/begin RECORD_LAYOUT RL_DTCC_B_1_LSOL FNC_VALUES 1 UBYTE COLUMN_DIR DIRECT /end RECORD_LAYOUT
/begin COMPU_METHOD CU_DTCC_B_1_LSOL "Conversion method for DTCc_b_1_lsol" RAT_FUNC "%10.0" "b" COEFFS 0.000000 1.000000 0.000000 0.000000 0.000000 1.000000 /end COMPU_METHOD
/* Scalar calibration for DDE 'DTCc_b_1_sb'. */
/begin CHARACTERISTIC DTCc_b_1_sb "Override flag" VALUE 0x8ccf3 RL_DTCC_B_1_SB 1.000000 CU_DTCC_B_1_SB 0.000000 1.000000 BYTE_ORDER MSB_FIRST /end CHARACTERISTIC
/begin RECORD_LAYOUT RL_DTCC_B_1_SB FNC_VALUES 1 UBYTE COLUMN_DIR DIRECT /end RECORD_LAYOUT
/begin COMPU_METHOD CU_DTCC_B_1_SB "Conversion method for DTCc_b_1_sb" RAT_FUNC "%10.0" "b" COEFFS 0.000000 1.000000 0.000000 0.000000 0.000000 1.000000 /end COMPU_METHOD
/* Scalar calibration for DDE 'DTCc_b_1_sg'. */
/begin CHARACTERISTIC DTCc_b_1_sg "Override flag" VALUE 0x8ccf7 RL_DTCC_B_1_SG 1.000000 CU_DTCC_B_1_SG 0.000000 1.000000 BYTE_ORDER MSB_FIRST /end CHARACTERISTIC
/begin RECORD_LAYOUT RL_DTCC_B_1_SG FNC_VALUES 1 UBYTE COLUMN_DIR DIRECT /end RECORD_LAYOUT
/begin COMPU_METHOD CU_DTCC_B_1_SG "Conversion method for DTCc_b_1_sg" RAT_FUNC "%10.0" "b" COEFFS 0.000000 1.000000 0.000000 0.000000 0.000000 1.000000 /end COMPU_METHOD
/* Scalar calibration for DDE 'DTCc_b_2_boostOC'. */
/begin CHARACTERISTIC DTCc_b_2_boostOC "Override flag" VALUE 0x8ccfd RL_DTCC_B_2_BOOSTOC 1.000000 CU_DTCC_B_2_BOOSTOC 0.000000 1.000000 BYTE_ORDER MSB_FIRST /end CHARACTERISTIC
/begin RECORD_LAYOUT RL_DTCC_B_2_BOOSTOC FNC_VALUES 1 UBYTE COLUMN_DIR DIRECT /end RECORD_LAYOUT
/begin COMPU_METHOD CU_DTCC_B_2_BOOSTOC "Conversion method for DTCc_b_2_boostOC" RAT_FUNC "%10.0" "b" COEFFS 0.000000 1.000000 0.000000 0.000000 0.000000 1.000000 /end COMPU_METHOD
/* Scalar calibration for DDE 'DTCc_b_2_lsol'. */
/begin CHARACTERISTIC DTCc_b_2_lsol "Override flag" VALUE 0x8ccf9 RL_DTCC_B_2_LSOL 1.000000 CU_DTCC_B_2_LSOL 0.000000 1.000000 BYTE_ORDER MSB_FIRST /end CHARACTERISTIC
/begin RECORD_LAYOUT RL_DTCC_B_2_LSOL FNC_VALUES 1 UBYTE COLUMN_DIR DIRECT /end RECORD_LAYOUT
/begin COMPU_METHOD CU_DTCC_B_2_LSOL "Conversion method for DTCc_b_2_lsol" RAT_FUNC "%10.0" "b" COEFFS 0.000000 1.000000 0.000000 0.000000 0.000000 1.000000 /end COMPU_METHOD
/* Scalar calibration for DDE 'DTCc_b_2_sb'. */
/begin CHARACTERISTIC DTCc_b_2_sb "Override flag" VALUE 0x8ccfb RL_DTCC_B_2_SB 1.000000 CU_DTCC_B_2_SB 0.000000 1.000000 BYTE_ORDER MSB_FIRST /end CHARACTERISTIC
/begin RECORD_LAYOUT RL_DTCC_B_2_SB FNC_VALUES 1 UBYTE COLUMN_DIR DIRECT /end RECORD_LAYOUT
/begin COMPU_METHOD CU_DTCC_B_2_SB "Conversion method for DTCc_b_2_sb" RAT_FUNC "%10.0" "b" COEFFS 0.000000 1.000000 0.000000 0.000000 0.000000 1.000000 /end COMPU_METHOD
/* Scalar calibration for DDE 'DTCc_b_2_sg'. */
/begin CHARACTERISTIC DTCc_b_2_sg "Override flag" VALUE 0x8ccff RL_DTCC_B_2_SG 1.000000 CU_DTCC_B_2_SG 0.000000 1.000000 BYTE_ORDER MSB_FIRST /end CHARACTERISTIC
/begin RECORD_LAYOUT RL_DTCC_B_2_SG FNC_VALUES 1 UBYTE COLUMN_DIR DIRECT /end RECORD_LAYOUT
/begin COMPU_METHOD CU_DTCC_B_2_SG "Conversion method for DTCc_b_2_sg" RAT_FUNC "%10.0" "b" COEFFS 0.000000 1.000000 0.000000 0.000000 0.000000 1.000000 /end COMPU_METHOD
/* Scalar calibration for DDE 'DTCc_b_3_boostOC'. */
/begin CHARACTERISTIC DTCc_b_3_boostOC "Override flag" VALUE 0x8cd0d RL_DTCC_B_3_BOOSTOC 1.000000 CU_DTCC_B_3_BOOSTOC 0.000000 1.000000 BYTE_ORDER MSB_FIRST /end CHARACTERISTIC
/begin RECORD_LAYOUT RL_DTCC_B_3_BOOSTOC FNC_VALUES 1 UBYTE COLUMN_DIR DIRECT /end RECORD_LAYOUT
/begin COMPU_METHOD CU_DTCC_B_3_BOOSTOC "Conversion method for DTCc_b_3_boostOC" RAT_FUNC "%10.0" "b" COEFFS 0.000000 1.000000 0.000000 0.000000 0.000000 1.000000 /end COMPU_METHOD
/* Scalar calibration for DDE 'DTCc_b_3_lsol'. */
/begin CHARACTERISTIC DTCc_b_3_lsol "Override flag" VALUE 0x8cd09 RL_DTCC_B_3_LSOL 1.000000 CU_DTCC_B_3_LSOL 0.000000 1.000000 BYTE_ORDER MSB_FIRST /end CHARACTERISTIC
/begin RECORD_LAYOUT RL_DTCC_B_3_LSOL FNC_VALUES 1 UBYTE COLUMN_DIR DIRECT /end RECORD_LAYOUT
/begin COMPU_METHOD CU_DTCC_B_3_LSOL "Conversion method for DTCc_b_3_lsol" RAT_FUNC "%10.0" "b" COEFFS 0.000000 1.000000 0.000000 0.000000 0.000000 1.000000 /end COMPU_METHOD
/* Scalar calibration for DDE 'DTCc_b_3_sb'. */
/begin CHARACTERISTIC DTCc_b_3_sb "Override flag" VALUE 0x8cd0b RL_DTCC_B_3_SB 1.000000 CU_DTCC_B_3_SB 0.000000 1.000000 BYTE_ORDER MSB_FIRST /end CHARACTERISTIC
/begin RECORD_LAYOUT RL_DTCC_B_3_SB FNC_VALUES 1 UBYTE COLUMN_DIR DIRECT /end RECORD_LAYOUT
/begin COMPU_METHOD CU_DTCC_B_3_SB "Conversion method for DTCc_b_3_sb" RAT_FUNC "%10.0" "b" COEFFS 0.000000 1.000000 0.000000 0.000000 0.000000 1.000000 /end COMPU_METHOD
/* Scalar calibration for DDE 'DTCc_b_3_sg'. */
/begin CHARACTERISTIC DTCc_b_3_sg "Override flag" VALUE 0x8cd0f RL_DTCC_B_3_SG 1.000000 CU_DTCC_B_3_SG 0.000000 1.000000 BYTE_ORDER MSB_FIRST /end CHARACTERISTIC
/begin RECORD_LAYOUT RL_DTCC_B_3_SG FNC_VALUES 1 UBYTE COLUMN_DIR DIRECT /end RECORD_LAYOUT
/begin COMPU_METHOD CU_DTCC_B_3_SG "Conversion method for DTCc_b_3_sg" RAT_FUNC "%10.0" "b" COEFFS 0.000000 1.000000 0.000000 0.000000 0.000000 1.000000 /end COMPU_METHOD
/* Scalar calibration for DDE 'DTCc_b_4_boostOC'. */
/begin CHARACTERISTIC DTCc_b_4_boostOC "Override flag" VALUE 0x8cd03 RL_DTCC_B_4_BOOSTOC 1.000000 CU_DTCC_B_4_BOOSTOC 0.000000 1.000000 BYTE_ORDER MSB_FIRST /end CHARACTERISTIC
/begin RECORD_LAYOUT RL_DTCC_B_4_BOOSTOC FNC_VALUES 1 UBYTE COLUMN_DIR DIRECT /end RECORD_LAYOUT
/begin COMPU_METHOD CU_DTCC_B_4_BOOSTOC "Conversion method for DTCc_b_4_boostOC" RAT_FUNC "%10.0" "b" COEFFS 0.000000 1.000000 0.000000 0.000000 0.000000 1.000000 /end COMPU_METHOD
/* Scalar calibration for DDE 'DTCc_b_4_lsol'. */
/begin CHARACTERISTIC DTCc_b_4_lsol "Override flag" VALUE 0x8cd01 RL_DTCC_B_4_LSOL 1.000000 CU_DTCC_B_4_LSOL 0.000000 1.000000 BYTE_ORDER MSB_FIRST /end CHARACTERISTIC
/begin RECORD_LAYOUT RL_DTCC_B_4_LSOL FNC_VALUES 1 UBYTE COLUMN_DIR DIRECT /end RECORD_LAYOUT
/begin COMPU_METHOD CU_DTCC_B_4_LSOL "Conversion method for DTCc_b_4_lsol" RAT_FUNC "%10.0" "b" COEFFS 0.000000 1.000000 0.000000 0.000000 0.000000 1.000000 /end COMPU_METHOD
/* Scalar calibration for DDE 'DTCc_b_4_sb'. */
/begin CHARACTERISTIC DTCc_b_4_sb "Override flag" VALUE 0x8cd05 RL_DTCC_B_4_SB 1.000000 CU_DTCC_B_4_SB 0.000000 1.000000 BYTE_ORDER MSB_FIRST /end CHARACTERISTIC
/begin RECORD_LAYOUT RL_DTCC_B_4_SB FNC_VALUES 1 UBYTE COLUMN_DIR DIRECT /end RECORD_LAYOUT
/begin COMPU_METHOD CU_DTCC_B_4_SB "Conversion method for DTCc_b_4_sb" RAT_FUNC "%10.0" "b" COEFFS 0.000000 1.000000 0.000000 0.000000 0.000000 1.000000 /end COMPU_METHOD
/* Scalar calibration for DDE 'DTCc_b_4_sg'. */
/begin CHARACTERISTIC DTCc_b_4_sg "Override flag" VALUE 0x8cd07 RL_DTCC_B_4_SG 1.000000 CU_DTCC_B_4_SG 0.000000 1.000000 BYTE_ORDER MSB_FIRST /end CHARACTERISTIC
/begin RECORD_LAYOUT RL_DTCC_B_4_SG FNC_VALUES 1 UBYTE COLUMN_DIR DIRECT /end RECORD_LAYOUT
/begin COMPU_METHOD CU_DTCC_B_4_SG "Conversion method for DTCc_b_4_sg" RAT_FUNC "%10.0" "b" COEFFS 0.000000 1.000000 0.000000 0.000000 0.000000 1.000000 /end COMPU_METHOD
/* Scalar calibration for DDE 'DTCc_b_APP1_NonValidVoltage'. */
/begin CHARACTERISTIC DTCc_b_APP1_NonValidVoltage "Override flag" VALUE 0x8bfbd RL_DTCC_B_APP1_NONVALIDVOLTAGE 1.000000 CU_DTCC_B_APP1_NONVALIDVOLTAGE 0.000000 1.000000 BYTE_ORDER MSB_FIRST /end CHARACTERISTIC
/begin RECORD_LAYOUT RL_DTCC_B_APP1_NONVALIDVOLTAGE FNC_VALUES 1 UBYTE COLUMN_DIR DIRECT /end RECORD_LAYOUT
/begin COMPU_METHOD CU_DTCC_B_APP1_NONVALIDVOLTAGE "Conversion method for DTCc_b_APP1_NonValidVoltage" RAT_FUNC "%10.0" "b" COEFFS 0.000000 1.000000 0.000000 0.000000 0.000000 1.000000 /end COMPU_METHOD
/* Scalar calibration for DDE 'DTCc_b_APP2_NonValidVoltage'. */
/begin CHARACTERISTIC DTCc_b_APP2_NonValidVoltage "Override flag" VALUE 0x8bfd1 RL_DTCC_B_APP2_NONVALIDVOLTAGE 1.000000 CU_DTCC_B_APP2_NONVALIDVOLTAGE 0.000000 1.000000 BYTE_ORDER MSB_FIRST /end CHARACTERISTIC
/begin RECORD_LAYOUT RL_DTCC_B_APP2_NONVALIDVOLTAGE FNC_VALUES 1 UBYTE COLUMN_DIR DIRECT /end RECORD_LAYOUT
/begin COMPU_METHOD CU_DTCC_B_APP2_NONVALIDVOLTAGE "Conversion method for DTCc_b_APP2_NonValidVoltage" RAT_FUNC "%10.0" "b" COEFFS 0.000000 1.000000 0.000000 0.000000 0.000000 1.000000 /end COMPU_METHOD
/* Scalar calibration for DDE 'DTCc_b_APP_CorrFLT'. */
/begin CHARACTERISTIC DTCc_b_APP_CorrFLT "Override flag" VALUE 0x86fc1 RL_DTCC_B_APP_CORRFLT 1.000000 CU_DTCC_B_APP_CORRFLT 0.000000 1.000000 BYTE_ORDER MSB_FIRST /end CHARACTERISTIC
/begin RECORD_LAYOUT RL_DTCC_B_APP_CORRFLT FNC_VALUES 1 UBYTE COLUMN_DIR DIRECT /end RECORD_LAYOUT
/begin COMPU_METHOD CU_DTCC_B_APP_CORRFLT "Conversion method for DTCc_b_APP_CorrFLT" RAT_FUNC "%10.0" "b" COEFFS 0.000000 1.000000 0.000000 0.000000 0.000000 1.000000 /end COMPU_METHOD
/* Scalar calibration for DDE 'DTCc_b_Air_HTemp'. */
/begin CHARACTERISTIC DTCc_b_Air_HTemp "Override flag" VALUE 0x8bfb1 RL_DTCC_B_AIR_HTEMP 1.000000 CU_DTCC_B_AIR_HTEMP 0.000000 1.000000 BYTE_ORDER MSB_FIRST /end CHARACTERISTIC
/begin RECORD_LAYOUT RL_DTCC_B_AIR_HTEMP FNC_VALUES 1 UBYTE COLUMN_DIR DIRECT /end RECORD_LAYOUT
/begin COMPU_METHOD CU_DTCC_B_AIR_HTEMP "Conversion method for DTCc_b_Air_HTemp" RAT_FUNC "%10.0" "b" COEFFS 0.000000 1.000000 0.000000 0.000000 0.000000 1.000000 /end COMPU_METHOD
/* Scalar calibration for DDE 'DTCc_b_Air_TempHV'. */
/begin CHARACTERISTIC DTCc_b_Air_TempHV "Override flag" VALUE 0x8bfaf RL_DTCC_B_AIR_TEMPHV 1.000000 CU_DTCC_B_AIR_TEMPHV 0.000000 1.000000 BYTE_ORDER MSB_FIRST /end CHARACTERISTIC
/begin RECORD_LAYOUT RL_DTCC_B_AIR_TEMPHV FNC_VALUES 1 UBYTE COLUMN_DIR DIRECT /end RECORD_LAYOUT
/begin COMPU_METHOD CU_DTCC_B_AIR_TEMPHV "Conversion method for DTCc_b_Air_TempHV" RAT_FUNC "%10.0" "b" COEFFS 0.000000 1.000000 0.000000 0.000000 0.000000 1.000000 /end COMPU_METHOD
/* Scalar calibration for DDE 'DTCc_b_Air_TempLV'. */
/begin CHARACTERISTIC DTCc_b_Air_TempLV "Override flag" VALUE 0x8bfad RL_DTCC_B_AIR_TEMPLV 1.000000 CU_DTCC_B_AIR_TEMPLV 0.000000 1.000000 BYTE_ORDER MSB_FIRST /end CHARACTERISTIC
/begin RECORD_LAYOUT RL_DTCC_B_AIR_TEMPLV FNC_VALUES 1 UBYTE COLUMN_DIR DIRECT /end RECORD_LAYOUT
/begin COMPU_METHOD CU_DTCC_B_AIR_TEMPLV "Conversion method for DTCc_b_Air_TempLV" RAT_FUNC "%10.0" "b" COEFFS 0.000000 1.000000 0.000000 0.000000 0.000000 1.000000 /end COMPU_METHOD
/* Scalar calibration for DDE 'DTCc_b_BARO_ErraticValue'. */
/begin CHARACTERISTIC DTCc_b_BARO_ErraticValue "Override flag" VALUE 0x8c081 RL_DTCC_B_BARO_ERRATICVALUE 1.000000 CU_DTCC_B_BARO_ERRATICVALUE 0.000000 1.000000 BYTE_ORDER MSB_FIRST /end CHARACTERISTIC
/begin RECORD_LAYOUT RL_DTCC_B_BARO_ERRATICVALUE FNC_VALUES 1 UBYTE COLUMN_DIR DIRECT /end RECORD_LAYOUT
/begin COMPU_METHOD CU_DTCC_B_BARO_ERRATICVALUE "Conversion method for DTCc_b_BARO_ErraticValue" RAT_FUNC "%10.0" "b" COEFFS 0.000000 1.000000 0.000000 0.000000 0.000000 1.000000 /end COMPU_METHOD
/* Scalar calibration for DDE 'DTCc_b_BARO_PressHVoltage'. */
/begin CHARACTERISTIC DTCc_b_BARO_PressHVoltage "Override flag" VALUE 0x8c07f RL_DTCC_B_BARO_PRESSHVOLTAGE 1.000000 CU_DTCC_B_BARO_PRESSHVOLTAGE 0.000000 1.000000 BYTE_ORDER MSB_FIRST /end CHARACTERISTIC
/begin RECORD_LAYOUT RL_DTCC_B_BARO_PRESSHVOLTAGE FNC_VALUES 1 UBYTE COLUMN_DIR DIRECT /end RECORD_LAYOUT
/begin COMPU_METHOD CU_DTCC_B_BARO_PRESSHVOLTAGE "Conversion method for DTCc_b_BARO_PressHVoltage" RAT_FUNC "%10.0" "b" COEFFS 0.000000 1.000000 0.000000 0.000000 0.000000 1.000000 /end COMPU_METHOD
/* Scalar calibration for DDE 'DTCc_b_BARO_PressLVoltage'. */
/begin CHARACTERISTIC DTCc_b_BARO_PressLVoltage "Override flag" VALUE 0x8c07d RL_DTCC_B_BARO_PRESSLVOLTAGE 1.000000 CU_DTCC_B_BARO_PRESSLVOLTAGE 0.000000 1.000000 BYTE_ORDER MSB_FIRST /end CHARACTERISTIC
/begin RECORD_LAYOUT RL_DTCC_B_BARO_PRESSLVOLTAGE FNC_VALUES 1 UBYTE COLUMN_DIR DIRECT /end RECORD_LAYOUT
/begin COMPU_METHOD CU_DTCC_B_BARO_PRESSLVOLTAGE "Conversion method for DTCc_b_BARO_PressLVoltage" RAT_FUNC "%10.0" "b" COEFFS 0.000000 1.000000 0.000000 0.000000 0.000000 1.000000 /end COMPU_METHOD
/* Scalar calibration for DDE 'DTCc_b_BAT_VoltageOutofRange'. */
/begin CHARACTERISTIC DTCc_b_BAT_VoltageOutofRange "Override flag" VALUE 0x8c37d RL_DTCC_B_BAT_VOLTAGEOUTOFRANGE 1.000000 CU_DTCC_B_BAT_VOLTAGEOUTOFRANGE 0.000000 1.000000 BYTE_ORDER MSB_FIRST /end CHARACTERISTIC
/begin RECORD_LAYOUT RL_DTCC_B_BAT_VOLTAGEOUTOFRANGE FNC_VALUES 1 UBYTE COLUMN_DIR DIRECT /end RECORD_LAYOUT
/begin COMPU_METHOD CU_DTCC_B_BAT_VOLTAGEOUTOFRANGE "Conversion method for DTCc_b_BAT_VoltageOutofRange" RAT_FUNC "%10.0" "b" COEFFS 0.000000 1.000000 0.000000 0.000000 0.000000 1.000000 /end COMPU_METHOD
/* Scalar calibration for DDE 'DTCc_b_CataCounting'. */
/begin CHARACTERISTIC DTCc_b_CataCounting "Override flag" VALUE 0x8c0e1 RL_DTCC_B_CATACOUNTING 1.000000 CU_DTCC_B_CATACOUNTING 0.000000 1.000000 BYTE_ORDER MSB_FIRST /end CHARACTERISTIC
/begin RECORD_LAYOUT RL_DTCC_B_CATACOUNTING FNC_VALUES 1 UBYTE COLUMN_DIR DIRECT /end RECORD_LAYOUT
/begin COMPU_METHOD CU_DTCC_B_CATACOUNTING "Conversion method for DTCc_b_CataCounting" RAT_FUNC "%10.0" "b" COEFFS 0.000000 1.000000 0.000000 0.000000 0.000000 1.000000 /end COMPU_METHOD
/* Scalar calibration for DDE 'DTCc_b_Catalyst_A'. */
/begin CHARACTERISTIC DTCc_b_Catalyst_A "Override flag" VALUE 0x8c0f5 RL_DTCC_B_CATALYST_A 1.000000 CU_DTCC_B_CATALYST_A 0.000000 1.000000 BYTE_ORDER MSB_FIRST /end CHARACTERISTIC
/begin RECORD_LAYOUT RL_DTCC_B_CATALYST_A FNC_VALUES 1 UBYTE COLUMN_DIR DIRECT /end RECORD_LAYOUT
/begin COMPU_METHOD CU_DTCC_B_CATALYST_A "Conversion method for DTCc_b_Catalyst_A" RAT_FUNC "%10.0" "b" COEFFS 0.000000 1.000000 0.000000 0.000000 0.000000 1.000000 /end COMPU_METHOD
/* Scalar calibration for DDE 'DTCc_b_CompIAT_HTemp'. */
/begin CHARACTERISTIC DTCc_b_CompIAT_HTemp "Override flag" VALUE 0x8c1b5 RL_DTCC_B_COMPIAT_HTEMP 1.000000 CU_DTCC_B_COMPIAT_HTEMP 0.000000 1.000000 BYTE_ORDER MSB_FIRST /end CHARACTERISTIC
/begin RECORD_LAYOUT RL_DTCC_B_COMPIAT_HTEMP FNC_VALUES 1 UBYTE COLUMN_DIR DIRECT /end RECORD_LAYOUT
/begin COMPU_METHOD CU_DTCC_B_COMPIAT_HTEMP "Conversion method for DTCc_b_CompIAT_HTemp" RAT_FUNC "%10.0" "b" COEFFS 0.000000 1.000000 0.000000 0.000000 0.000000 1.000000 /end COMPU_METHOD
/* Scalar calibration for DDE 'DTCc_b_CompIAT_TempHV'. */
/begin CHARACTERISTIC DTCc_b_CompIAT_TempHV "Override flag" VALUE 0x8c1b3 RL_DTCC_B_COMPIAT_TEMPHV 1.000000 CU_DTCC_B_COMPIAT_TEMPHV 0.000000 1.000000 BYTE_ORDER MSB_FIRST /end CHARACTERISTIC
/begin RECORD_LAYOUT RL_DTCC_B_COMPIAT_TEMPHV FNC_VALUES 1 UBYTE COLUMN_DIR DIRECT /end RECORD_LAYOUT
/begin COMPU_METHOD CU_DTCC_B_COMPIAT_TEMPHV "Conversion method for DTCc_b_CompIAT_TempHV" RAT_FUNC "%10.0" "b" COEFFS 0.000000 1.000000 0.000000 0.000000 0.000000 1.000000 /end COMPU_METHOD
/* Scalar calibration for DDE 'DTCc_b_CompIAT_TempLV'. */
/begin CHARACTERISTIC DTCc_b_CompIAT_TempLV "Override flag" VALUE 0x8c1b1 RL_DTCC_B_COMPIAT_TEMPLV 1.000000 CU_DTCC_B_COMPIAT_TEMPLV 0.000000 1.000000 BYTE_ORDER MSB_FIRST /end CHARACTERISTIC
/begin RECORD_LAYOUT RL_DTCC_B_COMPIAT_TEMPLV FNC_VALUES 1 UBYTE COLUMN_DIR DIRECT /end RECORD_LAYOUT
/begin COMPU_METHOD CU_DTCC_B_COMPIAT_TEMPLV "Conversion method for DTCc_b_CompIAT_TempLV" RAT_FUNC "%10.0" "b" COEFFS 0.000000 1.000000 0.000000 0.000000 0.000000 1.000000 /end COMPU_METHOD
/* Scalar calibration for DDE 'DTCc_b_DM11Force'. */
/begin CHARACTERISTIC DTCc_b_DM11Force "Override flag" VALUE 0x8ce6f RL_DTCC_B_DM11FORCE 1.000000 CU_DTCC_B_DM11FORCE 0.000000 1.000000 BYTE_ORDER MSB_FIRST /end CHARACTERISTIC
/begin RECORD_LAYOUT RL_DTCC_B_DM11FORCE FNC_VALUES 1 UBYTE COLUMN_DIR DIRECT /end RECORD_LAYOUT
/begin COMPU_METHOD CU_DTCC_B_DM11FORCE "Conversion method for DTCc_b_DM11Force" RAT_FUNC "%10.0" "b" COEFFS 0.000000 1.000000 0.000000 0.000000 0.000000 1.000000 /end COMPU_METHOD
/* Scalar calibration for DDE 'DTCc_b_DiagCata_TestEnd'. */
/begin CHARACTERISTIC DTCc_b_DiagCata_TestEnd "Override flag" VALUE 0x8c445 RL_DTCC_B_DIAGCATA_TESTEND 1.000000 CU_DTCC_B_DIAGCATA_TESTEND 0.000000 1.000000 BYTE_ORDER MSB_FIRST /end CHARACTERISTIC
/begin RECORD_LAYOUT RL_DTCC_B_DIAGCATA_TESTEND FNC_VALUES 1 UBYTE COLUMN_DIR DIRECT /end RECORD_LAYOUT
/begin COMPU_METHOD CU_DTCC_B_DIAGCATA_TESTEND "Conversion method for DTCc_b_DiagCata_TestEnd" RAT_FUNC "%10.0" "b" COEFFS 0.000000 1.000000 0.000000 0.000000 0.000000 1.000000 /end COMPU_METHOD
/* Scalar calibration for DDE 'DTCc_b_ECT_HTemp'. */
/begin CHARACTERISTIC DTCc_b_ECT_HTemp "Override flag" VALUE 0x8c101 RL_DTCC_B_ECT_HTEMP 1.000000 CU_DTCC_B_ECT_HTEMP 0.000000 1.000000 BYTE_ORDER MSB_FIRST /end CHARACTERISTIC
/begin RECORD_LAYOUT RL_DTCC_B_ECT_HTEMP FNC_VALUES 1 UBYTE COLUMN_DIR DIRECT /end RECORD_LAYOUT
/begin COMPU_METHOD CU_DTCC_B_ECT_HTEMP "Conversion method for DTCc_b_ECT_HTemp" RAT_FUNC "%10.0" "b" COEFFS 0.000000 1.000000 0.000000 0.000000 0.000000 1.000000 /end COMPU_METHOD
/* Scalar calibration for DDE 'DTCc_b_ECT_LTemp'. */
/begin CHARACTERISTIC DTCc_b_ECT_LTemp "Override flag" VALUE 0x8c109 RL_DTCC_B_ECT_LTEMP 1.000000 CU_DTCC_B_ECT_LTEMP 0.000000 1.000000 BYTE_ORDER MSB_FIRST /end CHARACTERISTIC
/begin RECORD_LAYOUT RL_DTCC_B_ECT_LTEMP FNC_VALUES 1 UBYTE COLUMN_DIR DIRECT /end RECORD_LAYOUT
/begin COMPU_METHOD CU_DTCC_B_ECT_LTEMP "Conversion method for DTCc_b_ECT_LTemp" RAT_FUNC "%10.0" "b" COEFFS 0.000000 1.000000 0.000000 0.000000 0.000000 1.000000 /end COMPU_METHOD
/* Scalar calibration for DDE 'DTCc_b_ECT_TempHVoltage'. */
/begin CHARACTERISTIC DTCc_b_ECT_TempHVoltage "Override flag" VALUE 0x8c0fd RL_DTCC_B_ECT_TEMPHVOLTAGE 1.000000 CU_DTCC_B_ECT_TEMPHVOLTAGE 0.000000 1.000000 BYTE_ORDER MSB_FIRST /end CHARACTERISTIC
/begin RECORD_LAYOUT RL_DTCC_B_ECT_TEMPHVOLTAGE FNC_VALUES 1 UBYTE COLUMN_DIR DIRECT /end RECORD_LAYOUT
/begin COMPU_METHOD CU_DTCC_B_ECT_TEMPHVOLTAGE "Conversion method for DTCc_b_ECT_TempHVoltage" RAT_FUNC "%10.0" "b" COEFFS 0.000000 1.000000 0.000000 0.000000 0.000000 1.000000 /end COMPU_METHOD
/* Scalar calibration for DDE 'DTCc_b_ECT_TempLVoltage'. */
/begin CHARACTERISTIC DTCc_b_ECT_TempLVoltage "Override flag" VALUE 0x8c0ff RL_DTCC_B_ECT_TEMPLVOLTAGE 1.000000 CU_DTCC_B_ECT_TEMPLVOLTAGE 0.000000 1.000000 BYTE_ORDER MSB_FIRST /end CHARACTERISTIC
/begin RECORD_LAYOUT RL_DTCC_B_ECT_TEMPLVOLTAGE FNC_VALUES 1 UBYTE COLUMN_DIR DIRECT /end RECORD_LAYOUT
/begin COMPU_METHOD CU_DTCC_B_ECT_TEMPLVOLTAGE "Conversion method for DTCc_b_ECT_TempLVoltage" RAT_FUNC "%10.0" "b" COEFFS 0.000000 1.000000 0.000000 0.000000 0.000000 1.000000 /end COMPU_METHOD
/* Scalar calibration for DDE 'DTCc_b_EGT_TempHV'. */
/begin CHARACTERISTIC DTCc_b_EGT_TempHV "Override flag" VALUE 0x8c111 RL_DTCC_B_EGT_TEMPHV 1.000000 CU_DTCC_B_EGT_TEMPHV 0.000000 1.000000 BYTE_ORDER MSB_FIRST /end CHARACTERISTIC
/begin RECORD_LAYOUT RL_DTCC_B_EGT_TEMPHV FNC_VALUES 1 UBYTE COLUMN_DIR DIRECT /end RECORD_LAYOUT
/begin COMPU_METHOD CU_DTCC_B_EGT_TEMPHV "Conversion method for DTCc_b_EGT_TempHV" RAT_FUNC "%10.0" "b" COEFFS 0.000000 1.000000 0.000000 0.000000 0.000000 1.000000 /end COMPU_METHOD
/* Scalar calibration for DDE 'DTCc_b_EGT_TempLV'. */
/begin CHARACTERISTIC DTCc_b_EGT_TempLV "Override flag" VALUE 0x8c113 RL_DTCC_B_EGT_TEMPLV 1.000000 CU_DTCC_B_EGT_TEMPLV 0.000000 1.000000 BYTE_ORDER MSB_FIRST /end CHARACTERISTIC
/begin RECORD_LAYOUT RL_DTCC_B_EGT_TEMPLV FNC_VALUES 1 UBYTE COLUMN_DIR DIRECT /end RECORD_LAYOUT
/begin COMPU_METHOD CU_DTCC_B_EGT_TEMPLV "Conversion method for DTCc_b_EGT_TempLV" RAT_FUNC "%10.0" "b" COEFFS 0.000000 1.000000 0.000000 0.000000 0.000000 1.000000 /end COMPU_METHOD
/* Scalar calibration for DDE 'DTCc_b_ETC_MotorFLT'. */
/begin CHARACTERISTIC DTCc_b_ETC_MotorFLT "Override flag" VALUE 0x879e9 RL_DTCC_B_ETC_MOTORFLT 1.000000 CU_DTCC_B_ETC_MOTORFLT 0.000000 1.000000 BYTE_ORDER MSB_FIRST /end CHARACTERISTIC
/begin RECORD_LAYOUT RL_DTCC_B_ETC_MOTORFLT FNC_VALUES 1 UBYTE COLUMN_DIR DIRECT /end RECORD_LAYOUT
/begin COMPU_METHOD CU_DTCC_B_ETC_MOTORFLT "Conversion method for DTCc_b_ETC_MotorFLT" RAT_FUNC "%10.0" "b" COEFFS 0.000000 1.000000 0.000000 0.000000 0.000000 1.000000 /end COMPU_METHOD
/* Scalar calibration for DDE 'DTCc_b_EcuMemFault'. */
/begin CHARACTERISTIC DTCc_b_EcuMemFault "Override flag" VALUE 0x8bf87 RL_DTCC_B_ECUMEMFAULT 1.000000 CU_DTCC_B_ECUMEMFAULT 0.000000 1.000000 BYTE_ORDER MSB_FIRST /end CHARACTERISTIC
/begin RECORD_LAYOUT RL_DTCC_B_ECUMEMFAULT FNC_VALUES 1 UBYTE COLUMN_DIR DIRECT /end RECORD_LAYOUT
/begin COMPU_METHOD CU_DTCC_B_ECUMEMFAULT "Conversion method for DTCc_b_EcuMemFault" RAT_FUNC "%10.0" "b" COEFFS 0.000000 1.000000 0.000000 0.000000 0.000000 1.000000 /end COMPU_METHOD
/* Scalar calibration for DDE 'DTCc_b_EnableMIsfire'. */
/begin CHARACTERISTIC DTCc_b_EnableMIsfire "Override flag" VALUE 0x8c4a9 RL_DTCC_B_ENABLEMISFIRE 1.000000 CU_DTCC_B_ENABLEMISFIRE 0.000000 1.000000 BYTE_ORDER MSB_FIRST /end CHARACTERISTIC
/begin RECORD_LAYOUT RL_DTCC_B_ENABLEMISFIRE FNC_VALUES 1 UBYTE COLUMN_DIR DIRECT /end RECORD_LAYOUT
/begin COMPU_METHOD CU_DTCC_B_ENABLEMISFIRE "Conversion method for DTCc_b_EnableMIsfire" RAT_FUNC "%10.0" "b" COEFFS 0.000000 1.000000 0.000000 0.000000 0.000000 1.000000 /end COMPU_METHOD
/* Scalar calibration for DDE 'DTCc_b_Exhaust_HTemp'. */
/begin CHARACTERISTIC DTCc_b_Exhaust_HTemp "Override flag" VALUE 0x8c115 RL_DTCC_B_EXHAUST_HTEMP 1.000000 CU_DTCC_B_EXHAUST_HTEMP 0.000000 1.000000 BYTE_ORDER MSB_FIRST /end CHARACTERISTIC
/begin RECORD_LAYOUT RL_DTCC_B_EXHAUST_HTEMP FNC_VALUES 1 UBYTE COLUMN_DIR DIRECT /end RECORD_LAYOUT
/begin COMPU_METHOD CU_DTCC_B_EXHAUST_HTEMP "Conversion method for DTCc_b_Exhaust_HTemp" RAT_FUNC "%10.0" "b" COEFFS 0.000000 1.000000 0.000000 0.000000 0.000000 1.000000 /end COMPU_METHOD
/* Scalar calibration for DDE 'DTCc_b_FAP_Disconected'. */
/begin CHARACTERISTIC DTCc_b_FAP_Disconected "Override value" VALUE 0x8c123 RL_DTCC_B_FAP_DISCONECTED 1.000000 CU_DTCC_B_FAP_DISCONECTED 0.000000 1.000000 BYTE_ORDER MSB_FIRST /end CHARACTERISTIC
/begin RECORD_LAYOUT RL_DTCC_B_FAP_DISCONECTED FNC_VALUES 1 UBYTE COLUMN_DIR DIRECT /end RECORD_LAYOUT
/begin COMPU_METHOD CU_DTCC_B_FAP_DISCONECTED "Conversion method for DTCc_b_FAP_Disconected" RAT_FUNC "%10.0" "b" COEFFS 0.000000 1.000000 0.000000 0.000000 0.000000 1.000000 /end COMPU_METHOD
/* Scalar calibration for DDE 'DTCc_b_FAP_HPress'. */
/begin CHARACTERISTIC DTCc_b_FAP_HPress "Override value" VALUE 0x8c121 RL_DTCC_B_FAP_HPRESS 1.000000 CU_DTCC_B_FAP_HPRESS 0.000000 1.000000 BYTE_ORDER MSB_FIRST /end CHARACTERISTIC
/begin RECORD_LAYOUT RL_DTCC_B_FAP_HPRESS FNC_VALUES 1 UBYTE COLUMN_DIR DIRECT /end RECORD_LAYOUT
/begin COMPU_METHOD CU_DTCC_B_FAP_HPRESS "Conversion method for DTCc_b_FAP_HPress" RAT_FUNC "%10.0" "b" COEFFS 0.000000 1.000000 0.000000 0.000000 0.000000 1.000000 /end COMPU_METHOD
/* Scalar calibration for DDE 'DTCc_b_FalloCamShaft'. */
/begin CHARACTERISTIC DTCc_b_FalloCamShaft "Override flag" VALUE 0x8c4f1 RL_DTCC_B_FALLOCAMSHAFT 1.000000 CU_DTCC_B_FALLOCAMSHAFT 0.000000 1.000000 BYTE_ORDER MSB_FIRST /end CHARACTERISTIC
/begin RECORD_LAYOUT RL_DTCC_B_FALLOCAMSHAFT FNC_VALUES 1 UBYTE COLUMN_DIR DIRECT /end RECORD_LAYOUT
/begin COMPU_METHOD CU_DTCC_B_FALLOCAMSHAFT "Conversion method for DTCc_b_FalloCamShaft" RAT_FUNC "%10.0" "b" COEFFS 0.000000 1.000000 0.000000 0.000000 0.000000 1.000000 /end COMPU_METHOD
/* Scalar calibration for DDE 'DTCc_b_FalloCramShaft'. */
/begin CHARACTERISTIC DTCc_b_FalloCramShaft "Override flag" VALUE 0x8c4cf RL_DTCC_B_FALLOCRAMSHAFT 1.000000 CU_DTCC_B_FALLOCRAMSHAFT 0.000000 1.000000 BYTE_ORDER MSB_FIRST /end CHARACTERISTIC
/begin RECORD_LAYOUT RL_DTCC_B_FALLOCRAMSHAFT FNC_VALUES 1 UBYTE COLUMN_DIR DIRECT /end RECORD_LAYOUT
/begin COMPU_METHOD CU_DTCC_B_FALLOCRAMSHAFT "Conversion method for DTCc_b_FalloCramShaft" RAT_FUNC "%10.0" "b" COEFFS 0.000000 1.000000 0.000000 0.000000 0.000000 1.000000 /end COMPU_METHOD
/* Scalar calibration for DDE 'DTCc_b_GLP1_HVoltage'. */
/begin CHARACTERISTIC DTCc_b_GLP1_HVoltage "Override flag" VALUE 0x8c149 RL_DTCC_B_GLP1_HVOLTAGE 1.000000 CU_DTCC_B_GLP1_HVOLTAGE 0.000000 1.000000 BYTE_ORDER MSB_FIRST /end CHARACTERISTIC
/begin RECORD_LAYOUT RL_DTCC_B_GLP1_HVOLTAGE FNC_VALUES 1 UBYTE COLUMN_DIR DIRECT /end RECORD_LAYOUT
/begin COMPU_METHOD CU_DTCC_B_GLP1_HVOLTAGE "Conversion method for DTCc_b_GLP1_HVoltage" RAT_FUNC "%10.0" "b" COEFFS 0.000000 1.000000 0.000000 0.000000 0.000000 1.000000 /end COMPU_METHOD
/* Scalar calibration for DDE 'DTCc_b_GLP2_HVoltage'. */
/begin CHARACTERISTIC DTCc_b_GLP2_HVoltage "Override flag" VALUE 0x8c159 RL_DTCC_B_GLP2_HVOLTAGE 1.000000 CU_DTCC_B_GLP2_HVOLTAGE 0.000000 1.000000 BYTE_ORDER MSB_FIRST /end CHARACTERISTIC
/begin RECORD_LAYOUT RL_DTCC_B_GLP2_HVOLTAGE FNC_VALUES 1 UBYTE COLUMN_DIR DIRECT /end RECORD_LAYOUT
/begin COMPU_METHOD CU_DTCC_B_GLP2_HVOLTAGE "Conversion method for DTCc_b_GLP2_HVoltage" RAT_FUNC "%10.0" "b" COEFFS 0.000000 1.000000 0.000000 0.000000 0.000000 1.000000 /end COMPU_METHOD
/* Scalar calibration for DDE 'DTCc_b_GLP_HPress'. */
/begin CHARACTERISTIC DTCc_b_GLP_HPress "Override flag" VALUE 0x8c125 RL_DTCC_B_GLP_HPRESS 1.000000 CU_DTCC_B_GLP_HPRESS 0.000000 1.000000 BYTE_ORDER MSB_FIRST /end CHARACTERISTIC
/begin RECORD_LAYOUT RL_DTCC_B_GLP_HPRESS FNC_VALUES 1 UBYTE COLUMN_DIR DIRECT /end RECORD_LAYOUT
/begin COMPU_METHOD CU_DTCC_B_GLP_HPRESS "Conversion method for DTCc_b_GLP_HPress" RAT_FUNC "%10.0" "b" COEFFS 0.000000 1.000000 0.000000 0.000000 0.000000 1.000000 /end COMPU_METHOD
/* Scalar calibration for DDE 'DTCc_b_GLP_HTemp'. */
/begin CHARACTERISTIC DTCc_b_GLP_HTemp "Override flag" VALUE 0x8c135 RL_DTCC_B_GLP_HTEMP 1.000000 CU_DTCC_B_GLP_HTEMP 0.000000 1.000000 BYTE_ORDER MSB_FIRST /end CHARACTERISTIC
/begin RECORD_LAYOUT RL_DTCC_B_GLP_HTEMP FNC_VALUES 1 UBYTE COLUMN_DIR DIRECT /end RECORD_LAYOUT
/begin COMPU_METHOD CU_DTCC_B_GLP_HTEMP "Conversion method for DTCc_b_GLP_HTemp" RAT_FUNC "%10.0" "b" COEFFS 0.000000 1.000000 0.000000 0.000000 0.000000 1.000000 /end COMPU_METHOD
/* Scalar calibration for DDE 'DTCc_b_GLP_LPress'. */
/begin CHARACTERISTIC DTCc_b_GLP_LPress "Override flag" VALUE 0x8c129 RL_DTCC_B_GLP_LPRESS 1.000000 CU_DTCC_B_GLP_LPRESS 0.000000 1.000000 BYTE_ORDER MSB_FIRST /end CHARACTERISTIC
/begin RECORD_LAYOUT RL_DTCC_B_GLP_LPRESS FNC_VALUES 1 UBYTE COLUMN_DIR DIRECT /end RECORD_LAYOUT
/begin COMPU_METHOD CU_DTCC_B_GLP_LPRESS "Conversion method for DTCc_b_GLP_LPress" RAT_FUNC "%10.0" "b" COEFFS 0.000000 1.000000 0.000000 0.000000 0.000000 1.000000 /end COMPU_METHOD
/* Scalar calibration for DDE 'DTCc_b_GLP_LTemp'. */
/begin CHARACTERISTIC DTCc_b_GLP_LTemp "Override flag" VALUE 0x8c137 RL_DTCC_B_GLP_LTEMP 1.000000 CU_DTCC_B_GLP_LTEMP 0.000000 1.000000 BYTE_ORDER MSB_FIRST /end CHARACTERISTIC
/begin RECORD_LAYOUT RL_DTCC_B_GLP_LTEMP FNC_VALUES 1 UBYTE COLUMN_DIR DIRECT /end RECORD_LAYOUT
/begin COMPU_METHOD CU_DTCC_B_GLP_LTEMP "Conversion method for DTCc_b_GLP_LTemp" RAT_FUNC "%10.0" "b" COEFFS 0.000000 1.000000 0.000000 0.000000 0.000000 1.000000 /end COMPU_METHOD
/* Scalar calibration for DDE 'DTCc_b_GLP_OL'. */
/begin CHARACTERISTIC DTCc_b_GLP_OL "Override flag" VALUE 0x8c127 RL_DTCC_B_GLP_OL 1.000000 CU_DTCC_B_GLP_OL 0.000000 1.000000 BYTE_ORDER MSB_FIRST /end CHARACTERISTIC
/begin RECORD_LAYOUT RL_DTCC_B_GLP_OL FNC_VALUES 1 UBYTE COLUMN_DIR DIRECT /end RECORD_LAYOUT
/begin COMPU_METHOD CU_DTCC_B_GLP_OL "Conversion method for DTCc_b_GLP_OL" RAT_FUNC "%10.0" "b" COEFFS 0.000000 1.000000 0.000000 0.000000 0.000000 1.000000 /end COMPU_METHOD
/* Scalar calibration for DDE 'DTCc_b_GLP_TempHVoltage'. */
/begin CHARACTERISTIC DTCc_b_GLP_TempHVoltage "Override flag" VALUE 0x8c131 RL_DTCC_B_GLP_TEMPHVOLTAGE 1.000000 CU_DTCC_B_GLP_TEMPHVOLTAGE 0.000000 1.000000 BYTE_ORDER MSB_FIRST /end CHARACTERISTIC
/begin RECORD_LAYOUT RL_DTCC_B_GLP_TEMPHVOLTAGE FNC_VALUES 1 UBYTE COLUMN_DIR DIRECT /end RECORD_LAYOUT
/begin COMPU_METHOD CU_DTCC_B_GLP_TEMPHVOLTAGE "Conversion method for DTCc_b_GLP_TempHVoltage" RAT_FUNC "%10.0" "b" COEFFS 0.000000 1.000000 0.000000 0.000000 0.000000 1.000000 /end COMPU_METHOD
/* Scalar calibration for DDE 'DTCc_b_GLP_TempLVoltage'. */
/begin CHARACTERISTIC DTCc_b_GLP_TempLVoltage "Override flag" VALUE 0x8c133 RL_DTCC_B_GLP_TEMPLVOLTAGE 1.000000 CU_DTCC_B_GLP_TEMPLVOLTAGE 0.000000 1.000000 BYTE_ORDER MSB_FIRST /end CHARACTERISTIC
/begin RECORD_LAYOUT RL_DTCC_B_GLP_TEMPLVOLTAGE FNC_VALUES 1 UBYTE COLUMN_DIR DIRECT /end RECORD_LAYOUT
/begin COMPU_METHOD CU_DTCC_B_GLP_TEMPLVOLTAGE "Conversion method for DTCc_b_GLP_TempLVoltage" RAT_FUNC "%10.0" "b" COEFFS 0.000000 1.000000 0.000000 0.000000 0.000000 1.000000 /end COMPU_METHOD
/* Scalar calibration for DDE 'DTCc_b_HeatersA_OL'. */
/begin CHARACTERISTIC DTCc_b_HeatersA_OL "Override flag" VALUE 0x8c34b RL_DTCC_B_HEATERSA_OL 1.000000 CU_DTCC_B_HEATERSA_OL 0.000000 1.000000 BYTE_ORDER MSB_FIRST /end CHARACTERISTIC
/begin RECORD_LAYOUT RL_DTCC_B_HEATERSA_OL FNC_VALUES 1 UBYTE COLUMN_DIR DIRECT /end RECORD_LAYOUT
/begin COMPU_METHOD CU_DTCC_B_HEATERSA_OL "Conversion method for DTCc_b_HeatersA_OL" RAT_FUNC "%10.0" "b" COEFFS 0.000000 1.000000 0.000000 0.000000 0.000000 1.000000 /end COMPU_METHOD
/* Scalar calibration for DDE 'DTCc_b_HeatersA_SB'. */
/begin CHARACTERISTIC DTCc_b_HeatersA_SB "Override flag" VALUE 0x8c351 RL_DTCC_B_HEATERSA_SB 1.000000 CU_DTCC_B_HEATERSA_SB 0.000000 1.000000 BYTE_ORDER MSB_FIRST /end CHARACTERISTIC
/begin RECORD_LAYOUT RL_DTCC_B_HEATERSA_SB FNC_VALUES 1 UBYTE COLUMN_DIR DIRECT /end RECORD_LAYOUT
/begin COMPU_METHOD CU_DTCC_B_HEATERSA_SB "Conversion method for DTCc_b_HeatersA_SB" RAT_FUNC "%10.0" "b" COEFFS 0.000000 1.000000 0.000000 0.000000 0.000000 1.000000 /end COMPU_METHOD
/* Scalar calibration for DDE 'DTCc_b_HeatersA_SG'. */
/begin CHARACTERISTIC DTCc_b_HeatersA_SG "Override flag" VALUE 0x8c34f RL_DTCC_B_HEATERSA_SG 1.000000 CU_DTCC_B_HEATERSA_SG 0.000000 1.000000 BYTE_ORDER MSB_FIRST /end CHARACTERISTIC
/begin RECORD_LAYOUT RL_DTCC_B_HEATERSA_SG FNC_VALUES 1 UBYTE COLUMN_DIR DIRECT /end RECORD_LAYOUT
/begin COMPU_METHOD CU_DTCC_B_HEATERSA_SG "Conversion method for DTCc_b_HeatersA_SG" RAT_FUNC "%10.0" "b" COEFFS 0.000000 1.000000 0.000000 0.000000 0.000000 1.000000 /end COMPU_METHOD
/* Scalar calibration for DDE 'DTCc_b_KNOCK_Cyl1'. */
/begin CHARACTERISTIC DTCc_b_KNOCK_Cyl1 "Override flag" VALUE 0x8ad82 RL_DTCC_B_KNOCK_CYL1 1.000000 CU_DTCC_B_KNOCK_CYL1 0.000000 1.000000 BYTE_ORDER MSB_FIRST /end CHARACTERISTIC
/begin RECORD_LAYOUT RL_DTCC_B_KNOCK_CYL1 FNC_VALUES 1 UBYTE COLUMN_DIR DIRECT /end RECORD_LAYOUT
/begin COMPU_METHOD CU_DTCC_B_KNOCK_CYL1 "Conversion method for DTCc_b_KNOCK_Cyl1" RAT_FUNC "%10.0" "b" COEFFS 0.000000 1.000000 0.000000 0.000000 0.000000 1.000000 /end COMPU_METHOD
/* Scalar calibration for DDE 'DTCc_b_KNOCK_Cyl2'. */
/begin CHARACTERISTIC DTCc_b_KNOCK_Cyl2 "Override flag" VALUE 0x8ad91 RL_DTCC_B_KNOCK_CYL2 1.000000 CU_DTCC_B_KNOCK_CYL2 0.000000 1.000000 BYTE_ORDER MSB_FIRST /end CHARACTERISTIC
/begin RECORD_LAYOUT RL_DTCC_B_KNOCK_CYL2 FNC_VALUES 1 UBYTE COLUMN_DIR DIRECT /end RECORD_LAYOUT
/begin COMPU_METHOD CU_DTCC_B_KNOCK_CYL2 "Conversion method for DTCc_b_KNOCK_Cyl2" RAT_FUNC "%10.0" "b" COEFFS 0.000000 1.000000 0.000000 0.000000 0.000000 1.000000 /end COMPU_METHOD
/* Scalar calibration for DDE 'DTCc_b_KNOCK_Cyl3'. */
/begin CHARACTERISTIC DTCc_b_KNOCK_Cyl3 "Override flag" VALUE 0x8ad93 RL_DTCC_B_KNOCK_CYL3 1.000000 CU_DTCC_B_KNOCK_CYL3 0.000000 1.000000 BYTE_ORDER MSB_FIRST /end CHARACTERISTIC
/begin RECORD_LAYOUT RL_DTCC_B_KNOCK_CYL3 FNC_VALUES 1 UBYTE COLUMN_DIR DIRECT /end RECORD_LAYOUT
/begin COMPU_METHOD CU_DTCC_B_KNOCK_CYL3 "Conversion method for DTCc_b_KNOCK_Cyl3" RAT_FUNC "%10.0" "b" COEFFS 0.000000 1.000000 0.000000 0.000000 0.000000 1.000000 /end COMPU_METHOD
/* Scalar calibration for DDE 'DTCc_b_KNOCK_Cyl4'. */
/begin CHARACTERISTIC DTCc_b_KNOCK_Cyl4 "Override flag" VALUE 0x8ad95 RL_DTCC_B_KNOCK_CYL4 1.000000 CU_DTCC_B_KNOCK_CYL4 0.000000 1.000000 BYTE_ORDER MSB_FIRST /end CHARACTERISTIC
/begin RECORD_LAYOUT RL_DTCC_B_KNOCK_CYL4 FNC_VALUES 1 UBYTE COLUMN_DIR DIRECT /end RECORD_LAYOUT
/begin COMPU_METHOD CU_DTCC_B_KNOCK_CYL4 "Conversion method for DTCc_b_KNOCK_Cyl4" RAT_FUNC "%10.0" "b" COEFFS 0.000000 1.000000 0.000000 0.000000 0.000000 1.000000 /end COMPU_METHOD
/* Scalar calibration for DDE 'DTCc_b_LB11CTFail'. */
/begin CHARACTERISTIC DTCc_b_LB11CTFail "Override flag" VALUE 0x8c34d RL_DTCC_B_LB11CTFAIL 1.000000 CU_DTCC_B_LB11CTFAIL 0.000000 1.000000 BYTE_ORDER MSB_FIRST /end CHARACTERISTIC
/begin RECORD_LAYOUT RL_DTCC_B_LB11CTFAIL FNC_VALUES 1 UBYTE COLUMN_DIR DIRECT /end RECORD_LAYOUT
/begin COMPU_METHOD CU_DTCC_B_LB11CTFAIL "Conversion method for DTCc_b_LB11CTFail" RAT_FUNC "%10.0" "b" COEFFS 0.000000 1.000000 0.000000 0.000000 0.000000 1.000000 /end COMPU_METHOD
/* Scalar calibration for DDE 'DTCc_b_LB12OL'. */
/begin CHARACTERISTIC DTCc_b_LB12OL "Override flag" VALUE 0x8c0a1 RL_DTCC_B_LB12OL 1.000000 CU_DTCC_B_LB12OL 0.000000 1.000000 BYTE_ORDER MSB_FIRST /end CHARACTERISTIC
/begin RECORD_LAYOUT RL_DTCC_B_LB12OL FNC_VALUES 1 UBYTE COLUMN_DIR DIRECT /end RECORD_LAYOUT
/begin COMPU_METHOD CU_DTCC_B_LB12OL "Conversion method for DTCc_b_LB12OL" RAT_FUNC "%10.0" "b" COEFFS 0.000000 1.000000 0.000000 0.000000 0.000000 1.000000 /end COMPU_METHOD
/* Scalar calibration for DDE 'DTCc_b_LB12SB'. */
/begin CHARACTERISTIC DTCc_b_LB12SB "Override flag" VALUE 0x8c0b9 RL_DTCC_B_LB12SB 1.000000 CU_DTCC_B_LB12SB 0.000000 1.000000 BYTE_ORDER MSB_FIRST /end CHARACTERISTIC
/begin RECORD_LAYOUT RL_DTCC_B_LB12SB FNC_VALUES 1 UBYTE COLUMN_DIR DIRECT /end RECORD_LAYOUT
/begin COMPU_METHOD CU_DTCC_B_LB12SB "Conversion method for DTCc_b_LB12SB" RAT_FUNC "%10.0" "b" COEFFS 0.000000 1.000000 0.000000 0.000000 0.000000 1.000000 /end COMPU_METHOD
/* Scalar calibration for DDE 'DTCc_b_LambdaA_SB'. */
/begin CHARACTERISTIC DTCc_b_LambdaA_SB "Override flag" VALUE 0x8c349 RL_DTCC_B_LAMBDAA_SB 1.000000 CU_DTCC_B_LAMBDAA_SB 0.000000 1.000000 BYTE_ORDER MSB_FIRST /end CHARACTERISTIC
/begin RECORD_LAYOUT RL_DTCC_B_LAMBDAA_SB FNC_VALUES 1 UBYTE COLUMN_DIR DIRECT /end RECORD_LAYOUT
/begin COMPU_METHOD CU_DTCC_B_LAMBDAA_SB "Conversion method for DTCc_b_LambdaA_SB" RAT_FUNC "%10.0" "b" COEFFS 0.000000 1.000000 0.000000 0.000000 0.000000 1.000000 /end COMPU_METHOD
/* Scalar calibration for DDE 'DTCc_b_LambdaA_SG'. */
/begin CHARACTERISTIC DTCc_b_LambdaA_SG "Override flag" VALUE 0x8c353 RL_DTCC_B_LAMBDAA_SG 1.000000 CU_DTCC_B_LAMBDAA_SG 0.000000 1.000000 BYTE_ORDER MSB_FIRST /end CHARACTERISTIC
/begin RECORD_LAYOUT RL_DTCC_B_LAMBDAA_SG FNC_VALUES 1 UBYTE COLUMN_DIR DIRECT /end RECORD_LAYOUT
/begin COMPU_METHOD CU_DTCC_B_LAMBDAA_SG "Conversion method for DTCc_b_LambdaA_SG" RAT_FUNC "%10.0" "b" COEFFS 0.000000 1.000000 0.000000 0.000000 0.000000 1.000000 /end COMPU_METHOD
/* Scalar calibration for DDE 'DTCc_b_LambdaB11NOTValid'. */
/begin CHARACTERISTIC DTCc_b_LambdaB11NOTValid "Override flag" VALUE 0x8c355 RL_DTCC_B_LAMBDAB11NOTVALID 1.000000 CU_DTCC_B_LAMBDAB11NOTVALID 0.000000 1.000000 BYTE_ORDER MSB_FIRST /end CHARACTERISTIC
/begin RECORD_LAYOUT RL_DTCC_B_LAMBDAB11NOTVALID FNC_VALUES 1 UBYTE COLUMN_DIR DIRECT /end RECORD_LAYOUT
/begin COMPU_METHOD CU_DTCC_B_LAMBDAB11NOTVALID "Conversion method for DTCc_b_LambdaB11NOTValid" RAT_FUNC "%10.0" "b" COEFFS 0.000000 1.000000 0.000000 0.000000 0.000000 1.000000 /end COMPU_METHOD
/* Scalar calibration for DDE 'DTCc_b_MAPAfterThInfraPress'. */
/begin CHARACTERISTIC DTCc_b_MAPAfterThInfraPress "Override flag" VALUE 0x8c061 RL_DTCC_B_MAPAFTERTHINFRAPRESS 1.000000 CU_DTCC_B_MAPAFTERTHINFRAPRESS 0.000000 1.000000 BYTE_ORDER MSB_FIRST /end CHARACTERISTIC
/begin RECORD_LAYOUT RL_DTCC_B_MAPAFTERTHINFRAPRESS FNC_VALUES 1 UBYTE COLUMN_DIR DIRECT /end RECORD_LAYOUT
/begin COMPU_METHOD CU_DTCC_B_MAPAFTERTHINFRAPRESS "Conversion method for DTCc_b_MAPAfterThInfraPress" RAT_FUNC "%10.0" "b" COEFFS 0.000000 1.000000 0.000000 0.000000 0.000000 1.000000 /end COMPU_METHOD
/* Scalar calibration for DDE 'DTCc_b_MAPAfterThOverPress'. */
/begin CHARACTERISTIC DTCc_b_MAPAfterThOverPress "Override flag" VALUE 0x8c051 RL_DTCC_B_MAPAFTERTHOVERPRESS 1.000000 CU_DTCC_B_MAPAFTERTHOVERPRESS 0.000000 1.000000 BYTE_ORDER MSB_FIRST /end CHARACTERISTIC
/begin RECORD_LAYOUT RL_DTCC_B_MAPAFTERTHOVERPRESS FNC_VALUES 1 UBYTE COLUMN_DIR DIRECT /end RECORD_LAYOUT
/begin COMPU_METHOD CU_DTCC_B_MAPAFTERTHOVERPRESS "Conversion method for DTCc_b_MAPAfterThOverPress" RAT_FUNC "%10.0" "b" COEFFS 0.000000 1.000000 0.000000 0.000000 0.000000 1.000000 /end COMPU_METHOD
/* Scalar calibration for DDE 'DTCc_b_MAPAfterThr_LV'. */
/begin CHARACTERISTIC DTCc_b_MAPAfterThr_LV "Override flag" VALUE 0x8c031 RL_DTCC_B_MAPAFTERTHR_LV 1.000000 CU_DTCC_B_MAPAFTERTHR_LV 0.000000 1.000000 BYTE_ORDER MSB_FIRST /end CHARACTERISTIC
/begin RECORD_LAYOUT RL_DTCC_B_MAPAFTERTHR_LV FNC_VALUES 1 UBYTE COLUMN_DIR DIRECT /end RECORD_LAYOUT
/begin COMPU_METHOD CU_DTCC_B_MAPAFTERTHR_LV "Conversion method for DTCc_b_MAPAfterThr_LV" RAT_FUNC "%10.0" "b" COEFFS 0.000000 1.000000 0.000000 0.000000 0.000000 1.000000 /end COMPU_METHOD
/* Scalar calibration for DDE 'DTCc_b_MAPAftrThr_HV'. */
/begin CHARACTERISTIC DTCc_b_MAPAftrThr_HV "Override flag" VALUE 0x8c021 RL_DTCC_B_MAPAFTRTHR_HV 1.000000 CU_DTCC_B_MAPAFTRTHR_HV 0.000000 1.000000 BYTE_ORDER MSB_FIRST /end CHARACTERISTIC
/begin RECORD_LAYOUT RL_DTCC_B_MAPAFTRTHR_HV FNC_VALUES 1 UBYTE COLUMN_DIR DIRECT /end RECORD_LAYOUT
/begin COMPU_METHOD CU_DTCC_B_MAPAFTRTHR_HV "Conversion method for DTCc_b_MAPAftrThr_HV" RAT_FUNC "%10.0" "b" COEFFS 0.000000 1.000000 0.000000 0.000000 0.000000 1.000000 /end COMPU_METHOD
/* Scalar calibration for DDE 'DTCc_b_MAPBefThroHV'. */
/begin CHARACTERISTIC DTCc_b_MAPBefThroHV "Override flag" VALUE 0x8c39f RL_DTCC_B_MAPBEFTHROHV 1.000000 CU_DTCC_B_MAPBEFTHROHV 0.000000 1.000000 BYTE_ORDER MSB_FIRST /end CHARACTERISTIC
/begin RECORD_LAYOUT RL_DTCC_B_MAPBEFTHROHV FNC_VALUES 1 UBYTE COLUMN_DIR DIRECT /end RECORD_LAYOUT
/begin COMPU_METHOD CU_DTCC_B_MAPBEFTHROHV "Conversion method for DTCc_b_MAPBefThroHV" RAT_FUNC "%10.0" "b" COEFFS 0.000000 1.000000 0.000000 0.000000 0.000000 1.000000 /end COMPU_METHOD
/* Scalar calibration for DDE 'DTCc_b_MAPBefThroOL'. */
/begin CHARACTERISTIC DTCc_b_MAPBefThroOL "Override flag" VALUE 0x8c39d RL_DTCC_B_MAPBEFTHROOL 1.000000 CU_DTCC_B_MAPBEFTHROOL 0.000000 1.000000 BYTE_ORDER MSB_FIRST /end CHARACTERISTIC
/begin RECORD_LAYOUT RL_DTCC_B_MAPBEFTHROOL FNC_VALUES 1 UBYTE COLUMN_DIR DIRECT /end RECORD_LAYOUT
/begin COMPU_METHOD CU_DTCC_B_MAPBEFTHROOL "Conversion method for DTCc_b_MAPBefThroOL" RAT_FUNC "%10.0" "b" COEFFS 0.000000 1.000000 0.000000 0.000000 0.000000 1.000000 /end COMPU_METHOD
/* Scalar calibration for DDE 'DTCc_b_MAPBeforeThroHPress'. */
/begin CHARACTERISTIC DTCc_b_MAPBeforeThroHPress "Override flag" VALUE 0x8c3a2 RL_DTCC_B_MAPBEFORETHROHPRESS 1.000000 CU_DTCC_B_MAPBEFORETHROHPRESS 0.000000 1.000000 BYTE_ORDER MSB_FIRST /end CHARACTERISTIC
/begin RECORD_LAYOUT RL_DTCC_B_MAPBEFORETHROHPRESS FNC_VALUES 1 UBYTE COLUMN_DIR DIRECT /end RECORD_LAYOUT
/begin COMPU_METHOD CU_DTCC_B_MAPBEFORETHROHPRESS "Conversion method for DTCc_b_MAPBeforeThroHPress" RAT_FUNC "%10.0" "b" COEFFS 0.000000 1.000000 0.000000 0.000000 0.000000 1.000000 /end COMPU_METHOD
/* Scalar calibration for DDE 'DTCc_b_MAPBeforeThroLPress'. */
/begin CHARACTERISTIC DTCc_b_MAPBeforeThroLPress "Override flag" VALUE 0x8c3a0 RL_DTCC_B_MAPBEFORETHROLPRESS 1.000000 CU_DTCC_B_MAPBEFORETHROLPRESS 0.000000 1.000000 BYTE_ORDER MSB_FIRST /end CHARACTERISTIC
/begin RECORD_LAYOUT RL_DTCC_B_MAPBEFORETHROLPRESS FNC_VALUES 1 UBYTE COLUMN_DIR DIRECT /end RECORD_LAYOUT
/begin COMPU_METHOD CU_DTCC_B_MAPBEFORETHROLPRESS "Conversion method for DTCc_b_MAPBeforeThroLPress" RAT_FUNC "%10.0" "b" COEFFS 0.000000 1.000000 0.000000 0.000000 0.000000 1.000000 /end COMPU_METHOD
/* Scalar calibration for DDE 'DTCc_b_Misfire_Bancada'. */
/begin CHARACTERISTIC DTCc_b_Misfire_Bancada "Override flag" VALUE 0x8c4c6 RL_DTCC_B_MISFIRE_BANCADA 1.000000 CU_DTCC_B_MISFIRE_BANCADA 0.000000 1.000000 BYTE_ORDER MSB_FIRST /end CHARACTERISTIC
/begin RECORD_LAYOUT RL_DTCC_B_MISFIRE_BANCADA FNC_VALUES 1 UBYTE COLUMN_DIR DIRECT /end RECORD_LAYOUT
/begin COMPU_METHOD CU_DTCC_B_MISFIRE_BANCADA "Conversion method for DTCc_b_Misfire_Bancada" RAT_FUNC "%10.0" "b" COEFFS 0.000000 1.000000 0.000000 0.000000 0.000000 1.000000 /end COMPU_METHOD
/* Scalar calibration for DDE 'DTCc_b_Misfire_Cylinder_1'. */
/begin CHARACTERISTIC DTCc_b_Misfire_Cylinder_1 "Override flag" VALUE 0x8c4be RL_DTCC_B_MISFIRE_CYLINDER_1 1.000000 CU_DTCC_B_MISFIRE_CYLINDER_1 0.000000 1.000000 BYTE_ORDER MSB_FIRST /end CHARACTERISTIC
/begin RECORD_LAYOUT RL_DTCC_B_MISFIRE_CYLINDER_1 FNC_VALUES 1 UBYTE COLUMN_DIR DIRECT /end RECORD_LAYOUT
/begin COMPU_METHOD CU_DTCC_B_MISFIRE_CYLINDER_1 "Conversion method for DTCc_b_Misfire_Cylinder_1" RAT_FUNC "%10.0" "b" COEFFS 0.000000 1.000000 0.000000 0.000000 0.000000 1.000000 /end COMPU_METHOD
/* Scalar calibration for DDE 'DTCc_b_Misfire_Cylinder_2'. */
/begin CHARACTERISTIC DTCc_b_Misfire_Cylinder_2 "Override flag" VALUE 0x8c4c0 RL_DTCC_B_MISFIRE_CYLINDER_2 1.000000 CU_DTCC_B_MISFIRE_CYLINDER_2 0.000000 1.000000 BYTE_ORDER MSB_FIRST /end CHARACTERISTIC
/begin RECORD_LAYOUT RL_DTCC_B_MISFIRE_CYLINDER_2 FNC_VALUES 1 UBYTE COLUMN_DIR DIRECT /end RECORD_LAYOUT
/begin COMPU_METHOD CU_DTCC_B_MISFIRE_CYLINDER_2 "Conversion method for DTCc_b_Misfire_Cylinder_2" RAT_FUNC "%10.0" "b" COEFFS 0.000000 1.000000 0.000000 0.000000 0.000000 1.000000 /end COMPU_METHOD
/* Scalar calibration for DDE 'DTCc_b_Misfire_Cylinder_3'. */
/begin CHARACTERISTIC DTCc_b_Misfire_Cylinder_3 "Override flag" VALUE 0x8c4c2 RL_DTCC_B_MISFIRE_CYLINDER_3 1.000000 CU_DTCC_B_MISFIRE_CYLINDER_3 0.000000 1.000000 BYTE_ORDER MSB_FIRST /end CHARACTERISTIC
/begin RECORD_LAYOUT RL_DTCC_B_MISFIRE_CYLINDER_3 FNC_VALUES 1 UBYTE COLUMN_DIR DIRECT /end RECORD_LAYOUT
/begin COMPU_METHOD CU_DTCC_B_MISFIRE_CYLINDER_3 "Conversion method for DTCc_b_Misfire_Cylinder_3" RAT_FUNC "%10.0" "b" COEFFS 0.000000 1.000000 0.000000 0.000000 0.000000 1.000000 /end COMPU_METHOD
/* Scalar calibration for DDE 'DTCc_b_Misfire_Cylinder_4'. */
/begin CHARACTERISTIC DTCc_b_Misfire_Cylinder_4 "Override flag" VALUE 0x8c4c4 RL_DTCC_B_MISFIRE_CYLINDER_4 1.000000 CU_DTCC_B_MISFIRE_CYLINDER_4 0.000000 1.000000 BYTE_ORDER MSB_FIRST /end CHARACTERISTIC
/begin RECORD_LAYOUT RL_DTCC_B_MISFIRE_CYLINDER_4 FNC_VALUES 1 UBYTE COLUMN_DIR DIRECT /end RECORD_LAYOUT
/begin COMPU_METHOD CU_DTCC_B_MISFIRE_CYLINDER_4 "Conversion method for DTCc_b_Misfire_Cylinder_4" RAT_FUNC "%10.0" "b" COEFFS 0.000000 1.000000 0.000000 0.000000 0.000000 1.000000 /end COMPU_METHOD
/* Scalar calibration for DDE 'DTCc_b_NBValid'. */
/begin CHARACTERISTIC DTCc_b_NBValid "Override flag" VALUE 0x8c0c5 RL_DTCC_B_NBVALID 1.000000 CU_DTCC_B_NBVALID 0.000000 1.000000 BYTE_ORDER MSB_FIRST /end CHARACTERISTIC
/begin RECORD_LAYOUT RL_DTCC_B_NBVALID FNC_VALUES 1 UBYTE COLUMN_DIR DIRECT /end RECORD_LAYOUT
/begin COMPU_METHOD CU_DTCC_B_NBVALID "Conversion method for DTCc_b_NBValid" RAT_FUNC "%10.0" "b" COEFFS 0.000000 1.000000 0.000000 0.000000 0.000000 1.000000 /end COMPU_METHOD
/* Scalar calibration for DDE 'DTCc_b_OIL_LPress'. */
/begin CHARACTERISTIC DTCc_b_OIL_LPress "Override flag" VALUE 0x8c855 RL_DTCC_B_OIL_LPRESS 1.000000 CU_DTCC_B_OIL_LPRESS 0.000000 1.000000 BYTE_ORDER MSB_FIRST /end CHARACTERISTIC
/begin RECORD_LAYOUT RL_DTCC_B_OIL_LPRESS FNC_VALUES 1 UBYTE COLUMN_DIR DIRECT /end RECORD_LAYOUT
/begin COMPU_METHOD CU_DTCC_B_OIL_LPRESS "Conversion method for DTCc_b_OIL_LPress" RAT_FUNC "%10.0" "b" COEFFS 0.000000 1.000000 0.000000 0.000000 0.000000 1.000000 /end COMPU_METHOD
/* Scalar calibration for DDE 'DTCc_b_OIL_Sensor'. */
/begin CHARACTERISTIC DTCc_b_OIL_Sensor "Override flag" VALUE 0x8c849 RL_DTCC_B_OIL_SENSOR 1.000000 CU_DTCC_B_OIL_SENSOR 0.000000 1.000000 BYTE_ORDER MSB_FIRST /end CHARACTERISTIC
/begin RECORD_LAYOUT RL_DTCC_B_OIL_SENSOR FNC_VALUES 1 UBYTE COLUMN_DIR DIRECT /end RECORD_LAYOUT
/begin COMPU_METHOD CU_DTCC_B_OIL_SENSOR "Conversion method for DTCc_b_OIL_Sensor" RAT_FUNC "%10.0" "b" COEFFS 0.000000 1.000000 0.000000 0.000000 0.000000 1.000000 /end COMPU_METHOD
/* Scalar calibration for DDE 'DTCc_b_OIL_SensorOL'. */
/begin CHARACTERISTIC DTCc_b_OIL_SensorOL "Override flag" VALUE 0x8c84b RL_DTCC_B_OIL_SENSOROL 1.000000 CU_DTCC_B_OIL_SENSOROL 0.000000 1.000000 BYTE_ORDER MSB_FIRST /end CHARACTERISTIC
/begin RECORD_LAYOUT RL_DTCC_B_OIL_SENSOROL FNC_VALUES 1 UBYTE COLUMN_DIR DIRECT /end RECORD_LAYOUT
/begin COMPU_METHOD CU_DTCC_B_OIL_SENSOROL "Conversion method for DTCc_b_OIL_SensorOL" RAT_FUNC "%10.0" "b" COEFFS 0.000000 1.000000 0.000000 0.000000 0.000000 1.000000 /end COMPU_METHOD
/* Scalar calibration for DDE 'DTCc_b_Readiness'. */
/begin CHARACTERISTIC DTCc_b_Readiness "(not defined)" VALUE 0x8ce6d RL_DTCC_B_READINESS 1.000000 CU_DTCC_B_READINESS 0.000000 1.000000 BYTE_ORDER MSB_FIRST /end CHARACTERISTIC
/begin RECORD_LAYOUT RL_DTCC_B_READINESS FNC_VALUES 1 UBYTE COLUMN_DIR DIRECT /end RECORD_LAYOUT
/begin COMPU_METHOD CU_DTCC_B_READINESS "Conversion method for DTCc_b_Readiness" RAT_FUNC "%10.0" "b" COEFFS 0.000000 1.000000 0.000000 0.000000 0.000000 1.000000 /end COMPU_METHOD
/* Scalar calibration for DDE 'DTCc_b_ResetKnockCounters'. */
/begin CHARACTERISTIC DTCc_b_ResetKnockCounters "(not defined)" VALUE 0x8ad80 RL_DTCC_B_RESETKNOCKCOUNTERS 1.000000 CU_DTCC_B_RESETKNOCKCOUNTERS 0.000000 1.000000 BYTE_ORDER MSB_FIRST /end CHARACTERISTIC
/begin RECORD_LAYOUT RL_DTCC_B_RESETKNOCKCOUNTERS FNC_VALUES 1 UBYTE COLUMN_DIR DIRECT /end RECORD_LAYOUT
/begin COMPU_METHOD CU_DTCC_B_RESETKNOCKCOUNTERS "Conversion method for DTCc_b_ResetKnockCounters" RAT_FUNC "%10.0" "o" COEFFS 0.000000 1.000000 0.000000 0.000000 0.000000 1.000000 /end COMPU_METHOD
/* Scalar calibration for DDE 'DTCc_b_ResetNVM'. */
/begin CHARACTERISTIC DTCc_b_ResetNVM "(not defined)" VALUE 0x8040b RL_DTCC_B_RESETNVM 1.000000 CU_DTCC_B_RESETNVM 0.000000 1.000000 BYTE_ORDER MSB_FIRST /end CHARACTERISTIC
/begin RECORD_LAYOUT RL_DTCC_B_RESETNVM FNC_VALUES 1 UBYTE COLUMN_DIR DIRECT /end RECORD_LAYOUT
/begin COMPU_METHOD CU_DTCC_B_RESETNVM "Conversion method for DTCc_b_ResetNVM" RAT_FUNC "%10.0" "o" COEFFS 0.000000 1.000000 0.000000 0.000000 0.000000 1.000000 /end COMPU_METHOD
/* Scalar calibration for DDE 'DTCc_b_ShutOffValveEngine_OL'. */
/begin CHARACTERISTIC DTCc_b_ShutOffValveEngine_OL "Override flag" VALUE 0x8d281 RL_DTCC_B_SHUTOFFVALVEENGINE_OL 1.000000 CU_DTCC_B_SHUTOFFVALVEENGINE_OL 0.000000 1.000000 BYTE_ORDER MSB_FIRST /end CHARACTERISTIC
/begin RECORD_LAYOUT RL_DTCC_B_SHUTOFFVALVEENGINE_OL FNC_VALUES 1 UBYTE COLUMN_DIR DIRECT /end RECORD_LAYOUT
/begin COMPU_METHOD CU_DTCC_B_SHUTOFFVALVEENGINE_OL "Conversion method for DTCc_b_ShutOffValveEngine_OL" RAT_FUNC "%10.0" "b" COEFFS 0.000000 1.000000 0.000000 0.000000 0.000000 1.000000 /end COMPU_METHOD
/* Scalar calibration for DDE 'DTCc_b_ShutOffValveEngine_SG'. */
/begin CHARACTERISTIC DTCc_b_ShutOffValveEngine_SG "Override flag" VALUE 0x8c099 RL_DTCC_B_SHUTOFFVALVEENGINE_SG 1.000000 CU_DTCC_B_SHUTOFFVALVEENGINE_SG 0.000000 1.000000 BYTE_ORDER MSB_FIRST /end CHARACTERISTIC
/begin RECORD_LAYOUT RL_DTCC_B_SHUTOFFVALVEENGINE_SG FNC_VALUES 1 UBYTE COLUMN_DIR DIRECT /end RECORD_LAYOUT
/begin COMPU_METHOD CU_DTCC_B_SHUTOFFVALVEENGINE_SG "Conversion method for DTCc_b_ShutOffValveEngine_SG" RAT_FUNC "%10.0" "b" COEFFS 0.000000 1.000000 0.000000 0.000000 0.000000 1.000000 /end COMPU_METHOD
/* Scalar calibration for DDE 'DTCc_b_Supply_VRefA'. */
/begin CHARACTERISTIC DTCc_b_Supply_VRefA "Override flag" VALUE 0x8cce1 RL_DTCC_B_SUPPLY_VREFA 1.000000 CU_DTCC_B_SUPPLY_VREFA 0.000000 1.000000 BYTE_ORDER MSB_FIRST /end CHARACTERISTIC
/begin RECORD_LAYOUT RL_DTCC_B_SUPPLY_VREFA FNC_VALUES 1 UBYTE COLUMN_DIR DIRECT /end RECORD_LAYOUT
/begin COMPU_METHOD CU_DTCC_B_SUPPLY_VREFA "Conversion method for DTCc_b_Supply_VRefA" RAT_FUNC "%10.0" "b" COEFFS 0.000000 1.000000 0.000000 0.000000 0.000000 1.000000 /end COMPU_METHOD
/* Scalar calibration for DDE 'DTCc_b_Supply_VRefB'. */
/begin CHARACTERISTIC DTCc_b_Supply_VRefB "Override flag" VALUE 0x8ccd5 RL_DTCC_B_SUPPLY_VREFB 1.000000 CU_DTCC_B_SUPPLY_VREFB 0.000000 1.000000 BYTE_ORDER MSB_FIRST /end CHARACTERISTIC
/begin RECORD_LAYOUT RL_DTCC_B_SUPPLY_VREFB FNC_VALUES 1 UBYTE COLUMN_DIR DIRECT /end RECORD_LAYOUT
/begin COMPU_METHOD CU_DTCC_B_SUPPLY_VREFB "Conversion method for DTCc_b_Supply_VRefB" RAT_FUNC "%10.0" "b" COEFFS 0.000000 1.000000 0.000000 0.000000 0.000000 1.000000 /end COMPU_METHOD
/* Scalar calibration for DDE 'DTCc_b_Supply_VRefC'. */
/begin CHARACTERISTIC DTCc_b_Supply_VRefC "Override flag" VALUE 0x8cce3 RL_DTCC_B_SUPPLY_VREFC 1.000000 CU_DTCC_B_SUPPLY_VREFC 0.000000 1.000000 BYTE_ORDER MSB_FIRST /end CHARACTERISTIC
/begin RECORD_LAYOUT RL_DTCC_B_SUPPLY_VREFC FNC_VALUES 1 UBYTE COLUMN_DIR DIRECT /end RECORD_LAYOUT
/begin COMPU_METHOD CU_DTCC_B_SUPPLY_VREFC "Conversion method for DTCc_b_Supply_VRefC" RAT_FUNC "%10.0" "b" COEFFS 0.000000 1.000000 0.000000 0.000000 0.000000 1.000000 /end COMPU_METHOD
/* Scalar calibration for DDE 'DTCc_b_Supply_VRefD'. */
/begin CHARACTERISTIC DTCc_b_Supply_VRefD "Override flag" VALUE 0x8cce5 RL_DTCC_B_SUPPLY_VREFD 1.000000 CU_DTCC_B_SUPPLY_VREFD 0.000000 1.000000 BYTE_ORDER MSB_FIRST /end CHARACTERISTIC
/begin RECORD_LAYOUT RL_DTCC_B_SUPPLY_VREFD FNC_VALUES 1 UBYTE COLUMN_DIR DIRECT /end RECORD_LAYOUT
/begin COMPU_METHOD CU_DTCC_B_SUPPLY_VREFD "Conversion method for DTCc_b_Supply_VRefD" RAT_FUNC "%10.0" "b" COEFFS 0.000000 1.000000 0.000000 0.000000 0.000000 1.000000 /end COMPU_METHOD
/* Scalar calibration for DDE 'DTCc_b_THR_Motor_Fail'. */
/begin CHARACTERISTIC DTCc_b_THR_Motor_Fail "Override flag" VALUE 0x8c36d RL_DTCC_B_THR_MOTOR_FAIL 1.000000 CU_DTCC_B_THR_MOTOR_FAIL 0.000000 1.000000 BYTE_ORDER MSB_FIRST /end CHARACTERISTIC
/begin RECORD_LAYOUT RL_DTCC_B_THR_MOTOR_FAIL FNC_VALUES 1 UBYTE COLUMN_DIR DIRECT /end RECORD_LAYOUT
/begin COMPU_METHOD CU_DTCC_B_THR_MOTOR_FAIL "Conversion method for DTCc_b_THR_Motor_Fail" RAT_FUNC "%10.0" "b" COEFFS 0.000000 1.000000 0.000000 0.000000 0.000000 1.000000 /end COMPU_METHOD
/* Scalar calibration for DDE 'DTCc_b_TP1_SensorHV'. */
/begin CHARACTERISTIC DTCc_b_TP1_SensorHV "Override flag" VALUE 0x8c363 RL_DTCC_B_TP1_SENSORHV 1.000000 CU_DTCC_B_TP1_SENSORHV 0.000000 1.000000 BYTE_ORDER MSB_FIRST /end CHARACTERISTIC
/begin RECORD_LAYOUT RL_DTCC_B_TP1_SENSORHV FNC_VALUES 1 UBYTE COLUMN_DIR DIRECT /end RECORD_LAYOUT
/begin COMPU_METHOD CU_DTCC_B_TP1_SENSORHV "Conversion method for DTCc_b_TP1_SensorHV" RAT_FUNC "%10.0" "b" COEFFS 0.000000 1.000000 0.000000 0.000000 0.000000 1.000000 /end COMPU_METHOD
/* Scalar calibration for DDE 'DTCc_b_TP1_SensorLV'. */
/begin CHARACTERISTIC DTCc_b_TP1_SensorLV "Override flag" VALUE 0x8c361 RL_DTCC_B_TP1_SENSORLV 1.000000 CU_DTCC_B_TP1_SENSORLV 0.000000 1.000000 BYTE_ORDER MSB_FIRST /end CHARACTERISTIC
/begin RECORD_LAYOUT RL_DTCC_B_TP1_SENSORLV FNC_VALUES 1 UBYTE COLUMN_DIR DIRECT /end RECORD_LAYOUT
/begin COMPU_METHOD CU_DTCC_B_TP1_SENSORLV "Conversion method for DTCc_b_TP1_SensorLV" RAT_FUNC "%10.0" "b" COEFFS 0.000000 1.000000 0.000000 0.000000 0.000000 1.000000 /end COMPU_METHOD
/* Scalar calibration for DDE 'DTCc_b_TP2_SensorHV'. */
/begin CHARACTERISTIC DTCc_b_TP2_SensorHV "Override flag" VALUE 0x8c37b RL_DTCC_B_TP2_SENSORHV 1.000000 CU_DTCC_B_TP2_SENSORHV 0.000000 1.000000 BYTE_ORDER MSB_FIRST /end CHARACTERISTIC
/begin RECORD_LAYOUT RL_DTCC_B_TP2_SENSORHV FNC_VALUES 1 UBYTE COLUMN_DIR DIRECT /end RECORD_LAYOUT
/begin COMPU_METHOD CU_DTCC_B_TP2_SENSORHV "Conversion method for DTCc_b_TP2_SensorHV" RAT_FUNC "%10.0" "b" COEFFS 0.000000 1.000000 0.000000 0.000000 0.000000 1.000000 /end COMPU_METHOD
/* Scalar calibration for DDE 'DTCc_b_TP2_SensorLV'. */
/begin CHARACTERISTIC DTCc_b_TP2_SensorLV "Override flag" VALUE 0x8c379 RL_DTCC_B_TP2_SENSORLV 1.000000 CU_DTCC_B_TP2_SENSORLV 0.000000 1.000000 BYTE_ORDER MSB_FIRST /end CHARACTERISTIC
/begin RECORD_LAYOUT RL_DTCC_B_TP2_SENSORLV FNC_VALUES 1 UBYTE COLUMN_DIR DIRECT /end RECORD_LAYOUT
/begin COMPU_METHOD CU_DTCC_B_TP2_SENSORLV "Conversion method for DTCc_b_TP2_SensorLV" RAT_FUNC "%10.0" "b" COEFFS 0.000000 1.000000 0.000000 0.000000 0.000000 1.000000 /end COMPU_METHOD
/* Scalar calibration for DDE 'DTCc_b_TP_CorrFLT'. */
/begin CHARACTERISTIC DTCc_b_TP_CorrFLT "Override flag" VALUE 0x87a39 RL_DTCC_B_TP_CORRFLT 1.000000 CU_DTCC_B_TP_CORRFLT 0.000000 1.000000 BYTE_ORDER MSB_FIRST /end CHARACTERISTIC
/begin RECORD_LAYOUT RL_DTCC_B_TP_CORRFLT FNC_VALUES 1 UBYTE COLUMN_DIR DIRECT /end RECORD_LAYOUT
/begin COMPU_METHOD CU_DTCC_B_TP_CORRFLT "Conversion method for DTCc_b_TP_CorrFLT" RAT_FUNC "%10.0" "b" COEFFS 0.000000 1.000000 0.000000 0.000000 0.000000 1.000000 /end COMPU_METHOD
/* Scalar calibration for DDE 'DTCc_b_TurboError'. */
/begin CHARACTERISTIC DTCc_b_TurboError "Override flag" VALUE 0x8b879 RL_DTCC_B_TURBOERROR 1.000000 CU_DTCC_B_TURBOERROR 0.000000 1.000000 BYTE_ORDER MSB_FIRST /end CHARACTERISTIC
/begin RECORD_LAYOUT RL_DTCC_B_TURBOERROR FNC_VALUES 1 UBYTE COLUMN_DIR DIRECT /end RECORD_LAYOUT
/begin COMPU_METHOD CU_DTCC_B_TURBOERROR "Conversion method for DTCc_b_TurboError" RAT_FUNC "%10.0" "b" COEFFS 0.000000 1.000000 0.000000 0.000000 0.000000 1.000000 /end COMPU_METHOD
/* Scalar calibration for DDE 'DTCc_cnt_KnockHIT'. */
/begin CHARACTERISTIC DTCc_cnt_KnockHIT "(not defined)" VALUE 0x8ad83 RL_DTCC_CNT_KNOCKHIT 255.000000 CU_DTCC_CNT_KNOCKHIT 0.000000 255.000000 BYTE_ORDER MSB_FIRST /end CHARACTERISTIC
/begin RECORD_LAYOUT RL_DTCC_CNT_KNOCKHIT FNC_VALUES 1 UBYTE COLUMN_DIR DIRECT /end RECORD_LAYOUT
/begin COMPU_METHOD CU_DTCC_CNT_KNOCKHIT "Conversion method for DTCc_cnt_KnockHIT" RAT_FUNC "%10.0" "cnt" COEFFS 0.000000 1.000000 0.000000 0.000000 0.000000 1.000000 /end COMPU_METHOD
/* Scalar calibration for DDE 'DTCc_o_1_boostOC'. */
/begin CHARACTERISTIC DTCc_o_1_boostOC "Override value" VALUE 0x8ccf4 RL_DTCC_O_1_BOOSTOC 1.000000 CU_DTCC_O_1_BOOSTOC 0.000000 1.000000 BYTE_ORDER MSB_FIRST /end CHARACTERISTIC
/begin RECORD_LAYOUT RL_DTCC_O_1_BOOSTOC FNC_VALUES 1 UBYTE COLUMN_DIR DIRECT /end RECORD_LAYOUT
/begin COMPU_METHOD CU_DTCC_O_1_BOOSTOC "Conversion method for DTCc_o_1_boostOC" RAT_FUNC "%10.0" "o" COEFFS 0.000000 1.000000 0.000000 0.000000 0.000000 1.000000 /end COMPU_METHOD
/* Scalar calibration for DDE 'DTCc_o_1_lsol'. */
/begin CHARACTERISTIC DTCc_o_1_lsol "Override value" VALUE 0x8ccf0 RL_DTCC_O_1_LSOL 1.000000 CU_DTCC_O_1_LSOL 0.000000 1.000000 BYTE_ORDER MSB_FIRST /end CHARACTERISTIC
/begin RECORD_LAYOUT RL_DTCC_O_1_LSOL FNC_VALUES 1 UBYTE COLUMN_DIR DIRECT /end RECORD_LAYOUT
/begin COMPU_METHOD CU_DTCC_O_1_LSOL "Conversion method for DTCc_o_1_lsol" RAT_FUNC "%10.0" "o" COEFFS 0.000000 1.000000 0.000000 0.000000 0.000000 1.000000 /end COMPU_METHOD
/* Scalar calibration for DDE 'DTCc_o_1_sb'. */
/begin CHARACTERISTIC DTCc_o_1_sb "Override value" VALUE 0x8ccf2 RL_DTCC_O_1_SB 1.000000 CU_DTCC_O_1_SB 0.000000 1.000000 BYTE_ORDER MSB_FIRST /end CHARACTERISTIC
/begin RECORD_LAYOUT RL_DTCC_O_1_SB FNC_VALUES 1 UBYTE COLUMN_DIR DIRECT /end RECORD_LAYOUT
/begin COMPU_METHOD CU_DTCC_O_1_SB "Conversion method for DTCc_o_1_sb" RAT_FUNC "%10.0" "o" COEFFS 0.000000 1.000000 0.000000 0.000000 0.000000 1.000000 /end COMPU_METHOD
/* Scalar calibration for DDE 'DTCc_o_1_sg'. */
/begin CHARACTERISTIC DTCc_o_1_sg "Override value" VALUE 0x8ccf6 RL_DTCC_O_1_SG 1.000000 CU_DTCC_O_1_SG 0.000000 1.000000 BYTE_ORDER MSB_FIRST /end CHARACTERISTIC
/begin RECORD_LAYOUT RL_DTCC_O_1_SG FNC_VALUES 1 UBYTE COLUMN_DIR DIRECT /end RECORD_LAYOUT
/begin COMPU_METHOD CU_DTCC_O_1_SG "Conversion method for DTCc_o_1_sg" RAT_FUNC "%10.0" "o" COEFFS 0.000000 1.000000 0.000000 0.000000 0.000000 1.000000 /end COMPU_METHOD
/* Scalar calibration for DDE 'DTCc_o_2_boostOC'. */
/begin CHARACTERISTIC DTCc_o_2_boostOC "Override value" VALUE 0x8ccfc RL_DTCC_O_2_BOOSTOC 1.000000 CU_DTCC_O_2_BOOSTOC 0.000000 1.000000 BYTE_ORDER MSB_FIRST /end CHARACTERISTIC
/begin RECORD_LAYOUT RL_DTCC_O_2_BOOSTOC FNC_VALUES 1 UBYTE COLUMN_DIR DIRECT /end RECORD_LAYOUT
/begin COMPU_METHOD CU_DTCC_O_2_BOOSTOC "Conversion method for DTCc_o_2_boostOC" RAT_FUNC "%10.0" "o" COEFFS 0.000000 1.000000 0.000000 0.000000 0.000000 1.000000 /end COMPU_METHOD
/* Scalar calibration for DDE 'DTCc_o_2_lsol'. */
/begin CHARACTERISTIC DTCc_o_2_lsol "Override value" VALUE 0x8ccf8 RL_DTCC_O_2_LSOL 1.000000 CU_DTCC_O_2_LSOL 0.000000 1.000000 BYTE_ORDER MSB_FIRST /end CHARACTERISTIC
/begin RECORD_LAYOUT RL_DTCC_O_2_LSOL FNC_VALUES 1 UBYTE COLUMN_DIR DIRECT /end RECORD_LAYOUT
/begin COMPU_METHOD CU_DTCC_O_2_LSOL "Conversion method for DTCc_o_2_lsol" RAT_FUNC "%10.0" "o" COEFFS 0.000000 1.000000 0.000000 0.000000 0.000000 1.000000 /end COMPU_METHOD
/* Scalar calibration for DDE 'DTCc_o_2_sb'. */
/begin CHARACTERISTIC DTCc_o_2_sb "Override value" VALUE 0x8ccfa RL_DTCC_O_2_SB 1.000000 CU_DTCC_O_2_SB 0.000000 1.000000 BYTE_ORDER MSB_FIRST /end CHARACTERISTIC
/begin RECORD_LAYOUT RL_DTCC_O_2_SB FNC_VALUES 1 UBYTE COLUMN_DIR DIRECT /end RECORD_LAYOUT
/begin COMPU_METHOD CU_DTCC_O_2_SB "Conversion method for DTCc_o_2_sb" RAT_FUNC "%10.0" "o" COEFFS 0.000000 1.000000 0.000000 0.000000 0.000000 1.000000 /end COMPU_METHOD
/* Scalar calibration for DDE 'DTCc_o_2_sg'. */
/begin CHARACTERISTIC DTCc_o_2_sg "Override value" VALUE 0x8ccfe RL_DTCC_O_2_SG 1.000000 CU_DTCC_O_2_SG 0.000000 1.000000 BYTE_ORDER MSB_FIRST /end CHARACTERISTIC
/begin RECORD_LAYOUT RL_DTCC_O_2_SG FNC_VALUES 1 UBYTE COLUMN_DIR DIRECT /end RECORD_LAYOUT
/begin COMPU_METHOD CU_DTCC_O_2_SG "Conversion method for DTCc_o_2_sg" RAT_FUNC "%10.0" "o" COEFFS 0.000000 1.000000 0.000000 0.000000 0.000000 1.000000 /end COMPU_METHOD
/* Scalar calibration for DDE 'DTCc_o_3_boostOC'. */
/begin CHARACTERISTIC DTCc_o_3_boostOC "Override value" VALUE 0x8cd0c RL_DTCC_O_3_BOOSTOC 1.000000 CU_DTCC_O_3_BOOSTOC 0.000000 1.000000 BYTE_ORDER MSB_FIRST /end CHARACTERISTIC
/begin RECORD_LAYOUT RL_DTCC_O_3_BOOSTOC FNC_VALUES 1 UBYTE COLUMN_DIR DIRECT /end RECORD_LAYOUT
/begin COMPU_METHOD CU_DTCC_O_3_BOOSTOC "Conversion method for DTCc_o_3_boostOC" RAT_FUNC "%10.0" "o" COEFFS 0.000000 1.000000 0.000000 0.000000 0.000000 1.000000 /end COMPU_METHOD
/* Scalar calibration for DDE 'DTCc_o_3_lsol'. */
/begin CHARACTERISTIC DTCc_o_3_lsol "Override value" VALUE 0x8cd08 RL_DTCC_O_3_LSOL 1.000000 CU_DTCC_O_3_LSOL 0.000000 1.000000 BYTE_ORDER MSB_FIRST /end CHARACTERISTIC
/begin RECORD_LAYOUT RL_DTCC_O_3_LSOL FNC_VALUES 1 UBYTE COLUMN_DIR DIRECT /end RECORD_LAYOUT
/begin COMPU_METHOD CU_DTCC_O_3_LSOL "Conversion method for DTCc_o_3_lsol" RAT_FUNC "%10.0" "o" COEFFS 0.000000 1.000000 0.000000 0.000000 0.000000 1.000000 /end COMPU_METHOD
/* Scalar calibration for DDE 'DTCc_o_3_sb'. */
/begin CHARACTERISTIC DTCc_o_3_sb "Override value" VALUE 0x8cd0a RL_DTCC_O_3_SB 1.000000 CU_DTCC_O_3_SB 0.000000 1.000000 BYTE_ORDER MSB_FIRST /end CHARACTERISTIC
/begin RECORD_LAYOUT RL_DTCC_O_3_SB FNC_VALUES 1 UBYTE COLUMN_DIR DIRECT /end RECORD_LAYOUT
/begin COMPU_METHOD CU_DTCC_O_3_SB "Conversion method for DTCc_o_3_sb" RAT_FUNC "%10.0" "o" COEFFS 0.000000 1.000000 0.000000 0.000000 0.000000 1.000000 /end COMPU_METHOD
/* Scalar calibration for DDE 'DTCc_o_3_sg'. */
/begin CHARACTERISTIC DTCc_o_3_sg "Override value" VALUE 0x8cd0e RL_DTCC_O_3_SG 1.000000 CU_DTCC_O_3_SG 0.000000 1.000000 BYTE_ORDER MSB_FIRST /end CHARACTERISTIC
/begin RECORD_LAYOUT RL_DTCC_O_3_SG FNC_VALUES 1 UBYTE COLUMN_DIR DIRECT /end RECORD_LAYOUT
/begin COMPU_METHOD CU_DTCC_O_3_SG "Conversion method for DTCc_o_3_sg" RAT_FUNC "%10.0" "o" COEFFS 0.000000 1.000000 0.000000 0.000000 0.000000 1.000000 /end COMPU_METHOD
/* Scalar calibration for DDE 'DTCc_o_4_boostOC'. */
/begin CHARACTERISTIC DTCc_o_4_boostOC "Override value" VALUE 0x8cd02 RL_DTCC_O_4_BOOSTOC 1.000000 CU_DTCC_O_4_BOOSTOC 0.000000 1.000000 BYTE_ORDER MSB_FIRST /end CHARACTERISTIC
/begin RECORD_LAYOUT RL_DTCC_O_4_BOOSTOC FNC_VALUES 1 UBYTE COLUMN_DIR DIRECT /end RECORD_LAYOUT
/begin COMPU_METHOD CU_DTCC_O_4_BOOSTOC "Conversion method for DTCc_o_4_boostOC" RAT_FUNC "%10.0" "o" COEFFS 0.000000 1.000000 0.000000 0.000000 0.000000 1.000000 /end COMPU_METHOD
/* Scalar calibration for DDE 'DTCc_o_4_lsol'. */
/begin CHARACTERISTIC DTCc_o_4_lsol "Override value" VALUE 0x8cd00 RL_DTCC_O_4_LSOL 1.000000 CU_DTCC_O_4_LSOL 0.000000 1.000000 BYTE_ORDER MSB_FIRST /end CHARACTERISTIC
/begin RECORD_LAYOUT RL_DTCC_O_4_LSOL FNC_VALUES 1 UBYTE COLUMN_DIR DIRECT /end RECORD_LAYOUT
/begin COMPU_METHOD CU_DTCC_O_4_LSOL "Conversion method for DTCc_o_4_lsol" RAT_FUNC "%10.0" "o" COEFFS 0.000000 1.000000 0.000000 0.000000 0.000000 1.000000 /end COMPU_METHOD
/* Scalar calibration for DDE 'DTCc_o_4_sb'. */
/begin CHARACTERISTIC DTCc_o_4_sb "Override value" VALUE 0x8cd04 RL_DTCC_O_4_SB 1.000000 CU_DTCC_O_4_SB 0.000000 1.000000 BYTE_ORDER MSB_FIRST /end CHARACTERISTIC
/begin RECORD_LAYOUT RL_DTCC_O_4_SB FNC_VALUES 1 UBYTE COLUMN_DIR DIRECT /end RECORD_LAYOUT
/begin COMPU_METHOD CU_DTCC_O_4_SB "Conversion method for DTCc_o_4_sb" RAT_FUNC "%10.0" "o" COEFFS 0.000000 1.000000 0.000000 0.000000 0.000000 1.000000 /end COMPU_METHOD
/* Scalar calibration for DDE 'DTCc_o_4_sg'. */
/begin CHARACTERISTIC DTCc_o_4_sg "Override value" VALUE 0x8cd06 RL_DTCC_O_4_SG 1.000000 CU_DTCC_O_4_SG 0.000000 1.000000 BYTE_ORDER MSB_FIRST /end CHARACTERISTIC
/begin RECORD_LAYOUT RL_DTCC_O_4_SG FNC_VALUES 1 UBYTE COLUMN_DIR DIRECT /end RECORD_LAYOUT
/begin COMPU_METHOD CU_DTCC_O_4_SG "Conversion method for DTCc_o_4_sg" RAT_FUNC "%10.0" "o" COEFFS 0.000000 1.000000 0.000000 0.000000 0.000000 1.000000 /end COMPU_METHOD
/* Scalar calibration for DDE 'DTCc_o_APP1_NonValidVoltage'. */
/begin CHARACTERISTIC DTCc_o_APP1_NonValidVoltage "Override value" VALUE 0x8bfbc RL_DTCC_O_APP1_NONVALIDVOLTAGE 1.000000 CU_DTCC_O_APP1_NONVALIDVOLTAGE 0.000000 1.000000 BYTE_ORDER MSB_FIRST /end CHARACTERISTIC
/begin RECORD_LAYOUT RL_DTCC_O_APP1_NONVALIDVOLTAGE FNC_VALUES 1 UBYTE COLUMN_DIR DIRECT /end RECORD_LAYOUT
/begin COMPU_METHOD CU_DTCC_O_APP1_NONVALIDVOLTAGE "Conversion method for DTCc_o_APP1_NonValidVoltage" RAT_FUNC "%10.0" "o" COEFFS 0.000000 1.000000 0.000000 0.000000 0.000000 1.000000 /end COMPU_METHOD
/* Scalar calibration for DDE 'DTCc_o_APP2_NonValidVoltage'. */
/begin CHARACTERISTIC DTCc_o_APP2_NonValidVoltage "Override value" VALUE 0x8bfd0 RL_DTCC_O_APP2_NONVALIDVOLTAGE 1.000000 CU_DTCC_O_APP2_NONVALIDVOLTAGE 0.000000 1.000000 BYTE_ORDER MSB_FIRST /end CHARACTERISTIC
/begin RECORD_LAYOUT RL_DTCC_O_APP2_NONVALIDVOLTAGE FNC_VALUES 1 UBYTE COLUMN_DIR DIRECT /end RECORD_LAYOUT
/begin COMPU_METHOD CU_DTCC_O_APP2_NONVALIDVOLTAGE "Conversion method for DTCc_o_APP2_NonValidVoltage" RAT_FUNC "%10.0" "o" COEFFS 0.000000 1.000000 0.000000 0.000000 0.000000 1.000000 /end COMPU_METHOD
/* Scalar calibration for DDE 'DTCc_o_APP_CorrFLT'. */
/begin CHARACTERISTIC DTCc_o_APP_CorrFLT "Override value" VALUE 0x86fc0 RL_DTCC_O_APP_CORRFLT 1.000000 CU_DTCC_O_APP_CORRFLT 0.000000 1.000000 BYTE_ORDER MSB_FIRST /end CHARACTERISTIC
/begin RECORD_LAYOUT RL_DTCC_O_APP_CORRFLT FNC_VALUES 1 UBYTE COLUMN_DIR DIRECT /end RECORD_LAYOUT
/begin COMPU_METHOD CU_DTCC_O_APP_CORRFLT "Conversion method for DTCc_o_APP_CorrFLT" RAT_FUNC "%10.0" "o" COEFFS 0.000000 1.000000 0.000000 0.000000 0.000000 1.000000 /end COMPU_METHOD
/* Scalar calibration for DDE 'DTCc_o_Air_HTemp'. */
/begin CHARACTERISTIC DTCc_o_Air_HTemp "Override value" VALUE 0x8bfb0 RL_DTCC_O_AIR_HTEMP 1.000000 CU_DTCC_O_AIR_HTEMP 0.000000 1.000000 BYTE_ORDER MSB_FIRST /end CHARACTERISTIC
/begin RECORD_LAYOUT RL_DTCC_O_AIR_HTEMP FNC_VALUES 1 UBYTE COLUMN_DIR DIRECT /end RECORD_LAYOUT
/begin COMPU_METHOD CU_DTCC_O_AIR_HTEMP "Conversion method for DTCc_o_Air_HTemp" RAT_FUNC "%10.0" "o" COEFFS 0.000000 1.000000 0.000000 0.000000 0.000000 1.000000 /end COMPU_METHOD
/* Scalar calibration for DDE 'DTCc_o_Air_TempHV'. */
/begin CHARACTERISTIC DTCc_o_Air_TempHV "Override value" VALUE 0x8bfae RL_DTCC_O_AIR_TEMPHV 1.000000 CU_DTCC_O_AIR_TEMPHV 0.000000 1.000000 BYTE_ORDER MSB_FIRST /end CHARACTERISTIC
/begin RECORD_LAYOUT RL_DTCC_O_AIR_TEMPHV FNC_VALUES 1 UBYTE COLUMN_DIR DIRECT /end RECORD_LAYOUT
/begin COMPU_METHOD CU_DTCC_O_AIR_TEMPHV "Conversion method for DTCc_o_Air_TempHV" RAT_FUNC "%10.0" "o" COEFFS 0.000000 1.000000 0.000000 0.000000 0.000000 1.000000 /end COMPU_METHOD
/* Scalar calibration for DDE 'DTCc_o_Air_TempLV'. */
/begin CHARACTERISTIC DTCc_o_Air_TempLV "Override value" VALUE 0x8bfac RL_DTCC_O_AIR_TEMPLV 1.000000 CU_DTCC_O_AIR_TEMPLV 0.000000 1.000000 BYTE_ORDER MSB_FIRST /end CHARACTERISTIC
/begin RECORD_LAYOUT RL_DTCC_O_AIR_TEMPLV FNC_VALUES 1 UBYTE COLUMN_DIR DIRECT /end RECORD_LAYOUT
/begin COMPU_METHOD CU_DTCC_O_AIR_TEMPLV "Conversion method for DTCc_o_Air_TempLV" RAT_FUNC "%10.0" "o" COEFFS 0.000000 1.000000 0.000000 0.000000 0.000000 1.000000 /end COMPU_METHOD
/* Scalar calibration for DDE 'DTCc_o_BARO_ErraticValue'. */
/begin CHARACTERISTIC DTCc_o_BARO_ErraticValue "Override value" VALUE 0x8c080 RL_DTCC_O_BARO_ERRATICVALUE 1.000000 CU_DTCC_O_BARO_ERRATICVALUE 0.000000 1.000000 BYTE_ORDER MSB_FIRST /end CHARACTERISTIC
/begin RECORD_LAYOUT RL_DTCC_O_BARO_ERRATICVALUE FNC_VALUES 1 UBYTE COLUMN_DIR DIRECT /end RECORD_LAYOUT
/begin COMPU_METHOD CU_DTCC_O_BARO_ERRATICVALUE "Conversion method for DTCc_o_BARO_ErraticValue" RAT_FUNC "%10.0" "o" COEFFS 0.000000 1.000000 0.000000 0.000000 0.000000 1.000000 /end COMPU_METHOD
/* Scalar calibration for DDE 'DTCc_o_BARO_PressHVoltage'. */
/begin CHARACTERISTIC DTCc_o_BARO_PressHVoltage "Override value" VALUE 0x8c07e RL_DTCC_O_BARO_PRESSHVOLTAGE 1.000000 CU_DTCC_O_BARO_PRESSHVOLTAGE 0.000000 1.000000 BYTE_ORDER MSB_FIRST /end CHARACTERISTIC
/begin RECORD_LAYOUT RL_DTCC_O_BARO_PRESSHVOLTAGE FNC_VALUES 1 UBYTE COLUMN_DIR DIRECT /end RECORD_LAYOUT
/begin COMPU_METHOD CU_DTCC_O_BARO_PRESSHVOLTAGE "Conversion method for DTCc_o_BARO_PressHVoltage" RAT_FUNC "%10.0" "o" COEFFS 0.000000 1.000000 0.000000 0.000000 0.000000 1.000000 /end COMPU_METHOD
/* Scalar calibration for DDE 'DTCc_o_BARO_PressLVoltage'. */
/begin CHARACTERISTIC DTCc_o_BARO_PressLVoltage "Override value" VALUE 0x8c07c RL_DTCC_O_BARO_PRESSLVOLTAGE 1.000000 CU_DTCC_O_BARO_PRESSLVOLTAGE 0.000000 1.000000 BYTE_ORDER MSB_FIRST /end CHARACTERISTIC
/begin RECORD_LAYOUT RL_DTCC_O_BARO_PRESSLVOLTAGE FNC_VALUES 1 UBYTE COLUMN_DIR DIRECT /end RECORD_LAYOUT
/begin COMPU_METHOD CU_DTCC_O_BARO_PRESSLVOLTAGE "Conversion method for DTCc_o_BARO_PressLVoltage" RAT_FUNC "%10.0" "o" COEFFS 0.000000 1.000000 0.000000 0.000000 0.000000 1.000000 /end COMPU_METHOD
/* Scalar calibration for DDE 'DTCc_o_BAT_VoltageOutofRange'. */
/begin CHARACTERISTIC DTCc_o_BAT_VoltageOutofRange "Override value" VALUE 0x8c37c RL_DTCC_O_BAT_VOLTAGEOUTOFRANGE 1.000000 CU_DTCC_O_BAT_VOLTAGEOUTOFRANGE 0.000000 1.000000 BYTE_ORDER MSB_FIRST /end CHARACTERISTIC
/begin RECORD_LAYOUT RL_DTCC_O_BAT_VOLTAGEOUTOFRANGE FNC_VALUES 1 UBYTE COLUMN_DIR DIRECT /end RECORD_LAYOUT
/begin COMPU_METHOD CU_DTCC_O_BAT_VOLTAGEOUTOFRANGE "Conversion method for DTCc_o_BAT_VoltageOutofRange" RAT_FUNC "%10.0" "o" COEFFS 0.000000 1.000000 0.000000 0.000000 0.000000 1.000000 /end COMPU_METHOD
/* Scalar calibration for DDE 'DTCc_o_BegasTime'. */
/begin CHARACTERISTIC DTCc_o_BegasTime "(not defined)" VALUE 0x8bfa4 RL_DTCC_O_BEGASTIME 1.000000 CU_DTCC_O_BEGASTIME 0.000000 1.000000 BYTE_ORDER MSB_FIRST /end CHARACTERISTIC
/begin RECORD_LAYOUT RL_DTCC_O_BEGASTIME FNC_VALUES 1 UBYTE COLUMN_DIR DIRECT /end RECORD_LAYOUT
/begin COMPU_METHOD CU_DTCC_O_BEGASTIME "Conversion method for DTCc_o_BegasTime" RAT_FUNC "%10.0" "b" COEFFS 0.000000 1.000000 0.000000 0.000000 0.000000 1.000000 /end COMPU_METHOD
/* Scalar calibration for DDE 'DTCc_o_CataCounting'. */
/begin CHARACTERISTIC DTCc_o_CataCounting "Override value" VALUE 0x8c0e0 RL_DTCC_O_CATACOUNTING 1.000000 CU_DTCC_O_CATACOUNTING 0.000000 1.000000 BYTE_ORDER MSB_FIRST /end CHARACTERISTIC
/begin RECORD_LAYOUT RL_DTCC_O_CATACOUNTING FNC_VALUES 1 UBYTE COLUMN_DIR DIRECT /end RECORD_LAYOUT
/begin COMPU_METHOD CU_DTCC_O_CATACOUNTING "Conversion method for DTCc_o_CataCounting" RAT_FUNC "%10.0" "o" COEFFS 0.000000 1.000000 0.000000 0.000000 0.000000 1.000000 /end COMPU_METHOD
/* Scalar calibration for DDE 'DTCc_o_Catalyst_A'. */
/begin CHARACTERISTIC DTCc_o_Catalyst_A "Override value" VALUE 0x8c0f4 RL_DTCC_O_CATALYST_A 1.000000 CU_DTCC_O_CATALYST_A 0.000000 1.000000 BYTE_ORDER MSB_FIRST /end CHARACTERISTIC
/begin RECORD_LAYOUT RL_DTCC_O_CATALYST_A FNC_VALUES 1 UBYTE COLUMN_DIR DIRECT /end RECORD_LAYOUT
/begin COMPU_METHOD CU_DTCC_O_CATALYST_A "Conversion method for DTCc_o_Catalyst_A" RAT_FUNC "%10.0" "o" COEFFS 0.000000 1.000000 0.000000 0.000000 0.000000 1.000000 /end COMPU_METHOD
/* Scalar calibration for DDE 'DTCc_o_CompIAT_HTemp'. */
/begin CHARACTERISTIC DTCc_o_CompIAT_HTemp "Override value" VALUE 0x8c1b4 RL_DTCC_O_COMPIAT_HTEMP 1.000000 CU_DTCC_O_COMPIAT_HTEMP 0.000000 1.000000 BYTE_ORDER MSB_FIRST /end CHARACTERISTIC
/begin RECORD_LAYOUT RL_DTCC_O_COMPIAT_HTEMP FNC_VALUES 1 UBYTE COLUMN_DIR DIRECT /end RECORD_LAYOUT
/begin COMPU_METHOD CU_DTCC_O_COMPIAT_HTEMP "Conversion method for DTCc_o_CompIAT_HTemp" RAT_FUNC "%10.0" "o" COEFFS 0.000000 1.000000 0.000000 0.000000 0.000000 1.000000 /end COMPU_METHOD
/* Scalar calibration for DDE 'DTCc_o_CompIAT_TempHV'. */
/begin CHARACTERISTIC DTCc_o_CompIAT_TempHV "Override value" VALUE 0x8c1b2 RL_DTCC_O_COMPIAT_TEMPHV 1.000000 CU_DTCC_O_COMPIAT_TEMPHV 0.000000 1.000000 BYTE_ORDER MSB_FIRST /end CHARACTERISTIC
/begin RECORD_LAYOUT RL_DTCC_O_COMPIAT_TEMPHV FNC_VALUES 1 UBYTE COLUMN_DIR DIRECT /end RECORD_LAYOUT
/begin COMPU_METHOD CU_DTCC_O_COMPIAT_TEMPHV "Conversion method for DTCc_o_CompIAT_TempHV" RAT_FUNC "%10.0" "o" COEFFS 0.000000 1.000000 0.000000 0.000000 0.000000 1.000000 /end COMPU_METHOD
/* Scalar calibration for DDE 'DTCc_o_CompIAT_TempLV'. */
/begin CHARACTERISTIC DTCc_o_CompIAT_TempLV "Override value" VALUE 0x8c1b0 RL_DTCC_O_COMPIAT_TEMPLV 1.000000 CU_DTCC_O_COMPIAT_TEMPLV 0.000000 1.000000 BYTE_ORDER MSB_FIRST /end CHARACTERISTIC
/begin RECORD_LAYOUT RL_DTCC_O_COMPIAT_TEMPLV FNC_VALUES 1 UBYTE COLUMN_DIR DIRECT /end RECORD_LAYOUT
/begin COMPU_METHOD CU_DTCC_O_COMPIAT_TEMPLV "Conversion method for DTCc_o_CompIAT_TempLV" RAT_FUNC "%10.0" "o" COEFFS 0.000000 1.000000 0.000000 0.000000 0.000000 1.000000 /end COMPU_METHOD
/* Scalar calibration for DDE 'DTCc_o_DM11Force'. */
/begin CHARACTERISTIC DTCc_o_DM11Force "Override value" VALUE 0x8ce6e RL_DTCC_O_DM11FORCE 1.000000 CU_DTCC_O_DM11FORCE 0.000000 1.000000 BYTE_ORDER MSB_FIRST /end CHARACTERISTIC
/begin RECORD_LAYOUT RL_DTCC_O_DM11FORCE FNC_VALUES 1 UBYTE COLUMN_DIR DIRECT /end RECORD_LAYOUT
/begin COMPU_METHOD CU_DTCC_O_DM11FORCE "Conversion method for DTCc_o_DM11Force" RAT_FUNC "%10.0" "o" COEFFS 0.000000 1.000000 0.000000 0.000000 0.000000 1.000000 /end COMPU_METHOD
/* Scalar calibration for DDE 'DTCc_o_DiagCata_TestEnd'. */
/begin CHARACTERISTIC DTCc_o_DiagCata_TestEnd "Override value" VALUE 0x8c444 RL_DTCC_O_DIAGCATA_TESTEND 1.000000 CU_DTCC_O_DIAGCATA_TESTEND 0.000000 1.000000 BYTE_ORDER MSB_FIRST /end CHARACTERISTIC
/begin RECORD_LAYOUT RL_DTCC_O_DIAGCATA_TESTEND FNC_VALUES 1 UBYTE COLUMN_DIR DIRECT /end RECORD_LAYOUT
/begin COMPU_METHOD CU_DTCC_O_DIAGCATA_TESTEND "Conversion method for DTCc_o_DiagCata_TestEnd" RAT_FUNC "%10.0" "o" COEFFS 0.000000 1.000000 0.000000 0.000000 0.000000 1.000000 /end COMPU_METHOD
/* Scalar calibration for DDE 'DTCc_o_ECT_HTemp'. */
/begin CHARACTERISTIC DTCc_o_ECT_HTemp "Override value" VALUE 0x8c100 RL_DTCC_O_ECT_HTEMP 1.000000 CU_DTCC_O_ECT_HTEMP 0.000000 1.000000 BYTE_ORDER MSB_FIRST /end CHARACTERISTIC
/begin RECORD_LAYOUT RL_DTCC_O_ECT_HTEMP FNC_VALUES 1 UBYTE COLUMN_DIR DIRECT /end RECORD_LAYOUT
/begin COMPU_METHOD CU_DTCC_O_ECT_HTEMP "Conversion method for DTCc_o_ECT_HTemp" RAT_FUNC "%10.0" "o" COEFFS 0.000000 1.000000 0.000000 0.000000 0.000000 1.000000 /end COMPU_METHOD
/* Scalar calibration for DDE 'DTCc_o_ECT_LTemp'. */
/begin CHARACTERISTIC DTCc_o_ECT_LTemp "Override value" VALUE 0x8c108 RL_DTCC_O_ECT_LTEMP 1.000000 CU_DTCC_O_ECT_LTEMP 0.000000 1.000000 BYTE_ORDER MSB_FIRST /end CHARACTERISTIC
/begin RECORD_LAYOUT RL_DTCC_O_ECT_LTEMP FNC_VALUES 1 UBYTE COLUMN_DIR DIRECT /end RECORD_LAYOUT
/begin COMPU_METHOD CU_DTCC_O_ECT_LTEMP "Conversion method for DTCc_o_ECT_LTemp" RAT_FUNC "%10.0" "o" COEFFS 0.000000 1.000000 0.000000 0.000000 0.000000 1.000000 /end COMPU_METHOD
/* Scalar calibration for DDE 'DTCc_o_ECT_TempHVoltage'. */
/begin CHARACTERISTIC DTCc_o_ECT_TempHVoltage "Override value" VALUE 0x8c0fc RL_DTCC_O_ECT_TEMPHVOLTAGE 1.000000 CU_DTCC_O_ECT_TEMPHVOLTAGE 0.000000 1.000000 BYTE_ORDER MSB_FIRST /end CHARACTERISTIC
/begin RECORD_LAYOUT RL_DTCC_O_ECT_TEMPHVOLTAGE FNC_VALUES 1 UBYTE COLUMN_DIR DIRECT /end RECORD_LAYOUT
/begin COMPU_METHOD CU_DTCC_O_ECT_TEMPHVOLTAGE "Conversion method for DTCc_o_ECT_TempHVoltage" RAT_FUNC "%10.0" "o" COEFFS 0.000000 1.000000 0.000000 0.000000 0.000000 1.000000 /end COMPU_METHOD
/* Scalar calibration for DDE 'DTCc_o_ECT_TempLVoltage'. */
/begin CHARACTERISTIC DTCc_o_ECT_TempLVoltage "Override value" VALUE 0x8c0fe RL_DTCC_O_ECT_TEMPLVOLTAGE 1.000000 CU_DTCC_O_ECT_TEMPLVOLTAGE 0.000000 1.000000 BYTE_ORDER MSB_FIRST /end CHARACTERISTIC
/begin RECORD_LAYOUT RL_DTCC_O_ECT_TEMPLVOLTAGE FNC_VALUES 1 UBYTE COLUMN_DIR DIRECT /end RECORD_LAYOUT
/begin COMPU_METHOD CU_DTCC_O_ECT_TEMPLVOLTAGE "Conversion method for DTCc_o_ECT_TempLVoltage" RAT_FUNC "%10.0" "o" COEFFS 0.000000 1.000000 0.000000 0.000000 0.000000 1.000000 /end COMPU_METHOD
/* Scalar calibration for DDE 'DTCc_o_EGT_TempHV'. */
/begin CHARACTERISTIC DTCc_o_EGT_TempHV "Override value" VALUE 0x8c110 RL_DTCC_O_EGT_TEMPHV 1.000000 CU_DTCC_O_EGT_TEMPHV 0.000000 1.000000 BYTE_ORDER MSB_FIRST /end CHARACTERISTIC
/begin RECORD_LAYOUT RL_DTCC_O_EGT_TEMPHV FNC_VALUES 1 UBYTE COLUMN_DIR DIRECT /end RECORD_LAYOUT
/begin COMPU_METHOD CU_DTCC_O_EGT_TEMPHV "Conversion method for DTCc_o_EGT_TempHV" RAT_FUNC "%10.0" "o" COEFFS 0.000000 1.000000 0.000000 0.000000 0.000000 1.000000 /end COMPU_METHOD
/* Scalar calibration for DDE 'DTCc_o_EGT_TempLV'. */
/begin CHARACTERISTIC DTCc_o_EGT_TempLV "Override value" VALUE 0x8c112 RL_DTCC_O_EGT_TEMPLV 1.000000 CU_DTCC_O_EGT_TEMPLV 0.000000 1.000000 BYTE_ORDER MSB_FIRST /end CHARACTERISTIC
/begin RECORD_LAYOUT RL_DTCC_O_EGT_TEMPLV FNC_VALUES 1 UBYTE COLUMN_DIR DIRECT /end RECORD_LAYOUT
/begin COMPU_METHOD CU_DTCC_O_EGT_TEMPLV "Conversion method for DTCc_o_EGT_TempLV" RAT_FUNC "%10.0" "o" COEFFS 0.000000 1.000000 0.000000 0.000000 0.000000 1.000000 /end COMPU_METHOD
/* Scalar calibration for DDE 'DTCc_o_ETC_MotorFLT'. */
/begin CHARACTERISTIC DTCc_o_ETC_MotorFLT "Override value" VALUE 0x879e8 RL_DTCC_O_ETC_MOTORFLT 1.000000 CU_DTCC_O_ETC_MOTORFLT 0.000000 1.000000 BYTE_ORDER MSB_FIRST /end CHARACTERISTIC
/begin RECORD_LAYOUT RL_DTCC_O_ETC_MOTORFLT FNC_VALUES 1 UBYTE COLUMN_DIR DIRECT /end RECORD_LAYOUT
/begin COMPU_METHOD CU_DTCC_O_ETC_MOTORFLT "Conversion method for DTCc_o_ETC_MotorFLT" RAT_FUNC "%10.0" "o" COEFFS 0.000000 1.000000 0.000000 0.000000 0.000000 1.000000 /end COMPU_METHOD
/* Scalar calibration for DDE 'DTCc_o_EcuMemFault'. */
/begin CHARACTERISTIC DTCc_o_EcuMemFault "Override value" VALUE 0x8bf86 RL_DTCC_O_ECUMEMFAULT 1.000000 CU_DTCC_O_ECUMEMFAULT 0.000000 1.000000 BYTE_ORDER MSB_FIRST /end CHARACTERISTIC
/begin RECORD_LAYOUT RL_DTCC_O_ECUMEMFAULT FNC_VALUES 1 UBYTE COLUMN_DIR DIRECT /end RECORD_LAYOUT
/begin COMPU_METHOD CU_DTCC_O_ECUMEMFAULT "Conversion method for DTCc_o_EcuMemFault" RAT_FUNC "%10.0" "o" COEFFS 0.000000 1.000000 0.000000 0.000000 0.000000 1.000000 /end COMPU_METHOD
/* Scalar calibration for DDE 'DTCc_o_EnableMIsfire'. */
/begin CHARACTERISTIC DTCc_o_EnableMIsfire "Override value" VALUE 0x8c4a8 RL_DTCC_O_ENABLEMISFIRE 1.000000 CU_DTCC_O_ENABLEMISFIRE 0.000000 1.000000 BYTE_ORDER MSB_FIRST /end CHARACTERISTIC
/begin RECORD_LAYOUT RL_DTCC_O_ENABLEMISFIRE FNC_VALUES 1 UBYTE COLUMN_DIR DIRECT /end RECORD_LAYOUT
/begin COMPU_METHOD CU_DTCC_O_ENABLEMISFIRE "Conversion method for DTCc_o_EnableMIsfire" RAT_FUNC "%10.0" "o" COEFFS 0.000000 1.000000 0.000000 0.000000 0.000000 1.000000 /end COMPU_METHOD
/* Scalar calibration for DDE 'DTCc_o_Exhaust_HTemp'. */
/begin CHARACTERISTIC DTCc_o_Exhaust_HTemp "Override value" VALUE 0x8c114 RL_DTCC_O_EXHAUST_HTEMP 1.000000 CU_DTCC_O_EXHAUST_HTEMP 0.000000 1.000000 BYTE_ORDER MSB_FIRST /end CHARACTERISTIC
/begin RECORD_LAYOUT RL_DTCC_O_EXHAUST_HTEMP FNC_VALUES 1 UBYTE COLUMN_DIR DIRECT /end RECORD_LAYOUT
/begin COMPU_METHOD CU_DTCC_O_EXHAUST_HTEMP "Conversion method for DTCc_o_Exhaust_HTemp" RAT_FUNC "%10.0" "o" COEFFS 0.000000 1.000000 0.000000 0.000000 0.000000 1.000000 /end COMPU_METHOD
/* Scalar calibration for DDE 'DTCc_o_FAP_Disconected'. */
/begin CHARACTERISTIC DTCc_o_FAP_Disconected "Override flag" VALUE 0x8c122 RL_DTCC_O_FAP_DISCONECTED 1.000000 CU_DTCC_O_FAP_DISCONECTED 0.000000 1.000000 BYTE_ORDER MSB_FIRST /end CHARACTERISTIC
/begin RECORD_LAYOUT RL_DTCC_O_FAP_DISCONECTED FNC_VALUES 1 UBYTE COLUMN_DIR DIRECT /end RECORD_LAYOUT
/begin COMPU_METHOD CU_DTCC_O_FAP_DISCONECTED "Conversion method for DTCc_o_FAP_Disconected" RAT_FUNC "%10.0" "o" COEFFS 0.000000 1.000000 0.000000 0.000000 0.000000 1.000000 /end COMPU_METHOD
/* Scalar calibration for DDE 'DTCc_o_FAP_HPress'. */
/begin CHARACTERISTIC DTCc_o_FAP_HPress "Override flag" VALUE 0x8c120 RL_DTCC_O_FAP_HPRESS 1.000000 CU_DTCC_O_FAP_HPRESS 0.000000 1.000000 BYTE_ORDER MSB_FIRST /end CHARACTERISTIC
/begin RECORD_LAYOUT RL_DTCC_O_FAP_HPRESS FNC_VALUES 1 UBYTE COLUMN_DIR DIRECT /end RECORD_LAYOUT
/begin COMPU_METHOD CU_DTCC_O_FAP_HPRESS "Conversion method for DTCc_o_FAP_HPress" RAT_FUNC "%10.0" "o" COEFFS 0.000000 1.000000 0.000000 0.000000 0.000000 1.000000 /end COMPU_METHOD
/* Scalar calibration for DDE 'DTCc_o_FalloCamShaft'. */
/begin CHARACTERISTIC DTCc_o_FalloCamShaft "Override value" VALUE 0x8c4f0 RL_DTCC_O_FALLOCAMSHAFT 1.000000 CU_DTCC_O_FALLOCAMSHAFT 0.000000 1.000000 BYTE_ORDER MSB_FIRST /end CHARACTERISTIC
/begin RECORD_LAYOUT RL_DTCC_O_FALLOCAMSHAFT FNC_VALUES 1 UBYTE COLUMN_DIR DIRECT /end RECORD_LAYOUT
/begin COMPU_METHOD CU_DTCC_O_FALLOCAMSHAFT "Conversion method for DTCc_o_FalloCamShaft" RAT_FUNC "%10.0" "o" COEFFS 0.000000 1.000000 0.000000 0.000000 0.000000 1.000000 /end COMPU_METHOD
/* Scalar calibration for DDE 'DTCc_o_FalloCramShaft'. */
/begin CHARACTERISTIC DTCc_o_FalloCramShaft "Override value" VALUE 0x8c4ce RL_DTCC_O_FALLOCRAMSHAFT 1.000000 CU_DTCC_O_FALLOCRAMSHAFT 0.000000 1.000000 BYTE_ORDER MSB_FIRST /end CHARACTERISTIC
/begin RECORD_LAYOUT RL_DTCC_O_FALLOCRAMSHAFT FNC_VALUES 1 UBYTE COLUMN_DIR DIRECT /end RECORD_LAYOUT
/begin COMPU_METHOD CU_DTCC_O_FALLOCRAMSHAFT "Conversion method for DTCc_o_FalloCramShaft" RAT_FUNC "%10.0" "o" COEFFS 0.000000 1.000000 0.000000 0.000000 0.000000 1.000000 /end COMPU_METHOD
/* Scalar calibration for DDE 'DTCc_o_GLP1_HVoltage'. */
/begin CHARACTERISTIC DTCc_o_GLP1_HVoltage "Override value" VALUE 0x8c148 RL_DTCC_O_GLP1_HVOLTAGE 1.000000 CU_DTCC_O_GLP1_HVOLTAGE 0.000000 1.000000 BYTE_ORDER MSB_FIRST /end CHARACTERISTIC
/begin RECORD_LAYOUT RL_DTCC_O_GLP1_HVOLTAGE FNC_VALUES 1 UBYTE COLUMN_DIR DIRECT /end RECORD_LAYOUT
/begin COMPU_METHOD CU_DTCC_O_GLP1_HVOLTAGE "Conversion method for DTCc_o_GLP1_HVoltage" RAT_FUNC "%10.0" "o" COEFFS 0.000000 1.000000 0.000000 0.000000 0.000000 1.000000 /end COMPU_METHOD
/* Scalar calibration for DDE 'DTCc_o_GLP2_HVoltage'. */
/begin CHARACTERISTIC DTCc_o_GLP2_HVoltage "Override value" VALUE 0x8c158 RL_DTCC_O_GLP2_HVOLTAGE 1.000000 CU_DTCC_O_GLP2_HVOLTAGE 0.000000 1.000000 BYTE_ORDER MSB_FIRST /end CHARACTERISTIC
/begin RECORD_LAYOUT RL_DTCC_O_GLP2_HVOLTAGE FNC_VALUES 1 UBYTE COLUMN_DIR DIRECT /end RECORD_LAYOUT
/begin COMPU_METHOD CU_DTCC_O_GLP2_HVOLTAGE "Conversion method for DTCc_o_GLP2_HVoltage" RAT_FUNC "%10.0" "o" COEFFS 0.000000 1.000000 0.000000 0.000000 0.000000 1.000000 /end COMPU_METHOD
/* Scalar calibration for DDE 'DTCc_o_GLP_HPress'. */
/begin CHARACTERISTIC DTCc_o_GLP_HPress "Override value" VALUE 0x8c124 RL_DTCC_O_GLP_HPRESS 1.000000 CU_DTCC_O_GLP_HPRESS 0.000000 1.000000 BYTE_ORDER MSB_FIRST /end CHARACTERISTIC
/begin RECORD_LAYOUT RL_DTCC_O_GLP_HPRESS FNC_VALUES 1 UBYTE COLUMN_DIR DIRECT /end RECORD_LAYOUT
/begin COMPU_METHOD CU_DTCC_O_GLP_HPRESS "Conversion method for DTCc_o_GLP_HPress" RAT_FUNC "%10.0" "o" COEFFS 0.000000 1.000000 0.000000 0.000000 0.000000 1.000000 /end COMPU_METHOD
/* Scalar calibration for DDE 'DTCc_o_GLP_HTemp'. */
/begin CHARACTERISTIC DTCc_o_GLP_HTemp "Override value" VALUE 0x8c134 RL_DTCC_O_GLP_HTEMP 1.000000 CU_DTCC_O_GLP_HTEMP 0.000000 1.000000 BYTE_ORDER MSB_FIRST /end CHARACTERISTIC
/begin RECORD_LAYOUT RL_DTCC_O_GLP_HTEMP FNC_VALUES 1 UBYTE COLUMN_DIR DIRECT /end RECORD_LAYOUT
/begin COMPU_METHOD CU_DTCC_O_GLP_HTEMP "Conversion method for DTCc_o_GLP_HTemp" RAT_FUNC "%10.0" "o" COEFFS 0.000000 1.000000 0.000000 0.000000 0.000000 1.000000 /end COMPU_METHOD
/* Scalar calibration for DDE 'DTCc_o_GLP_LPress'. */
/begin CHARACTERISTIC DTCc_o_GLP_LPress "Override value" VALUE 0x8c128 RL_DTCC_O_GLP_LPRESS 1.000000 CU_DTCC_O_GLP_LPRESS 0.000000 1.000000 BYTE_ORDER MSB_FIRST /end CHARACTERISTIC
/begin RECORD_LAYOUT RL_DTCC_O_GLP_LPRESS FNC_VALUES 1 UBYTE COLUMN_DIR DIRECT /end RECORD_LAYOUT
/begin COMPU_METHOD CU_DTCC_O_GLP_LPRESS "Conversion method for DTCc_o_GLP_LPress" RAT_FUNC "%10.0" "o" COEFFS 0.000000 1.000000 0.000000 0.000000 0.000000 1.000000 /end COMPU_METHOD
/* Scalar calibration for DDE 'DTCc_o_GLP_LTemp'. */
/begin CHARACTERISTIC DTCc_o_GLP_LTemp "Override value" VALUE 0x8c136 RL_DTCC_O_GLP_LTEMP 1.000000 CU_DTCC_O_GLP_LTEMP 0.000000 1.000000 BYTE_ORDER MSB_FIRST /end CHARACTERISTIC
/begin RECORD_LAYOUT RL_DTCC_O_GLP_LTEMP FNC_VALUES 1 UBYTE COLUMN_DIR DIRECT /end RECORD_LAYOUT
/begin COMPU_METHOD CU_DTCC_O_GLP_LTEMP "Conversion method for DTCc_o_GLP_LTemp" RAT_FUNC "%10.0" "o" COEFFS 0.000000 1.000000 0.000000 0.000000 0.000000 1.000000 /end COMPU_METHOD
/* Scalar calibration for DDE 'DTCc_o_GLP_OL'. */
/begin CHARACTERISTIC DTCc_o_GLP_OL "Override value" VALUE 0x8c126 RL_DTCC_O_GLP_OL 1.000000 CU_DTCC_O_GLP_OL 0.000000 1.000000 BYTE_ORDER MSB_FIRST /end CHARACTERISTIC
/begin RECORD_LAYOUT RL_DTCC_O_GLP_OL FNC_VALUES 1 UBYTE COLUMN_DIR DIRECT /end RECORD_LAYOUT
/begin COMPU_METHOD CU_DTCC_O_GLP_OL "Conversion method for DTCc_o_GLP_OL" RAT_FUNC "%10.0" "o" COEFFS 0.000000 1.000000 0.000000 0.000000 0.000000 1.000000 /end COMPU_METHOD
/* Scalar calibration for DDE 'DTCc_o_GLP_TempHVoltage'. */
/begin CHARACTERISTIC DTCc_o_GLP_TempHVoltage "Override value" VALUE 0x8c130 RL_DTCC_O_GLP_TEMPHVOLTAGE 1.000000 CU_DTCC_O_GLP_TEMPHVOLTAGE 0.000000 1.000000 BYTE_ORDER MSB_FIRST /end CHARACTERISTIC
/begin RECORD_LAYOUT RL_DTCC_O_GLP_TEMPHVOLTAGE FNC_VALUES 1 UBYTE COLUMN_DIR DIRECT /end RECORD_LAYOUT
/begin COMPU_METHOD CU_DTCC_O_GLP_TEMPHVOLTAGE "Conversion method for DTCc_o_GLP_TempHVoltage" RAT_FUNC "%10.0" "o" COEFFS 0.000000 1.000000 0.000000 0.000000 0.000000 1.000000 /end COMPU_METHOD
/* Scalar calibration for DDE 'DTCc_o_GLP_TempLVoltage'. */
/begin CHARACTERISTIC DTCc_o_GLP_TempLVoltage "Override value" VALUE 0x8c132 RL_DTCC_O_GLP_TEMPLVOLTAGE 1.000000 CU_DTCC_O_GLP_TEMPLVOLTAGE 0.000000 1.000000 BYTE_ORDER MSB_FIRST /end CHARACTERISTIC
/begin RECORD_LAYOUT RL_DTCC_O_GLP_TEMPLVOLTAGE FNC_VALUES 1 UBYTE COLUMN_DIR DIRECT /end RECORD_LAYOUT
/begin COMPU_METHOD CU_DTCC_O_GLP_TEMPLVOLTAGE "Conversion method for DTCc_o_GLP_TempLVoltage" RAT_FUNC "%10.0" "o" COEFFS 0.000000 1.000000 0.000000 0.000000 0.000000 1.000000 /end COMPU_METHOD
/* Scalar calibration for DDE 'DTCc_o_HeatersA_OL'. */
/begin CHARACTERISTIC DTCc_o_HeatersA_OL "Override value" VALUE 0x8c34a RL_DTCC_O_HEATERSA_OL 1.000000 CU_DTCC_O_HEATERSA_OL 0.000000 1.000000 BYTE_ORDER MSB_FIRST /end CHARACTERISTIC
/begin RECORD_LAYOUT RL_DTCC_O_HEATERSA_OL FNC_VALUES 1 UBYTE COLUMN_DIR DIRECT /end RECORD_LAYOUT
/begin COMPU_METHOD CU_DTCC_O_HEATERSA_OL "Conversion method for DTCc_o_HeatersA_OL" RAT_FUNC "%10.0" "o" COEFFS 0.000000 1.000000 0.000000 0.000000 0.000000 1.000000 /end COMPU_METHOD
/* Scalar calibration for DDE 'DTCc_o_HeatersA_SB'. */
/begin CHARACTERISTIC DTCc_o_HeatersA_SB "Override value" VALUE 0x8c350 RL_DTCC_O_HEATERSA_SB 1.000000 CU_DTCC_O_HEATERSA_SB 0.000000 1.000000 BYTE_ORDER MSB_FIRST /end CHARACTERISTIC
/begin RECORD_LAYOUT RL_DTCC_O_HEATERSA_SB FNC_VALUES 1 UBYTE COLUMN_DIR DIRECT /end RECORD_LAYOUT
/begin COMPU_METHOD CU_DTCC_O_HEATERSA_SB "Conversion method for DTCc_o_HeatersA_SB" RAT_FUNC "%10.0" "o" COEFFS 0.000000 1.000000 0.000000 0.000000 0.000000 1.000000 /end COMPU_METHOD
/* Scalar calibration for DDE 'DTCc_o_HeatersA_SG'. */
/begin CHARACTERISTIC DTCc_o_HeatersA_SG "Override value" VALUE 0x8c34e RL_DTCC_O_HEATERSA_SG 1.000000 CU_DTCC_O_HEATERSA_SG 0.000000 1.000000 BYTE_ORDER MSB_FIRST /end CHARACTERISTIC
/begin RECORD_LAYOUT RL_DTCC_O_HEATERSA_SG FNC_VALUES 1 UBYTE COLUMN_DIR DIRECT /end RECORD_LAYOUT
/begin COMPU_METHOD CU_DTCC_O_HEATERSA_SG "Conversion method for DTCc_o_HeatersA_SG" RAT_FUNC "%10.0" "o" COEFFS 0.000000 1.000000 0.000000 0.000000 0.000000 1.000000 /end COMPU_METHOD
/* Scalar calibration for DDE 'DTCc_o_KNKButaneThr'. */
/begin CHARACTERISTIC DTCc_o_KNKButaneThr "(not defined)" VALUE 0x8ad84 RL_DTCC_O_KNKBUTANETHR 1.000000 CU_DTCC_O_KNKBUTANETHR 0.000000 1.000000 BYTE_ORDER MSB_FIRST /end CHARACTERISTIC
/begin RECORD_LAYOUT RL_DTCC_O_KNKBUTANETHR FNC_VALUES 1 UBYTE COLUMN_DIR DIRECT /end RECORD_LAYOUT
/begin COMPU_METHOD CU_DTCC_O_KNKBUTANETHR "Conversion method for DTCc_o_KNKButaneThr" RAT_FUNC "%10.0" "b" COEFFS 0.000000 1.000000 0.000000 0.000000 0.000000 1.000000 /end COMPU_METHOD
/* Scalar calibration for DDE 'DTCc_o_KNOCK_Cyl1'. */
/begin CHARACTERISTIC DTCc_o_KNOCK_Cyl1 "Override value" VALUE 0x8ad81 RL_DTCC_O_KNOCK_CYL1 1.000000 CU_DTCC_O_KNOCK_CYL1 0.000000 1.000000 BYTE_ORDER MSB_FIRST /end CHARACTERISTIC
/begin RECORD_LAYOUT RL_DTCC_O_KNOCK_CYL1 FNC_VALUES 1 UBYTE COLUMN_DIR DIRECT /end RECORD_LAYOUT
/begin COMPU_METHOD CU_DTCC_O_KNOCK_CYL1 "Conversion method for DTCc_o_KNOCK_Cyl1" RAT_FUNC "%10.0" "o" COEFFS 0.000000 1.000000 0.000000 0.000000 0.000000 1.000000 /end COMPU_METHOD
/* Scalar calibration for DDE 'DTCc_o_KNOCK_Cyl2'. */
/begin CHARACTERISTIC DTCc_o_KNOCK_Cyl2 "Override value" VALUE 0x8ad90 RL_DTCC_O_KNOCK_CYL2 1.000000 CU_DTCC_O_KNOCK_CYL2 0.000000 1.000000 BYTE_ORDER MSB_FIRST /end CHARACTERISTIC
/begin RECORD_LAYOUT RL_DTCC_O_KNOCK_CYL2 FNC_VALUES 1 UBYTE COLUMN_DIR DIRECT /end RECORD_LAYOUT
/begin COMPU_METHOD CU_DTCC_O_KNOCK_CYL2 "Conversion method for DTCc_o_KNOCK_Cyl2" RAT_FUNC "%10.0" "o" COEFFS 0.000000 1.000000 0.000000 0.000000 0.000000 1.000000 /end COMPU_METHOD
/* Scalar calibration for DDE 'DTCc_o_KNOCK_Cyl3'. */
/begin CHARACTERISTIC DTCc_o_KNOCK_Cyl3 "Override value" VALUE 0x8ad92 RL_DTCC_O_KNOCK_CYL3 1.000000 CU_DTCC_O_KNOCK_CYL3 0.000000 1.000000 BYTE_ORDER MSB_FIRST /end CHARACTERISTIC
/begin RECORD_LAYOUT RL_DTCC_O_KNOCK_CYL3 FNC_VALUES 1 UBYTE COLUMN_DIR DIRECT /end RECORD_LAYOUT
/begin COMPU_METHOD CU_DTCC_O_KNOCK_CYL3 "Conversion method for DTCc_o_KNOCK_Cyl3" RAT_FUNC "%10.0" "o" COEFFS 0.000000 1.000000 0.000000 0.000000 0.000000 1.000000 /end COMPU_METHOD
/* Scalar calibration for DDE 'DTCc_o_KNOCK_Cyl4'. */
/begin CHARACTERISTIC DTCc_o_KNOCK_Cyl4 "Override value" VALUE 0x8ad94 RL_DTCC_O_KNOCK_CYL4 1.000000 CU_DTCC_O_KNOCK_CYL4 0.000000 1.000000 BYTE_ORDER MSB_FIRST /end CHARACTERISTIC
/begin RECORD_LAYOUT RL_DTCC_O_KNOCK_CYL4 FNC_VALUES 1 UBYTE COLUMN_DIR DIRECT /end RECORD_LAYOUT
/begin COMPU_METHOD CU_DTCC_O_KNOCK_CYL4 "Conversion method for DTCc_o_KNOCK_Cyl4" RAT_FUNC "%10.0" "o" COEFFS 0.000000 1.000000 0.000000 0.000000 0.000000 1.000000 /end COMPU_METHOD
/* Scalar calibration for DDE 'DTCc_o_LB11CTFail'. */
/begin CHARACTERISTIC DTCc_o_LB11CTFail "Override value" VALUE 0x8c34c RL_DTCC_O_LB11CTFAIL 1.000000 CU_DTCC_O_LB11CTFAIL 0.000000 1.000000 BYTE_ORDER MSB_FIRST /end CHARACTERISTIC
/begin RECORD_LAYOUT RL_DTCC_O_LB11CTFAIL FNC_VALUES 1 UBYTE COLUMN_DIR DIRECT /end RECORD_LAYOUT
/begin COMPU_METHOD CU_DTCC_O_LB11CTFAIL "Conversion method for DTCc_o_LB11CTFail" RAT_FUNC "%10.0" "o" COEFFS 0.000000 1.000000 0.000000 0.000000 0.000000 1.000000 /end COMPU_METHOD
/* Scalar calibration for DDE 'DTCc_o_LB12OL'. */
/begin CHARACTERISTIC DTCc_o_LB12OL "Override value" VALUE 0x8c0a0 RL_DTCC_O_LB12OL 1.000000 CU_DTCC_O_LB12OL 0.000000 1.000000 BYTE_ORDER MSB_FIRST /end CHARACTERISTIC
/begin RECORD_LAYOUT RL_DTCC_O_LB12OL FNC_VALUES 1 UBYTE COLUMN_DIR DIRECT /end RECORD_LAYOUT
/begin COMPU_METHOD CU_DTCC_O_LB12OL "Conversion method for DTCc_o_LB12OL" RAT_FUNC "%10.0" "o" COEFFS 0.000000 1.000000 0.000000 0.000000 0.000000 1.000000 /end COMPU_METHOD
/* Scalar calibration for DDE 'DTCc_o_LB12SB'. */
/begin CHARACTERISTIC DTCc_o_LB12SB "Override value" VALUE 0x8c0b8 RL_DTCC_O_LB12SB 1.000000 CU_DTCC_O_LB12SB 0.000000 1.000000 BYTE_ORDER MSB_FIRST /end CHARACTERISTIC
/begin RECORD_LAYOUT RL_DTCC_O_LB12SB FNC_VALUES 1 UBYTE COLUMN_DIR DIRECT /end RECORD_LAYOUT
/begin COMPU_METHOD CU_DTCC_O_LB12SB "Conversion method for DTCc_o_LB12SB" RAT_FUNC "%10.0" "o" COEFFS 0.000000 1.000000 0.000000 0.000000 0.000000 1.000000 /end COMPU_METHOD
/* Scalar calibration for DDE 'DTCc_o_LambdaA_SB'. */
/begin CHARACTERISTIC DTCc_o_LambdaA_SB "Override value" VALUE 0x8c348 RL_DTCC_O_LAMBDAA_SB 1.000000 CU_DTCC_O_LAMBDAA_SB 0.000000 1.000000 BYTE_ORDER MSB_FIRST /end CHARACTERISTIC
/begin RECORD_LAYOUT RL_DTCC_O_LAMBDAA_SB FNC_VALUES 1 UBYTE COLUMN_DIR DIRECT /end RECORD_LAYOUT
/begin COMPU_METHOD CU_DTCC_O_LAMBDAA_SB "Conversion method for DTCc_o_LambdaA_SB" RAT_FUNC "%10.0" "o" COEFFS 0.000000 1.000000 0.000000 0.000000 0.000000 1.000000 /end COMPU_METHOD
/* Scalar calibration for DDE 'DTCc_o_LambdaA_SG'. */
/begin CHARACTERISTIC DTCc_o_LambdaA_SG "Override value" VALUE 0x8c352 RL_DTCC_O_LAMBDAA_SG 1.000000 CU_DTCC_O_LAMBDAA_SG 0.000000 1.000000 BYTE_ORDER MSB_FIRST /end CHARACTERISTIC
/begin RECORD_LAYOUT RL_DTCC_O_LAMBDAA_SG FNC_VALUES 1 UBYTE COLUMN_DIR DIRECT /end RECORD_LAYOUT
/begin COMPU_METHOD CU_DTCC_O_LAMBDAA_SG "Conversion method for DTCc_o_LambdaA_SG" RAT_FUNC "%10.0" "o" COEFFS 0.000000 1.000000 0.000000 0.000000 0.000000 1.000000 /end COMPU_METHOD
/* Scalar calibration for DDE 'DTCc_o_LambdaB11NOTValid'. */
/begin CHARACTERISTIC DTCc_o_LambdaB11NOTValid "Override value" VALUE 0x8c354 RL_DTCC_O_LAMBDAB11NOTVALID 1.000000 CU_DTCC_O_LAMBDAB11NOTVALID 0.000000 1.000000 BYTE_ORDER MSB_FIRST /end CHARACTERISTIC
/begin RECORD_LAYOUT RL_DTCC_O_LAMBDAB11NOTVALID FNC_VALUES 1 UBYTE COLUMN_DIR DIRECT /end RECORD_LAYOUT
/begin COMPU_METHOD CU_DTCC_O_LAMBDAB11NOTVALID "Conversion method for DTCc_o_LambdaB11NOTValid" RAT_FUNC "%10.0" "o" COEFFS 0.000000 1.000000 0.000000 0.000000 0.000000 1.000000 /end COMPU_METHOD
/* Scalar calibration for DDE 'DTCc_o_MAPAfterThInfraPress'. */
/begin CHARACTERISTIC DTCc_o_MAPAfterThInfraPress "Override value" VALUE 0x8c060 RL_DTCC_O_MAPAFTERTHINFRAPRESS 1.000000 CU_DTCC_O_MAPAFTERTHINFRAPRESS 0.000000 1.000000 BYTE_ORDER MSB_FIRST /end CHARACTERISTIC
/begin RECORD_LAYOUT RL_DTCC_O_MAPAFTERTHINFRAPRESS FNC_VALUES 1 UBYTE COLUMN_DIR DIRECT /end RECORD_LAYOUT
/begin COMPU_METHOD CU_DTCC_O_MAPAFTERTHINFRAPRESS "Conversion method for DTCc_o_MAPAfterThInfraPress" RAT_FUNC "%10.0" "o" COEFFS 0.000000 1.000000 0.000000 0.000000 0.000000 1.000000 /end COMPU_METHOD
/* Scalar calibration for DDE 'DTCc_o_MAPAfterThOverPress'. */
/begin CHARACTERISTIC DTCc_o_MAPAfterThOverPress "Override value" VALUE 0x8c050 RL_DTCC_O_MAPAFTERTHOVERPRESS 1.000000 CU_DTCC_O_MAPAFTERTHOVERPRESS 0.000000 1.000000 BYTE_ORDER MSB_FIRST /end CHARACTERISTIC
/begin RECORD_LAYOUT RL_DTCC_O_MAPAFTERTHOVERPRESS FNC_VALUES 1 UBYTE COLUMN_DIR DIRECT /end RECORD_LAYOUT
/begin COMPU_METHOD CU_DTCC_O_MAPAFTERTHOVERPRESS "Conversion method for DTCc_o_MAPAfterThOverPress" RAT_FUNC "%10.0" "o" COEFFS 0.000000 1.000000 0.000000 0.000000 0.000000 1.000000 /end COMPU_METHOD
/end MODULE
/end PROJECT
