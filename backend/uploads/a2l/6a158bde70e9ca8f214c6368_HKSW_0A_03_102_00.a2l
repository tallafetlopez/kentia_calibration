ASAP2_VERSION 1 31
/begin PROJECT M670_Engine_Control_1.2.0_M670_000 "BeGas B430LG Turbocharged engine"
/begin HEADER "Begas Motor 2017-2022 (c)" VERSION "1_2_0" /end HEADER
/begin MODULE OpenECU_M670_000 ""
/* Scalar measurable for DDE 'ADM_NU_Alpha'. */
/begin MEASUREMENT ADM_NU_Alpha "Displayable" FLOAT32_IEEE CU_ADM_NU_ALPHA 1 100 0.0 0.0 ECU_ADDRESS 0x40003390 BYTE_ORDER MSB_FIRST /end MEASUREMENT
/begin COMPU_METHOD CU_ADM_NU_ALPHA "Conversion method for ADM_NU_Alpha" RAT_FUNC "%10.2" "NU" COEFFS 0.000000 1.000000 0.000000 0.000000 0.000000 1.000000 /end COMPU_METHOD
/* Scalar measurable for DDE 'ADM_NU_BoostIGain'. */
/begin MEASUREMENT ADM_NU_BoostIGain "Integral gain for MAF target feedback control" FLOAT32_IEEE CU_ADM_NU_BOOSTIGAIN 1 100 0.0 0.0 ECU_ADDRESS 0x400033cc BYTE_ORDER MSB_FIRST /end MEASUREMENT
/begin COMPU_METHOD CU_ADM_NU_BOOSTIGAIN "Conversion method for ADM_NU_BoostIGain" RAT_FUNC "%10.3" "NU" COEFFS 0.000000 1.000000 0.000000 0.000000 0.000000 1.000000 /end COMPU_METHOD
/* Scalar measurable for DDE 'ADM_NU_ComprInDens'. */
/begin MEASUREMENT ADM_NU_ComprInDens "(kg/m3) Air density estimate" FLOAT32_IEEE CU_ADM_NU_COMPRINDENS 1 100 0.0 0.0 ECU_ADDRESS 0x4000343c BYTE_ORDER MSB_FIRST /end MEASUREMENT
/begin COMPU_METHOD CU_ADM_NU_COMPRINDENS "Conversion method for ADM_NU_ComprInDens" RAT_FUNC "%10.3" "NU" COEFFS 0.000000 1.000000 0.000000 0.000000 0.000000 1.000000 /end COMPU_METHOD
/* Scalar measurable for DDE 'ADM_NU_ComprOutDens'. */
/begin MEASUREMENT ADM_NU_ComprOutDens "(kg/m3) Air density estimate" FLOAT32_IEEE CU_ADM_NU_COMPROUTDENS 1 100 0.0 0.0 ECU_ADDRESS 0x40003428 BYTE_ORDER MSB_FIRST /end MEASUREMENT
/begin COMPU_METHOD CU_ADM_NU_COMPROUTDENS "Conversion method for ADM_NU_ComprOutDens" RAT_FUNC "%10.3" "NU" COEFFS 0.000000 1.000000 0.000000 0.000000 0.000000 1.000000 /end COMPU_METHOD
/* Scalar measurable for DDE 'ADM_NU_ComprPressRatio'. */
/begin MEASUREMENT ADM_NU_ComprPressRatio "Estimated pressure ratio" FLOAT32_IEEE CU_ADM_NU_COMPRPRESSRATIO 1 100 0.0 0.0 ECU_ADDRESS 0x40003418 BYTE_ORDER MSB_FIRST /end MEASUREMENT
/begin COMPU_METHOD CU_ADM_NU_COMPRPRESSRATIO "Conversion method for ADM_NU_ComprPressRatio" RAT_FUNC "%10.2" "NU" COEFFS 0.000000 1.000000 0.000000 0.000000 0.000000 1.000000 /end COMPU_METHOD
/* Scalar measurable for DDE 'ADM_NU_ComprSurgeProx'. */
/begin MEASUREMENT ADM_NU_ComprSurgeProx "Pressure-ratio-delta between current operation and surge limit" FLOAT32_IEEE CU_ADM_NU_COMPRSURGEPROX 1 100 0.0 0.0 ECU_ADDRESS 0x40003414 BYTE_ORDER MSB_FIRST /end MEASUREMENT
/begin COMPU_METHOD CU_ADM_NU_COMPRSURGEPROX "Conversion method for ADM_NU_ComprSurgeProx" RAT_FUNC "%10.2" "NU" COEFFS 0.000000 1.000000 0.000000 0.000000 0.000000 1.000000 /end COMPU_METHOD
/* Scalar measurable for DDE 'ADM_NU_ISFC'. */
/begin MEASUREMENT ADM_NU_ISFC "(not defined)" FLOAT32_IEEE CU_ADM_NU_ISFC 1 100 0.0 0.0 ECU_ADDRESS 0x400033e4 BYTE_ORDER MSB_FIRST /end MEASUREMENT
/begin COMPU_METHOD CU_ADM_NU_ISFC "Conversion method for ADM_NU_ISFC" RAT_FUNC "%10.2" "NU" COEFFS 0.000000 1.000000 0.000000 0.000000 0.000000 1.000000 /end COMPU_METHOD
/* Scalar measurable for DDE 'ADM_NU_SurgePressRatio'. */
/begin MEASUREMENT ADM_NU_SurgePressRatio "map output displayable" FLOAT32_IEEE CU_ADM_NU_SURGEPRESSRATIO 1 100 0.0 0.0 ECU_ADDRESS 0x40003440 BYTE_ORDER MSB_FIRST /end MEASUREMENT
/begin COMPU_METHOD CU_ADM_NU_SURGEPRESSRATIO "Conversion method for ADM_NU_SurgePressRatio" RAT_FUNC "%10.2" "NU" COEFFS 0.000000 1.000000 0.000000 0.000000 0.000000 1.000000 /end COMPU_METHOD
/* Scalar measurable for DDE 'ADM_NU_ThrottleIGain'. */
/begin MEASUREMENT ADM_NU_ThrottleIGain "Integral gain for MAF target feedback control" FLOAT32_IEEE CU_ADM_NU_THROTTLEIGAIN 1 100 0.0 0.0 ECU_ADDRESS 0x400033b4 BYTE_ORDER MSB_FIRST /end MEASUREMENT
/begin COMPU_METHOD CU_ADM_NU_THROTTLEIGAIN "Conversion method for ADM_NU_ThrottleIGain" RAT_FUNC "%10.3" "NU" COEFFS 0.000000 1.000000 0.000000 0.000000 0.000000 1.000000 /end COMPU_METHOD
/* Scalar measurable for DDE 'ADM_RPM_TurSpdCorr'. */
/begin MEASUREMENT ADM_RPM_TurSpdCorr "Turboshaft speed corrected to standard compressor condition" FLOAT32_IEEE CU_ADM_RPM_TURSPDCORR 1 100 0.0 0.0 ECU_ADDRESS 0x40003410 BYTE_ORDER MSB_FIRST /end MEASUREMENT
/begin COMPU_METHOD CU_ADM_RPM_TURSPDCORR "Conversion method for ADM_RPM_TurSpdCorr" RAT_FUNC "%10.0" "RPM" COEFFS 0.000000 1.000000 0.000000 0.000000 0.000000 1.000000 /end COMPU_METHOD
/* Scalar measurable for DDE 'ADM_b_ComprSurge'. */
/begin MEASUREMENT ADM_b_ComprSurge "Surge detection result" UBYTE CU_ADM_B_COMPRSURGE 1 100 0.0 1.0 ECU_ADDRESS 0x40002ebd BYTE_ORDER MSB_FIRST /end MEASUREMENT
/begin COMPU_METHOD CU_ADM_B_COMPRSURGE "Conversion method for ADM_b_ComprSurge" RAT_FUNC "%10.0" "b" COEFFS 0.000000 1.000000 0.000000 0.000000 0.000000 1.000000 /end COMPU_METHOD
/* Scalar measurable for DDE 'ADM_b_TurOverspeed'. */
/begin MEASUREMENT ADM_b_TurOverspeed "Status displayable" UBYTE CU_ADM_B_TUROVERSPEED 1 100 0.0 1.0 ECU_ADDRESS 0x40002e90 BYTE_ORDER MSB_FIRST /end MEASUREMENT
/begin COMPU_METHOD CU_ADM_B_TUROVERSPEED "Conversion method for ADM_b_TurOverspeed" RAT_FUNC "%10.0" "b" COEFFS 0.000000 1.000000 0.000000 0.000000 0.000000 1.000000 /end COMPU_METHOD
/* Scalar measurable for DDE 'ADM_b_TurboCancelThrottleITerm'. */
/begin MEASUREMENT ADM_b_TurboCancelThrottleITerm "Status displayable" UBYTE CU_ADM_B_TURBOCANCELTHROTTLEIT0 1 100 0.0 1.0 ECU_ADDRESS 0x40002eba BYTE_ORDER MSB_FIRST /end MEASUREMENT
/begin COMPU_METHOD CU_ADM_B_TURBOCANCELTHROTTLEIT0 "Conversion method for ADM_b_TurboCancelThrottleITerm" RAT_FUNC "%10.0" "b" COEFFS 0.000000 1.000000 0.000000 0.000000 0.000000 1.000000 /end COMPU_METHOD
/* Scalar measurable for DDE 'ADM_b_UseTurbo'. */
/begin MEASUREMENT ADM_b_UseTurbo "Flag to latch throttle control (ITerm) because Turbo is regulating the mass flow" UBYTE CU_ADM_B_USETURBO 1 100 0.0 1.0 ECU_ADDRESS 0x40002ebb BYTE_ORDER MSB_FIRST /end MEASUREMENT
/begin COMPU_METHOD CU_ADM_B_USETURBO "Conversion method for ADM_b_UseTurbo" RAT_FUNC "%10.0" "b" COEFFS 0.000000 1.000000 0.000000 0.000000 0.000000 1.000000 /end COMPU_METHOD
/* Scalar measurable for DDE 'ADM_deg_EquationBasedThCorr'. */
/begin MEASUREMENT ADM_deg_EquationBasedThCorr "Displayable" FLOAT32_IEEE CU_ADM_DEG_EQUATIONBASEDTHCORR 1 100 0.0 0.0 ECU_ADDRESS 0x4000338c BYTE_ORDER MSB_FIRST /end MEASUREMENT
/begin COMPU_METHOD CU_ADM_DEG_EQUATIONBASEDTHCORR "Conversion method for ADM_deg_EquationBasedThCorr" RAT_FUNC "%10.1" "deg" COEFFS 0.000000 1.000000 0.000000 0.000000 0.000000 1.000000 /end COMPU_METHOD
/* Scalar measurable for DDE 'ADM_deg_ThrottleTrgt'. */
/begin MEASUREMENT ADM_deg_ThrottleTrgt "Corrected Throttle Angle request output" FLOAT32_IEEE CU_ADM_DEG_THROTTLETRGT 1 100 0.0 0.0 ECU_ADDRESS 0x4000333c BYTE_ORDER MSB_FIRST /end MEASUREMENT
/begin COMPU_METHOD CU_ADM_DEG_THROTTLETRGT "Conversion method for ADM_deg_ThrottleTrgt" RAT_FUNC "%10.2" "deg" COEFFS 0.000000 1.000000 0.000000 0.000000 0.000000 1.000000 /end COMPU_METHOD
/* Scalar measurable for DDE 'ADM_deg_ThrottleTrgtRaw'. */
/begin MEASUREMENT ADM_deg_ThrottleTrgtRaw "Raw throttle blade angle target" FLOAT32_IEEE CU_ADM_DEG_THROTTLETRGTRAW 1 100 0.0 0.0 ECU_ADDRESS 0x4000339c BYTE_ORDER MSB_FIRST /end MEASUREMENT
/begin COMPU_METHOD CU_ADM_DEG_THROTTLETRGTRAW "Conversion method for ADM_deg_ThrottleTrgtRaw" RAT_FUNC "%10.2" "deg" COEFFS 0.000000 1.000000 0.000000 0.000000 0.000000 1.000000 /end COMPU_METHOD
/* Scalar measurable for DDE 'ADM_deg_VCP_ThCorr'. */
/begin MEASUREMENT ADM_deg_VCP_ThCorr "Throttle angle disturbance caused by VCP" FLOAT32_IEEE CU_ADM_DEG_VCP_THCORR 1 100 0.0 0.0 ECU_ADDRESS 0x40003388 BYTE_ORDER MSB_FIRST /end MEASUREMENT
/begin COMPU_METHOD CU_ADM_DEG_VCP_THCORR "Conversion method for ADM_deg_VCP_ThCorr" RAT_FUNC "%10.1" "deg" COEFFS 0.000000 1.000000 0.000000 0.000000 0.000000 1.000000 /end COMPU_METHOD
/* Scalar measurable for DDE 'ADM_gps_AirDemandRAW'. */
/begin MEASUREMENT ADM_gps_AirDemandRAW "Torque request air demand" FLOAT32_IEEE CU_ADM_GPS_AIRDEMANDRAW 1 100 0.0 0.0 ECU_ADDRESS 0x40003200 BYTE_ORDER MSB_FIRST /end MEASUREMENT
/begin COMPU_METHOD CU_ADM_GPS_AIRDEMANDRAW "Conversion method for ADM_gps_AirDemandRAW" RAT_FUNC "%10.3" "gps" COEFFS 0.000000 1.000000 0.000000 0.000000 0.000000 1.000000 /end COMPU_METHOD
/* Scalar measurable for DDE 'ADM_gps_MAF_Corr'. */
/begin MEASUREMENT ADM_gps_MAF_Corr "Airflow corrected to standard compressor condition" FLOAT32_IEEE CU_ADM_GPS_MAF_CORR 1 100 0.0 0.0 ECU_ADDRESS 0x40003444 BYTE_ORDER MSB_FIRST /end MEASUREMENT
/begin COMPU_METHOD CU_ADM_GPS_MAF_CORR "Conversion method for ADM_gps_MAF_Corr" RAT_FUNC "%10.2" "gps" COEFFS 0.000000 1.000000 0.000000 0.000000 0.000000 1.000000 /end COMPU_METHOD
/* Scalar measurable for DDE 'ADM_gps_MAF_Trgt'. */
/begin MEASUREMENT ADM_gps_MAF_Trgt "Target mass air flow" FLOAT32_IEEE CU_ADM_GPS_MAF_TRGT 1 100 0.0 0.0 ECU_ADDRESS 0x400033d8 BYTE_ORDER MSB_FIRST /end MEASUREMENT
/begin COMPU_METHOD CU_ADM_GPS_MAF_TRGT "Conversion method for ADM_gps_MAF_Trgt" RAT_FUNC "%10.1" "gps" COEFFS 0.000000 1.000000 0.000000 0.000000 0.000000 1.000000 /end COMPU_METHOD
/* Scalar measurable for DDE 'ADM_gps_MAF_TrgtErr'. */
/begin MEASUREMENT ADM_gps_MAF_TrgtErr "MAF target error" FLOAT32_IEEE CU_ADM_GPS_MAF_TRGTERR 1 100 0.0 0.0 ECU_ADDRESS 0x400033d4 BYTE_ORDER MSB_FIRST /end MEASUREMENT
/begin COMPU_METHOD CU_ADM_GPS_MAF_TRGTERR "Conversion method for ADM_gps_MAF_TrgtErr" RAT_FUNC "%10.2" "gps" COEFFS 0.000000 1.000000 0.000000 0.000000 0.000000 1.000000 /end COMPU_METHOD
/* Scalar measurable for DDE 'ADM_gps_NominalMAF'. */
/begin MEASUREMENT ADM_gps_NominalMAF "Mass-flow reference for zero VCP" FLOAT32_IEEE CU_ADM_GPS_NOMINALMAF 1 100 0.0 0.0 ECU_ADDRESS 0x40003394 BYTE_ORDER MSB_FIRST /end MEASUREMENT
/begin COMPU_METHOD CU_ADM_GPS_NOMINALMAF "Conversion method for ADM_gps_NominalMAF" RAT_FUNC "%10.1" "gps" COEFFS 0.000000 1.000000 0.000000 0.000000 0.000000 1.000000 /end COMPU_METHOD
/* Scalar measurable for DDE 'ADM_gps_TrgtFuelFlow'. */
/begin MEASUREMENT ADM_gps_TrgtFuelFlow "Target fuel flow" FLOAT32_IEEE CU_ADM_GPS_TRGTFUELFLOW 1 100 0.0 0.0 ECU_ADDRESS 0x400033dc BYTE_ORDER MSB_FIRST /end MEASUREMENT
/begin COMPU_METHOD CU_ADM_GPS_TRGTFUELFLOW "Conversion method for ADM_gps_TrgtFuelFlow" RAT_FUNC "%10.3" "gps" COEFFS 0.000000 1.000000 0.000000 0.000000 0.000000 1.000000 /end COMPU_METHOD
/* Scalar measurable for DDE 'ADM_kPa_BoostFB'. */
/begin MEASUREMENT ADM_kPa_BoostFB "MAF PI control effort" FLOAT32_IEEE CU_ADM_KPA_BOOSTFB 1 100 0.0 0.0 ECU_ADDRESS 0x400033c4 BYTE_ORDER MSB_FIRST /end MEASUREMENT
/begin COMPU_METHOD CU_ADM_KPA_BOOSTFB "Conversion method for ADM_kPa_BoostFB" RAT_FUNC "%10.2" "kPa" COEFFS 0.000000 1.000000 0.000000 0.000000 0.000000 1.000000 /end COMPU_METHOD
/* Scalar measurable for DDE 'ADM_kPa_BoostFF'. */
/begin MEASUREMENT ADM_kPa_BoostFF "Feedforward manifold pressure target" FLOAT32_IEEE CU_ADM_KPA_BOOSTFF 1 100 0.0 0.0 ECU_ADDRESS 0x400033c0 BYTE_ORDER MSB_FIRST /end MEASUREMENT
/begin COMPU_METHOD CU_ADM_KPA_BOOSTFF "Conversion method for ADM_kPa_BoostFF" RAT_FUNC "%10.2" "kPa" COEFFS 0.000000 1.000000 0.000000 0.000000 0.000000 1.000000 /end COMPU_METHOD
/* Scalar measurable for DDE 'ADM_kPa_BoostITerm'. */
/begin MEASUREMENT ADM_kPa_BoostITerm "Integral effort for MAF target feedback control" FLOAT32_IEEE CU_ADM_KPA_BOOSTITERM 1 100 0.0 0.0 ECU_ADDRESS 0x400033c8 BYTE_ORDER MSB_FIRST /end MEASUREMENT
/begin COMPU_METHOD CU_ADM_KPA_BOOSTITERM "Conversion method for ADM_kPa_BoostITerm" RAT_FUNC "%10.2" "kPa" COEFFS 0.000000 1.000000 0.000000 0.000000 0.000000 1.000000 /end COMPU_METHOD
/* Scalar measurable for DDE 'ADM_kPa_BoostPTerm'. */
/begin MEASUREMENT ADM_kPa_BoostPTerm "Proportional effort for MAF target feedback control" FLOAT32_IEEE CU_ADM_KPA_BOOSTPTERM 1 100 0.0 0.0 ECU_ADDRESS 0x400033d0 BYTE_ORDER MSB_FIRST /end MEASUREMENT
/begin COMPU_METHOD CU_ADM_KPA_BOOSTPTERM "Conversion method for ADM_kPa_BoostPTerm" RAT_FUNC "%10.2" "kPa" COEFFS 0.000000 1.000000 0.000000 0.000000 0.000000 1.000000 /end COMPU_METHOD
/* Scalar measurable for DDE 'ADM_kPa_BoostPressTrgt'. */
/begin MEASUREMENT ADM_kPa_BoostPressTrgt "Target Boost Pressure Output" FLOAT32_IEEE CU_ADM_KPA_BOOSTPRESSTRGT 1 100 0.0 0.0 ECU_ADDRESS 0x40003294 BYTE_ORDER MSB_FIRST /end MEASUREMENT
/begin COMPU_METHOD CU_ADM_KPA_BOOSTPRESSTRGT "Conversion method for ADM_kPa_BoostPressTrgt" RAT_FUNC "%10.2" "kPa" COEFFS 0.000000 1.000000 0.000000 0.000000 0.000000 1.000000 /end COMPU_METHOD
/* Scalar measurable for DDE 'ADM_kPa_BoostPressTrgtRaw'. */
/begin MEASUREMENT ADM_kPa_BoostPressTrgtRaw "MAP target" FLOAT32_IEEE CU_ADM_KPA_BOOSTPRESSTRGTRAW 1 100 0.0 0.0 ECU_ADDRESS 0x400033bc BYTE_ORDER MSB_FIRST /end MEASUREMENT
/begin COMPU_METHOD CU_ADM_KPA_BOOSTPRESSTRGTRAW "Conversion method for ADM_kPa_BoostPressTrgtRaw" RAT_FUNC "%10.0" "kPa" COEFFS 0.000000 1.000000 0.000000 0.000000 0.000000 1.000000 /end COMPU_METHOD
/* Scalar measurable for DDE 'ADM_kPa_BoostPressTrgtRawCorr'. */
/begin MEASUREMENT ADM_kPa_BoostPressTrgtRawCorr "(not defined)" FLOAT32_IEEE CU_ADM_KPA_BOOSTPRESSTRGTRAWCO0 1 100 0.0 0.0 ECU_ADDRESS 0x400033b8 BYTE_ORDER MSB_FIRST /end MEASUREMENT
/begin COMPU_METHOD CU_ADM_KPA_BOOSTPRESSTRGTRAWCO0 "Conversion method for ADM_kPa_BoostPressTrgtRawCorr" RAT_FUNC "%10.2" "kPa" COEFFS 0.000000 1.000000 0.000000 0.000000 0.000000 1.000000 /end COMPU_METHOD
/* Scalar measurable for DDE 'ADM_kPa_ComprInDynPress'. */
/begin MEASUREMENT ADM_kPa_ComprInDynPress "Dynamic pressure term" FLOAT32_IEEE CU_ADM_KPA_COMPRINDYNPRESS 1 100 0.0 0.0 ECU_ADDRESS 0x40003430 BYTE_ORDER MSB_FIRST /end MEASUREMENT
/begin COMPU_METHOD CU_ADM_KPA_COMPRINDYNPRESS "Conversion method for ADM_kPa_ComprInDynPress" RAT_FUNC "%10.2" "kPa" COEFFS 0.000000 1.000000 0.000000 0.000000 0.000000 1.000000 /end COMPU_METHOD
/* Scalar measurable for DDE 'ADM_kPa_ComprInPressTot'. */
/begin MEASUREMENT ADM_kPa_ComprInPressTot "Total pressure estimate" FLOAT32_IEEE CU_ADM_KPA_COMPRINPRESSTOT 1 100 0.0 0.0 ECU_ADDRESS 0x4000342c BYTE_ORDER MSB_FIRST /end MEASUREMENT
/begin COMPU_METHOD CU_ADM_KPA_COMPRINPRESSTOT "Conversion method for ADM_kPa_ComprInPressTot" RAT_FUNC "%10.2" "kPa" COEFFS 0.000000 1.000000 0.000000 0.000000 0.000000 1.000000 /end COMPU_METHOD
/* Scalar measurable for DDE 'ADM_kPa_ComprOutDynPress'. */
/begin MEASUREMENT ADM_kPa_ComprOutDynPress "Dynamic pressure term" FLOAT32_IEEE CU_ADM_KPA_COMPROUTDYNPRESS 1 100 0.0 0.0 ECU_ADDRESS 0x40003420 BYTE_ORDER MSB_FIRST /end MEASUREMENT
/begin COMPU_METHOD CU_ADM_KPA_COMPROUTDYNPRESS "Conversion method for ADM_kPa_ComprOutDynPress" RAT_FUNC "%10.2" "kPa" COEFFS 0.000000 1.000000 0.000000 0.000000 0.000000 1.000000 /end COMPU_METHOD
/* Scalar measurable for DDE 'ADM_kPa_ComprOutPressTot'. */
/begin MEASUREMENT ADM_kPa_ComprOutPressTot "Total pressure estimate" FLOAT32_IEEE CU_ADM_KPA_COMPROUTPRESSTOT 1 100 0.0 0.0 ECU_ADDRESS 0x4000341c BYTE_ORDER MSB_FIRST /end MEASUREMENT
/begin COMPU_METHOD CU_ADM_KPA_COMPROUTPRESSTOT "Conversion method for ADM_kPa_ComprOutPressTot" RAT_FUNC "%10.2" "kPa" COEFFS 0.000000 1.000000 0.000000 0.000000 0.000000 1.000000 /end COMPU_METHOD
/* Scalar measurable for DDE 'ADM_kPa_NominalDP'. */
/begin MEASUREMENT ADM_kPa_NominalDP "Delta-Pressure calmap output displayable" FLOAT32_IEEE CU_ADM_KPA_NOMINALDP 1 100 0.0 0.0 ECU_ADDRESS 0x40003398 BYTE_ORDER MSB_FIRST /end MEASUREMENT
/begin COMPU_METHOD CU_ADM_KPA_NOMINALDP "Conversion method for ADM_kPa_NominalDP" RAT_FUNC "%10.1" "kPa" COEFFS 0.000000 1.000000 0.000000 0.000000 0.000000 1.000000 /end COMPU_METHOD
/* Scalar measurable for DDE 'ADM_kW_TrgtPwr'. */
/begin MEASUREMENT ADM_kW_TrgtPwr "Target power" FLOAT32_IEEE CU_ADM_KW_TRGTPWR 1 100 0.0 0.0 ECU_ADDRESS 0x400033e0 BYTE_ORDER MSB_FIRST /end MEASUREMENT
/begin COMPU_METHOD CU_ADM_KW_TRGTPWR "Conversion method for ADM_kW_TrgtPwr" RAT_FUNC "%10.2" "kW" COEFFS 0.000000 1.000000 0.000000 0.000000 0.000000 1.000000 /end COMPU_METHOD
/* Scalar measurable for DDE 'ADM_mps_ComprInVel'. */
/begin MEASUREMENT ADM_mps_ComprInVel "(m/s) Airstream velocity" FLOAT32_IEEE CU_ADM_MPS_COMPRINVEL 1 100 0.0 0.0 ECU_ADDRESS 0x40003438 BYTE_ORDER MSB_FIRST /end MEASUREMENT
/begin COMPU_METHOD CU_ADM_MPS_COMPRINVEL "Conversion method for ADM_mps_ComprInVel" RAT_FUNC "%10.2" "mps" COEFFS 0.000000 1.000000 0.000000 0.000000 0.000000 1.000000 /end COMPU_METHOD
/* Scalar measurable for DDE 'ADM_mps_ComprOutVel'. */
/begin MEASUREMENT ADM_mps_ComprOutVel "(m/s) Airstream velocity" FLOAT32_IEEE CU_ADM_MPS_COMPROUTVEL 1 100 0.0 0.0 ECU_ADDRESS 0x40003424 BYTE_ORDER MSB_FIRST /end MEASUREMENT
/begin COMPU_METHOD CU_ADM_MPS_COMPROUTVEL "Conversion method for ADM_mps_ComprOutVel" RAT_FUNC "%10.2" "mps" COEFFS 0.000000 1.000000 0.000000 0.000000 0.000000 1.000000 /end COMPU_METHOD
/* Scalar measurable for DDE 'ADM_pct_AirDemand'. */
/begin MEASUREMENT ADM_pct_AirDemand "Corrected Throttle Angle request output" FLOAT32_IEEE CU_ADM_PCT_AIRDEMAND 1 100 0.0 0.0 ECU_ADDRESS 0x400031e8 BYTE_ORDER MSB_FIRST /end MEASUREMENT
/begin COMPU_METHOD CU_ADM_PCT_AIRDEMAND "Conversion method for ADM_pct_AirDemand" RAT_FUNC "%10.2" "pct" COEFFS 0.000000 1.000000 0.000000 0.000000 0.000000 1.000000 /end COMPU_METHOD
/* Scalar measurable for DDE 'ADM_pct_ThrottleEffortRaw'. */
/begin MEASUREMENT ADM_pct_ThrottleEffortRaw "Target throttle opening" FLOAT32_IEEE CU_ADM_PCT_THROTTLEEFFORTRAW 1 100 0.0 0.0 ECU_ADDRESS 0x400033a0 BYTE_ORDER MSB_FIRST /end MEASUREMENT
/begin COMPU_METHOD CU_ADM_PCT_THROTTLEEFFORTRAW "Conversion method for ADM_pct_ThrottleEffortRaw" RAT_FUNC "%10.3" "pct" COEFFS 0.000000 1.000000 0.000000 0.000000 0.000000 1.000000 /end COMPU_METHOD
/* Scalar measurable for DDE 'ADM_pct_ThrottleFB'. */
/begin MEASUREMENT ADM_pct_ThrottleFB "MAF PI control effort" FLOAT32_IEEE CU_ADM_PCT_THROTTLEFB 1 100 0.0 0.0 ECU_ADDRESS 0x400033a4 BYTE_ORDER MSB_FIRST /end MEASUREMENT
/begin COMPU_METHOD CU_ADM_PCT_THROTTLEFB "Conversion method for ADM_pct_ThrottleFB" RAT_FUNC "%10.2" "pct" COEFFS 0.000000 1.000000 0.000000 0.000000 0.000000 1.000000 /end COMPU_METHOD
/* Scalar measurable for DDE 'ADM_pct_ThrottleITerm'. */
/begin MEASUREMENT ADM_pct_ThrottleITerm "Integral effort for MAF target feedback control" FLOAT32_IEEE CU_ADM_PCT_THROTTLEITERM 1 100 0.0 0.0 ECU_ADDRESS 0x400033b0 BYTE_ORDER MSB_FIRST /end MEASUREMENT
/begin COMPU_METHOD CU_ADM_PCT_THROTTLEITERM "Conversion method for ADM_pct_ThrottleITerm" RAT_FUNC "%10.2" "pct" COEFFS 0.000000 1.000000 0.000000 0.000000 0.000000 1.000000 /end COMPU_METHOD
/* Scalar measurable for DDE 'ADM_pct_ThrottlePGain'. */
/begin MEASUREMENT ADM_pct_ThrottlePGain "Proportional gain for MAF target feedback control" FLOAT32_IEEE CU_ADM_PCT_THROTTLEPGAIN 1 100 0.0 0.0 ECU_ADDRESS 0x400033ac BYTE_ORDER MSB_FIRST /end MEASUREMENT
/begin COMPU_METHOD CU_ADM_PCT_THROTTLEPGAIN "Conversion method for ADM_pct_ThrottlePGain" RAT_FUNC "%10.3" "pct" COEFFS 0.000000 1.000000 0.000000 0.000000 0.000000 1.000000 /end COMPU_METHOD
/* Scalar measurable for DDE 'ADM_pct_ThrottlePTerm'. */
/begin MEASUREMENT ADM_pct_ThrottlePTerm "Proportional effort for MAF target feedback control" FLOAT32_IEEE CU_ADM_PCT_THROTTLEPTERM 1 100 0.0 0.0 ECU_ADDRESS 0x400033a8 BYTE_ORDER MSB_FIRST /end MEASUREMENT
/begin COMPU_METHOD CU_ADM_PCT_THROTTLEPTERM "Conversion method for ADM_pct_ThrottlePTerm" RAT_FUNC "%10.2" "pct" COEFFS 0.000000 1.000000 0.000000 0.000000 0.000000 1.000000 /end COMPU_METHOD
/* Scalar measurable for DDE 'ADM_ret_VCP_Trgt'. */
/begin MEASUREMENT ADM_ret_VCP_Trgt "Intake Cam Angle Output for monitoring" FLOAT32_IEEE CU_ADM_RET_VCP_TRGT 1 100 0.0 0.0 ECU_ADDRESS 0x4000325c BYTE_ORDER MSB_FIRST /end MEASUREMENT
/begin COMPU_METHOD CU_ADM_RET_VCP_TRGT "Conversion method for ADM_ret_VCP_Trgt" RAT_FUNC "%10.2" "ret" COEFFS 0.000000 1.000000 0.000000 0.000000 0.000000 1.000000 /end COMPU_METHOD
/* Scalar measurable for DDE 'AFR_b_UseRateLim'. */
/begin MEASUREMENT AFR_b_UseRateLim "Displayable" UBYTE CU_AFR_B_USERATELIM 1 100 0.0 1.0 ECU_ADDRESS 0x40002ebf BYTE_ORDER MSB_FIRST /end MEASUREMENT
/begin COMPU_METHOD CU_AFR_B_USERATELIM "Conversion method for AFR_b_UseRateLim" RAT_FUNC "%10.0" "b" COEFFS 0.000000 1.000000 0.000000 0.000000 0.000000 1.000000 /end COMPU_METHOD
/* Scalar measurable for DDE 'AFR_lam_BaseTrgt'. */
/begin MEASUREMENT AFR_lam_BaseTrgt "Base AFR target" FLOAT32_IEEE CU_AFR_LAM_BASETRGT 1 100 10.0 20.0 ECU_ADDRESS 0x400034b0 BYTE_ORDER MSB_FIRST /end MEASUREMENT
/begin COMPU_METHOD CU_AFR_LAM_BASETRGT "Conversion method for AFR_lam_BaseTrgt" RAT_FUNC "%10.3" "lam" COEFFS 0.000000 1.000000 0.000000 0.000000 0.000000 1.000000 /end COMPU_METHOD
/* Scalar measurable for DDE 'AFR_lam_CrankingTrgt'. */
/begin MEASUREMENT AFR_lam_CrankingTrgt "Cranking AFR target" FLOAT32_IEEE CU_AFR_LAM_CRANKINGTRGT 1 100 0.0 0.0 ECU_ADDRESS 0x40003540 BYTE_ORDER MSB_FIRST /end MEASUREMENT
/begin COMPU_METHOD CU_AFR_LAM_CRANKINGTRGT "Conversion method for AFR_lam_CrankingTrgt" RAT_FUNC "%10.2" "lam" COEFFS 0.000000 1.000000 0.000000 0.000000 0.000000 1.000000 /end COMPU_METHOD
/* Scalar measurable for DDE 'AFR_lam_FinalTrgt1'. */
/begin MEASUREMENT AFR_lam_FinalTrgt1 "Final AFR target 1" FLOAT32_IEEE CU_AFR_LAM_FINALTRGT1 1 100 0.0 0.0 ECU_ADDRESS 0x400034ac BYTE_ORDER MSB_FIRST /end MEASUREMENT
/begin COMPU_METHOD CU_AFR_LAM_FINALTRGT1 "Conversion method for AFR_lam_FinalTrgt1" RAT_FUNC "%10.3" "lam" COEFFS 0.000000 1.000000 0.000000 0.000000 0.000000 1.000000 /end COMPU_METHOD
/* Scalar measurable for DDE 'AFR_lam_FinalTrgt2'. */
/begin MEASUREMENT AFR_lam_FinalTrgt2 "Final AFR target 2" FLOAT32_IEEE CU_AFR_LAM_FINALTRGT2 1 100 0.0 0.0 ECU_ADDRESS 0x400031e0 BYTE_ORDER MSB_FIRST /end MEASUREMENT
/begin COMPU_METHOD CU_AFR_LAM_FINALTRGT2 "Conversion method for AFR_lam_FinalTrgt2" RAT_FUNC "%10.3" "lam" COEFFS 0.000000 1.000000 0.000000 0.000000 0.000000 1.000000 /end COMPU_METHOD
/* Scalar measurable for DDE 'AFR_lam_RampedTrgt'. */
/begin MEASUREMENT AFR_lam_RampedTrgt "Ramped AFR target" FLOAT32_IEEE CU_AFR_LAM_RAMPEDTRGT 1 100 0.0 2.0 ECU_ADDRESS 0x400034b4 BYTE_ORDER MSB_FIRST /end MEASUREMENT
/begin COMPU_METHOD CU_AFR_LAM_RAMPEDTRGT "Conversion method for AFR_lam_RampedTrgt" RAT_FUNC "%10.2" "lam" COEFFS 0.000000 1.000000 0.000000 0.000000 0.000000 1.000000 /end COMPU_METHOD
/* Scalar measurable for DDE 'AFR_lam_TableResult'. */
/begin MEASUREMENT AFR_lam_TableResult "Map output displayable" FLOAT32_IEEE CU_AFR_LAM_TABLERESULT 1 100 10.0 20.0 ECU_ADDRESS 0x400034b8 BYTE_ORDER MSB_FIRST /end MEASUREMENT
/begin COMPU_METHOD CU_AFR_LAM_TABLERESULT "Conversion method for AFR_lam_TableResult" RAT_FUNC "%10.3" "lam" COEFFS 0.000000 1.000000 0.000000 0.000000 0.000000 1.000000 /end COMPU_METHOD
/* Scalar measurable for DDE 'AIN_A_ETC_CurrentB'. */
/begin MEASUREMENT AIN_A_ETC_CurrentB "Output current monitor" FLOAT32_IEEE CU_AIN_A_ETC_CURRENTB 1 100 0.0 0.0 ECU_ADDRESS 0x400037b0 BYTE_ORDER MSB_FIRST /end MEASUREMENT
/begin COMPU_METHOD CU_AIN_A_ETC_CURRENTB "Conversion method for AIN_A_ETC_CurrentB" RAT_FUNC "%10.3" "A" COEFFS 0.000000 1.000000 0.000000 0.000000 0.000000 1.000000 /end COMPU_METHOD
/* Scalar measurable for DDE 'AIN_A_Y1_Current'. */
/begin MEASUREMENT AIN_A_Y1_Current "Output current monitor" FLOAT32_IEEE CU_AIN_A_Y1_CURRENT 1 100 0.0 0.0 ECU_ADDRESS 0x400037ac BYTE_ORDER MSB_FIRST /end MEASUREMENT
/begin COMPU_METHOD CU_AIN_A_Y1_CURRENT "Conversion method for AIN_A_Y1_Current" RAT_FUNC "%10.3" "A" COEFFS 0.000000 1.000000 0.000000 0.000000 0.000000 1.000000 /end COMPU_METHOD
/* Scalar measurable for DDE 'AIN_A_Y5_Current'. */
/begin MEASUREMENT AIN_A_Y5_Current "Output current monitor" FLOAT32_IEEE CU_AIN_A_Y5_CURRENT 1 100 0.0 0.0 ECU_ADDRESS 0x400037a8 BYTE_ORDER MSB_FIRST /end MEASUREMENT
/begin COMPU_METHOD CU_AIN_A_Y5_CURRENT "Conversion method for AIN_A_Y5_Current" RAT_FUNC "%10.3" "A" COEFFS 0.000000 1.000000 0.000000 0.000000 0.000000 1.000000 /end COMPU_METHOD
/* Scalar measurable for DDE 'AIN_C_AmbientTemp'. */
/begin MEASUREMENT AIN_C_AmbientTemp "Displayable" FLOAT32_IEEE CU_AIN_C_AMBIENTTEMP 1 100 0.0 0.0 ECU_ADDRESS 0x40003880 BYTE_ORDER MSB_FIRST /end MEASUREMENT
/begin COMPU_METHOD CU_AIN_C_AMBIENTTEMP "Conversion method for AIN_C_AmbientTemp" RAT_FUNC "%10.3" "C" COEFFS 0.000000 1.000000 0.000000 0.000000 0.000000 1.000000 /end COMPU_METHOD
/* Scalar measurable for DDE 'AIN_C_CompOutTemp'. */
/begin MEASUREMENT AIN_C_CompOutTemp "Displayable" FLOAT32_IEEE CU_AIN_C_COMPOUTTEMP 1 100 -40.0 120.0 ECU_ADDRESS 0x40003860 BYTE_ORDER MSB_FIRST /end MEASUREMENT
/begin COMPU_METHOD CU_AIN_C_COMPOUTTEMP "Conversion method for AIN_C_CompOutTemp" RAT_FUNC "%10.3" "C" COEFFS 0.000000 1.000000 0.000000 0.000000 0.000000 1.000000 /end COMPU_METHOD
/* Scalar measurable for DDE 'AIN_C_CoolantTemp'. */
/begin MEASUREMENT AIN_C_CoolantTemp "Displayable" FLOAT32_IEEE CU_AIN_C_COOLANTTEMP 1 100 -40.0 120.0 ECU_ADDRESS 0x40003850 BYTE_ORDER MSB_FIRST /end MEASUREMENT
/begin COMPU_METHOD CU_AIN_C_COOLANTTEMP "Conversion method for AIN_C_CoolantTemp" RAT_FUNC "%10.0" "C" COEFFS 0.000000 1.000000 0.000000 0.000000 0.000000 1.000000 /end COMPU_METHOD
/* Scalar measurable for DDE 'AIN_C_ExhaustTemp'. */
/begin MEASUREMENT AIN_C_ExhaustTemp "Displayable" FLOAT32_IEEE CU_AIN_C_EXHAUSTTEMP 1 100 0.0 0.0 ECU_ADDRESS 0x40003908 BYTE_ORDER MSB_FIRST /end MEASUREMENT
/begin COMPU_METHOD CU_AIN_C_EXHAUSTTEMP "Conversion method for AIN_C_ExhaustTemp" RAT_FUNC "%10.3" "C" COEFFS 0.000000 1.000000 0.000000 0.000000 0.000000 1.000000 /end COMPU_METHOD
/* Scalar measurable for DDE 'AIN_C_FuelTemp'. */
/begin MEASUREMENT AIN_C_FuelTemp "Displayable" FLOAT32_IEEE CU_AIN_C_FUELTEMP 1 100 0.0 0.0 ECU_ADDRESS 0x4000385c BYTE_ORDER MSB_FIRST /end MEASUREMENT
/begin COMPU_METHOD CU_AIN_C_FUELTEMP "Conversion method for AIN_C_FuelTemp" RAT_FUNC "%10.3" "C" COEFFS 0.000000 1.000000 0.000000 0.000000 0.000000 1.000000 /end COMPU_METHOD
/* Scalar measurable for DDE 'AIN_C_ManifoldTemp'. */
/begin MEASUREMENT AIN_C_ManifoldTemp "Displayable" FLOAT32_IEEE CU_AIN_C_MANIFOLDTEMP 1 100 -40.0 120.0 ECU_ADDRESS 0x40003858 BYTE_ORDER MSB_FIRST /end MEASUREMENT
/begin COMPU_METHOD CU_AIN_C_MANIFOLDTEMP "Conversion method for AIN_C_ManifoldTemp" RAT_FUNC "%10.1" "C" COEFFS 0.000000 1.000000 0.000000 0.000000 0.000000 1.000000 /end COMPU_METHOD
/* Scalar measurable for DDE 'AIN_C_OilTemp'. */
/begin MEASUREMENT AIN_C_OilTemp "Displayable" FLOAT32_IEEE CU_AIN_C_OILTEMP 1 100 -40.0 120.0 ECU_ADDRESS 0x40003874 BYTE_ORDER MSB_FIRST /end MEASUREMENT
/begin COMPU_METHOD CU_AIN_C_OILTEMP "Conversion method for AIN_C_OilTemp" RAT_FUNC "%10.3" "C" COEFFS 0.000000 1.000000 0.000000 0.000000 0.000000 1.000000 /end COMPU_METHOD
/* Scalar measurable for DDE 'AIN_NU_APP1_Raw'. */
/begin MEASUREMENT AIN_NU_APP1_Raw "Displayable" FLOAT32_IEEE CU_AIN_NU_APP1_RAW 1 100 0.0 0.0 ECU_ADDRESS 0x40003870 BYTE_ORDER MSB_FIRST /end MEASUREMENT
/begin COMPU_METHOD CU_AIN_NU_APP1_RAW "Conversion method for AIN_NU_APP1_Raw" RAT_FUNC "%10.3" "NU" COEFFS 0.000000 1.000000 0.000000 0.000000 0.000000 1.000000 /end COMPU_METHOD
/* Scalar measurable for DDE 'AIN_NU_APP2_Raw'. */
/begin MEASUREMENT AIN_NU_APP2_Raw "Displayable" FLOAT32_IEEE CU_AIN_NU_APP2_RAW 1 100 0.0 0.0 ECU_ADDRESS 0x4000386c BYTE_ORDER MSB_FIRST /end MEASUREMENT
/begin COMPU_METHOD CU_AIN_NU_APP2_RAW "Conversion method for AIN_NU_APP2_Raw" RAT_FUNC "%10.3" "NU" COEFFS 0.000000 1.000000 0.000000 0.000000 0.000000 1.000000 /end COMPU_METHOD
/* Scalar measurable for DDE 'AIN_NU_MIL_Status'. */
/begin MEASUREMENT AIN_NU_MIL_Status "(not defined)" FLOAT32_IEEE CU_AIN_NU_MIL_STATUS 1 100 0.0 10.0 ECU_ADDRESS 0x40003670 BYTE_ORDER MSB_FIRST /end MEASUREMENT
/begin COMPU_METHOD CU_AIN_NU_MIL_STATUS "Conversion method for AIN_NU_MIL_Status" RAT_FUNC "%10.0" "NU" COEFFS 0.000000 1.000000 0.000000 0.000000 0.000000 1.000000 /end COMPU_METHOD
/* Scalar measurable for DDE 'AIN_NU_TP1_Raw'. */
/begin MEASUREMENT AIN_NU_TP1_Raw "Displayable" FLOAT32_IEEE CU_AIN_NU_TP1_RAW 1 100 0.0 0.0 ECU_ADDRESS 0x4000389c BYTE_ORDER MSB_FIRST /end MEASUREMENT
/begin COMPU_METHOD CU_AIN_NU_TP1_RAW "Conversion method for AIN_NU_TP1_Raw" RAT_FUNC "%10.1" "NU" COEFFS 0.000000 1.000000 0.000000 0.000000 0.000000 1.000000 /end COMPU_METHOD
/* Scalar measurable for DDE 'DFC_b_BurningDFC_Active'. */
/begin MEASUREMENT DFC_b_BurningDFC_Active "DFC fuel cut flag" UBYTE CU_DFC_B_BURNINGDFC_ACTIVE 1 100 0.0 1.0 ECU_ADDRESS 0x40002e6e BYTE_ORDER MSB_FIRST /end MEASUREMENT
/begin COMPU_METHOD CU_DFC_B_BURNINGDFC_ACTIVE "Conversion method for DFC_b_BurningDFC_Active" RAT_FUNC "%10.0" "b" COEFFS 0.000000 1.000000 0.000000 0.000000 0.000000 1.000000 /end COMPU_METHOD
/* Scalar measurable for DDE 'DTC_b_ShutOffValveEngine_OL'. */
/begin MEASUREMENT DTC_b_ShutOffValveEngine_OL "DTC119" UBYTE CU_DTC_B_SHUTOFFVALVEENGINE_OL 1 100 0.0 1.0 ECU_ADDRESS 0x40002f1e BYTE_ORDER MSB_FIRST /end MEASUREMENT
/begin COMPU_METHOD CU_DTC_B_SHUTOFFVALVEENGINE_OL "Conversion method for DTC_b_ShutOffValveEngine_OL" RAT_FUNC "%10.0" "b" COEFFS 0.000000 1.000000 0.000000 0.000000 0.000000 1.000000 /end COMPU_METHOD
/* Scalar measurable for DDE 'EFP_NU_FuelPumpErrROC'. */
/begin MEASUREMENT EFP_NU_FuelPumpErrROC "(bar/s) Time derivative of position error" FLOAT32_IEEE CU_EFP_NU_FUELPUMPERRROC 1 100 -100.0 100.0 ECU_ADDRESS 0x400036d8 BYTE_ORDER MSB_FIRST /end MEASUREMENT
/begin COMPU_METHOD CU_EFP_NU_FUELPUMPERRROC "Conversion method for EFP_NU_FuelPumpErrROC" RAT_FUNC "%10.3" "NU" COEFFS 0.000000 1.000000 0.000000 0.000000 0.000000 1.000000 /end COMPU_METHOD
/* Scalar measurable for DDE 'EFP_b_FuelPumpDC'. */
/begin MEASUREMENT EFP_b_FuelPumpDC "PWM Signal percentage for Monitoring" FLOAT32_IEEE CU_EFP_B_FUELPUMPDC 1 100 0.0 1.0 ECU_ADDRESS 0x400036c8 BYTE_ORDER MSB_FIRST /end MEASUREMENT
/begin COMPU_METHOD CU_EFP_B_FUELPUMPDC "Conversion method for EFP_b_FuelPumpDC" RAT_FUNC "%10.2" "pct" COEFFS 0.000000 1.000000 0.000000 0.000000 0.000000 1.000000 /end COMPU_METHOD
/* Scalar measurable for DDE 'EFP_b_NotStalled'. */
/begin MEASUREMENT EFP_b_NotStalled "Displayable" UBYTE CU_EFP_B_NOTSTALLED 1 100 0.0 1.0 ECU_ADDRESS 0x40002f28 BYTE_ORDER MSB_FIRST /end MEASUREMENT
/begin COMPU_METHOD CU_EFP_B_NOTSTALLED "Conversion method for EFP_b_NotStalled" RAT_FUNC "%10.0" "b" COEFFS 0.000000 1.000000 0.000000 0.000000 0.000000 1.000000 /end COMPU_METHOD
/* Scalar measurable for DDE 'EFP_b_RunFuelPump'. */
/begin MEASUREMENT EFP_b_RunFuelPump "Displayable" UBYTE CU_EFP_B_RUNFUELPUMP 1 100 0.0 1.0 ECU_ADDRESS 0x40002f27 BYTE_ORDER MSB_FIRST /end MEASUREMENT
/begin COMPU_METHOD CU_EFP_B_RUNFUELPUMP "Conversion method for EFP_b_RunFuelPump" RAT_FUNC "%10.0" "b" COEFFS 0.000000 1.000000 0.000000 0.000000 0.000000 1.000000 /end COMPU_METHOD
/* Scalar measurable for DDE 'EFP_bar_PressErr'. */
/begin MEASUREMENT EFP_bar_PressErr "Fuel pressure error" FLOAT32_IEEE CU_EFP_BAR_PRESSERR 1 100 -100.0 100.0 ECU_ADDRESS 0x400036e4 BYTE_ORDER MSB_FIRST /end MEASUREMENT
/begin COMPU_METHOD CU_EFP_BAR_PRESSERR "Conversion method for EFP_bar_PressErr" RAT_FUNC "%10.3" "NU" COEFFS 0.000000 1.000000 0.000000 0.000000 0.000000 1.000000 /end COMPU_METHOD
/* Scalar measurable for DDE 'EFP_pct_FuelPumpDC_PID'. */
/begin MEASUREMENT EFP_pct_FuelPumpDC_PID "Feedback control effort for  FuelPump" FLOAT32_IEEE CU_EFP_PCT_FUELPUMPDC_PID 1 100 0.0 1.0 ECU_ADDRESS 0x400036cc BYTE_ORDER MSB_FIRST /end MEASUREMENT
/begin COMPU_METHOD CU_EFP_PCT_FUELPUMPDC_PID "Conversion method for EFP_pct_FuelPumpDC_PID" RAT_FUNC "%10.3" "NU" COEFFS 0.000000 1.000000 0.000000 0.000000 0.000000 1.000000 /end COMPU_METHOD
/* Scalar measurable for DDE 'EFP_pct_FuelPumpDTerm'. */
/begin MEASUREMENT EFP_pct_FuelPumpDTerm "Derivative effort for  FuelPump" FLOAT32_IEEE CU_EFP_PCT_FUELPUMPDTERM 1 100 -1.0 1.0 ECU_ADDRESS 0x400036d4 BYTE_ORDER MSB_FIRST /end MEASUREMENT
/begin COMPU_METHOD CU_EFP_PCT_FUELPUMPDTERM "Conversion method for EFP_pct_FuelPumpDTerm" RAT_FUNC "%10.3" "NU" COEFFS 0.000000 1.000000 0.000000 0.000000 0.000000 1.000000 /end COMPU_METHOD
/* Scalar measurable for DDE 'EFP_pct_FuelPumpITerm'. */
/begin MEASUREMENT EFP_pct_FuelPumpITerm "Integral effort for  FuelPump" FLOAT32_IEEE CU_EFP_PCT_FUELPUMPITERM 1 100 -1.0 1.0 ECU_ADDRESS 0x400036dc BYTE_ORDER MSB_FIRST /end MEASUREMENT
/begin COMPU_METHOD CU_EFP_PCT_FUELPUMPITERM "Conversion method for EFP_pct_FuelPumpITerm" RAT_FUNC "%10.3" "NU" COEFFS 0.000000 1.000000 0.000000 0.000000 0.000000 1.000000 /end COMPU_METHOD
/* Scalar measurable for DDE 'EFP_pct_FuelPumpPIDRaw'. */
/begin MEASUREMENT EFP_pct_FuelPumpPIDRaw "FuelPump PID effort raw" FLOAT32_IEEE CU_EFP_PCT_FUELPUMPPIDRAW 1 100 -1.0 1.0 ECU_ADDRESS 0x400036d0 BYTE_ORDER MSB_FIRST /end MEASUREMENT
/begin COMPU_METHOD CU_EFP_PCT_FUELPUMPPIDRAW "Conversion method for EFP_pct_FuelPumpPIDRaw" RAT_FUNC "%10.3" "NU" COEFFS 0.000000 1.000000 0.000000 0.000000 0.000000 1.000000 /end COMPU_METHOD
/* Scalar measurable for DDE 'EFP_pct_FuelPumpPTerm'. */
/begin MEASUREMENT EFP_pct_FuelPumpPTerm "Proportional effort" FLOAT32_IEEE CU_EFP_PCT_FUELPUMPPTERM 1 100 0.0 1.0 ECU_ADDRESS 0x400036e0 BYTE_ORDER MSB_FIRST /end MEASUREMENT
/begin COMPU_METHOD CU_EFP_PCT_FUELPUMPPTERM "Conversion method for EFP_pct_FuelPumpPTerm" RAT_FUNC "%10.3" "NU" COEFFS 0.000000 1.000000 0.000000 0.000000 0.000000 1.000000 /end COMPU_METHOD
/* Scalar measurable for DDE 'FCA_lpk_AverageFuelConsumption'. */
/begin MEASUREMENT FCA_lpk_AverageFuelConsumption "Fuel consumption in Liters per 100km" FLOAT32_IEEE CU_FCA_LPK_AVERAGEFUELCONSUMPT0 1 100 0.0 0.0 ECU_ADDRESS 0x400031f8 BYTE_ORDER MSB_FIRST /end MEASUREMENT
/begin COMPU_METHOD CU_FCA_LPK_AVERAGEFUELCONSUMPT0 "Conversion method for FCA_lpk_AverageFuelConsumption" RAT_FUNC "%10.1" "lpk" COEFFS 0.000000 1.000000 0.000000 0.000000 0.000000 1.000000 /end COMPU_METHOD
/* Scalar measurable for DDE 'FLT_NU_APP1'. */
/begin MEASUREMENT FLT_NU_APP1 "Exported Global for sensor fault status" UBYTE CU_FLT_NU_APP1 1 100 0.0 0.0 ECU_ADDRESS 0x40003000 BYTE_ORDER MSB_FIRST /end MEASUREMENT
/begin COMPU_METHOD CU_FLT_NU_APP1 "Conversion method for FLT_NU_APP1" RAT_FUNC "%10.0" "NU" COEFFS 0.000000 1.000000 0.000000 0.000000 0.000000 1.000000 /end COMPU_METHOD
/* Scalar measurable for DDE 'FLT_NU_APP2'. */
/begin MEASUREMENT FLT_NU_APP2 "Exported Global for sensor fault status" UBYTE CU_FLT_NU_APP2 1 100 0.0 0.0 ECU_ADDRESS 0x40002fff BYTE_ORDER MSB_FIRST /end MEASUREMENT
/begin COMPU_METHOD CU_FLT_NU_APP2 "Conversion method for FLT_NU_APP2" RAT_FUNC "%10.0" "NU" COEFFS 0.000000 1.000000 0.000000 0.000000 0.000000 1.000000 /end COMPU_METHOD
/* Scalar measurable for DDE 'FLT_NU_BrkSw'. */
/begin MEASUREMENT FLT_NU_BrkSw "Exported Global for sensor fault status" UBYTE CU_FLT_NU_BRKSW 1 100 0.0 0.0 ECU_ADDRESS 0x40003001 BYTE_ORDER MSB_FIRST /end MEASUREMENT
/begin COMPU_METHOD CU_FLT_NU_BRKSW "Conversion method for FLT_NU_BrkSw" RAT_FUNC "%10.0" "NU" COEFFS 0.000000 1.000000 0.000000 0.000000 0.000000 1.000000 /end COMPU_METHOD
/* Scalar measurable for DDE 'FLT_NU_CAN_CCVS'. */
/begin MEASUREMENT FLT_NU_CAN_CCVS "Exported Global for sensor fault status" UBYTE CU_FLT_NU_CAN_CCVS 1 100 0.0 0.0 ECU_ADDRESS 0x40002ffe BYTE_ORDER MSB_FIRST /end MEASUREMENT
/begin COMPU_METHOD CU_FLT_NU_CAN_CCVS "Conversion method for FLT_NU_CAN_CCVS" RAT_FUNC "%10.0" "NU" COEFFS 0.000000 1.000000 0.000000 0.000000 0.000000 1.000000 /end COMPU_METHOD
/* Scalar measurable for DDE 'FLT_NU_CamPhaser'. */
/begin MEASUREMENT FLT_NU_CamPhaser "Exported Global for sensor fault status" UBYTE CU_FLT_NU_CAMPHASER 1 100 0.0 0.0 ECU_ADDRESS 0x40002ffc BYTE_ORDER MSB_FIRST /end MEASUREMENT
/begin COMPU_METHOD CU_FLT_NU_CAMPHASER "Conversion method for FLT_NU_CamPhaser" RAT_FUNC "%10.0" "NU" COEFFS 0.000000 1.000000 0.000000 0.000000 0.000000 1.000000 /end COMPU_METHOD
/* Scalar measurable for DDE 'FLT_NU_CoolantTemp'. */
/begin MEASUREMENT FLT_NU_CoolantTemp "Exported Global for sensor fault status" UBYTE CU_FLT_NU_COOLANTTEMP 1 100 0.0 0.0 ECU_ADDRESS 0x40003006 BYTE_ORDER MSB_FIRST /end MEASUREMENT
/begin COMPU_METHOD CU_FLT_NU_COOLANTTEMP "Conversion method for FLT_NU_CoolantTemp" RAT_FUNC "%10.0" "NU" COEFFS 0.000000 1.000000 0.000000 0.000000 0.000000 1.000000 /end COMPU_METHOD
/* Scalar measurable for DDE 'FLT_NU_ECU'. */
/begin MEASUREMENT FLT_NU_ECU "Exported Global for sensor fault status" UBYTE CU_FLT_NU_ECU 1 100 0.0 0.0 ECU_ADDRESS 0x40003002 BYTE_ORDER MSB_FIRST /end MEASUREMENT
/begin COMPU_METHOD CU_FLT_NU_ECU "Conversion method for FLT_NU_ECU" RAT_FUNC "%10.0" "NU" COEFFS 0.000000 1.000000 0.000000 0.000000 0.000000 1.000000 /end COMPU_METHOD
/* Scalar measurable for DDE 'FLT_NU_EGO11'. */
/begin MEASUREMENT FLT_NU_EGO11 "Exported Global for sensor fault status" UBYTE CU_FLT_NU_EGO11 1 100 0.0 0.0 ECU_ADDRESS 0x4000300c BYTE_ORDER MSB_FIRST /end MEASUREMENT
/begin COMPU_METHOD CU_FLT_NU_EGO11 "Conversion method for FLT_NU_EGO11" RAT_FUNC "%10.0" "NU" COEFFS 0.000000 1.000000 0.000000 0.000000 0.000000 1.000000 /end COMPU_METHOD
/* Scalar measurable for DDE 'FLT_NU_EGO12'. */
/begin MEASUREMENT FLT_NU_EGO12 "Exported Global for sensor fault status" UBYTE CU_FLT_NU_EGO12 1 100 0.0 0.0 ECU_ADDRESS 0x4000300a BYTE_ORDER MSB_FIRST /end MEASUREMENT
/begin COMPU_METHOD CU_FLT_NU_EGO12 "Conversion method for FLT_NU_EGO12" RAT_FUNC "%10.0" "NU" COEFFS 0.000000 1.000000 0.000000 0.000000 0.000000 1.000000 /end COMPU_METHOD
/* Scalar measurable for DDE 'FLT_NU_EGO21'. */
/begin MEASUREMENT FLT_NU_EGO21 "Exported Global for sensor fault status" UBYTE CU_FLT_NU_EGO21 1 100 0.0 0.0 ECU_ADDRESS 0x4000300b BYTE_ORDER MSB_FIRST /end MEASUREMENT
/begin COMPU_METHOD CU_FLT_NU_EGO21 "Conversion method for FLT_NU_EGO21" RAT_FUNC "%10.0" "NU" COEFFS 0.000000 1.000000 0.000000 0.000000 0.000000 1.000000 /end COMPU_METHOD
/* Scalar measurable for DDE 'FLT_NU_EGO22'. */
/begin MEASUREMENT FLT_NU_EGO22 "Exported Global for sensor fault status" UBYTE CU_FLT_NU_EGO22 1 100 0.0 0.0 ECU_ADDRESS 0x40003009 BYTE_ORDER MSB_FIRST /end MEASUREMENT
/begin COMPU_METHOD CU_FLT_NU_EGO22 "Conversion method for FLT_NU_EGO22" RAT_FUNC "%10.0" "NU" COEFFS 0.000000 1.000000 0.000000 0.000000 0.000000 1.000000 /end COMPU_METHOD
/* Scalar measurable for DDE 'FLT_NU_ETC'. */
/begin MEASUREMENT FLT_NU_ETC "Exported Global for sensor fault status" UBYTE CU_FLT_NU_ETC 1 100 0.0 0.0 ECU_ADDRESS 0x40002ffd BYTE_ORDER MSB_FIRST /end MEASUREMENT
/begin COMPU_METHOD CU_FLT_NU_ETC "Conversion method for FLT_NU_ETC" RAT_FUNC "%10.0" "NU" COEFFS 0.000000 1.000000 0.000000 0.000000 0.000000 1.000000 /end COMPU_METHOD
/* Scalar measurable for DDE 'FLT_NU_FCV'. */
/begin MEASUREMENT FLT_NU_FCV "Exported Global for sensor fault status" UBYTE CU_FLT_NU_FCV 1 100 0.0 0.0 ECU_ADDRESS 0x40002ffb BYTE_ORDER MSB_FIRST /end MEASUREMENT
/begin COMPU_METHOD CU_FLT_NU_FCV "Conversion method for FLT_NU_FCV" RAT_FUNC "%10.0" "NU" COEFFS 0.000000 1.000000 0.000000 0.000000 0.000000 1.000000 /end COMPU_METHOD
/* Scalar measurable for DDE 'FLT_NU_HighLevel1'. */
/begin MEASUREMENT FLT_NU_HighLevel1 "High level Exported Global for sensor fault status" ULONG CU_FLT_NU_HIGHLEVEL1 1 100 0.0 0.0 ECU_ADDRESS 0x40003044 BYTE_ORDER MSB_FIRST /end MEASUREMENT
/begin COMPU_METHOD CU_FLT_NU_HIGHLEVEL1 "Conversion method for FLT_NU_HighLevel1" RAT_FUNC "%10.0" "NU" COEFFS 0.000000 1.000000 0.000000 0.000000 0.000000 1.000000 /end COMPU_METHOD
/* Scalar measurable for DDE 'FLT_NU_HighLevel2'. */
/begin MEASUREMENT FLT_NU_HighLevel2 "High level Exported Global for sensor fault status" ULONG CU_FLT_NU_HIGHLEVEL2 1 100 0.0 0.0 ECU_ADDRESS 0x40003040 BYTE_ORDER MSB_FIRST /end MEASUREMENT
/begin COMPU_METHOD CU_FLT_NU_HIGHLEVEL2 "Conversion method for FLT_NU_HighLevel2" RAT_FUNC "%10.0" "NU" COEFFS 0.000000 1.000000 0.000000 0.000000 0.000000 1.000000 /end COMPU_METHOD
/* Scalar measurable for DDE 'FLT_NU_Inj1'. */
/begin MEASUREMENT FLT_NU_Inj1 "Exported Global for sensor fault status" UBYTE CU_FLT_NU_INJ1 1 100 0.0 0.0 ECU_ADDRESS 0x40002ff8 BYTE_ORDER MSB_FIRST /end MEASUREMENT
/begin COMPU_METHOD CU_FLT_NU_INJ1 "Conversion method for FLT_NU_Inj1" RAT_FUNC "%10.0" "NU" COEFFS 0.000000 1.000000 0.000000 0.000000 0.000000 1.000000 /end COMPU_METHOD
/* Scalar measurable for DDE 'FLT_NU_Inj2'. */
/begin MEASUREMENT FLT_NU_Inj2 "Exported Global for sensor fault status" UBYTE CU_FLT_NU_INJ2 1 100 0.0 0.0 ECU_ADDRESS 0x40002ff7 BYTE_ORDER MSB_FIRST /end MEASUREMENT
/begin COMPU_METHOD CU_FLT_NU_INJ2 "Conversion method for FLT_NU_Inj2" RAT_FUNC "%10.0" "NU" COEFFS 0.000000 1.000000 0.000000 0.000000 0.000000 1.000000 /end COMPU_METHOD
/* Scalar measurable for DDE 'FLT_NU_Inj3'. */
/begin MEASUREMENT FLT_NU_Inj3 "Exported Global for sensor fault status" UBYTE CU_FLT_NU_INJ3 1 100 0.0 0.0 ECU_ADDRESS 0x40002ff6 BYTE_ORDER MSB_FIRST /end MEASUREMENT
/begin COMPU_METHOD CU_FLT_NU_INJ3 "Conversion method for FLT_NU_Inj3" RAT_FUNC "%10.0" "NU" COEFFS 0.000000 1.000000 0.000000 0.000000 0.000000 1.000000 /end COMPU_METHOD
/* Scalar measurable for DDE 'FLT_NU_Inj4'. */
/begin MEASUREMENT FLT_NU_Inj4 "Exported Global for sensor fault status" UBYTE CU_FLT_NU_INJ4 1 100 0.0 0.0 ECU_ADDRESS 0x40002ff5 BYTE_ORDER MSB_FIRST /end MEASUREMENT
/begin COMPU_METHOD CU_FLT_NU_INJ4 "Conversion method for FLT_NU_Inj4" RAT_FUNC "%10.0" "NU" COEFFS 0.000000 1.000000 0.000000 0.000000 0.000000 1.000000 /end COMPU_METHOD
/* Scalar measurable for DDE 'FLT_NU_Inj5'. */
/begin MEASUREMENT FLT_NU_Inj5 "Exported Global for sensor fault status" UBYTE CU_FLT_NU_INJ5 1 100 0.0 0.0 ECU_ADDRESS 0x40002ff4 BYTE_ORDER MSB_FIRST /end MEASUREMENT
/begin COMPU_METHOD CU_FLT_NU_INJ5 "Conversion method for FLT_NU_Inj5" RAT_FUNC "%10.0" "NU" COEFFS 0.000000 1.000000 0.000000 0.000000 0.000000 1.000000 /end COMPU_METHOD
/* Scalar measurable for DDE 'FLT_NU_Inj6'. */
/begin MEASUREMENT FLT_NU_Inj6 "Exported Global for sensor fault status" UBYTE CU_FLT_NU_INJ6 1 100 0.0 0.0 ECU_ADDRESS 0x40002ff3 BYTE_ORDER MSB_FIRST /end MEASUREMENT
/begin COMPU_METHOD CU_FLT_NU_INJ6 "Conversion method for FLT_NU_Inj6" RAT_FUNC "%10.0" "NU" COEFFS 0.000000 1.000000 0.000000 0.000000 0.000000 1.000000 /end COMPU_METHOD
/* Scalar measurable for DDE 'FLT_NU_Inj7'. */
/begin MEASUREMENT FLT_NU_Inj7 "Exported Global for sensor fault status" UBYTE CU_FLT_NU_INJ7 1 100 0.0 0.0 ECU_ADDRESS 0x40002ff2 BYTE_ORDER MSB_FIRST /end MEASUREMENT
/begin COMPU_METHOD CU_FLT_NU_INJ7 "Conversion method for FLT_NU_Inj7" RAT_FUNC "%10.0" "NU" COEFFS 0.000000 1.000000 0.000000 0.000000 0.000000 1.000000 /end COMPU_METHOD
/* Scalar measurable for DDE 'FLT_NU_Inj8'. */
/begin MEASUREMENT FLT_NU_Inj8 "Exported Global for sensor fault status" UBYTE CU_FLT_NU_INJ8 1 100 0.0 0.0 ECU_ADDRESS 0x40002ff1 BYTE_ORDER MSB_FIRST /end MEASUREMENT
/begin COMPU_METHOD CU_FLT_NU_INJ8 "Conversion method for FLT_NU_Inj8" RAT_FUNC "%10.0" "NU" COEFFS 0.000000 1.000000 0.000000 0.000000 0.000000 1.000000 /end COMPU_METHOD
/* Scalar measurable for DDE 'FLT_NU_MAF'. */
/begin MEASUREMENT FLT_NU_MAF "Exported Global for sensor fault status" UBYTE CU_FLT_NU_MAF 1 100 0.0 0.0 ECU_ADDRESS 0x4000300d BYTE_ORDER MSB_FIRST /end MEASUREMENT
/begin COMPU_METHOD CU_FLT_NU_MAF "Conversion method for FLT_NU_MAF" RAT_FUNC "%10.0" "NU" COEFFS 0.000000 1.000000 0.000000 0.000000 0.000000 1.000000 /end COMPU_METHOD
/* Scalar measurable for DDE 'FLT_NU_OilTemp'. */
/begin MEASUREMENT FLT_NU_OilTemp "Exported Global for sensor fault status" UBYTE CU_FLT_NU_OILTEMP 1 100 0.0 0.0 ECU_ADDRESS 0x40003005 BYTE_ORDER MSB_FIRST /end MEASUREMENT
/begin COMPU_METHOD CU_FLT_NU_OILTEMP "Conversion method for FLT_NU_OilTemp" RAT_FUNC "%10.0" "NU" COEFFS 0.000000 1.000000 0.000000 0.000000 0.000000 1.000000 /end COMPU_METHOD
/* Scalar measurable for DDE 'FLT_NU_PSU'. */
/begin MEASUREMENT FLT_NU_PSU "Exported Global for sensor fault status" UBYTE CU_FLT_NU_PSU 1 100 0.0 0.0 ECU_ADDRESS 0x40003003 BYTE_ORDER MSB_FIRST /end MEASUREMENT
/begin COMPU_METHOD CU_FLT_NU_PSU "Conversion method for FLT_NU_PSU" RAT_FUNC "%10.0" "NU" COEFFS 0.000000 1.000000 0.000000 0.000000 0.000000 1.000000 /end COMPU_METHOD
/* Scalar measurable for DDE 'FLT_NU_PurgeVlv'. */
/begin MEASUREMENT FLT_NU_PurgeVlv "Exported Global for sensor fault status" UBYTE CU_FLT_NU_PURGEVLV 1 100 0.0 0.0 ECU_ADDRESS 0x40002ff9 BYTE_ORDER MSB_FIRST /end MEASUREMENT
/begin COMPU_METHOD CU_FLT_NU_PURGEVLV "Conversion method for FLT_NU_PurgeVlv" RAT_FUNC "%10.0" "NU" COEFFS 0.000000 1.000000 0.000000 0.000000 0.000000 1.000000 /end COMPU_METHOD
/* Scalar measurable for DDE 'FLT_NU_Spk1'. */
/begin MEASUREMENT FLT_NU_Spk1 "Exported Global for sensor fault status" UBYTE CU_FLT_NU_SPK1 1 100 0.0 0.0 ECU_ADDRESS 0x40002ff0 BYTE_ORDER MSB_FIRST /end MEASUREMENT
/begin COMPU_METHOD CU_FLT_NU_SPK1 "Conversion method for FLT_NU_Spk1" RAT_FUNC "%10.0" "NU" COEFFS 0.000000 1.000000 0.000000 0.000000 0.000000 1.000000 /end COMPU_METHOD
/* Scalar measurable for DDE 'FLT_NU_Spk2'. */
/begin MEASUREMENT FLT_NU_Spk2 "Exported Global for sensor fault status" UBYTE CU_FLT_NU_SPK2 1 100 0.0 0.0 ECU_ADDRESS 0x40002fef BYTE_ORDER MSB_FIRST /end MEASUREMENT
/begin COMPU_METHOD CU_FLT_NU_SPK2 "Conversion method for FLT_NU_Spk2" RAT_FUNC "%10.0" "NU" COEFFS 0.000000 1.000000 0.000000 0.000000 0.000000 1.000000 /end COMPU_METHOD
/* Scalar measurable for DDE 'FLT_NU_Spk3'. */
/begin MEASUREMENT FLT_NU_Spk3 "Exported Global for sensor fault status" UBYTE CU_FLT_NU_SPK3 1 100 0.0 0.0 ECU_ADDRESS 0x40002fee BYTE_ORDER MSB_FIRST /end MEASUREMENT
/begin COMPU_METHOD CU_FLT_NU_SPK3 "Conversion method for FLT_NU_Spk3" RAT_FUNC "%10.0" "NU" COEFFS 0.000000 1.000000 0.000000 0.000000 0.000000 1.000000 /end COMPU_METHOD
/* Scalar measurable for DDE 'FLT_NU_Spk4'. */
/begin MEASUREMENT FLT_NU_Spk4 "Exported Global for sensor fault status" UBYTE CU_FLT_NU_SPK4 1 100 0.0 0.0 ECU_ADDRESS 0x40002fed BYTE_ORDER MSB_FIRST /end MEASUREMENT
/begin COMPU_METHOD CU_FLT_NU_SPK4 "Conversion method for FLT_NU_Spk4" RAT_FUNC "%10.0" "NU" COEFFS 0.000000 1.000000 0.000000 0.000000 0.000000 1.000000 /end COMPU_METHOD
/* Scalar measurable for DDE 'FLT_NU_Spk5'. */
/begin MEASUREMENT FLT_NU_Spk5 "Exported Global for sensor fault status" UBYTE CU_FLT_NU_SPK5 1 100 0.0 0.0 ECU_ADDRESS 0x40002fec BYTE_ORDER MSB_FIRST /end MEASUREMENT
/begin COMPU_METHOD CU_FLT_NU_SPK5 "Conversion method for FLT_NU_Spk5" RAT_FUNC "%10.0" "NU" COEFFS 0.000000 1.000000 0.000000 0.000000 0.000000 1.000000 /end COMPU_METHOD
/* Scalar measurable for DDE 'FLT_NU_Spk6'. */
/begin MEASUREMENT FLT_NU_Spk6 "Exported Global for sensor fault status" UBYTE CU_FLT_NU_SPK6 1 100 0.0 0.0 ECU_ADDRESS 0x40002feb BYTE_ORDER MSB_FIRST /end MEASUREMENT
/begin COMPU_METHOD CU_FLT_NU_SPK6 "Conversion method for FLT_NU_Spk6" RAT_FUNC "%10.0" "NU" COEFFS 0.000000 1.000000 0.000000 0.000000 0.000000 1.000000 /end COMPU_METHOD
/* Scalar measurable for DDE 'FLT_NU_Spk7'. */
/begin MEASUREMENT FLT_NU_Spk7 "Exported Global for sensor fault status" UBYTE CU_FLT_NU_SPK7 1 100 0.0 0.0 ECU_ADDRESS 0x40002fea BYTE_ORDER MSB_FIRST /end MEASUREMENT
/begin COMPU_METHOD CU_FLT_NU_SPK7 "Conversion method for FLT_NU_Spk7" RAT_FUNC "%10.0" "NU" COEFFS 0.000000 1.000000 0.000000 0.000000 0.000000 1.000000 /end COMPU_METHOD
/* Scalar measurable for DDE 'FLT_NU_Spk8'. */
/begin MEASUREMENT FLT_NU_Spk8 "Exported Global for sensor fault status" UBYTE CU_FLT_NU_SPK8 1 100 0.0 0.0 ECU_ADDRESS 0x40002fe9 BYTE_ORDER MSB_FIRST /end MEASUREMENT
/begin COMPU_METHOD CU_FLT_NU_SPK8 "Conversion method for FLT_NU_Spk8" RAT_FUNC "%10.0" "NU" COEFFS 0.000000 1.000000 0.000000 0.000000 0.000000 1.000000 /end COMPU_METHOD
/* Scalar measurable for DDE 'FLT_NU_TP1'. */
/begin MEASUREMENT FLT_NU_TP1 "Exported Global for sensor fault status" UBYTE CU_FLT_NU_TP1 1 100 0.0 0.0 ECU_ADDRESS 0x40003010 BYTE_ORDER MSB_FIRST /end MEASUREMENT
/begin COMPU_METHOD CU_FLT_NU_TP1 "Conversion method for FLT_NU_TP1" RAT_FUNC "%10.0" "NU" COEFFS 0.000000 1.000000 0.000000 0.000000 0.000000 1.000000 /end COMPU_METHOD
/* Scalar measurable for DDE 'FLT_NU_TP2'. */
/begin MEASUREMENT FLT_NU_TP2 "Exported Global for sensor fault status" UBYTE CU_FLT_NU_TP2 1 100 0.0 0.0 ECU_ADDRESS 0x4000300f BYTE_ORDER MSB_FIRST /end MEASUREMENT
/begin COMPU_METHOD CU_FLT_NU_TP2 "Conversion method for FLT_NU_TP2" RAT_FUNC "%10.0" "NU" COEFFS 0.000000 1.000000 0.000000 0.000000 0.000000 1.000000 /end COMPU_METHOD
/* Scalar measurable for DDE 'FLT_NU_TurCtrl'. */
/begin MEASUREMENT FLT_NU_TurCtrl "Exported Global for sensor fault status" UBYTE CU_FLT_NU_TURCTRL 1 100 0.0 0.0 ECU_ADDRESS 0x40002ffa BYTE_ORDER MSB_FIRST /end MEASUREMENT
/begin COMPU_METHOD CU_FLT_NU_TURCTRL "Conversion method for FLT_NU_TurCtrl" RAT_FUNC "%10.0" "NU" COEFFS 0.000000 1.000000 0.000000 0.000000 0.000000 1.000000 /end COMPU_METHOD
/* Scalar measurable for DDE 'FLT_NU_UEGO1'. */
/begin MEASUREMENT FLT_NU_UEGO1 "Exported Global for sensor fault status" UBYTE CU_FLT_NU_UEGO1 1 100 0.0 0.0 ECU_ADDRESS 0x40003008 BYTE_ORDER MSB_FIRST /end MEASUREMENT
/begin COMPU_METHOD CU_FLT_NU_UEGO1 "Conversion method for FLT_NU_UEGO1" RAT_FUNC "%10.0" "NU" COEFFS 0.000000 1.000000 0.000000 0.000000 0.000000 1.000000 /end COMPU_METHOD
/* Scalar measurable for DDE 'FLT_NU_UEGO2'. */
/begin MEASUREMENT FLT_NU_UEGO2 "Exported Global for sensor fault status" UBYTE CU_FLT_NU_UEGO2 1 100 0.0 0.0 ECU_ADDRESS 0x40003007 BYTE_ORDER MSB_FIRST /end MEASUREMENT
/begin COMPU_METHOD CU_FLT_NU_UEGO2 "Conversion method for FLT_NU_UEGO2" RAT_FUNC "%10.0" "NU" COEFFS 0.000000 1.000000 0.000000 0.000000 0.000000 1.000000 /end COMPU_METHOD
/* Scalar measurable for DDE 'FLT_NU_VCP'. */
/begin MEASUREMENT FLT_NU_VCP "Exported Global for sensor fault status" UBYTE CU_FLT_NU_VCP 1 100 0.0 0.0 ECU_ADDRESS 0x4000300e BYTE_ORDER MSB_FIRST /end MEASUREMENT
/begin COMPU_METHOD CU_FLT_NU_VCP "Conversion method for FLT_NU_VCP" RAT_FUNC "%10.0" "NU" COEFFS 0.000000 1.000000 0.000000 0.000000 0.000000 1.000000 /end COMPU_METHOD
/* Scalar measurable for DDE 'FLT_NU_VRef'. */
/begin MEASUREMENT FLT_NU_VRef "Exported Global for sensor fault status" UBYTE CU_FLT_NU_VREF 1 100 0.0 0.0 ECU_ADDRESS 0x40003004 BYTE_ORDER MSB_FIRST /end MEASUREMENT
/begin COMPU_METHOD CU_FLT_NU_VREF "Conversion method for FLT_NU_VRef" RAT_FUNC "%10.0" "NU" COEFFS 0.000000 1.000000 0.000000 0.000000 0.000000 1.000000 /end COMPU_METHOD
/* Scalar measurable for DDE 'HHT_pct_EGO11_HeaterDuty'. */
/begin MEASUREMENT HHT_pct_EGO11_HeaterDuty "Displayable" FLOAT32_IEEE CU_HHT_PCT_EGO11_HEATERDUTY 1 100 0.0 0.0 ECU_ADDRESS 0x400036c4 BYTE_ORDER MSB_FIRST /end MEASUREMENT
/begin COMPU_METHOD CU_HHT_PCT_EGO11_HEATERDUTY "Conversion method for HHT_pct_EGO11_HeaterDuty" RAT_FUNC "%10.2" "pct" COEFFS 0.000000 1.000000 0.000000 0.000000 0.000000 1.000000 /end COMPU_METHOD
/* Scalar measurable for DDE 'HHT_pct_EGO12_HeaterDuty'. */
/begin MEASUREMENT HHT_pct_EGO12_HeaterDuty "Displayable" FLOAT32_IEEE CU_HHT_PCT_EGO12_HEATERDUTY 1 100 0.0 0.0 ECU_ADDRESS 0x400036bc BYTE_ORDER MSB_FIRST /end MEASUREMENT
/begin COMPU_METHOD CU_HHT_PCT_EGO12_HEATERDUTY "Conversion method for HHT_pct_EGO12_HeaterDuty" RAT_FUNC "%10.2" "pct" COEFFS 0.000000 1.000000 0.000000 0.000000 0.000000 1.000000 /end COMPU_METHOD
/* Scalar measurable for DDE 'HHT_pct_EGO21_HeaterDuty'. */
/begin MEASUREMENT HHT_pct_EGO21_HeaterDuty "Displayable" FLOAT32_IEEE CU_HHT_PCT_EGO21_HEATERDUTY 1 100 0.0 0.0 ECU_ADDRESS 0x400036c0 BYTE_ORDER MSB_FIRST /end MEASUREMENT
/begin COMPU_METHOD CU_HHT_PCT_EGO21_HEATERDUTY "Conversion method for HHT_pct_EGO21_HeaterDuty" RAT_FUNC "%10.2" "pct" COEFFS 0.000000 1.000000 0.000000 0.000000 0.000000 1.000000 /end COMPU_METHOD
/* Scalar measurable for DDE 'HHT_pct_EGO22_HeaterDuty'. */
/begin MEASUREMENT HHT_pct_EGO22_HeaterDuty "Displayable" FLOAT32_IEEE CU_HHT_PCT_EGO22_HEATERDUTY 1 100 0.0 0.0 ECU_ADDRESS 0x400036b8 BYTE_ORDER MSB_FIRST /end MEASUREMENT
/begin COMPU_METHOD CU_HHT_PCT_EGO22_HEATERDUTY "Conversion method for HHT_pct_EGO22_HeaterDuty" RAT_FUNC "%10.2" "pct" COEFFS 0.000000 1.000000 0.000000 0.000000 0.000000 1.000000 /end COMPU_METHOD
/* Scalar measurable for DDE 'LOG_NU_ManualPump'. */
/begin MEASUREMENT LOG_NU_ManualPump "Corrected Throttle Angle request output" ULONG CU_LOG_NU_MANUALPUMP 1 100 0.0 0.0 ECU_ADDRESS 0x40003058 BYTE_ORDER MSB_FIRST /end MEASUREMENT
/begin COMPU_METHOD CU_LOG_NU_MANUALPUMP "Conversion method for LOG_NU_ManualPump" RAT_FUNC "%10.0" "NU" COEFFS 0.000000 1.000000 0.000000 0.000000 0.000000 1.000000 /end COMPU_METHOD
/* Scalar measurable for DDE 'LOG_PWM_BLOWER'. */
/begin MEASUREMENT LOG_PWM_BLOWER "Displayable" FLOAT32_IEEE CU_LOG_PWM_BLOWER 1 100 0.0 1.0 ECU_ADDRESS 0x400036a4 BYTE_ORDER MSB_FIRST /end MEASUREMENT
/begin COMPU_METHOD CU_LOG_PWM_BLOWER "Conversion method for LOG_PWM_BLOWER" RAT_FUNC "%10.2" "V" COEFFS 0.000000 1.000000 0.000000 0.000000 0.000000 1.000000 /end COMPU_METHOD
/* Scalar measurable for DDE 'LOG_PWM_PUMP'. */
/begin MEASUREMENT LOG_PWM_PUMP "Displayable" FLOAT32_IEEE CU_LOG_PWM_PUMP 1 100 0.0 1.0 ECU_ADDRESS 0x400036a8 BYTE_ORDER MSB_FIRST /end MEASUREMENT
/begin COMPU_METHOD CU_LOG_PWM_PUMP "Conversion method for LOG_PWM_PUMP" RAT_FUNC "%10.2" "V" COEFFS 0.000000 1.000000 0.000000 0.000000 0.000000 1.000000 /end COMPU_METHOD
/* Scalar measurable for DDE 'LOG_b_RelePump1'. */
/begin MEASUREMENT LOG_b_RelePump1 "(not defined)" UBYTE CU_LOG_B_RELEPUMP1 1 100 0.0 1.0 ECU_ADDRESS 0x40002f22 BYTE_ORDER MSB_FIRST /end MEASUREMENT
/begin COMPU_METHOD CU_LOG_B_RELEPUMP1 "Conversion method for LOG_b_RelePump1" RAT_FUNC "%10.0" "b" COEFFS 0.000000 1.000000 0.000000 0.000000 0.000000 1.000000 /end COMPU_METHOD
/* Scalar measurable for DDE 'LOG_b_RelePump2'. */
/begin MEASUREMENT LOG_b_RelePump2 "(not defined)" UBYTE CU_LOG_B_RELEPUMP2 1 100 0.0 1.0 ECU_ADDRESS 0x40002f21 BYTE_ORDER MSB_FIRST /end MEASUREMENT
/begin COMPU_METHOD CU_LOG_B_RELEPUMP2 "Conversion method for LOG_b_RelePump2" RAT_FUNC "%10.0" "b" COEFFS 0.000000 1.000000 0.000000 0.000000 0.000000 1.000000 /end COMPU_METHOD
/* Scalar measurable for DDE 'OUT_Hz_EngSpd'. */
/begin MEASUREMENT OUT_Hz_EngSpd "(not defined)" FLOAT32_IEEE CU_OUT_HZ_ENGSPD 1 100 0.0 0.0 ECU_ADDRESS 0x400036ac BYTE_ORDER MSB_FIRST /end MEASUREMENT
/begin COMPU_METHOD CU_OUT_HZ_ENGSPD "Conversion method for OUT_Hz_EngSpd" RAT_FUNC "%10.4" "Hz" COEFFS 0.000000 1.000000 0.000000 0.000000 0.000000 1.000000 /end COMPU_METHOD
/* Scalar measurable for DDE 'OUT_Hz_VhSpd'. */
/begin MEASUREMENT OUT_Hz_VhSpd "(not defined)" FLOAT32_IEEE CU_OUT_HZ_VHSPD 1 100 0.0 0.0 ECU_ADDRESS 0x400036b0 BYTE_ORDER MSB_FIRST /end MEASUREMENT
/begin COMPU_METHOD CU_OUT_HZ_VHSPD "Conversion method for OUT_Hz_VhSpd" RAT_FUNC "%10.4" "Hz" COEFFS 0.000000 1.000000 0.000000 0.000000 0.000000 1.000000 /end COMPU_METHOD
/* Scalar measurable for DDE 'OUT_b_BankA_Enbld'. */
/begin MEASUREMENT OUT_b_BankA_Enbld "Injections will not occur until this is enabled" UBYTE CU_OUT_B_BANKA_ENBLD 1 100 0.0 1.0 ECU_ADDRESS 0x40002f1d BYTE_ORDER MSB_FIRST /end MEASUREMENT
/begin COMPU_METHOD CU_OUT_B_BANKA_ENBLD "Conversion method for OUT_b_BankA_Enbld" RAT_FUNC "%10.0" "b" COEFFS 0.000000 1.000000 0.000000 0.000000 0.000000 1.000000 /end COMPU_METHOD
/* Scalar measurable for DDE 'OUT_b_BankB_Enbld'. */
/begin MEASUREMENT OUT_b_BankB_Enbld "Injections will not occur until this is enabled" UBYTE CU_OUT_B_BANKB_ENBLD 1 100 0.0 1.0 ECU_ADDRESS 0x40002f1c BYTE_ORDER MSB_FIRST /end MEASUREMENT
/begin COMPU_METHOD CU_OUT_B_BANKB_ENBLD "Conversion method for OUT_b_BankB_Enbld" RAT_FUNC "%10.0" "b" COEFFS 0.000000 1.000000 0.000000 0.000000 0.000000 1.000000 /end COMPU_METHOD
/* Scalar measurable for DDE 'OUT_b_CombustionAllCyls'. */
/begin MEASUREMENT OUT_b_CombustionAllCyls "Displayable" UBYTE CU_OUT_B_COMBUSTIONALLCYLS 1 100 0.0 1.0 ECU_ADDRESS 0x40002f0b BYTE_ORDER MSB_FIRST /end MEASUREMENT
/begin COMPU_METHOD CU_OUT_B_COMBUSTIONALLCYLS "Conversion method for OUT_b_CombustionAllCyls" RAT_FUNC "%10.0" "b" COEFFS 0.000000 1.000000 0.000000 0.000000 0.000000 1.000000 /end COMPU_METHOD
/* Scalar measurable for DDE 'OUT_b_FlashChecksum'. */
/begin MEASUREMENT OUT_b_FlashChecksum "Displayable" UBYTE CU_OUT_B_FLASHCHECKSUM 1 100 0.0 1.0 ECU_ADDRESS 0x40002f23 BYTE_ORDER MSB_FIRST /end MEASUREMENT
/begin COMPU_METHOD CU_OUT_B_FLASHCHECKSUM "Conversion method for OUT_b_FlashChecksum" RAT_FUNC "%10.0" "b" COEFFS 0.000000 1.000000 0.000000 0.000000 0.000000 1.000000 /end COMPU_METHOD
/* Scalar measurable for DDE 'OUT_b_HighsideY1'. */
/begin MEASUREMENT OUT_b_HighsideY1 "Displayable" UBYTE CU_OUT_B_HIGHSIDEY1 1 100 0.0 1.0 ECU_ADDRESS 0x40002f11 BYTE_ORDER MSB_FIRST /end MEASUREMENT
/begin COMPU_METHOD CU_OUT_B_HIGHSIDEY1 "Conversion method for OUT_b_HighsideY1" RAT_FUNC "%10.0" "b" COEFFS 0.000000 1.000000 0.000000 0.000000 0.000000 1.000000 /end COMPU_METHOD
/* Scalar measurable for DDE 'OUT_b_HighsideY5'. */
/begin MEASUREMENT OUT_b_HighsideY5 "Displayable" UBYTE CU_OUT_B_HIGHSIDEY5 1 100 0.0 1.0 ECU_ADDRESS 0x40002f12 BYTE_ORDER MSB_FIRST /end MEASUREMENT
/begin COMPU_METHOD CU_OUT_B_HIGHSIDEY5 "Conversion method for OUT_b_HighsideY5" RAT_FUNC "%10.0" "b" COEFFS 0.000000 1.000000 0.000000 0.000000 0.000000 1.000000 /end COMPU_METHOD
/* Scalar measurable for DDE 'OUT_b_Inj1_LSD_Active'. */
/begin MEASUREMENT OUT_b_Inj1_LSD_Active "Displayable" UBYTE CU_OUT_B_INJ1_LSD_ACTIVE 1 100 0.0 1.0 ECU_ADDRESS 0x40002f17 BYTE_ORDER MSB_FIRST /end MEASUREMENT
/begin COMPU_METHOD CU_OUT_B_INJ1_LSD_ACTIVE "Conversion method for OUT_b_Inj1_LSD_Active" RAT_FUNC "%10.0" "b" COEFFS 0.000000 1.000000 0.000000 0.000000 0.000000 1.000000 /end COMPU_METHOD
/* Scalar measurable for DDE 'OUT_b_Inj2_LSD_Active'. */
/begin MEASUREMENT OUT_b_Inj2_LSD_Active "Displayable" UBYTE CU_OUT_B_INJ2_LSD_ACTIVE 1 100 0.0 1.0 ECU_ADDRESS 0x40002f16 BYTE_ORDER MSB_FIRST /end MEASUREMENT
/begin COMPU_METHOD CU_OUT_B_INJ2_LSD_ACTIVE "Conversion method for OUT_b_Inj2_LSD_Active" RAT_FUNC "%10.0" "b" COEFFS 0.000000 1.000000 0.000000 0.000000 0.000000 1.000000 /end COMPU_METHOD
/* Scalar measurable for DDE 'OUT_b_Inj3_LSD_Active'. */
/begin MEASUREMENT OUT_b_Inj3_LSD_Active "Displayable" UBYTE CU_OUT_B_INJ3_LSD_ACTIVE 1 100 0.0 1.0 ECU_ADDRESS 0x40002f15 BYTE_ORDER MSB_FIRST /end MEASUREMENT
/begin COMPU_METHOD CU_OUT_B_INJ3_LSD_ACTIVE "Conversion method for OUT_b_Inj3_LSD_Active" RAT_FUNC "%10.0" "b" COEFFS 0.000000 1.000000 0.000000 0.000000 0.000000 1.000000 /end COMPU_METHOD
/* Scalar measurable for DDE 'OUT_b_Inj4_LSD_Active'. */
/begin MEASUREMENT OUT_b_Inj4_LSD_Active "Displayable" UBYTE CU_OUT_B_INJ4_LSD_ACTIVE 1 100 0.0 1.0 ECU_ADDRESS 0x40002f14 BYTE_ORDER MSB_FIRST /end MEASUREMENT
/begin COMPU_METHOD CU_OUT_B_INJ4_LSD_ACTIVE "Conversion method for OUT_b_Inj4_LSD_Active" RAT_FUNC "%10.0" "b" COEFFS 0.000000 1.000000 0.000000 0.000000 0.000000 1.000000 /end COMPU_METHOD
/* Scalar measurable for DDE 'OUT_b_PT_Relay'. */
/begin MEASUREMENT OUT_b_PT_Relay "Displayable" UBYTE CU_OUT_B_PT_RELAY 1 100 0.0 1.0 ECU_ADDRESS 0x40002f13 BYTE_ORDER MSB_FIRST /end MEASUREMENT
/begin COMPU_METHOD CU_OUT_B_PT_RELAY "Conversion method for OUT_b_PT_Relay" RAT_FUNC "%10.0" "b" COEFFS 0.000000 1.000000 0.000000 0.000000 0.000000 1.000000 /end COMPU_METHOD
/* Scalar measurable for DDE 'OUT_b_PT_RelayEnergized'. */
/begin MEASUREMENT OUT_b_PT_RelayEnergized "Status reported to the rest of the system" UBYTE CU_OUT_B_PT_RELAYENERGIZED 1 100 0.0 1.0 ECU_ADDRESS 0x40002f0c BYTE_ORDER MSB_FIRST /end MEASUREMENT
/begin COMPU_METHOD CU_OUT_B_PT_RELAYENERGIZED "Conversion method for OUT_b_PT_RelayEnergized" RAT_FUNC "%10.0" "b" COEFFS 0.000000 1.000000 0.000000 0.000000 0.000000 1.000000 /end COMPU_METHOD
/* Scalar measurable for DDE 'OUT_b_RAM_Checksum'. */
/begin MEASUREMENT OUT_b_RAM_Checksum "Displayable" UBYTE CU_OUT_B_RAM_CHECKSUM 1 100 0.0 1.0 ECU_ADDRESS 0x40002f24 BYTE_ORDER MSB_FIRST /end MEASUREMENT
/begin COMPU_METHOD CU_OUT_B_RAM_CHECKSUM "Conversion method for OUT_b_RAM_Checksum" RAT_FUNC "%10.0" "b" COEFFS 0.000000 1.000000 0.000000 0.000000 0.000000 1.000000 /end COMPU_METHOD
/* Scalar measurable for DDE 'OUT_b_Spk1_Active'. */
/begin MEASUREMENT OUT_b_Spk1_Active "Displayable" UBYTE CU_OUT_B_SPK1_ACTIVE 1 100 0.0 1.0 ECU_ADDRESS 0x40002f1b BYTE_ORDER MSB_FIRST /end MEASUREMENT
/begin COMPU_METHOD CU_OUT_B_SPK1_ACTIVE "Conversion method for OUT_b_Spk1_Active" RAT_FUNC "%10.0" "b" COEFFS 0.000000 1.000000 0.000000 0.000000 0.000000 1.000000 /end COMPU_METHOD
/* Scalar measurable for DDE 'OUT_b_Spk2_Active'. */
/begin MEASUREMENT OUT_b_Spk2_Active "Displayable" UBYTE CU_OUT_B_SPK2_ACTIVE 1 100 0.0 1.0 ECU_ADDRESS 0x40002f1a BYTE_ORDER MSB_FIRST /end MEASUREMENT
/begin COMPU_METHOD CU_OUT_B_SPK2_ACTIVE "Conversion method for OUT_b_Spk2_Active" RAT_FUNC "%10.0" "b" COEFFS 0.000000 1.000000 0.000000 0.000000 0.000000 1.000000 /end COMPU_METHOD
/* Scalar measurable for DDE 'OUT_b_Spk3_Active'. */
/begin MEASUREMENT OUT_b_Spk3_Active "Displayable" UBYTE CU_OUT_B_SPK3_ACTIVE 1 100 0.0 1.0 ECU_ADDRESS 0x40002f19 BYTE_ORDER MSB_FIRST /end MEASUREMENT
/begin COMPU_METHOD CU_OUT_B_SPK3_ACTIVE "Conversion method for OUT_b_Spk3_Active" RAT_FUNC "%10.0" "b" COEFFS 0.000000 1.000000 0.000000 0.000000 0.000000 1.000000 /end COMPU_METHOD
/* Scalar measurable for DDE 'OUT_b_Spk4_Active'. */
/begin MEASUREMENT OUT_b_Spk4_Active "Displayable" UBYTE CU_OUT_B_SPK4_ACTIVE 1 100 0.0 1.0 ECU_ADDRESS 0x40002f18 BYTE_ORDER MSB_FIRST /end MEASUREMENT
/begin COMPU_METHOD CU_OUT_B_SPK4_ACTIVE "Conversion method for OUT_b_Spk4_Active" RAT_FUNC "%10.0" "b" COEFFS 0.000000 1.000000 0.000000 0.000000 0.000000 1.000000 /end COMPU_METHOD
/* Scalar measurable for DDE 'OUT_b_Spk5_Active'. */
/begin MEASUREMENT OUT_b_Spk5_Active "Displayable" UBYTE CU_OUT_B_SPK5_ACTIVE 1 100 0.0 1.0 ECU_ADDRESS 0x40002f10 BYTE_ORDER MSB_FIRST /end MEASUREMENT
/begin COMPU_METHOD CU_OUT_B_SPK5_ACTIVE "Conversion method for OUT_b_Spk5_Active" RAT_FUNC "%10.0" "b" COEFFS 0.000000 1.000000 0.000000 0.000000 0.000000 1.000000 /end COMPU_METHOD
/* Scalar measurable for DDE 'OUT_b_Spk6_Active'. */
/begin MEASUREMENT OUT_b_Spk6_Active "Displayable" UBYTE CU_OUT_B_SPK6_ACTIVE 1 100 0.0 1.0 ECU_ADDRESS 0x40002f0f BYTE_ORDER MSB_FIRST /end MEASUREMENT
/begin COMPU_METHOD CU_OUT_B_SPK6_ACTIVE "Conversion method for OUT_b_Spk6_Active" RAT_FUNC "%10.0" "b" COEFFS 0.000000 1.000000 0.000000 0.000000 0.000000 1.000000 /end COMPU_METHOD
/* Scalar measurable for DDE 'OUT_b_Spk7_Active'. */
/begin MEASUREMENT OUT_b_Spk7_Active "Displayable" UBYTE CU_OUT_B_SPK7_ACTIVE 1 100 0.0 1.0 ECU_ADDRESS 0x40002f0e BYTE_ORDER MSB_FIRST /end MEASUREMENT
/begin COMPU_METHOD CU_OUT_B_SPK7_ACTIVE "Conversion method for OUT_b_Spk7_Active" RAT_FUNC "%10.0" "b" COEFFS 0.000000 1.000000 0.000000 0.000000 0.000000 1.000000 /end COMPU_METHOD
/* Scalar measurable for DDE 'OUT_b_Spk8_Active'. */
/begin MEASUREMENT OUT_b_Spk8_Active "Displayable" UBYTE CU_OUT_B_SPK8_ACTIVE 1 100 0.0 1.0 ECU_ADDRESS 0x40002f0d BYTE_ORDER MSB_FIRST /end MEASUREMENT
/begin COMPU_METHOD CU_OUT_B_SPK8_ACTIVE "Conversion method for OUT_b_Spk8_Active" RAT_FUNC "%10.0" "b" COEFFS 0.000000 1.000000 0.000000 0.000000 0.000000 1.000000 /end COMPU_METHOD
/* Scalar measurable for DDE 'OUT_b_VISCO_1st'. */
/begin MEASUREMENT OUT_b_VISCO_1st "(not defined)" UBYTE CU_OUT_B_VISCO_1ST 1 100 0.0 1.0 ECU_ADDRESS 0x40002f20 BYTE_ORDER MSB_FIRST /end MEASUREMENT
/begin COMPU_METHOD CU_OUT_B_VISCO_1ST "Conversion method for OUT_b_VISCO_1st" RAT_FUNC "%10.0" "b" COEFFS 0.000000 1.000000 0.000000 0.000000 0.000000 1.000000 /end COMPU_METHOD
/* Scalar measurable for DDE 'OUT_b_VISCO_2nd'. */
/begin MEASUREMENT OUT_b_VISCO_2nd "(not defined)" UBYTE CU_OUT_B_VISCO_2ND 1 100 0.0 1.0 ECU_ADDRESS 0x40002f1f BYTE_ORDER MSB_FIRST /end MEASUREMENT
/begin COMPU_METHOD CU_OUT_B_VISCO_2ND "Conversion method for OUT_b_VISCO_2nd" RAT_FUNC "%10.0" "b" COEFFS 0.000000 1.000000 0.000000 0.000000 0.000000 1.000000 /end COMPU_METHOD
/* Scalar measurable for DDE 'SOV_b_OpenValve1'. */
/begin MEASUREMENT SOV_b_OpenValve1 "Displayable" UBYTE CU_SOV_B_OPENVALVE1 1 100 0.0 1.0 ECU_ADDRESS 0x40002f26 BYTE_ORDER MSB_FIRST /end MEASUREMENT
/begin COMPU_METHOD CU_SOV_B_OPENVALVE1 "Conversion method for SOV_b_OpenValve1" RAT_FUNC "%10.0" "b" COEFFS 0.000000 1.000000 0.000000 0.000000 0.000000 1.000000 /end COMPU_METHOD
/* Scalar measurable for DDE 'SOV_b_OpenValve2'. */
/begin MEASUREMENT SOV_b_OpenValve2 "Displayable" UBYTE CU_SOV_B_OPENVALVE2 1 100 0.0 1.0 ECU_ADDRESS 0x40002f25 BYTE_ORDER MSB_FIRST /end MEASUREMENT
/begin COMPU_METHOD CU_SOV_B_OPENVALVE2 "Conversion method for SOV_b_OpenValve2" RAT_FUNC "%10.0" "b" COEFFS 0.000000 1.000000 0.000000 0.000000 0.000000 1.000000 /end COMPU_METHOD
/* Scalar measurable for DDE 'STR_b_ManualStarter'. */
/begin MEASUREMENT STR_b_ManualStarter "Displayable- global fault management control signal, sent to each FBM" UBYTE CU_STR_B_MANUALSTARTER 1 100 0.0 1.0 ECU_ADDRESS 0x40002f2b BYTE_ORDER MSB_FIRST /end MEASUREMENT
/begin COMPU_METHOD CU_STR_B_MANUALSTARTER "Conversion method for STR_b_ManualStarter" RAT_FUNC "%10.0" "b" COEFFS 0.000000 1.000000 0.000000 0.000000 0.000000 1.000000 /end COMPU_METHOD
/* Scalar measurable for DDE 'SYS_NU_CurrCyl'. */
/begin MEASUREMENT SYS_NU_CurrCyl "Current cyclinder" UBYTE CU_SYS_NU_CURRCYL 1 100 0.0 4.0 ECU_ADDRESS 0x40002fd9 BYTE_ORDER MSB_FIRST /end MEASUREMENT
/begin COMPU_METHOD CU_SYS_NU_CURRCYL "Conversion method for SYS_NU_CurrCyl" RAT_FUNC "%10.0" "NU" COEFFS 0.000000 1.000000 0.000000 0.000000 0.000000 1.000000 /end COMPU_METHOD
/* Scalar measurable for DDE 'SYS_NU_ResetType'. */
/begin MEASUREMENT SYS_NU_ResetType "Bit flags for reset status" UBYTE CU_SYS_NU_RESETTYPE 1 100 0.0 128.0 ECU_ADDRESS 0x40003014 BYTE_ORDER MSB_FIRST /end MEASUREMENT
/begin COMPU_METHOD CU_SYS_NU_RESETTYPE "Conversion method for SYS_NU_ResetType" RAT_FUNC "%10.0" "NU" COEFFS 0.000000 1.000000 0.000000 0.000000 0.000000 1.000000 /end COMPU_METHOD
/* Scalar measurable for DDE 'SYS_b_CurrCylValid'. */
/begin MEASUREMENT SYS_b_CurrCylValid "Current cyclinder valid flag" UBYTE CU_SYS_B_CURRCYLVALID 1 100 0.0 1.0 ECU_ADDRESS 0x40002e2c BYTE_ORDER MSB_FIRST /end MEASUREMENT
/begin COMPU_METHOD CU_SYS_B_CURRCYLVALID "Conversion method for SYS_b_CurrCylValid" RAT_FUNC "%10.0" "b" COEFFS 0.000000 1.000000 0.000000 0.000000 0.000000 1.000000 /end COMPU_METHOD
/* Scalar measurable for DDE 'SYS_e_CAN0_State'. */
/begin MEASUREMENT SYS_e_CAN0_State "CAN0 bus state" FLOAT32_IEEE CU_SYS_E_CAN0_STATE 1 100 0.0 2.0 ECU_ADDRESS 0x4000369c BYTE_ORDER MSB_FIRST /end MEASUREMENT
/begin COMPU_METHOD CU_SYS_E_CAN0_STATE "Conversion method for SYS_e_CAN0_State" TAB_VERB "%12.0" "e" COMPU_TAB_REF CT_SYS_E_CAN0_STATE /end COMPU_METHOD
/begin COMPU_VTAB CT_SYS_E_CAN0_STATE "Conversion method for SYS_e_CAN0_State" TAB_VERB 3 0 "SYSk_e_CAN_Active" 1 "SYSk_e_CAN_ErrorPassive" 2 "SYSk_e_CAN_BusOff" /end COMPU_VTAB
/* Scalar measurable for DDE 'SYS_e_CAN1_State'. */
/begin MEASUREMENT SYS_e_CAN1_State "CAN1 bus state" FLOAT32_IEEE CU_SYS_E_CAN1_STATE 1 100 0.0 2.0 ECU_ADDRESS 0x40003694 BYTE_ORDER MSB_FIRST /end MEASUREMENT
/begin COMPU_METHOD CU_SYS_E_CAN1_STATE "Conversion method for SYS_e_CAN1_State" TAB_VERB "%12.0" "e" COMPU_TAB_REF CT_SYS_E_CAN1_STATE /end COMPU_METHOD
/begin COMPU_VTAB CT_SYS_E_CAN1_STATE "Conversion method for SYS_e_CAN1_State" TAB_VERB 3 0 "SYSk_e_CAN_Active" 1 "SYSk_e_CAN_ErrorPassive" 2 "SYSk_e_CAN_BusOff" /end COMPU_VTAB
/* Scalar measurable for DDE 'SYS_e_CAN3_State'. */
/begin MEASUREMENT SYS_e_CAN3_State "CAN3 bus state" FLOAT32_IEEE CU_SYS_E_CAN3_STATE 1 100 0.0 2.0 ECU_ADDRESS 0x40003698 BYTE_ORDER MSB_FIRST /end MEASUREMENT
/begin COMPU_METHOD CU_SYS_E_CAN3_STATE "Conversion method for SYS_e_CAN3_State" TAB_VERB "%12.0" "e" COMPU_TAB_REF CT_SYS_E_CAN3_STATE /end COMPU_METHOD
/begin COMPU_VTAB CT_SYS_E_CAN3_STATE "Conversion method for SYS_e_CAN3_State" TAB_VERB 3 0 "SYSk_e_CAN_Active" 1 "SYSk_e_CAN_ErrorPassive" 2 "SYSk_e_CAN_BusOff" /end COMPU_VTAB
/* Scalar measurable for DDE 'SYS_s_BootDuration'. */
/begin MEASUREMENT SYS_s_BootDuration "Time taken for ECU boot" FLOAT32_IEEE CU_SYS_S_BOOTDURATION 1 100 0.0 100.0 ECU_ADDRESS 0x400036b4 BYTE_ORDER MSB_FIRST /end MEASUREMENT
/begin COMPU_METHOD CU_SYS_S_BOOTDURATION "Conversion method for SYS_s_BootDuration" RAT_FUNC "%10.6" "s" COEFFS 0.000000 1.000000 0.000000 0.000000 0.000000 1.000000 /end COMPU_METHOD
/* Scalar measurable for DDE 'TAR_Nm_J1939DrvrDmndTq'. */
/begin MEASUREMENT TAR_Nm_J1939DrvrDmndTq "(not defined)" FLOAT32_IEEE CU_TAR_NM_J1939DRVRDMNDTQ 1 100 3.0 3.0 ECU_ADDRESS 0x40003298 BYTE_ORDER MSB_FIRST /end MEASUREMENT
/begin COMPU_METHOD CU_TAR_NM_J1939DRVRDMNDTQ "Conversion method for TAR_Nm_J1939DrvrDmndTq" RAT_FUNC "%10.0" "Nm" COEFFS 0.000000 1.000000 0.000000 0.000000 0.000000 1.000000 /end COMPU_METHOD
/* Scalar measurable for DDE 'mpl_app_build_day'. */
/begin MEASUREMENT mpl_app_build_day "Date application was built in days." UWORD CU_MPL_APP_BUILD_DAY 1 100 0.0 65535.0 ECU_ADDRESS 0x152964 BYTE_ORDER MSB_FIRST /end MEASUREMENT
/begin COMPU_METHOD CU_MPL_APP_BUILD_DAY "Conversion method for mpl_app_build_day" RAT_FUNC "%10.0" "(not defined)" COEFFS 0.000000 1.000000 0.000000 0.000000 0.000000 1.000000 /end COMPU_METHOD
/* Scalar measurable for DDE 'mpl_app_build_hour'. */
/begin MEASUREMENT mpl_app_build_hour "Time application was built in hours" UWORD CU_MPL_APP_BUILD_HOUR 1 100 0.0 65535.0 ECU_ADDRESS 0x152966 BYTE_ORDER MSB_FIRST /end MEASUREMENT
/begin COMPU_METHOD CU_MPL_APP_BUILD_HOUR "Conversion method for mpl_app_build_hour" RAT_FUNC "%10.0" "(not defined)" COEFFS 0.000000 1.000000 0.000000 0.000000 0.000000 1.000000 /end COMPU_METHOD
/* Scalar measurable for DDE 'mpl_app_build_min'. */
/begin MEASUREMENT mpl_app_build_min "Time application was built in minutes" UWORD CU_MPL_APP_BUILD_MIN 1 100 0.0 65535.0 ECU_ADDRESS 0x152968 BYTE_ORDER MSB_FIRST /end MEASUREMENT
/begin COMPU_METHOD CU_MPL_APP_BUILD_MIN "Conversion method for mpl_app_build_min" RAT_FUNC "%10.0" "(not defined)" COEFFS 0.000000 1.000000 0.000000 0.000000 0.000000 1.000000 /end COMPU_METHOD
/* Scalar measurable for DDE 'mpl_app_build_month'. */
/begin MEASUREMENT mpl_app_build_month "Date application was built in months." UWORD CU_MPL_APP_BUILD_MONTH 1 100 0.0 65535.0 ECU_ADDRESS 0x152962 BYTE_ORDER MSB_FIRST /end MEASUREMENT
/begin COMPU_METHOD CU_MPL_APP_BUILD_MONTH "Conversion method for mpl_app_build_month" RAT_FUNC "%10.0" "(not defined)" COEFFS 0.000000 1.000000 0.000000 0.000000 0.000000 1.000000 /end COMPU_METHOD
/* Scalar measurable for DDE 'mpl_app_build_sec'. */
/begin MEASUREMENT mpl_app_build_sec "Time application was built in seconds" UWORD CU_MPL_APP_BUILD_SEC 1 100 0.0 65535.0 ECU_ADDRESS 0x15296a BYTE_ORDER MSB_FIRST /end MEASUREMENT
/begin COMPU_METHOD CU_MPL_APP_BUILD_SEC "Conversion method for mpl_app_build_sec" RAT_FUNC "%10.0" "(not defined)" COEFFS 0.000000 1.000000 0.000000 0.000000 0.000000 1.000000 /end COMPU_METHOD
/* Scalar measurable for DDE 'mpl_app_build_year'. */
/begin MEASUREMENT mpl_app_build_year "Date application was built in years." UWORD CU_MPL_APP_BUILD_YEAR 1 100 0.0 65535.0 ECU_ADDRESS 0x152960 BYTE_ORDER MSB_FIRST /end MEASUREMENT
/begin COMPU_METHOD CU_MPL_APP_BUILD_YEAR "Conversion method for mpl_app_build_year" RAT_FUNC "%10.0" "(not defined)" COEFFS 0.000000 1.000000 0.000000 0.000000 0.000000 1.000000 /end COMPU_METHOD
/* Scalar measurable for DDE 'mpl_app_ver_major'. */
/begin MEASUREMENT mpl_app_ver_major "App major version number" UWORD CU_MPL_APP_VER_MAJOR 1 100 0.0 65535.0 ECU_ADDRESS 0x92ab2 BYTE_ORDER MSB_FIRST /end MEASUREMENT
/begin COMPU_METHOD CU_MPL_APP_VER_MAJOR "Conversion method for mpl_app_ver_major" RAT_FUNC "%10.0" "(not defined)" COEFFS 0.000000 1.000000 0.000000 0.000000 0.000000 1.000000 /end COMPU_METHOD
/* Scalar measurable for DDE 'mpl_app_ver_minor'. */
/begin MEASUREMENT mpl_app_ver_minor "App minor version number" UWORD CU_MPL_APP_VER_MINOR 1 100 0.0 65535.0 ECU_ADDRESS 0x92ab0 BYTE_ORDER MSB_FIRST /end MEASUREMENT
/begin COMPU_METHOD CU_MPL_APP_VER_MINOR "Conversion method for mpl_app_ver_minor" RAT_FUNC "%10.0" "(not defined)" COEFFS 0.000000 1.000000 0.000000 0.000000 0.000000 1.000000 /end COMPU_METHOD
/* Scalar measurable for DDE 'mpl_app_ver_sub'. */
/begin MEASUREMENT mpl_app_ver_sub "App sub-minor version number" UWORD CU_MPL_APP_VER_SUB 1 100 0.0 65535.0 ECU_ADDRESS 0x92aae BYTE_ORDER MSB_FIRST /end MEASUREMENT
/begin COMPU_METHOD CU_MPL_APP_VER_SUB "Conversion method for mpl_app_ver_sub" RAT_FUNC "%10.0" "(not defined)" COEFFS 0.000000 1.000000 0.000000 0.000000 0.000000 1.000000 /end COMPU_METHOD
/* Scalar measurable for DDE 'mpl_boot_build_day'. */
/begin MEASUREMENT mpl_boot_build_day "Boot build day" UWORD CU_MPL_BOOT_BUILD_DAY 1 100 0.0 65535.0 ECU_ADDRESS 0x40003ca2 BYTE_ORDER MSB_FIRST /end MEASUREMENT
/begin COMPU_METHOD CU_MPL_BOOT_BUILD_DAY "Conversion method for mpl_boot_build_day" RAT_FUNC "%10.0" "(not defined)" COEFFS 0.000000 1.000000 0.000000 0.000000 0.000000 1.000000 /end COMPU_METHOD
/* Scalar measurable for DDE 'mpl_boot_build_month'. */
/begin MEASUREMENT mpl_boot_build_month "Boot build month" UWORD CU_MPL_BOOT_BUILD_MONTH 1 100 0.0 65535.0 ECU_ADDRESS 0x40003ca4 BYTE_ORDER MSB_FIRST /end MEASUREMENT
/begin COMPU_METHOD CU_MPL_BOOT_BUILD_MONTH "Conversion method for mpl_boot_build_month" RAT_FUNC "%10.0" "(not defined)" COEFFS 0.000000 1.000000 0.000000 0.000000 0.000000 1.000000 /end COMPU_METHOD
/* Scalar measurable for DDE 'mpl_boot_build_year'. */
/begin MEASUREMENT mpl_boot_build_year "Boot build year" UWORD CU_MPL_BOOT_BUILD_YEAR 1 100 0.0 65535.0 ECU_ADDRESS 0x40003ca6 BYTE_ORDER MSB_FIRST /end MEASUREMENT
/begin COMPU_METHOD CU_MPL_BOOT_BUILD_YEAR "Conversion method for mpl_boot_build_year" RAT_FUNC "%10.0" "(not defined)" COEFFS 0.000000 1.000000 0.000000 0.000000 0.000000 1.000000 /end COMPU_METHOD
/* Scalar measurable for DDE 'mpl_boot_part_num_group'. */
/begin MEASUREMENT mpl_boot_part_num_group "Boot Group ID number in the part number" UBYTE CU_MPL_BOOT_PART_NUM_GROUP 1 100 0.0 255.0 ECU_ADDRESS 0x40003ca8 BYTE_ORDER MSB_FIRST /end MEASUREMENT
/begin COMPU_METHOD CU_MPL_BOOT_PART_NUM_GROUP "Conversion method for mpl_boot_part_num_group" RAT_FUNC "%10.0" "(not defined)" COEFFS 0.000000 1.000000 0.000000 0.000000 0.000000 1.000000 /end COMPU_METHOD
/* Scalar measurable for DDE 'mpl_boot_part_num_id'. */
/begin MEASUREMENT mpl_boot_part_num_id "Boot Part ID in the part number" ULONG CU_MPL_BOOT_PART_NUM_ID 1 100 0.0 4294967295.0 ECU_ADDRESS 0x40003cac BYTE_ORDER MSB_FIRST /end MEASUREMENT
/begin COMPU_METHOD CU_MPL_BOOT_PART_NUM_ID "Conversion method for mpl_boot_part_num_id" RAT_FUNC "%10.0" "(not defined)" COEFFS 0.000000 1.000000 0.000000 0.000000 0.000000 1.000000 /end COMPU_METHOD
/* Scalar measurable for DDE 'mpl_boot_part_num_issue'. */
/begin MEASUREMENT mpl_boot_part_num_issue "Boot Issue Number in the part number" UWORD CU_MPL_BOOT_PART_NUM_ISSUE 1 100 0.0 65535.0 ECU_ADDRESS 0x40003cb0 BYTE_ORDER MSB_FIRST /end MEASUREMENT
/begin COMPU_METHOD CU_MPL_BOOT_PART_NUM_ISSUE "Conversion method for mpl_boot_part_num_issue" RAT_FUNC "%10.0" "(not defined)" COEFFS 0.000000 1.000000 0.000000 0.000000 0.000000 1.000000 /end COMPU_METHOD
/* Scalar measurable for DDE 'mpl_boot_part_num_letter'. */
/begin MEASUREMENT mpl_boot_part_num_letter "Boot Group Letter in the part number" UBYTE CU_MPL_BOOT_PART_NUM_LETTER 1 100 0.0 255.0 ECU_ADDRESS 0x40003ca9 BYTE_ORDER MSB_FIRST /end MEASUREMENT
/begin COMPU_METHOD CU_MPL_BOOT_PART_NUM_LETTER "Conversion method for mpl_boot_part_num_letter" RAT_FUNC "%10.0" "(not defined)" COEFFS 0.000000 1.000000 0.000000 0.000000 0.000000 1.000000 /end COMPU_METHOD
/* Scalar measurable for DDE 'mpl_boot_ver_major'. */
/begin MEASUREMENT mpl_boot_ver_major "Boot major version number" UWORD CU_MPL_BOOT_VER_MAJOR 1 100 0.0 65535.0 ECU_ADDRESS 0x40003c9c BYTE_ORDER MSB_FIRST /end MEASUREMENT
/begin COMPU_METHOD CU_MPL_BOOT_VER_MAJOR "Conversion method for mpl_boot_ver_major" RAT_FUNC "%10.0" "(not defined)" COEFFS 0.000000 1.000000 0.000000 0.000000 0.000000 1.000000 /end COMPU_METHOD
/* Scalar measurable for DDE 'mpl_boot_ver_minor'. */
/begin MEASUREMENT mpl_boot_ver_minor "Boot minor version number" UWORD CU_MPL_BOOT_VER_MINOR 1 100 0.0 65535.0 ECU_ADDRESS 0x40003c9e BYTE_ORDER MSB_FIRST /end MEASUREMENT
/begin COMPU_METHOD CU_MPL_BOOT_VER_MINOR "Conversion method for mpl_boot_ver_minor" RAT_FUNC "%10.0" "(not defined)" COEFFS 0.000000 1.000000 0.000000 0.000000 0.000000 1.000000 /end COMPU_METHOD
/* Scalar measurable for DDE 'mpl_boot_ver_sub'. */
/begin MEASUREMENT mpl_boot_ver_sub "Boot sub minor version number" UWORD CU_MPL_BOOT_VER_SUB 1 100 0.0 65535.0 ECU_ADDRESS 0x40003ca0 BYTE_ORDER MSB_FIRST /end MEASUREMENT
/begin COMPU_METHOD CU_MPL_BOOT_VER_SUB "Conversion method for mpl_boot_ver_sub" RAT_FUNC "%10.0" "(not defined)" COEFFS 0.000000 1.000000 0.000000 0.000000 0.000000 1.000000 /end COMPU_METHOD
/* Scalar measurable for DDE 'mpl_cpu_loaded'. */
/begin MEASUREMENT mpl_cpu_loaded "CPU loading each 50ms" UBYTE CU_MPL_CPU_LOADED 1 100 0.0 255.0 ECU_ADDRESS 0x40003c94 BYTE_ORDER MSB_FIRST /end MEASUREMENT
/begin COMPU_METHOD CU_MPL_CPU_LOADED "Conversion method for mpl_cpu_loaded" RAT_FUNC "%10.0" "%" COEFFS 0.000000 1.000000 0.000000 0.000000 0.000000 1.000000 /end COMPU_METHOD
/* Scalar measurable for DDE 'mpl_cpu_loaded_1000ms'. */
/begin MEASUREMENT mpl_cpu_loaded_1000ms "CPU loading each second" UBYTE CU_MPL_CPU_LOADED_1000MS 1 100 0.0 255.0 ECU_ADDRESS 0x40003c95 BYTE_ORDER MSB_FIRST /end MEASUREMENT
/begin COMPU_METHOD CU_MPL_CPU_LOADED_1000MS "Conversion method for mpl_cpu_loaded_1000ms" RAT_FUNC "%10.0" "%" COEFFS 0.000000 1.000000 0.000000 0.000000 0.000000 1.000000 /end COMPU_METHOD
/* Scalar measurable for DDE 'mpl_cpu_loaded_50ms'. */
/begin MEASUREMENT mpl_cpu_loaded_50ms "CPU loading each 50ms" UBYTE CU_MPL_CPU_LOADED_50MS 1 100 0.0 255.0 ECU_ADDRESS 0x40003c94 BYTE_ORDER MSB_FIRST /end MEASUREMENT
/begin COMPU_METHOD CU_MPL_CPU_LOADED_50MS "Conversion method for mpl_cpu_loaded_50ms" RAT_FUNC "%10.0" "%" COEFFS 0.000000 1.000000 0.000000 0.000000 0.000000 1.000000 /end COMPU_METHOD
/* Scalar measurable for DDE 'mpl_ecc_flash_address'. */
/begin MEASUREMENT mpl_ecc_flash_address "Address of last Flash non-correctable ECC error, zero if no error has occurred." ULONG CU_MPL_ECC_FLASH_ADDRESS 1 100 0.0 4294967295.0 ECU_ADDRESS 0x40003c4c BYTE_ORDER MSB_FIRST /end MEASUREMENT
/begin COMPU_METHOD CU_MPL_ECC_FLASH_ADDRESS "Conversion method for mpl_ecc_flash_address" RAT_FUNC "%10.0" "addr" COEFFS 0.000000 1.000000 0.000000 0.000000 0.000000 1.000000 /end COMPU_METHOD
/* Scalar measurable for DDE 'mpl_ecc_ram_address'. */
/begin MEASUREMENT mpl_ecc_ram_address "Address of last RAM non-correctable ECC error, zero if no error has occurred." ULONG CU_MPL_ECC_RAM_ADDRESS 1 100 0.0 4294967295.0 ECU_ADDRESS 0x40003c48 BYTE_ORDER MSB_FIRST /end MEASUREMENT
/begin COMPU_METHOD CU_MPL_ECC_RAM_ADDRESS "Conversion method for mpl_ecc_ram_address" RAT_FUNC "%10.0" "addr" COEFFS 0.000000 1.000000 0.000000 0.000000 0.000000 1.000000 /end COMPU_METHOD
/* Scalar measurable for DDE 'mpl_etpu_a_loaded'. */
/begin MEASUREMENT mpl_etpu_a_loaded "eTPU-A loading each 50ms" UBYTE CU_MPL_ETPU_A_LOADED 1 100 0.0 255.0 ECU_ADDRESS 0x40003f44 BYTE_ORDER MSB_FIRST /end MEASUREMENT
/begin COMPU_METHOD CU_MPL_ETPU_A_LOADED "Conversion method for mpl_etpu_a_loaded" RAT_FUNC "%10.0" "%" COEFFS 0.000000 1.000000 0.000000 0.000000 0.000000 1.000000 /end COMPU_METHOD
/* Scalar measurable for DDE 'mpl_etpu_b_loaded'. */
/begin MEASUREMENT mpl_etpu_b_loaded "eTPU-B loading each 50ms" UBYTE CU_MPL_ETPU_B_LOADED 1 100 0.0 255.0 ECU_ADDRESS 0x40003f45 BYTE_ORDER MSB_FIRST /end MEASUREMENT
/begin COMPU_METHOD CU_MPL_ETPU_B_LOADED "Conversion method for mpl_etpu_b_loaded" RAT_FUNC "%10.0" "%" COEFFS 0.000000 1.000000 0.000000 0.000000 0.000000 1.000000 /end COMPU_METHOD
/* Scalar measurable for DDE 'mpl_flp_div_by_zero'. */
/begin MEASUREMENT mpl_flp_div_by_zero "Set if FLP division by zero has occurred since the last reset, clear otherwise." UBYTE CU_MPL_FLP_DIV_BY_ZERO 1 100 0.0 255.0 ECU_ADDRESS 0x40004042 BYTE_ORDER MSB_FIRST /end MEASUREMENT
/begin COMPU_METHOD CU_MPL_FLP_DIV_BY_ZERO "Conversion method for mpl_flp_div_by_zero" RAT_FUNC "%10.0" "flag" COEFFS 0.000000 1.000000 0.000000 0.000000 0.000000 1.000000 /end COMPU_METHOD
/* Scalar measurable for DDE 'mpl_flp_inexact'. */
/begin MEASUREMENT mpl_flp_inexact "Set if an inexact FLP result has occurred since the last reset, clear otherwise." UBYTE CU_MPL_FLP_INEXACT 1 100 0.0 255.0 ECU_ADDRESS 0x40004043 BYTE_ORDER MSB_FIRST /end MEASUREMENT
/begin COMPU_METHOD CU_MPL_FLP_INEXACT "Conversion method for mpl_flp_inexact" RAT_FUNC "%10.0" "flag" COEFFS 0.000000 1.000000 0.000000 0.000000 0.000000 1.000000 /end COMPU_METHOD
/* Scalar measurable for DDE 'mpl_flp_invalid'. */
/begin MEASUREMENT mpl_flp_invalid "Set if an invalid FLP result has occurred since the last reset, clear otherwise." UBYTE CU_MPL_FLP_INVALID 1 100 0.0 255.0 ECU_ADDRESS 0x40004044 BYTE_ORDER MSB_FIRST /end MEASUREMENT
/begin COMPU_METHOD CU_MPL_FLP_INVALID "Conversion method for mpl_flp_invalid" RAT_FUNC "%10.0" "flag" COEFFS 0.000000 1.000000 0.000000 0.000000 0.000000 1.000000 /end COMPU_METHOD
/* Scalar measurable for DDE 'mpl_flp_overflow'. */
/begin MEASUREMENT mpl_flp_overflow "Set if FLP overflow has occurred since the last reset, clear otherwise." UBYTE CU_MPL_FLP_OVERFLOW 1 100 0.0 255.0 ECU_ADDRESS 0x40004040 BYTE_ORDER MSB_FIRST /end MEASUREMENT
/begin COMPU_METHOD CU_MPL_FLP_OVERFLOW "Conversion method for mpl_flp_overflow" RAT_FUNC "%10.0" "flag" COEFFS 0.000000 1.000000 0.000000 0.000000 0.000000 1.000000 /end COMPU_METHOD
/* Scalar measurable for DDE 'mpl_flp_underflow'. */
/begin MEASUREMENT mpl_flp_underflow "Set if FLP underflow has occurred since the last reset, clear otherwise." UBYTE CU_MPL_FLP_UNDERFLOW 1 100 0.0 255.0 ECU_ADDRESS 0x40004041 BYTE_ORDER MSB_FIRST /end MEASUREMENT
/begin COMPU_METHOD CU_MPL_FLP_UNDERFLOW "Conversion method for mpl_flp_underflow" RAT_FUNC "%10.0" "flag" COEFFS 0.000000 1.000000 0.000000 0.000000 0.000000 1.000000 /end COMPU_METHOD
/* Scalar measurable for DDE 'mpl_hw_version'. */
/begin MEASUREMENT mpl_hw_version "Hardware version number." SWORD CU_MPL_HW_VERSION 1 100 -32768.0 32767.0 ECU_ADDRESS 0x40003dd4 BYTE_ORDER MSB_FIRST /end MEASUREMENT
/begin COMPU_METHOD CU_MPL_HW_VERSION "Conversion method for mpl_hw_version" RAT_FUNC "%10.0" "(not defined)" COEFFS 0.000000 1.000000 0.000000 0.000000 0.000000 1.000000 /end COMPU_METHOD
/* Scalar measurable for DDE 'mpl_max_cpu_loaded'. */
/begin MEASUREMENT mpl_max_cpu_loaded "Maximum CPU loading seen since startup" UBYTE CU_MPL_MAX_CPU_LOADED 1 100 0.0 255.0 ECU_ADDRESS 0x40003c98 BYTE_ORDER MSB_FIRST /end MEASUREMENT
/begin COMPU_METHOD CU_MPL_MAX_CPU_LOADED "Conversion method for mpl_max_cpu_loaded" RAT_FUNC "%10.0" "%" COEFFS 0.000000 1.000000 0.000000 0.000000 0.000000 1.000000 /end COMPU_METHOD
/* Scalar measurable for DDE 'mpl_max_cpu_loaded_1000ms'. */
/begin MEASUREMENT mpl_max_cpu_loaded_1000ms "Maximum CPU loading seen since startup" UBYTE CU_MPL_MAX_CPU_LOADED_1000MS 1 100 0.0 255.0 ECU_ADDRESS 0x40003c99 BYTE_ORDER MSB_FIRST /end MEASUREMENT
/begin COMPU_METHOD CU_MPL_MAX_CPU_LOADED_1000MS "Conversion method for mpl_max_cpu_loaded_1000ms" RAT_FUNC "%10.0" "%" COEFFS 0.000000 1.000000 0.000000 0.000000 0.000000 1.000000 /end COMPU_METHOD
/* Scalar measurable for DDE 'mpl_max_cpu_loaded_50ms'. */
/begin MEASUREMENT mpl_max_cpu_loaded_50ms "Maximum CPU loading seen since startup" UBYTE CU_MPL_MAX_CPU_LOADED_50MS 1 100 0.0 255.0 ECU_ADDRESS 0x40003c98 BYTE_ORDER MSB_FIRST /end MEASUREMENT
/begin COMPU_METHOD CU_MPL_MAX_CPU_LOADED_50MS "Conversion method for mpl_max_cpu_loaded_50ms" RAT_FUNC "%10.0" "%" COEFFS 0.000000 1.000000 0.000000 0.000000 0.000000 1.000000 /end COMPU_METHOD
/* Scalar measurable for DDE 'mpl_max_etpu_a_loaded'. */
/begin MEASUREMENT mpl_max_etpu_a_loaded "Maximum eTPU-A loading seen since startup" UBYTE CU_MPL_MAX_ETPU_A_LOADED 1 100 0.0 255.0 ECU_ADDRESS 0x40003f48 BYTE_ORDER MSB_FIRST /end MEASUREMENT
/begin COMPU_METHOD CU_MPL_MAX_ETPU_A_LOADED "Conversion method for mpl_max_etpu_a_loaded" RAT_FUNC "%10.0" "%" COEFFS 0.000000 1.000000 0.000000 0.000000 0.000000 1.000000 /end COMPU_METHOD
/* Scalar measurable for DDE 'mpl_max_etpu_b_loaded'. */
/begin MEASUREMENT mpl_max_etpu_b_loaded "Maximum eTPU-B loading seen since startup" UBYTE CU_MPL_MAX_ETPU_B_LOADED 1 100 0.0 255.0 ECU_ADDRESS 0x40003f49 BYTE_ORDER MSB_FIRST /end MEASUREMENT
/begin COMPU_METHOD CU_MPL_MAX_ETPU_B_LOADED "Conversion method for mpl_max_etpu_b_loaded" RAT_FUNC "%10.0" "%" COEFFS 0.000000 1.000000 0.000000 0.000000 0.000000 1.000000 /end COMPU_METHOD
/* Scalar measurable for DDE 'mpl_max_used_stack'. */
/begin MEASUREMENT mpl_max_used_stack "Amount of stack used during runtime so far." ULONG CU_MPL_MAX_USED_STACK 1 100 0.0 4294967295.0 ECU_ADDRESS 0x40003cfc BYTE_ORDER MSB_FIRST /end MEASUREMENT
/begin COMPU_METHOD CU_MPL_MAX_USED_STACK "Conversion method for mpl_max_used_stack" RAT_FUNC "%10.0" "bytes" COEFFS 0.000000 1.000000 0.000000 0.000000 0.000000 1.000000 /end COMPU_METHOD
/* Scalar measurable for DDE 'mpl_mtt_pan_task'. */
/begin MEASUREMENT mpl_mtt_pan_task "Duration of library task: pan_task" ULONG CU_MPL_MTT_PAN_TASK 1 100 0.0 4294967295.0 ECU_ADDRESS 0x4000e540 BYTE_ORDER MSB_FIRST /end MEASUREMENT
/begin COMPU_METHOD CU_MPL_MTT_PAN_TASK "Conversion method for mpl_mtt_pan_task" RAT_FUNC "%10.0" "microseconds" COEFFS 0.000000 264.000000 0.000000 0.000000 0.000000 1.000000 /end COMPU_METHOD
/* Scalar measurable for DDE 'mpl_mtt_pcp_client'. */
/begin MEASUREMENT mpl_mtt_pcp_client "Duration of library task: pcp_client" ULONG CU_MPL_MTT_PCP_CLIENT 1 100 0.0 4294967295.0 ECU_ADDRESS 0x4000e594 BYTE_ORDER MSB_FIRST /end MEASUREMENT
/begin COMPU_METHOD CU_MPL_MTT_PCP_CLIENT "Conversion method for mpl_mtt_pcp_client" RAT_FUNC "%10.0" "microseconds" COEFFS 0.000000 264.000000 0.000000 0.000000 0.000000 1.000000 /end COMPU_METHOD
/* Scalar measurable for DDE 'mpl_mtt_pcx_can_callback'. */
/begin MEASUREMENT mpl_mtt_pcx_can_callback "Duration of library task: pcx_can_callback" ULONG CU_MPL_MTT_PCX_CAN_CALLBACK 1 100 0.0 4294967295.0 ECU_ADDRESS 0x4000e558 BYTE_ORDER MSB_FIRST /end MEASUREMENT
/begin COMPU_METHOD CU_MPL_MTT_PCX_CAN_CALLBACK "Conversion method for mpl_mtt_pcx_can_callback" RAT_FUNC "%10.0" "microseconds" COEFFS 0.000000 264.000000 0.000000 0.000000 0.000000 1.000000 /end COMPU_METHOD
/* Scalar measurable for DDE 'mpl_mtt_pcx_periodic'. */
/begin MEASUREMENT mpl_mtt_pcx_periodic "Duration of library task: pcx_periodic" ULONG CU_MPL_MTT_PCX_PERIODIC 1 100 0.0 4294967295.0 ECU_ADDRESS 0x4000e584 BYTE_ORDER MSB_FIRST /end MEASUREMENT
/begin COMPU_METHOD CU_MPL_MTT_PCX_PERIODIC "Conversion method for mpl_mtt_pcx_periodic" RAT_FUNC "%10.0" "microseconds" COEFFS 0.000000 264.000000 0.000000 0.000000 0.000000 1.000000 /end COMPU_METHOD
/* Scalar measurable for DDE 'mpl_mtt_pcx_qemptier'. */
/begin MEASUREMENT mpl_mtt_pcx_qemptier "Duration of library task: pcx_qemptier" ULONG CU_MPL_MTT_PCX_QEMPTIER 1 100 0.0 4294967295.0 ECU_ADDRESS 0x4000e588 BYTE_ORDER MSB_FIRST /end MEASUREMENT
/begin COMPU_METHOD CU_MPL_MTT_PCX_QEMPTIER "Conversion method for mpl_mtt_pcx_qemptier" RAT_FUNC "%10.0" "microseconds" COEFFS 0.000000 264.000000 0.000000 0.000000 0.000000 1.000000 /end COMPU_METHOD
/* Scalar measurable for DDE 'mpl_mtt_pdc_worker_task'. */
/begin MEASUREMENT mpl_mtt_pdc_worker_task "Duration of library task: pdc_worker_task" ULONG CU_MPL_MTT_PDC_WORKER_TASK 1 100 0.0 4294967295.0 ECU_ADDRESS 0x4000e550 BYTE_ORDER MSB_FIRST /end MEASUREMENT
/begin COMPU_METHOD CU_MPL_MTT_PDC_WORKER_TASK "Conversion method for mpl_mtt_pdc_worker_task" RAT_FUNC "%10.0" "microseconds" COEFFS 0.000000 264.000000 0.000000 0.000000 0.000000 1.000000 /end COMPU_METHOD
/* Scalar measurable for DDE 'mpl_mtt_pdg_client_task'. */
/begin MEASUREMENT mpl_mtt_pdg_client_task "Duration of library task: pdg_client_task" ULONG CU_MPL_MTT_PDG_CLIENT_TASK 1 100 0.0 4294967295.0 ECU_ADDRESS 0x4000e56c BYTE_ORDER MSB_FIRST /end MEASUREMENT
/begin COMPU_METHOD CU_MPL_MTT_PDG_CLIENT_TASK "Conversion method for mpl_mtt_pdg_client_task" RAT_FUNC "%10.0" "microseconds" COEFFS 0.000000 264.000000 0.000000 0.000000 0.000000 1.000000 /end COMPU_METHOD
/* Scalar measurable for DDE 'mpl_mtt_pdtc_client_task'. */
/begin MEASUREMENT mpl_mtt_pdtc_client_task "Duration of library task: pdtc_client_task" ULONG CU_MPL_MTT_PDTC_CLIENT_TASK 1 100 0.0 4294967295.0 ECU_ADDRESS 0x4000e580 BYTE_ORDER MSB_FIRST /end MEASUREMENT
/begin COMPU_METHOD CU_MPL_MTT_PDTC_CLIENT_TASK "Conversion method for mpl_mtt_pdtc_client_task" RAT_FUNC "%10.0" "microseconds" COEFFS 0.000000 264.000000 0.000000 0.000000 0.000000 1.000000 /end COMPU_METHOD
/* Scalar measurable for DDE 'mpl_mtt_pfc_task'. */
/begin MEASUREMENT mpl_mtt_pfc_task "Duration of library task: pfc_task" ULONG CU_MPL_MTT_PFC_TASK 1 100 0.0 4294967295.0 ECU_ADDRESS 0x4000e548 BYTE_ORDER MSB_FIRST /end MEASUREMENT
/begin COMPU_METHOD CU_MPL_MTT_PFC_TASK "Conversion method for mpl_mtt_pfc_task" RAT_FUNC "%10.0" "microseconds" COEFFS 0.000000 264.000000 0.000000 0.000000 0.000000 1.000000 /end COMPU_METHOD
/* Scalar measurable for DDE 'mpl_mtt_pff_client'. */
/begin MEASUREMENT mpl_mtt_pff_client "Duration of library task: pff_client" ULONG CU_MPL_MTT_PFF_CLIENT 1 100 0.0 4294967295.0 ECU_ADDRESS 0x4000e560 BYTE_ORDER MSB_FIRST /end MEASUREMENT
/begin COMPU_METHOD CU_MPL_MTT_PFF_CLIENT "Conversion method for mpl_mtt_pff_client" RAT_FUNC "%10.0" "microseconds" COEFFS 0.000000 264.000000 0.000000 0.000000 0.000000 1.000000 /end COMPU_METHOD
/* Scalar measurable for DDE 'mpl_mtt_pfs_client'. */
/begin MEASUREMENT mpl_mtt_pfs_client "Duration of library task: pfs_client" ULONG CU_MPL_MTT_PFS_CLIENT 1 100 0.0 4294967295.0 ECU_ADDRESS 0x4000e564 BYTE_ORDER MSB_FIRST /end MEASUREMENT
/begin COMPU_METHOD CU_MPL_MTT_PFS_CLIENT "Conversion method for mpl_mtt_pfs_client" RAT_FUNC "%10.0" "microseconds" COEFFS 0.000000 264.000000 0.000000 0.000000 0.000000 1.000000 /end COMPU_METHOD
/* Scalar measurable for DDE 'mpl_mtt_piso_client_task'. */
/begin MEASUREMENT mpl_mtt_piso_client_task "Duration of library task: piso_client_task" ULONG CU_MPL_MTT_PISO_CLIENT_TASK 1 100 0.0 4294967295.0 ECU_ADDRESS 0x4000e568 BYTE_ORDER MSB_FIRST /end MEASUREMENT
/begin COMPU_METHOD CU_MPL_MTT_PISO_CLIENT_TASK "Conversion method for mpl_mtt_piso_client_task" RAT_FUNC "%10.0" "microseconds" COEFFS 0.000000 264.000000 0.000000 0.000000 0.000000 1.000000 /end COMPU_METHOD
/* Scalar measurable for DDE 'mpl_mtt_pj1939_client'. */
/begin MEASUREMENT mpl_mtt_pj1939_client "Duration of library task: pj1939_client" ULONG CU_MPL_MTT_PJ1939_CLIENT 1 100 0.0 4294967295.0 ECU_ADDRESS 0x4000e55c BYTE_ORDER MSB_FIRST /end MEASUREMENT
/begin COMPU_METHOD CU_MPL_MTT_PJ1939_CLIENT "Conversion method for mpl_mtt_pj1939_client" RAT_FUNC "%10.0" "microseconds" COEFFS 0.000000 264.000000 0.000000 0.000000 0.000000 1.000000 /end COMPU_METHOD
/* Scalar measurable for DDE 'mpl_mtt_ppm_task'. */
/begin MEASUREMENT mpl_mtt_ppm_task "Duration of library task: ppm_task" ULONG CU_MPL_MTT_PPM_TASK 1 100 0.0 4294967295.0 ECU_ADDRESS 0x4000e544 BYTE_ORDER MSB_FIRST /end MEASUREMENT
/begin COMPU_METHOD CU_MPL_MTT_PPM_TASK "Conversion method for mpl_mtt_ppm_task" RAT_FUNC "%10.0" "microseconds" COEFFS 0.000000 264.000000 0.000000 0.000000 0.000000 1.000000 /end COMPU_METHOD
/* Scalar measurable for DDE 'mpl_mtt_psc_watchdog'. */
/begin MEASUREMENT mpl_mtt_psc_watchdog "Duration of library task: psc_watchdog" ULONG CU_MPL_MTT_PSC_WATCHDOG 1 100 0.0 4294967295.0 ECU_ADDRESS 0x4000e590 BYTE_ORDER MSB_FIRST /end MEASUREMENT
/begin COMPU_METHOD CU_MPL_MTT_PSC_WATCHDOG "Conversion method for mpl_mtt_psc_watchdog" RAT_FUNC "%10.0" "microseconds" COEFFS 0.000000 264.000000 0.000000 0.000000 0.000000 1.000000 /end COMPU_METHOD
/* Scalar measurable for DDE 'mpl_mtt_psp_periodic'. */
/begin MEASUREMENT mpl_mtt_psp_periodic "Duration of library task: psp_periodic" ULONG CU_MPL_MTT_PSP_PERIODIC 1 100 0.0 4294967295.0 ECU_ADDRESS 0x4000e58c BYTE_ORDER MSB_FIRST /end MEASUREMENT
/begin COMPU_METHOD CU_MPL_MTT_PSP_PERIODIC "Conversion method for mpl_mtt_psp_periodic" RAT_FUNC "%10.0" "microseconds" COEFFS 0.000000 264.000000 0.000000 0.000000 0.000000 1.000000 /end COMPU_METHOD
/* Scalar measurable for DDE 'mpl_mtt_psp_receive'. */
/begin MEASUREMENT mpl_mtt_psp_receive "Duration of library task: psp_receive" ULONG CU_MPL_MTT_PSP_RECEIVE 1 100 0.0 4294967295.0 ECU_ADDRESS 0x4000e554 BYTE_ORDER MSB_FIRST /end MEASUREMENT
/begin COMPU_METHOD CU_MPL_MTT_PSP_RECEIVE "Conversion method for mpl_mtt_psp_receive" RAT_FUNC "%10.0" "microseconds" COEFFS 0.000000 264.000000 0.000000 0.000000 0.000000 1.000000 /end COMPU_METHOD
/* Scalar measurable for DDE 'mpl_mtt_pss_task'. */
/begin MEASUREMENT mpl_mtt_pss_task "Duration of library task: pss_task" ULONG CU_MPL_MTT_PSS_TASK 1 100 0.0 4294967295.0 ECU_ADDRESS 0x4000e53c BYTE_ORDER MSB_FIRST /end MEASUREMENT
/begin COMPU_METHOD CU_MPL_MTT_PSS_TASK "Conversion method for mpl_mtt_pss_task" RAT_FUNC "%10.0" "microseconds" COEFFS 0.000000 264.000000 0.000000 0.000000 0.000000 1.000000 /end COMPU_METHOD
/* Scalar measurable for DDE 'mpl_mtt_pxs_task'. */
/begin MEASUREMENT mpl_mtt_pxs_task "Duration of library task: pxs_task" ULONG CU_MPL_MTT_PXS_TASK 1 100 0.0 4294967295.0 ECU_ADDRESS 0x4000e54c BYTE_ORDER MSB_FIRST /end MEASUREMENT
/begin COMPU_METHOD CU_MPL_MTT_PXS_TASK "Conversion method for mpl_mtt_pxs_task" RAT_FUNC "%10.0" "microseconds" COEFFS 0.000000 264.000000 0.000000 0.000000 0.000000 1.000000 /end COMPU_METHOD
/* Scalar measurable for DDE 'mpl_mtt_task_1000ms'. */
/begin MEASUREMENT mpl_mtt_task_1000ms "Duration of application task: task_1000ms" ULONG CU_MPL_MTT_TASK_1000MS 1 100 0.0 4294967295.0 ECU_ADDRESS 0x4000e57c BYTE_ORDER MSB_FIRST /end MEASUREMENT
/begin COMPU_METHOD CU_MPL_MTT_TASK_1000MS "Conversion method for mpl_mtt_task_1000ms" RAT_FUNC "%10.0" "microseconds" COEFFS 0.000000 264.000000 0.000000 0.000000 0.000000 1.000000 /end COMPU_METHOD
/* Scalar measurable for DDE 'mpl_mtt_task_100ms'. */
/begin MEASUREMENT mpl_mtt_task_100ms "Duration of application task: task_100ms" ULONG CU_MPL_MTT_TASK_100MS 1 100 0.0 4294967295.0 ECU_ADDRESS 0x4000e578 BYTE_ORDER MSB_FIRST /end MEASUREMENT
/begin COMPU_METHOD CU_MPL_MTT_TASK_100MS "Conversion method for mpl_mtt_task_100ms" RAT_FUNC "%10.0" "microseconds" COEFFS 0.000000 264.000000 0.000000 0.000000 0.000000 1.000000 /end COMPU_METHOD
/* Scalar measurable for DDE 'mpl_mtt_task_10ms'. */
/begin MEASUREMENT mpl_mtt_task_10ms "Duration of application task: task_10ms" ULONG CU_MPL_MTT_TASK_10MS 1 100 0.0 4294967295.0 ECU_ADDRESS 0x4000e574 BYTE_ORDER MSB_FIRST /end MEASUREMENT
/begin COMPU_METHOD CU_MPL_MTT_TASK_10MS "Conversion method for mpl_mtt_task_10ms" RAT_FUNC "%10.0" "microseconds" COEFFS 0.000000 264.000000 0.000000 0.000000 0.000000 1.000000 /end COMPU_METHOD
/* Scalar measurable for DDE 'mpl_mtt_task_angular'. */
/begin MEASUREMENT mpl_mtt_task_angular "Duration of application task: task_angular" ULONG CU_MPL_MTT_TASK_ANGULAR 1 100 0.0 4294967295.0 ECU_ADDRESS 0x4000e570 BYTE_ORDER MSB_FIRST /end MEASUREMENT
/begin COMPU_METHOD CU_MPL_MTT_TASK_ANGULAR "Conversion method for mpl_mtt_task_angular" RAT_FUNC "%10.0" "microseconds" COEFFS 0.000000 264.000000 0.000000 0.000000 0.000000 1.000000 /end COMPU_METHOD
/* Scalar measurable for DDE 'mpl_ovrc_pcp_client'. */
/begin MEASUREMENT mpl_ovrc_pcp_client "Overrun count of library task: pcp_client" UBYTE CU_MPL_OVRC_PCP_CLIENT 1 100 0.0 255.0 ECU_ADDRESS 0x4000e4eb BYTE_ORDER MSB_FIRST /end MEASUREMENT
/begin COMPU_METHOD CU_MPL_OVRC_PCP_CLIENT "Conversion method for mpl_ovrc_pcp_client" RAT_FUNC "%10.0" "count" COEFFS 0.000000 1.000000 0.000000 0.000000 0.000000 1.000000 /end COMPU_METHOD
/* Scalar measurable for DDE 'mpl_ovrc_pcx_can_callback'. */
/begin MEASUREMENT mpl_ovrc_pcx_can_callback "Overrun count of library task: pcx_can_callback" UBYTE CU_MPL_OVRC_PCX_CAN_CALLBACK 1 100 0.0 255.0 ECU_ADDRESS 0x4000e4dd BYTE_ORDER MSB_FIRST /end MEASUREMENT
/begin COMPU_METHOD CU_MPL_OVRC_PCX_CAN_CALLBACK "Conversion method for mpl_ovrc_pcx_can_callback" RAT_FUNC "%10.0" "count" COEFFS 0.000000 1.000000 0.000000 0.000000 0.000000 1.000000 /end COMPU_METHOD
/* Scalar measurable for DDE 'mpl_ovrc_pcx_periodic'. */
/begin MEASUREMENT mpl_ovrc_pcx_periodic "Overrun count of library task: pcx_periodic" UBYTE CU_MPL_OVRC_PCX_PERIODIC 1 100 0.0 255.0 ECU_ADDRESS 0x4000e4e7 BYTE_ORDER MSB_FIRST /end MEASUREMENT
/begin COMPU_METHOD CU_MPL_OVRC_PCX_PERIODIC "Conversion method for mpl_ovrc_pcx_periodic" RAT_FUNC "%10.0" "count" COEFFS 0.000000 1.000000 0.000000 0.000000 0.000000 1.000000 /end COMPU_METHOD
/* Scalar measurable for DDE 'mpl_ovrc_pcx_qemptier'. */
/begin MEASUREMENT mpl_ovrc_pcx_qemptier "Overrun count of library task: pcx_qemptier" UBYTE CU_MPL_OVRC_PCX_QEMPTIER 1 100 0.0 255.0 ECU_ADDRESS 0x4000e4e8 BYTE_ORDER MSB_FIRST /end MEASUREMENT
/begin COMPU_METHOD CU_MPL_OVRC_PCX_QEMPTIER "Conversion method for mpl_ovrc_pcx_qemptier" RAT_FUNC "%10.0" "count" COEFFS 0.000000 1.000000 0.000000 0.000000 0.000000 1.000000 /end COMPU_METHOD
/* Scalar measurable for DDE 'mpl_ovrc_pdc_worker_task'. */
/begin MEASUREMENT mpl_ovrc_pdc_worker_task "Overrun count of library task: pdc_worker_task" UBYTE CU_MPL_OVRC_PDC_WORKER_TASK 1 100 0.0 255.0 ECU_ADDRESS 0x4000e4dc BYTE_ORDER MSB_FIRST /end MEASUREMENT
/begin COMPU_METHOD CU_MPL_OVRC_PDC_WORKER_TASK "Conversion method for mpl_ovrc_pdc_worker_task" RAT_FUNC "%10.0" "count" COEFFS 0.000000 1.000000 0.000000 0.000000 0.000000 1.000000 /end COMPU_METHOD
/* Scalar measurable for DDE 'mpl_ovrc_pdg_client_task'. */
/begin MEASUREMENT mpl_ovrc_pdg_client_task "Overrun count of library task: pdg_client_task" UBYTE CU_MPL_OVRC_PDG_CLIENT_TASK 1 100 0.0 255.0 ECU_ADDRESS 0x4000e4e2 BYTE_ORDER MSB_FIRST /end MEASUREMENT
/begin COMPU_METHOD CU_MPL_OVRC_PDG_CLIENT_TASK "Conversion method for mpl_ovrc_pdg_client_task" RAT_FUNC "%10.0" "count" COEFFS 0.000000 1.000000 0.000000 0.000000 0.000000 1.000000 /end COMPU_METHOD
/* Scalar measurable for DDE 'mpl_ovrc_pdtc_client_task'. */
/begin MEASUREMENT mpl_ovrc_pdtc_client_task "Overrun count of library task: pdtc_client_task" UBYTE CU_MPL_OVRC_PDTC_CLIENT_TASK 1 100 0.0 255.0 ECU_ADDRESS 0x4000e4e6 BYTE_ORDER MSB_FIRST /end MEASUREMENT
/begin COMPU_METHOD CU_MPL_OVRC_PDTC_CLIENT_TASK "Conversion method for mpl_ovrc_pdtc_client_task" RAT_FUNC "%10.0" "count" COEFFS 0.000000 1.000000 0.000000 0.000000 0.000000 1.000000 /end COMPU_METHOD
/* Scalar measurable for DDE 'mpl_ovrc_pfc_task'. */
/begin MEASUREMENT mpl_ovrc_pfc_task "Overrun count of library task: pfc_task" UBYTE CU_MPL_OVRC_PFC_TASK 1 100 0.0 255.0 ECU_ADDRESS 0x4000e4da BYTE_ORDER MSB_FIRST /end MEASUREMENT
/begin COMPU_METHOD CU_MPL_OVRC_PFC_TASK "Conversion method for mpl_ovrc_pfc_task" RAT_FUNC "%10.0" "count" COEFFS 0.000000 1.000000 0.000000 0.000000 0.000000 1.000000 /end COMPU_METHOD
/* Scalar measurable for DDE 'mpl_ovrc_pff_client'. */
/begin MEASUREMENT mpl_ovrc_pff_client "Overrun count of library task: pff_client" UBYTE CU_MPL_OVRC_PFF_CLIENT 1 100 0.0 255.0 ECU_ADDRESS 0x4000e4df BYTE_ORDER MSB_FIRST /end MEASUREMENT
/begin COMPU_METHOD CU_MPL_OVRC_PFF_CLIENT "Conversion method for mpl_ovrc_pff_client" RAT_FUNC "%10.0" "count" COEFFS 0.000000 1.000000 0.000000 0.000000 0.000000 1.000000 /end COMPU_METHOD
/* Scalar measurable for DDE 'mpl_ovrc_pfs_client'. */
/begin MEASUREMENT mpl_ovrc_pfs_client "Overrun count of library task: pfs_client" UBYTE CU_MPL_OVRC_PFS_CLIENT 1 100 0.0 255.0 ECU_ADDRESS 0x4000e4e0 BYTE_ORDER MSB_FIRST /end MEASUREMENT
/begin COMPU_METHOD CU_MPL_OVRC_PFS_CLIENT "Conversion method for mpl_ovrc_pfs_client" RAT_FUNC "%10.0" "count" COEFFS 0.000000 1.000000 0.000000 0.000000 0.000000 1.000000 /end COMPU_METHOD
/* Scalar measurable for DDE 'mpl_ovrc_piso_client_task'. */
/begin MEASUREMENT mpl_ovrc_piso_client_task "Overrun count of library task: piso_client_task" UBYTE CU_MPL_OVRC_PISO_CLIENT_TASK 1 100 0.0 255.0 ECU_ADDRESS 0x4000e4e1 BYTE_ORDER MSB_FIRST /end MEASUREMENT
/begin COMPU_METHOD CU_MPL_OVRC_PISO_CLIENT_TASK "Conversion method for mpl_ovrc_piso_client_task" RAT_FUNC "%10.0" "count" COEFFS 0.000000 1.000000 0.000000 0.000000 0.000000 1.000000 /end COMPU_METHOD
/* Scalar measurable for DDE 'mpl_ovrc_pj1939_client'. */
/begin MEASUREMENT mpl_ovrc_pj1939_client "Overrun count of library task: pj1939_client" UBYTE CU_MPL_OVRC_PJ1939_CLIENT 1 100 0.0 255.0 ECU_ADDRESS 0x4000e4de BYTE_ORDER MSB_FIRST /end MEASUREMENT
/begin COMPU_METHOD CU_MPL_OVRC_PJ1939_CLIENT "Conversion method for mpl_ovrc_pj1939_client" RAT_FUNC "%10.0" "count" COEFFS 0.000000 1.000000 0.000000 0.000000 0.000000 1.000000 /end COMPU_METHOD
/* Scalar measurable for DDE 'mpl_ovrc_ppm_task'. */
/begin MEASUREMENT mpl_ovrc_ppm_task "Overrun count of library task: ppm_task" UBYTE CU_MPL_OVRC_PPM_TASK 1 100 0.0 255.0 ECU_ADDRESS 0x4000e4d9 BYTE_ORDER MSB_FIRST /end MEASUREMENT
/begin COMPU_METHOD CU_MPL_OVRC_PPM_TASK "Conversion method for mpl_ovrc_ppm_task" RAT_FUNC "%10.0" "count" COEFFS 0.000000 1.000000 0.000000 0.000000 0.000000 1.000000 /end COMPU_METHOD
/* Scalar measurable for DDE 'mpl_ovrc_psc_watchdog'. */
/begin MEASUREMENT mpl_ovrc_psc_watchdog "Overrun count of library task: psc_watchdog" UBYTE CU_MPL_OVRC_PSC_WATCHDOG 1 100 0.0 255.0 ECU_ADDRESS 0x4000e4ea BYTE_ORDER MSB_FIRST /end MEASUREMENT
/begin COMPU_METHOD CU_MPL_OVRC_PSC_WATCHDOG "Conversion method for mpl_ovrc_psc_watchdog" RAT_FUNC "%10.0" "count" COEFFS 0.000000 1.000000 0.000000 0.000000 0.000000 1.000000 /end COMPU_METHOD
/* Scalar measurable for DDE 'mpl_ovrc_psp_periodic'. */
/begin MEASUREMENT mpl_ovrc_psp_periodic "Overrun count of library task: psp_periodic" UBYTE CU_MPL_OVRC_PSP_PERIODIC 1 100 0.0 255.0 ECU_ADDRESS 0x4000e4e9 BYTE_ORDER MSB_FIRST /end MEASUREMENT
/begin COMPU_METHOD CU_MPL_OVRC_PSP_PERIODIC "Conversion method for mpl_ovrc_psp_periodic" RAT_FUNC "%10.0" "count" COEFFS 0.000000 1.000000 0.000000 0.000000 0.000000 1.000000 /end COMPU_METHOD
/* Scalar measurable for DDE 'mpl_ovrc_pss_task'. */
/begin MEASUREMENT mpl_ovrc_pss_task "Overrun count of library task: pss_task" UBYTE CU_MPL_OVRC_PSS_TASK 1 100 0.0 255.0 ECU_ADDRESS 0x4000e4d8 BYTE_ORDER MSB_FIRST /end MEASUREMENT
/begin COMPU_METHOD CU_MPL_OVRC_PSS_TASK "Conversion method for mpl_ovrc_pss_task" RAT_FUNC "%10.0" "count" COEFFS 0.000000 1.000000 0.000000 0.000000 0.000000 1.000000 /end COMPU_METHOD
/* Scalar measurable for DDE 'mpl_ovrc_pxs_task'. */
/begin MEASUREMENT mpl_ovrc_pxs_task "Overrun count of library task: pxs_task" UBYTE CU_MPL_OVRC_PXS_TASK 1 100 0.0 255.0 ECU_ADDRESS 0x4000e4db BYTE_ORDER MSB_FIRST /end MEASUREMENT
/begin COMPU_METHOD CU_MPL_OVRC_PXS_TASK "Conversion method for mpl_ovrc_pxs_task" RAT_FUNC "%10.0" "count" COEFFS 0.000000 1.000000 0.000000 0.000000 0.000000 1.000000 /end COMPU_METHOD
/* Scalar measurable for DDE 'mpl_ovrc_task_1000ms'. */
/begin MEASUREMENT mpl_ovrc_task_1000ms "Overrun count of application task: task_1000ms" UBYTE CU_MPL_OVRC_TASK_1000MS 1 100 0.0 255.0 ECU_ADDRESS 0x4000e4e5 BYTE_ORDER MSB_FIRST /end MEASUREMENT
/begin COMPU_METHOD CU_MPL_OVRC_TASK_1000MS "Conversion method for mpl_ovrc_task_1000ms" RAT_FUNC "%10.0" "count" COEFFS 0.000000 1.000000 0.000000 0.000000 0.000000 1.000000 /end COMPU_METHOD
/* Scalar measurable for DDE 'mpl_ovrc_task_100ms'. */
/begin MEASUREMENT mpl_ovrc_task_100ms "Overrun count of application task: task_100ms" UBYTE CU_MPL_OVRC_TASK_100MS 1 100 0.0 255.0 ECU_ADDRESS 0x4000e4e4 BYTE_ORDER MSB_FIRST /end MEASUREMENT
/begin COMPU_METHOD CU_MPL_OVRC_TASK_100MS "Conversion method for mpl_ovrc_task_100ms" RAT_FUNC "%10.0" "count" COEFFS 0.000000 1.000000 0.000000 0.000000 0.000000 1.000000 /end COMPU_METHOD
/* Scalar measurable for DDE 'mpl_ovrc_task_10ms'. */
/begin MEASUREMENT mpl_ovrc_task_10ms "Overrun count of application task: task_10ms" UBYTE CU_MPL_OVRC_TASK_10MS 1 100 0.0 255.0 ECU_ADDRESS 0x4000e4e3 BYTE_ORDER MSB_FIRST /end MEASUREMENT
/begin COMPU_METHOD CU_MPL_OVRC_TASK_10MS "Conversion method for mpl_ovrc_task_10ms" RAT_FUNC "%10.0" "count" COEFFS 0.000000 1.000000 0.000000 0.000000 0.000000 1.000000 /end COMPU_METHOD
/* Scalar measurable for DDE 'mpl_plat_build_day'. */
/begin MEASUREMENT mpl_plat_build_day "Platform build day" UWORD CU_MPL_PLAT_BUILD_DAY 1 100 0.0 65535.0 ECU_ADDRESS 0x40003ccc BYTE_ORDER MSB_FIRST /end MEASUREMENT
/begin COMPU_METHOD CU_MPL_PLAT_BUILD_DAY "Conversion method for mpl_plat_build_day" RAT_FUNC "%10.0" "(not defined)" COEFFS 0.000000 1.000000 0.000000 0.000000 0.000000 1.000000 /end COMPU_METHOD
/* Scalar measurable for DDE 'mpl_plat_build_month'. */
/begin MEASUREMENT mpl_plat_build_month "Platform build month" UWORD CU_MPL_PLAT_BUILD_MONTH 1 100 0.0 65535.0 ECU_ADDRESS 0x40003cce BYTE_ORDER MSB_FIRST /end MEASUREMENT
/begin COMPU_METHOD CU_MPL_PLAT_BUILD_MONTH "Conversion method for mpl_plat_build_month" RAT_FUNC "%10.0" "(not defined)" COEFFS 0.000000 1.000000 0.000000 0.000000 0.000000 1.000000 /end COMPU_METHOD
/* Scalar measurable for DDE 'mpl_plat_build_year'. */
/begin MEASUREMENT mpl_plat_build_year "Platform build year" UWORD CU_MPL_PLAT_BUILD_YEAR 1 100 0.0 65535.0 ECU_ADDRESS 0x40003cd0 BYTE_ORDER MSB_FIRST /end MEASUREMENT
/begin COMPU_METHOD CU_MPL_PLAT_BUILD_YEAR "Conversion method for mpl_plat_build_year" RAT_FUNC "%10.0" "(not defined)" COEFFS 0.000000 1.000000 0.000000 0.000000 0.000000 1.000000 /end COMPU_METHOD
/* Scalar measurable for DDE 'mpl_plat_part_num_group'. */
/begin MEASUREMENT mpl_plat_part_num_group "Platform Group ID number of the part number" UBYTE CU_MPL_PLAT_PART_NUM_GROUP 1 100 0.0 255.0 ECU_ADDRESS 0x40003cd2 BYTE_ORDER MSB_FIRST /end MEASUREMENT
/begin COMPU_METHOD CU_MPL_PLAT_PART_NUM_GROUP "Conversion method for mpl_plat_part_num_group" RAT_FUNC "%10.0" "(not defined)" COEFFS 0.000000 1.000000 0.000000 0.000000 0.000000 1.000000 /end COMPU_METHOD
/* Scalar measurable for DDE 'mpl_plat_part_num_id'. */
/begin MEASUREMENT mpl_plat_part_num_id "Platform Part ID of the part number" ULONG CU_MPL_PLAT_PART_NUM_ID 1 100 0.0 4294967295.0 ECU_ADDRESS 0x40003cd4 BYTE_ORDER MSB_FIRST /end MEASUREMENT
/begin COMPU_METHOD CU_MPL_PLAT_PART_NUM_ID "Conversion method for mpl_plat_part_num_id" RAT_FUNC "%10.0" "(not defined)" COEFFS 0.000000 1.000000 0.000000 0.000000 0.000000 1.000000 /end COMPU_METHOD
/* Scalar measurable for DDE 'mpl_plat_part_num_issue'. */
/begin MEASUREMENT mpl_plat_part_num_issue "Platform Issue number of the part number" UWORD CU_MPL_PLAT_PART_NUM_ISSUE 1 100 0.0 65535.0 ECU_ADDRESS 0x40003cd8 BYTE_ORDER MSB_FIRST /end MEASUREMENT
/begin COMPU_METHOD CU_MPL_PLAT_PART_NUM_ISSUE "Conversion method for mpl_plat_part_num_issue" RAT_FUNC "%10.0" "(not defined)" COEFFS 0.000000 1.000000 0.000000 0.000000 0.000000 1.000000 /end COMPU_METHOD
/* Scalar measurable for DDE 'mpl_plat_part_num_letter'. */
/begin MEASUREMENT mpl_plat_part_num_letter "Platform Group Letter of the part number" UBYTE CU_MPL_PLAT_PART_NUM_LETTER 1 100 0.0 255.0 ECU_ADDRESS 0x40003cd3 BYTE_ORDER MSB_FIRST /end MEASUREMENT
/begin COMPU_METHOD CU_MPL_PLAT_PART_NUM_LETTER "Conversion method for mpl_plat_part_num_letter" RAT_FUNC "%10.0" "(not defined)" COEFFS 0.000000 1.000000 0.000000 0.000000 0.000000 1.000000 /end COMPU_METHOD
/* Scalar measurable for DDE 'mpl_plat_ver_major'. */
/begin MEASUREMENT mpl_plat_ver_major "Platform major version number" UWORD CU_MPL_PLAT_VER_MAJOR 1 100 0.0 65535.0 ECU_ADDRESS 0x40003cc6 BYTE_ORDER MSB_FIRST /end MEASUREMENT
/begin COMPU_METHOD CU_MPL_PLAT_VER_MAJOR "Conversion method for mpl_plat_ver_major" RAT_FUNC "%10.0" "(not defined)" COEFFS 0.000000 1.000000 0.000000 0.000000 0.000000 1.000000 /end COMPU_METHOD
/* Scalar measurable for DDE 'mpl_plat_ver_minor'. */
/begin MEASUREMENT mpl_plat_ver_minor "Platform minor version number" UWORD CU_MPL_PLAT_VER_MINOR 1 100 0.0 65535.0 ECU_ADDRESS 0x40003cc8 BYTE_ORDER MSB_FIRST /end MEASUREMENT
/begin COMPU_METHOD CU_MPL_PLAT_VER_MINOR "Conversion method for mpl_plat_ver_minor" RAT_FUNC "%10.0" "(not defined)" COEFFS 0.000000 1.000000 0.000000 0.000000 0.000000 1.000000 /end COMPU_METHOD
/* Scalar measurable for DDE 'mpl_plat_ver_sub'. */
/begin MEASUREMENT mpl_plat_ver_sub "Platform sub minor version number" UWORD CU_MPL_PLAT_VER_SUB 1 100 0.0 65535.0 ECU_ADDRESS 0x40003cca BYTE_ORDER MSB_FIRST /end MEASUREMENT
/begin COMPU_METHOD CU_MPL_PLAT_VER_SUB "Conversion method for mpl_plat_ver_sub" RAT_FUNC "%10.0" "(not defined)" COEFFS 0.000000 1.000000 0.000000 0.000000 0.000000 1.000000 /end COMPU_METHOD
/* Scalar measurable for DDE 'mpl_prg_build_day'. */
/begin MEASUREMENT mpl_prg_build_day "PRG build day" UWORD CU_MPL_PRG_BUILD_DAY 1 100 0.0 65535.0 ECU_ADDRESS 0x40003cb8 BYTE_ORDER MSB_FIRST /end MEASUREMENT
/begin COMPU_METHOD CU_MPL_PRG_BUILD_DAY "Conversion method for mpl_prg_build_day" RAT_FUNC "%10.0" "(not defined)" COEFFS 0.000000 1.000000 0.000000 0.000000 0.000000 1.000000 /end COMPU_METHOD
/* Scalar measurable for DDE 'mpl_prg_build_month'. */
/begin MEASUREMENT mpl_prg_build_month "PRG build month" UWORD CU_MPL_PRG_BUILD_MONTH 1 100 0.0 65535.0 ECU_ADDRESS 0x40003cba BYTE_ORDER MSB_FIRST /end MEASUREMENT
/begin COMPU_METHOD CU_MPL_PRG_BUILD_MONTH "Conversion method for mpl_prg_build_month" RAT_FUNC "%10.0" "(not defined)" COEFFS 0.000000 1.000000 0.000000 0.000000 0.000000 1.000000 /end COMPU_METHOD
/* Scalar measurable for DDE 'mpl_prg_build_year'. */
/begin MEASUREMENT mpl_prg_build_year "PRG build year" UWORD CU_MPL_PRG_BUILD_YEAR 1 100 0.0 65535.0 ECU_ADDRESS 0x40003cbc BYTE_ORDER MSB_FIRST /end MEASUREMENT
/begin COMPU_METHOD CU_MPL_PRG_BUILD_YEAR "Conversion method for mpl_prg_build_year" RAT_FUNC "%10.0" "(not defined)" COEFFS 0.000000 1.000000 0.000000 0.000000 0.000000 1.000000 /end COMPU_METHOD
/* Scalar measurable for DDE 'mpl_prg_part_num_group'. */
/begin MEASUREMENT mpl_prg_part_num_group "PRG Group ID number in the part number" UBYTE CU_MPL_PRG_PART_NUM_GROUP 1 100 0.0 255.0 ECU_ADDRESS 0x40003cbe BYTE_ORDER MSB_FIRST /end MEASUREMENT
/begin COMPU_METHOD CU_MPL_PRG_PART_NUM_GROUP "Conversion method for mpl_prg_part_num_group" RAT_FUNC "%10.0" "(not defined)" COEFFS 0.000000 1.000000 0.000000 0.000000 0.000000 1.000000 /end COMPU_METHOD
/* Scalar measurable for DDE 'mpl_prg_part_num_id'. */
/begin MEASUREMENT mpl_prg_part_num_id "PRG Part ID in the part number" ULONG CU_MPL_PRG_PART_NUM_ID 1 100 0.0 4294967295.0 ECU_ADDRESS 0x40003cc0 BYTE_ORDER MSB_FIRST /end MEASUREMENT
/begin COMPU_METHOD CU_MPL_PRG_PART_NUM_ID "Conversion method for mpl_prg_part_num_id" RAT_FUNC "%10.0" "(not defined)" COEFFS 0.000000 1.000000 0.000000 0.000000 0.000000 1.000000 /end COMPU_METHOD
/* Scalar measurable for DDE 'mpl_prg_part_num_issue'. */
/begin MEASUREMENT mpl_prg_part_num_issue "PRG Issue number in the part number" UWORD CU_MPL_PRG_PART_NUM_ISSUE 1 100 0.0 65535.0 ECU_ADDRESS 0x40003cc4 BYTE_ORDER MSB_FIRST /end MEASUREMENT
/begin COMPU_METHOD CU_MPL_PRG_PART_NUM_ISSUE "Conversion method for mpl_prg_part_num_issue" RAT_FUNC "%10.0" "(not defined)" COEFFS 0.000000 1.000000 0.000000 0.000000 0.000000 1.000000 /end COMPU_METHOD
/* Scalar measurable for DDE 'mpl_prg_part_num_letter'. */
/begin MEASUREMENT mpl_prg_part_num_letter "PRG Group Letter in the part number" UBYTE CU_MPL_PRG_PART_NUM_LETTER 1 100 0.0 255.0 ECU_ADDRESS 0x40003cbf BYTE_ORDER MSB_FIRST /end MEASUREMENT
/begin COMPU_METHOD CU_MPL_PRG_PART_NUM_LETTER "Conversion method for mpl_prg_part_num_letter" RAT_FUNC "%10.0" "(not defined)" COEFFS 0.000000 1.000000 0.000000 0.000000 0.000000 1.000000 /end COMPU_METHOD
/* Scalar measurable for DDE 'mpl_prg_ver_major'. */
/begin MEASUREMENT mpl_prg_ver_major "PRG major version number" UWORD CU_MPL_PRG_VER_MAJOR 1 100 0.0 65535.0 ECU_ADDRESS 0x40003cb2 BYTE_ORDER MSB_FIRST /end MEASUREMENT
/begin COMPU_METHOD CU_MPL_PRG_VER_MAJOR "Conversion method for mpl_prg_ver_major" RAT_FUNC "%10.0" "(not defined)" COEFFS 0.000000 1.000000 0.000000 0.000000 0.000000 1.000000 /end COMPU_METHOD
/* Scalar measurable for DDE 'mpl_prg_ver_minor'. */
/begin MEASUREMENT mpl_prg_ver_minor "PRG minor version number" UWORD CU_MPL_PRG_VER_MINOR 1 100 0.0 65535.0 ECU_ADDRESS 0x40003cb4 BYTE_ORDER MSB_FIRST /end MEASUREMENT
/begin COMPU_METHOD CU_MPL_PRG_VER_MINOR "Conversion method for mpl_prg_ver_minor" RAT_FUNC "%10.0" "(not defined)" COEFFS 0.000000 1.000000 0.000000 0.000000 0.000000 1.000000 /end COMPU_METHOD
/* Scalar measurable for DDE 'mpl_prg_ver_sub'. */
/begin MEASUREMENT mpl_prg_ver_sub "PRG sub minor version number" UWORD CU_MPL_PRG_VER_SUB 1 100 0.0 65535.0 ECU_ADDRESS 0x40003cb6 BYTE_ORDER MSB_FIRST /end MEASUREMENT
/begin COMPU_METHOD CU_MPL_PRG_VER_SUB "Conversion method for mpl_prg_ver_sub" RAT_FUNC "%10.0" "(not defined)" COEFFS 0.000000 1.000000 0.000000 0.000000 0.000000 1.000000 /end COMPU_METHOD
/* Scalar measurable for DDE 'mpl_reset_count'. */
/begin MEASUREMENT mpl_reset_count "Number of resets since power-up." ULONG CU_MPL_RESET_COUNT 1 100 0.0 4294967295.0 ECU_ADDRESS 0x40003cf0 BYTE_ORDER MSB_FIRST /end MEASUREMENT
/begin COMPU_METHOD CU_MPL_RESET_COUNT "Conversion method for mpl_reset_count" RAT_FUNC "%10.0" "events" COEFFS 0.000000 1.000000 0.000000 0.000000 0.000000 1.000000 /end COMPU_METHOD
/* Scalar measurable for DDE 'mpl_run_time'. */
/begin MEASUREMENT mpl_run_time "Time since startup" ULONG CU_MPL_RUN_TIME 1 100 0.0 4294967295.0 ECU_ADDRESS 0x40003cf8 BYTE_ORDER MSB_FIRST /end MEASUREMENT
/begin COMPU_METHOD CU_MPL_RUN_TIME "Conversion method for mpl_run_time" RAT_FUNC "%10.0" "seconds" COEFFS 0.000000 1.000000 0.000000 0.000000 0.000000 1.000000 /end COMPU_METHOD
/* Scalar measurable for DDE 'mpl_tt_pan_task'. */
/begin MEASUREMENT mpl_tt_pan_task "Duration of library task: pan_task" ULONG CU_MPL_TT_PAN_TASK 1 100 0.0 4294967295.0 ECU_ADDRESS 0x4000e5a0 BYTE_ORDER MSB_FIRST /end MEASUREMENT
/begin COMPU_METHOD CU_MPL_TT_PAN_TASK "Conversion method for mpl_tt_pan_task" RAT_FUNC "%10.0" "microseconds" COEFFS 0.000000 264.000000 0.000000 0.000000 0.000000 1.000000 /end COMPU_METHOD
/* Scalar measurable for DDE 'mpl_tt_pcp_client'. */
/begin MEASUREMENT mpl_tt_pcp_client "Duration of library task: pcp_client" ULONG CU_MPL_TT_PCP_CLIENT 1 100 0.0 4294967295.0 ECU_ADDRESS 0x4000e5f4 BYTE_ORDER MSB_FIRST /end MEASUREMENT
/begin COMPU_METHOD CU_MPL_TT_PCP_CLIENT "Conversion method for mpl_tt_pcp_client" RAT_FUNC "%10.0" "microseconds" COEFFS 0.000000 264.000000 0.000000 0.000000 0.000000 1.000000 /end COMPU_METHOD
/* Scalar measurable for DDE 'mpl_tt_pcx_can_callback'. */
/begin MEASUREMENT mpl_tt_pcx_can_callback "Duration of library task: pcx_can_callback" ULONG CU_MPL_TT_PCX_CAN_CALLBACK 1 100 0.0 4294967295.0 ECU_ADDRESS 0x4000e5b8 BYTE_ORDER MSB_FIRST /end MEASUREMENT
/begin COMPU_METHOD CU_MPL_TT_PCX_CAN_CALLBACK "Conversion method for mpl_tt_pcx_can_callback" RAT_FUNC "%10.0" "microseconds" COEFFS 0.000000 264.000000 0.000000 0.000000 0.000000 1.000000 /end COMPU_METHOD
/* Scalar measurable for DDE 'mpl_tt_pcx_periodic'. */
/begin MEASUREMENT mpl_tt_pcx_periodic "Duration of library task: pcx_periodic" ULONG CU_MPL_TT_PCX_PERIODIC 1 100 0.0 4294967295.0 ECU_ADDRESS 0x4000e5e4 BYTE_ORDER MSB_FIRST /end MEASUREMENT
/begin COMPU_METHOD CU_MPL_TT_PCX_PERIODIC "Conversion method for mpl_tt_pcx_periodic" RAT_FUNC "%10.0" "microseconds" COEFFS 0.000000 264.000000 0.000000 0.000000 0.000000 1.000000 /end COMPU_METHOD
/* Scalar measurable for DDE 'mpl_tt_pcx_qemptier'. */
/begin MEASUREMENT mpl_tt_pcx_qemptier "Duration of library task: pcx_qemptier" ULONG CU_MPL_TT_PCX_QEMPTIER 1 100 0.0 4294967295.0 ECU_ADDRESS 0x4000e5e8 BYTE_ORDER MSB_FIRST /end MEASUREMENT
/begin COMPU_METHOD CU_MPL_TT_PCX_QEMPTIER "Conversion method for mpl_tt_pcx_qemptier" RAT_FUNC "%10.0" "microseconds" COEFFS 0.000000 264.000000 0.000000 0.000000 0.000000 1.000000 /end COMPU_METHOD
/* Scalar measurable for DDE 'mpl_tt_pdc_worker_task'. */
/begin MEASUREMENT mpl_tt_pdc_worker_task "Duration of library task: pdc_worker_task" ULONG CU_MPL_TT_PDC_WORKER_TASK 1 100 0.0 4294967295.0 ECU_ADDRESS 0x4000e5b0 BYTE_ORDER MSB_FIRST /end MEASUREMENT
/begin COMPU_METHOD CU_MPL_TT_PDC_WORKER_TASK "Conversion method for mpl_tt_pdc_worker_task" RAT_FUNC "%10.0" "microseconds" COEFFS 0.000000 264.000000 0.000000 0.000000 0.000000 1.000000 /end COMPU_METHOD
/* Scalar measurable for DDE 'mpl_tt_pdg_client_task'. */
/begin MEASUREMENT mpl_tt_pdg_client_task "Duration of library task: pdg_client_task" ULONG CU_MPL_TT_PDG_CLIENT_TASK 1 100 0.0 4294967295.0 ECU_ADDRESS 0x4000e5cc BYTE_ORDER MSB_FIRST /end MEASUREMENT
/begin COMPU_METHOD CU_MPL_TT_PDG_CLIENT_TASK "Conversion method for mpl_tt_pdg_client_task" RAT_FUNC "%10.0" "microseconds" COEFFS 0.000000 264.000000 0.000000 0.000000 0.000000 1.000000 /end COMPU_METHOD
/* Scalar measurable for DDE 'mpl_tt_pdtc_client_task'. */
/begin MEASUREMENT mpl_tt_pdtc_client_task "Duration of library task: pdtc_client_task" ULONG CU_MPL_TT_PDTC_CLIENT_TASK 1 100 0.0 4294967295.0 ECU_ADDRESS 0x4000e5e0 BYTE_ORDER MSB_FIRST /end MEASUREMENT
/begin COMPU_METHOD CU_MPL_TT_PDTC_CLIENT_TASK "Conversion method for mpl_tt_pdtc_client_task" RAT_FUNC "%10.0" "microseconds" COEFFS 0.000000 264.000000 0.000000 0.000000 0.000000 1.000000 /end COMPU_METHOD
/* Scalar measurable for DDE 'mpl_tt_pfc_task'. */
/begin MEASUREMENT mpl_tt_pfc_task "Duration of library task: pfc_task" ULONG CU_MPL_TT_PFC_TASK 1 100 0.0 4294967295.0 ECU_ADDRESS 0x4000e5a8 BYTE_ORDER MSB_FIRST /end MEASUREMENT
/begin COMPU_METHOD CU_MPL_TT_PFC_TASK "Conversion method for mpl_tt_pfc_task" RAT_FUNC "%10.0" "microseconds" COEFFS 0.000000 264.000000 0.000000 0.000000 0.000000 1.000000 /end COMPU_METHOD
/* Scalar measurable for DDE 'mpl_tt_pff_client'. */
/begin MEASUREMENT mpl_tt_pff_client "Duration of library task: pff_client" ULONG CU_MPL_TT_PFF_CLIENT 1 100 0.0 4294967295.0 ECU_ADDRESS 0x4000e5c0 BYTE_ORDER MSB_FIRST /end MEASUREMENT
/begin COMPU_METHOD CU_MPL_TT_PFF_CLIENT "Conversion method for mpl_tt_pff_client" RAT_FUNC "%10.0" "microseconds" COEFFS 0.000000 264.000000 0.000000 0.000000 0.000000 1.000000 /end COMPU_METHOD
/* Scalar measurable for DDE 'mpl_tt_pfs_client'. */
/begin MEASUREMENT mpl_tt_pfs_client "Duration of library task: pfs_client" ULONG CU_MPL_TT_PFS_CLIENT 1 100 0.0 4294967295.0 ECU_ADDRESS 0x4000e5c4 BYTE_ORDER MSB_FIRST /end MEASUREMENT
/begin COMPU_METHOD CU_MPL_TT_PFS_CLIENT "Conversion method for mpl_tt_pfs_client" RAT_FUNC "%10.0" "microseconds" COEFFS 0.000000 264.000000 0.000000 0.000000 0.000000 1.000000 /end COMPU_METHOD
/* Scalar measurable for DDE 'mpl_tt_piso_client_task'. */
/begin MEASUREMENT mpl_tt_piso_client_task "Duration of library task: piso_client_task" ULONG CU_MPL_TT_PISO_CLIENT_TASK 1 100 0.0 4294967295.0 ECU_ADDRESS 0x4000e5c8 BYTE_ORDER MSB_FIRST /end MEASUREMENT
/begin COMPU_METHOD CU_MPL_TT_PISO_CLIENT_TASK "Conversion method for mpl_tt_piso_client_task" RAT_FUNC "%10.0" "microseconds" COEFFS 0.000000 264.000000 0.000000 0.000000 0.000000 1.000000 /end COMPU_METHOD
/* Scalar measurable for DDE 'mpl_tt_pj1939_client'. */
/begin MEASUREMENT mpl_tt_pj1939_client "Duration of library task: pj1939_client" ULONG CU_MPL_TT_PJ1939_CLIENT 1 100 0.0 4294967295.0 ECU_ADDRESS 0x4000e5bc BYTE_ORDER MSB_FIRST /end MEASUREMENT
/begin COMPU_METHOD CU_MPL_TT_PJ1939_CLIENT "Conversion method for mpl_tt_pj1939_client" RAT_FUNC "%10.0" "microseconds" COEFFS 0.000000 264.000000 0.000000 0.000000 0.000000 1.000000 /end COMPU_METHOD
/* Scalar measurable for DDE 'mpl_tt_ppm_task'. */
/begin MEASUREMENT mpl_tt_ppm_task "Duration of library task: ppm_task" ULONG CU_MPL_TT_PPM_TASK 1 100 0.0 4294967295.0 ECU_ADDRESS 0x4000e5a4 BYTE_ORDER MSB_FIRST /end MEASUREMENT
/begin COMPU_METHOD CU_MPL_TT_PPM_TASK "Conversion method for mpl_tt_ppm_task" RAT_FUNC "%10.0" "microseconds" COEFFS 0.000000 264.000000 0.000000 0.000000 0.000000 1.000000 /end COMPU_METHOD
/* Scalar measurable for DDE 'mpl_tt_psc_watchdog'. */
/begin MEASUREMENT mpl_tt_psc_watchdog "Duration of library task: psc_watchdog" ULONG CU_MPL_TT_PSC_WATCHDOG 1 100 0.0 4294967295.0 ECU_ADDRESS 0x4000e5f0 BYTE_ORDER MSB_FIRST /end MEASUREMENT
/begin COMPU_METHOD CU_MPL_TT_PSC_WATCHDOG "Conversion method for mpl_tt_psc_watchdog" RAT_FUNC "%10.0" "microseconds" COEFFS 0.000000 264.000000 0.000000 0.000000 0.000000 1.000000 /end COMPU_METHOD
/* Scalar measurable for DDE 'mpl_tt_psp_periodic'. */
/begin MEASUREMENT mpl_tt_psp_periodic "Duration of library task: psp_periodic" ULONG CU_MPL_TT_PSP_PERIODIC 1 100 0.0 4294967295.0 ECU_ADDRESS 0x4000e5ec BYTE_ORDER MSB_FIRST /end MEASUREMENT
/begin COMPU_METHOD CU_MPL_TT_PSP_PERIODIC "Conversion method for mpl_tt_psp_periodic" RAT_FUNC "%10.0" "microseconds" COEFFS 0.000000 264.000000 0.000000 0.000000 0.000000 1.000000 /end COMPU_METHOD
/* Scalar measurable for DDE 'mpl_tt_psp_receive'. */
/begin MEASUREMENT mpl_tt_psp_receive "Duration of library task: psp_receive" ULONG CU_MPL_TT_PSP_RECEIVE 1 100 0.0 4294967295.0 ECU_ADDRESS 0x4000e5b4 BYTE_ORDER MSB_FIRST /end MEASUREMENT
/begin COMPU_METHOD CU_MPL_TT_PSP_RECEIVE "Conversion method for mpl_tt_psp_receive" RAT_FUNC "%10.0" "microseconds" COEFFS 0.000000 264.000000 0.000000 0.000000 0.000000 1.000000 /end COMPU_METHOD
/* Scalar measurable for DDE 'mpl_tt_pss_task'. */
/begin MEASUREMENT mpl_tt_pss_task "Duration of library task: pss_task" ULONG CU_MPL_TT_PSS_TASK 1 100 0.0 4294967295.0 ECU_ADDRESS 0x4000e59c BYTE_ORDER MSB_FIRST /end MEASUREMENT
/begin COMPU_METHOD CU_MPL_TT_PSS_TASK "Conversion method for mpl_tt_pss_task" RAT_FUNC "%10.0" "microseconds" COEFFS 0.000000 264.000000 0.000000 0.000000 0.000000 1.000000 /end COMPU_METHOD
/* Scalar measurable for DDE 'mpl_tt_pxs_task'. */
/begin MEASUREMENT mpl_tt_pxs_task "Duration of library task: pxs_task" ULONG CU_MPL_TT_PXS_TASK 1 100 0.0 4294967295.0 ECU_ADDRESS 0x4000e5ac BYTE_ORDER MSB_FIRST /end MEASUREMENT
/begin COMPU_METHOD CU_MPL_TT_PXS_TASK "Conversion method for mpl_tt_pxs_task" RAT_FUNC "%10.0" "microseconds" COEFFS 0.000000 264.000000 0.000000 0.000000 0.000000 1.000000 /end COMPU_METHOD
/* Scalar measurable for DDE 'mpl_tt_task_1000ms'. */
/begin MEASUREMENT mpl_tt_task_1000ms "Duration of application task: task_1000ms" ULONG CU_MPL_TT_TASK_1000MS 1 100 0.0 4294967295.0 ECU_ADDRESS 0x4000e5dc BYTE_ORDER MSB_FIRST /end MEASUREMENT
/begin COMPU_METHOD CU_MPL_TT_TASK_1000MS "Conversion method for mpl_tt_task_1000ms" RAT_FUNC "%10.0" "microseconds" COEFFS 0.000000 264.000000 0.000000 0.000000 0.000000 1.000000 /end COMPU_METHOD
/* Scalar measurable for DDE 'mpl_tt_task_100ms'. */
/begin MEASUREMENT mpl_tt_task_100ms "Duration of application task: task_100ms" ULONG CU_MPL_TT_TASK_100MS 1 100 0.0 4294967295.0 ECU_ADDRESS 0x4000e5d8 BYTE_ORDER MSB_FIRST /end MEASUREMENT
/begin COMPU_METHOD CU_MPL_TT_TASK_100MS "Conversion method for mpl_tt_task_100ms" RAT_FUNC "%10.0" "microseconds" COEFFS 0.000000 264.000000 0.000000 0.000000 0.000000 1.000000 /end COMPU_METHOD
/* Scalar measurable for DDE 'mpl_tt_task_10ms'. */
/begin MEASUREMENT mpl_tt_task_10ms "Duration of application task: task_10ms" ULONG CU_MPL_TT_TASK_10MS 1 100 0.0 4294967295.0 ECU_ADDRESS 0x4000e5d4 BYTE_ORDER MSB_FIRST /end MEASUREMENT
/begin COMPU_METHOD CU_MPL_TT_TASK_10MS "Conversion method for mpl_tt_task_10ms" RAT_FUNC "%10.0" "microseconds" COEFFS 0.000000 264.000000 0.000000 0.000000 0.000000 1.000000 /end COMPU_METHOD
/* Scalar measurable for DDE 'mpl_tt_task_angular'. */
/begin MEASUREMENT mpl_tt_task_angular "Duration of application task: task_angular" ULONG CU_MPL_TT_TASK_ANGULAR 1 100 0.0 4294967295.0 ECU_ADDRESS 0x4000e5d0 BYTE_ORDER MSB_FIRST /end MEASUREMENT
/begin COMPU_METHOD CU_MPL_TT_TASK_ANGULAR "Conversion method for mpl_tt_task_angular" RAT_FUNC "%10.0" "microseconds" COEFFS 0.000000 264.000000 0.000000 0.000000 0.000000 1.000000 /end COMPU_METHOD
/* Scalar measurable for DDE 'mpl_unstable_reset_count'. */
/begin MEASUREMENT mpl_unstable_reset_count "Number of resets since power-up, or since the application was last stable." ULONG CU_MPL_UNSTABLE_RESET_COUNT 1 100 0.0 4294967295.0 ECU_ADDRESS 0x40003cec BYTE_ORDER MSB_FIRST /end MEASUREMENT
/begin COMPU_METHOD CU_MPL_UNSTABLE_RESET_COUNT "Conversion method for mpl_unstable_reset_count" RAT_FUNC "%10.0" "events" COEFFS 0.000000 1.000000 0.000000 0.000000 0.000000 1.000000 /end COMPU_METHOD
/begin FUNCTION _4.Engine_Control "Group /ByModelHeirarchy/Gasoline/4.Engine_Control"
 /begin SUB_FUNCTION ADM AF1_OK AFR AMB_OK AME APP Auto BAF BAS BCM Begas_Herko_LCD CI CLF__upstream_UEGO CPL CTC Cruiser_Begas DATALOGGER_HERKO DD DFC Displayables1 Dyno_requested_load DynoMessages EC1 EEC14 EEC1_OK EEC2_OK EEC3_OK EFL EGF1_OK ELM ERL ERM ET1_OK ETC1 ETH FCA_2.0 HOURS IC1_OK IDL IJT_DisplayablesPFI IJT_PFI KNK LFE LFE1_OK Manual OVR_AndExport69 OVR_AndExport104 OVR_AndExport125 OVR_AndExport133 OVR_AndExport145 OVR_AndExport153 OVR_AndExport164 OVR_AndExport174 OVR_AndExport184 OVR_AndExport195 OVR_AndExport70 OVR_AndExport203 OVR_AndExport213 OVR_AndExport223 OVR_AndExport231 OVR_AndExport242 OVR_AndExport263 OVR_AndExport273 OVR_AndExport283 OVR_AndExport292 OVR_AndExport71 OVR_AndExport302 OVR_AndExport312 OVR_AndExport322 OVR_AndExport332 OVR_AndExport327 OVR_AndExport352 OVR_AndExport362 OVR_AndExport373 OVR_AndExport384 OVR_AndExport394 OVR_AndExport72 OVR_AndExport401 OVR_AndExport411 OVR_AndExport421 OVR_AndExport43 OVR_AndExport451 OVR_AndExport46 OVR_AndExport47 OVR_AndExport481 OVR_AndExport491 OVR_AndExport73 OVR_AndExport50 OVR_AndExport51 OVR_AndExport52 OVR_AndExport541 OVR_AndExport55 OVR_AndExport56 OVR_AndExport57 OVR_AndExport58 OVR_AndExport68 OVR_AndExport60 OVR_AndExport63 OVR_AndExport64 OVR_AndExport65 OVR_AndExport66 OVR_AndExport67 OVR_AndExport77 OVR_AndExport86 OVR_AndExport96 Powertrain_Can.ZF RFC SAR SHUTDN SPN_544_ SPN_544 SPT TAR TC1 TRF TRS TUR VCP VEP1_OK /end SUB_FUNCTION
 /begin LOC_MEASUREMENT DFC_b_BurningDFC_Active FCA_lpk_AverageFuelConsumption TAR_Nm_J1939DrvrDmndTq /end LOC_MEASUREMENT
 /begin REF_CHARACTERISTIC AFRc_lam_BaseAFR_Trim APPc_b_ResetNVM SYSc_Nm_ManualTqRqst SYSc_adv_ManualSparkOfst SYSc_pct_ManualFuelTrim TARc_NU_RearAxleRatio TARc_b_Disable_TQmodel TARc_mm_WheelCircumference /end REF_CHARACTERISTIC
/end FUNCTION
/begin FUNCTION FuelPump_Derivative_Controller "Group /ByModelHeirarchy/Gasoline/5.Aux_Controls/EFP/Fuel pump control/feedback controller/FuelPump_Derivative_Controller" /begin LOC_MEASUREMENT EFP_NU_FuelPumpErrROC EFP_pct_FuelPumpDTerm /end LOC_MEASUREMENT /begin REF_CHARACTERISTIC EFPc_NU_FuelPumpDGain EFPc_NU_FuelPumpErrROCThrsh /end REF_CHARACTERISTIC /end FUNCTION
/begin FUNCTION FuelPump_Integral_Controller "Group /ByModelHeirarchy/Gasoline/5.Aux_Controls/EFP/Fuel pump control/feedback controller/FuelPump_Integral_Controller" /begin LOC_MEASUREMENT EFP_pct_FuelPumpITerm /end LOC_MEASUREMENT
 /begin REF_CHARACTERISTIC EFPc_NU_FuelPumpIGain EFPc_bar_FuelPumpDbndLatchI EFPc_pct_FuelPumpITermMax EFPc_pct_FuelPumpITermMin /end REF_CHARACTERISTIC
/end FUNCTION
/begin FUNCTION feedback_controller1 "Group /ByModelHeirarchy/Gasoline/5.Aux_Controls/EFP/Fuel pump control/feedback controller"
 /begin SUB_FUNCTION FuelPump_Derivative_Controller FuelPump_Integral_Controller /end SUB_FUNCTION
 /begin LOC_MEASUREMENT EFP_pct_FuelPumpPIDRaw EFP_pct_FuelPumpPTerm /end LOC_MEASUREMENT
 /begin REF_CHARACTERISTIC EFPc_NU_FuelPumpPGain EFPc_b_FuelPumpResetITerm EFPc_pct_FuelPumpPID_Dbnd EFPc_pct_FuelPumpPID_Max EFPc_pct_FuelPumpPID_Min /end REF_CHARACTERISTIC
/end FUNCTION
/begin FUNCTION Fuel_pump_control "Group /ByModelHeirarchy/Gasoline/5.Aux_Controls/EFP/Fuel pump control" /begin SUB_FUNCTION feedback_controller1 /end SUB_FUNCTION /begin LOC_MEASUREMENT EFP_bar_PressErr EFP_pct_FuelPumpDC_PID /end LOC_MEASUREMENT
 /begin REF_CHARACTERISTIC EFPm_NU_FuelPumpDC_FF_x EFPm_NU_FuelPumpDC_FF_y EFPm_NU_FuelPumpDC_FF_z FRPm_NU_DutyCycle_x FRPm_NU_DutyCycle_z /end REF_CHARACTERISTIC
/end FUNCTION
/begin FUNCTION Hold_10s "Group /ByModelHeirarchy/Gasoline/5.Aux_Controls/EFP/Hold_10s" /begin REF_CHARACTERISTIC DINc_s_TimeIgnitionON /end REF_CHARACTERISTIC /end FUNCTION
/begin FUNCTION OVR_AndExport146 "Group /ByModelHeirarchy/Gasoline/5.Aux_Controls/EFP/OVR_AndExport14" /begin LOC_MEASUREMENT EFP_b_NotStalled /end LOC_MEASUREMENT /begin REF_CHARACTERISTIC EFPc_b_NotStalled EFPc_o_NotStalled /end REF_CHARACTERISTIC /end FUNCTION
/begin FUNCTION EFP "Group /ByModelHeirarchy/Gasoline/5.Aux_Controls/EFP" /begin SUB_FUNCTION Fuel_pump_control Hold_10s OVR_AndExport146 /end SUB_FUNCTION /end FUNCTION
/begin FUNCTION Heater_timeout2 "Group /ByModelHeirarchy/Gasoline/5.Aux_Controls/HHT/Heater timeout" /begin REF_CHARACTERISTIC HTRc_s_EngineStopTimeout /end REF_CHARACTERISTIC /end FUNCTION
/begin FUNCTION PWM_Changing "Group /ByModelHeirarchy/Gasoline/5.Aux_Controls/HHT/PWM_Changing" /begin REF_CHARACTERISTIC HHTc_pct_RunningDuty HHTc_pct_WarmupDuty HHTc_s_Warmup /end REF_CHARACTERISTIC /end FUNCTION
/begin FUNCTION PWM_Changing1 "Group /ByModelHeirarchy/Gasoline/5.Aux_Controls/HHT/PWM_Changing1" /begin REF_CHARACTERISTIC HHTc_pct_RunningDuty HHTc_pct_WarmupDuty HHTc_s_Warmup /end REF_CHARACTERISTIC /end FUNCTION
/begin FUNCTION HHT "Group /ByModelHeirarchy/Gasoline/5.Aux_Controls/HHT" /begin SUB_FUNCTION Heater_timeout2 PWM_Changing PWM_Changing1 /end SUB_FUNCTION /end FUNCTION
/begin FUNCTION OVR_AndExport80 "Group /ByModelHeirarchy/Gasoline/5.Aux_Controls/OVR_AndExport1" /begin LOC_MEASUREMENT EFP_b_FuelPumpDC /end LOC_MEASUREMENT /begin REF_CHARACTERISTIC EFPc_b_FuelPumpDC EFPc_o_FuelPumpDC /end REF_CHARACTERISTIC /end FUNCTION
/begin FUNCTION OVR_AndExport126 "Group /ByModelHeirarchy/Gasoline/5.Aux_Controls/OVR_AndExport12" /begin LOC_MEASUREMENT HHT_pct_EGO11_HeaterDuty /end LOC_MEASUREMENT /begin REF_CHARACTERISTIC HHTc_o_EGO11_HeaterDuty HHTc_pct_EGO11_HeaterDuty /end REF_CHARACTERISTIC /end FUNCTION
/begin FUNCTION OVR_AndExport134 "Group /ByModelHeirarchy/Gasoline/5.Aux_Controls/OVR_AndExport13" /begin LOC_MEASUREMENT HHT_pct_EGO21_HeaterDuty /end LOC_MEASUREMENT /begin REF_CHARACTERISTIC HHTc_o_EGO21_HeaterDuty HHTc_pct_EGO21_HeaterDuty /end REF_CHARACTERISTIC /end FUNCTION
/begin FUNCTION OVR_AndExport147 "Group /ByModelHeirarchy/Gasoline/5.Aux_Controls/OVR_AndExport14" /begin LOC_MEASUREMENT EFP_b_RunFuelPump /end LOC_MEASUREMENT /begin REF_CHARACTERISTIC EFPc_b_RunFuelPump EFPc_o_RunFuelPump /end REF_CHARACTERISTIC /end FUNCTION
/begin FUNCTION OVR_AndExport154 "Group /ByModelHeirarchy/Gasoline/5.Aux_Controls/OVR_AndExport15" /begin LOC_MEASUREMENT HHT_pct_EGO12_HeaterDuty /end LOC_MEASUREMENT /begin REF_CHARACTERISTIC HHTc_o_EGO12_HeaterDuty HHTc_pct_EGO12_HeaterDuty /end REF_CHARACTERISTIC /end FUNCTION
/begin FUNCTION OVR_AndExport167 "Group /ByModelHeirarchy/Gasoline/5.Aux_Controls/OVR_AndExport16" /begin LOC_MEASUREMENT HHT_pct_EGO22_HeaterDuty /end LOC_MEASUREMENT /begin REF_CHARACTERISTIC HHTc_o_EGO22_HeaterDuty HHTc_pct_EGO22_HeaterDuty /end REF_CHARACTERISTIC /end FUNCTION
/begin FUNCTION OVR_AndExport81 "Group /ByModelHeirarchy/Gasoline/5.Aux_Controls/OVR_AndExport3" /begin LOC_MEASUREMENT SOV_b_OpenValve1 /end LOC_MEASUREMENT /begin REF_CHARACTERISTIC SOVc_b_OpenValve1 SOVc_o_OpenValve1 /end REF_CHARACTERISTIC /end FUNCTION
/begin FUNCTION OVR_AndExport82 "Group /ByModelHeirarchy/Gasoline/5.Aux_Controls/OVR_AndExport4" /begin LOC_MEASUREMENT SOV_b_OpenValve2 /end LOC_MEASUREMENT /begin REF_CHARACTERISTIC SOVc_b_OpenValve2 SOVc_o_OpenValve2 /end REF_CHARACTERISTIC /end FUNCTION
/begin FUNCTION OVR_AndExport83 "Group /ByModelHeirarchy/Gasoline/5.Aux_Controls/OVR_AndExport5" /begin LOC_MEASUREMENT STR_b_ManualStarter /end LOC_MEASUREMENT /begin REF_CHARACTERISTIC STRc_b_ManualStarter STRc_o_ManualStarter /end REF_CHARACTERISTIC /end FUNCTION
/begin FUNCTION Hold_10s1 "Group /ByModelHeirarchy/Gasoline/5.Aux_Controls/SOV/Hold_10s" /begin REF_CHARACTERISTIC DINc_s_TimeIgnitionON /end REF_CHARACTERISTIC /end FUNCTION
/begin FUNCTION SOV "Group /ByModelHeirarchy/Gasoline/5.Aux_Controls/SOV" /begin SUB_FUNCTION Hold_10s1 /end SUB_FUNCTION /end FUNCTION
/begin FUNCTION _5.Aux_Controls "Group /ByModelHeirarchy/Gasoline/5.Aux_Controls"
 /begin SUB_FUNCTION EFP HHT OVR_AndExport80 OVR_AndExport126 OVR_AndExport134 OVR_AndExport147 OVR_AndExport154 OVR_AndExport167 OVR_AndExport81 OVR_AndExport82 OVR_AndExport83 SOV /end SUB_FUNCTION
 /begin REF_CHARACTERISTIC EFPc_bar_FRP_Trgt EFPc_bar_FuelPressMax EFPc_bar_FuelPressMin /end REF_CHARACTERISTIC
/end FUNCTION
/begin FUNCTION FaultExports "Group /ByModelHeirarchy/Gasoline/6.Output_Processing/FaultExports"
 /begin LOC_MEASUREMENT FLT_NU_APP1 FLT_NU_APP2 FLT_NU_BrkSw FLT_NU_CAN_CCVS FLT_NU_CamPhaser FLT_NU_CoolantTemp FLT_NU_ECU FLT_NU_EGO11 FLT_NU_EGO12 FLT_NU_EGO21 FLT_NU_EGO22 FLT_NU_ETC FLT_NU_FCV FLT_NU_HighLevel1 FLT_NU_HighLevel2 FLT_NU_Inj1 FLT_NU_Inj2 FLT_NU_Inj3 FLT_NU_Inj4 FLT_NU_Inj5 FLT_NU_Inj6 FLT_NU_Inj7 FLT_NU_Inj8 FLT_NU_MAF FLT_NU_OilTemp FLT_NU_PSU FLT_NU_PurgeVlv FLT_NU_Spk1 FLT_NU_Spk2 FLT_NU_Spk3 FLT_NU_Spk4 FLT_NU_Spk5 FLT_NU_Spk6 FLT_NU_Spk7 FLT_NU_Spk8 FLT_NU_TP1 FLT_NU_TP2 FLT_NU_TurCtrl FLT_NU_UEGO1 FLT_NU_UEGO2 FLT_NU_VCP FLT_NU_VRef /end LOC_MEASUREMENT
/end FUNCTION
/begin FUNCTION Internal_Signals "Group /ByModelHeirarchy/Gasoline/6.Output_Processing/Internal Signals" /begin LOC_MEASUREMENT SYS_NU_ResetType SYS_s_BootDuration /end LOC_MEASUREMENT
 /begin REF_CHARACTERISTIC OUTc_b_EnablePowerHold OUTc_b_ResetFltBankA OUTc_b_ResetFltBankB OUTc_b_ResetHighsideTrip OUTc_b_ResetOC_Trip OUTc_s_ShutdownDelay SYSc_b_ModuleReset /end REF_CHARACTERISTIC
/end FUNCTION
/begin FUNCTION NVM1 "Group /ByModelHeirarchy/Gasoline/6.Output_Processing/NVM" /begin LOC_MEASUREMENT OUT_b_FlashChecksum OUT_b_RAM_Checksum /end LOC_MEASUREMENT /end FUNCTION
/begin FUNCTION OVR_AndExport84 "Group /ByModelHeirarchy/Gasoline/6.Output_Processing/OVR_AndExport1" /begin LOC_MEASUREMENT OUT_b_PT_RelayEnergized /end LOC_MEASUREMENT /begin REF_CHARACTERISTIC OUTc_b_PT_RelayEnergized OUTc_o_PT_RelayEnergized /end REF_CHARACTERISTIC /end FUNCTION
/begin FUNCTION OVR_AndExport79 "Group /ByModelHeirarchy/Gasoline/6.Output_Processing/OVR_AndExport7" /begin LOC_MEASUREMENT OUT_b_CombustionAllCyls /end LOC_MEASUREMENT /begin REF_CHARACTERISTIC OUTc_b_CombustionAllCyls OUTc_o_CombustionAllCyls /end REF_CHARACTERISTIC /end FUNCTION
/begin FUNCTION _5V_Sensor_Power_Supplies "Group /ByModelHeirarchy/Gasoline/6.Output_Processing/Wired outputs/5V Sensor Power Supplies"
 /begin REF_CHARACTERISTIC OUTc_b_VRefA_Enbl OUTc_b_VRefB_Enbl OUTc_b_VRefC_Enbl OUTc_b_VRefD_Enbl /end REF_CHARACTERISTIC
/end FUNCTION
/begin FUNCTION OVR_AndExport85 "Group /ByModelHeirarchy/Gasoline/6.Output_Processing/Wired outputs/Auxiliary Devices/Control_alternancia_depósitos/OVR_AndExport1" /begin LOC_MEASUREMENT LOG_NU_ManualPump /end LOC_MEASUREMENT /begin REF_CHARACTERISTIC LOGc_NU_ManualPump LOGc_o_ManualPump /end REF_CHARACTERISTIC /end FUNCTION
/begin FUNCTION Control_alternancia_dep__sitos "Group /ByModelHeirarchy/Gasoline/6.Output_Processing/Wired outputs/Auxiliary Devices/Control_alternancia_depósitos" /begin SUB_FUNCTION OVR_AndExport85 /end SUB_FUNCTION
 /begin REF_CHARACTERISTIC AINc_b_Tank2_Available OUTc_s_ChangeTanksDelay OUTc_s_FuelLevelLimDelay OUTc_s_SwichTankHold /end REF_CHARACTERISTIC
/end FUNCTION
/begin FUNCTION EngSpd_calculate "Group /ByModelHeirarchy/Gasoline/6.Output_Processing/Wired outputs/Auxiliary Devices/EngSpd_calculate" /begin REF_CHARACTERISTIC OUTc_NU_EngSpdFq_Type OUTm_NU_EngSpd_x OUTm_NU_EngSpd_z /end REF_CHARACTERISTIC /end FUNCTION
/begin FUNCTION OVR_AndExport86 "Group /ByModelHeirarchy/Gasoline/6.Output_Processing/Wired outputs/Auxiliary Devices/OVR_AndExport1" /begin LOC_MEASUREMENT LOG_PWM_PUMP /end LOC_MEASUREMENT /begin REF_CHARACTERISTIC LOGc_PWM_PUMP LOGc_o_PUMP /end REF_CHARACTERISTIC /end FUNCTION
/begin FUNCTION OVR_AndExport87 "Group /ByModelHeirarchy/Gasoline/6.Output_Processing/Wired outputs/Auxiliary Devices/OVR_AndExport2" /begin LOC_MEASUREMENT LOG_PWM_BLOWER /end LOC_MEASUREMENT /begin REF_CHARACTERISTIC LOGc_PWM_BLOWER LOGc_o_BLOWER /end REF_CHARACTERISTIC /end FUNCTION
/begin FUNCTION OVR_AndExport88 "Group /ByModelHeirarchy/Gasoline/6.Output_Processing/Wired outputs/Auxiliary Devices/OVR_AndExport3" /begin LOC_MEASUREMENT OUT_b_VISCO_1st /end LOC_MEASUREMENT /begin REF_CHARACTERISTIC OUTc_b_VISCO_1st OUTc_o_VISCO_1st /end REF_CHARACTERISTIC /end FUNCTION
/begin FUNCTION OVR_AndExport328 "Group /ByModelHeirarchy/Gasoline/6.Output_Processing/Wired outputs/Auxiliary Devices/OVR_AndExport34" /begin LOC_MEASUREMENT DTC_b_ShutOffValveEngine_OL /end LOC_MEASUREMENT /begin REF_CHARACTERISTIC DTCc_b_ShutOffValveEngine_OL DTCc_o_ShutOffValveEngine_OL /end REF_CHARACTERISTIC /end FUNCTION
/begin FUNCTION OVR_AndExport89 "Group /ByModelHeirarchy/Gasoline/6.Output_Processing/Wired outputs/Auxiliary Devices/OVR_AndExport4" /begin LOC_MEASUREMENT LOG_b_RelePump1 /end LOC_MEASUREMENT /begin REF_CHARACTERISTIC LOGc_b_RelePump1 LOGc_o_RelePump1 /end REF_CHARACTERISTIC /end FUNCTION
/begin FUNCTION OVR_AndExport90 "Group /ByModelHeirarchy/Gasoline/6.Output_Processing/Wired outputs/Auxiliary Devices/OVR_AndExport5" /begin LOC_MEASUREMENT LOG_b_RelePump2 /end LOC_MEASUREMENT /begin REF_CHARACTERISTIC LOGc_b_RelePump2 LOGc_o_RelePump2 /end REF_CHARACTERISTIC /end FUNCTION
/begin FUNCTION OVR_AndExport91 "Group /ByModelHeirarchy/Gasoline/6.Output_Processing/Wired outputs/Auxiliary Devices/OVR_AndExport6" /begin LOC_MEASUREMENT OUT_Hz_EngSpd /end LOC_MEASUREMENT /begin REF_CHARACTERISTIC OUTc_Hz_EngSpd OUTc_o_EngSpd /end REF_CHARACTERISTIC /end FUNCTION
/begin FUNCTION OVR_AndExport92 "Group /ByModelHeirarchy/Gasoline/6.Output_Processing/Wired outputs/Auxiliary Devices/OVR_AndExport7" /begin LOC_MEASUREMENT OUT_Hz_VhSpd /end LOC_MEASUREMENT /begin REF_CHARACTERISTIC OUTc_Hz_VhSpd OUTc_o_VhSpd /end REF_CHARACTERISTIC /end FUNCTION
/begin FUNCTION OVR_AndExport87 "Group /ByModelHeirarchy/Gasoline/6.Output_Processing/Wired outputs/Auxiliary Devices/OVR_AndExport8" /begin LOC_MEASUREMENT OUT_b_VISCO_2nd /end LOC_MEASUREMENT /begin REF_CHARACTERISTIC OUTc_b_VISCO_2nd OUTc_o_VISCO_2nd /end REF_CHARACTERISTIC /end FUNCTION
/begin FUNCTION Subsystem4 "Group /ByModelHeirarchy/Gasoline/6.Output_Processing/Wired outputs/Auxiliary Devices/Subsystem" /begin REF_CHARACTERISTIC OUTc_C_Thres_off OUTc_C_Thres_on /end REF_CHARACTERISTIC /end FUNCTION
/begin FUNCTION Subsystem11 "Group /ByModelHeirarchy/Gasoline/6.Output_Processing/Wired outputs/Auxiliary Devices/Subsystem1" /begin REF_CHARACTERISTIC OUTc_s_ViscoOFFPulse OUTc_s_ViscoPeakPulse /end REF_CHARACTERISTIC /end FUNCTION
/begin FUNCTION VhSpd_calculate "Group /ByModelHeirarchy/Gasoline/6.Output_Processing/Wired outputs/Auxiliary Devices/VhSpd_calculate" /begin REF_CHARACTERISTIC OUTc_NU_VhSpdFq_Type OUTm_NU_VhSpd_x OUTm_NU_VhSpd_z /end REF_CHARACTERISTIC /end FUNCTION
/begin FUNCTION Auxiliary_Devices "Group /ByModelHeirarchy/Gasoline/6.Output_Processing/Wired outputs/Auxiliary Devices"
 /begin SUB_FUNCTION Control_alternancia_dep__sitos EngSpd_calculate OVR_AndExport86 OVR_AndExport87 OVR_AndExport88 OVR_AndExport328 OVR_AndExport89 OVR_AndExport90 OVR_AndExport91 OVR_AndExport92 OVR_AndExport87 Subsystem4 Subsystem11 VhSpd_calculate /end SUB_FUNCTION
 /begin REF_CHARACTERISTIC OUTc_C_EFPFuelTemp OUTc_C_Visco_off_1st OUTc_C_Visco_off_2nd OUTc_C_Visco_on_1st OUTc_C_Visco_on_2nd OUTc_Hz_EGO_HeaterFrq OUTc_Hz_ShutOffValveFrq OUTc_pct_ActvLoadPumpThrs OUTc_pct_DeactvLoadPumpThrs OUTc_pct_EngSpd_Fq OUTc_pct_FuelMinLevel OUTc_pct_VhSpd_Fq /end REF_CHARACTERISTIC
/end FUNCTION
/begin FUNCTION Combustion_criteria "Group /ByModelHeirarchy/Gasoline/6.Output_Processing/Wired outputs/Combustion criteria" /begin LOC_MEASUREMENT OUT_b_BankA_Enbld OUT_b_BankB_Enbld /end LOC_MEASUREMENT /end FUNCTION
/begin FUNCTION ETC_Output "Group /ByModelHeirarchy/Gasoline/6.Output_Processing/Wired outputs/ETC_Output" /begin REF_CHARACTERISTIC OUTc_Hz_ETC_HBridgeFrq OUTc_b_InvertETC /end REF_CHARACTERISTIC /end FUNCTION
/begin FUNCTION Highside_Outputs_and_Powertrai0 "Group /ByModelHeirarchy/Gasoline/6.Output_Processing/Wired outputs/Highside Outputs and Powertrain Relay" /begin LOC_MEASUREMENT OUT_b_HighsideY1 OUT_b_HighsideY5 OUT_b_PT_Relay /end LOC_MEASUREMENT
 /begin REF_CHARACTERISTIC OUTc_b_EnableHighsideY1 OUTc_b_EnableHighsideY5 OUTc_b_EnablePowertrainRly OUTc_b_PowerRelayIgnoreSync /end REF_CHARACTERISTIC
/end FUNCTION
/begin FUNCTION Fuel_Cut "Group /ByModelHeirarchy/Gasoline/6.Output_Processing/Wired outputs/Injectors and Spark/Fuel Cut" /begin REF_CHARACTERISTIC OUTc_b_EnblManualFuelCut OUTc_b_ManualFuelCut1 /end REF_CHARACTERISTIC /end FUNCTION
/begin FUNCTION Fuel_Cut1 "Group /ByModelHeirarchy/Gasoline/6.Output_Processing/Wired outputs/Injectors and Spark/Fuel Cut1" /begin REF_CHARACTERISTIC OUTc_b_EnblManualFuelCut OUTc_b_ManualFuelCut2 /end REF_CHARACTERISTIC /end FUNCTION
/begin FUNCTION Fuel_Cut2 "Group /ByModelHeirarchy/Gasoline/6.Output_Processing/Wired outputs/Injectors and Spark/Fuel Cut2" /begin REF_CHARACTERISTIC OUTc_b_EnblManualFuelCut OUTc_b_ManualFuelCut3 /end REF_CHARACTERISTIC /end FUNCTION
/begin FUNCTION Fuel_Cut3 "Group /ByModelHeirarchy/Gasoline/6.Output_Processing/Wired outputs/Injectors and Spark/Fuel Cut3" /begin REF_CHARACTERISTIC OUTc_b_EnblManualFuelCut OUTc_b_ManualFuelCut4 /end REF_CHARACTERISTIC /end FUNCTION
/begin FUNCTION Cylinder_1_Inj "Group /ByModelHeirarchy/Gasoline/6.Output_Processing/Wired outputs/Injectors and Spark/Injection_Output_Driver/Cylinder 1 Inj" /begin REF_CHARACTERISTIC SYSc_ret_InjDropDeadAng /end REF_CHARACTERISTIC /end FUNCTION
/begin FUNCTION Cylinder_2_Inj "Group /ByModelHeirarchy/Gasoline/6.Output_Processing/Wired outputs/Injectors and Spark/Injection_Output_Driver/Cylinder 2 Inj" /begin REF_CHARACTERISTIC SYSc_ret_InjDropDeadAng /end REF_CHARACTERISTIC /end FUNCTION
/begin FUNCTION Cylinder_3_Inj "Group /ByModelHeirarchy/Gasoline/6.Output_Processing/Wired outputs/Injectors and Spark/Injection_Output_Driver/Cylinder 3 Inj" /begin REF_CHARACTERISTIC SYSc_ret_InjDropDeadAng /end REF_CHARACTERISTIC /end FUNCTION
/begin FUNCTION Cylinder_4_Inj "Group /ByModelHeirarchy/Gasoline/6.Output_Processing/Wired outputs/Injectors and Spark/Injection_Output_Driver/Cylinder 4 Inj" /begin REF_CHARACTERISTIC SYSc_ret_InjDropDeadAng /end REF_CHARACTERISTIC /end FUNCTION
/begin FUNCTION Injection_Output_Driver "Group /ByModelHeirarchy/Gasoline/6.Output_Processing/Wired outputs/Injectors and Spark/Injection_Output_Driver"
 /begin SUB_FUNCTION Cylinder_1_Inj Cylinder_2_Inj Cylinder_3_Inj Cylinder_4_Inj /end SUB_FUNCTION
/end FUNCTION
/begin FUNCTION Manual_Spark_Cut "Group /ByModelHeirarchy/Gasoline/6.Output_Processing/Wired outputs/Injectors and Spark/Manual Spark Cut" /begin LOC_MEASUREMENT OUT_b_Spk1_Active /end LOC_MEASUREMENT /begin REF_CHARACTERISTIC OUTc_b_EnblManualSparkCut OUTc_b_ManualSparkCut1 /end REF_CHARACTERISTIC /end FUNCTION
/begin FUNCTION Manual_Spark_Cut1 "Group /ByModelHeirarchy/Gasoline/6.Output_Processing/Wired outputs/Injectors and Spark/Manual Spark Cut1" /begin LOC_MEASUREMENT OUT_b_Spk2_Active /end LOC_MEASUREMENT /begin REF_CHARACTERISTIC OUTc_b_EnblManualSparkCut OUTc_b_ManualSparkCut2 /end REF_CHARACTERISTIC /end FUNCTION
/begin FUNCTION Manual_Spark_Cut2 "Group /ByModelHeirarchy/Gasoline/6.Output_Processing/Wired outputs/Injectors and Spark/Manual Spark Cut2" /begin LOC_MEASUREMENT OUT_b_Spk3_Active /end LOC_MEASUREMENT /begin REF_CHARACTERISTIC OUTc_b_EnblManualSparkCut OUTc_b_ManualSparkCut3 /end REF_CHARACTERISTIC /end FUNCTION
/begin FUNCTION Manual_Spark_Cut3 "Group /ByModelHeirarchy/Gasoline/6.Output_Processing/Wired outputs/Injectors and Spark/Manual Spark Cut3" /begin LOC_MEASUREMENT OUT_b_Spk4_Active /end LOC_MEASUREMENT /begin REF_CHARACTERISTIC OUTc_b_EnblManualSparkCut OUTc_b_ManualSparkCut4 /end REF_CHARACTERISTIC /end FUNCTION
/begin FUNCTION Manual_Spark_Cut4 "Group /ByModelHeirarchy/Gasoline/6.Output_Processing/Wired outputs/Injectors and Spark/Manual Spark Cut4" /begin LOC_MEASUREMENT OUT_b_Spk5_Active /end LOC_MEASUREMENT /begin REF_CHARACTERISTIC OUTc_b_EnblManualSparkCut OUTc_b_ManualSparkCut5 /end REF_CHARACTERISTIC /end FUNCTION
/begin FUNCTION Manual_Spark_Cut5 "Group /ByModelHeirarchy/Gasoline/6.Output_Processing/Wired outputs/Injectors and Spark/Manual Spark Cut5" /begin LOC_MEASUREMENT OUT_b_Spk6_Active /end LOC_MEASUREMENT /begin REF_CHARACTERISTIC OUTc_b_EnblManualSparkCut OUTc_b_ManualSparkCut6 /end REF_CHARACTERISTIC /end FUNCTION
/begin FUNCTION Manual_Spark_Cut6 "Group /ByModelHeirarchy/Gasoline/6.Output_Processing/Wired outputs/Injectors and Spark/Manual Spark Cut6" /begin LOC_MEASUREMENT OUT_b_Spk7_Active /end LOC_MEASUREMENT /begin REF_CHARACTERISTIC OUTc_b_EnblManualSparkCut OUTc_b_ManualSparkCut7 /end REF_CHARACTERISTIC /end FUNCTION
/begin FUNCTION Manual_Spark_Cut7 "Group /ByModelHeirarchy/Gasoline/6.Output_Processing/Wired outputs/Injectors and Spark/Manual Spark Cut7" /begin LOC_MEASUREMENT OUT_b_Spk8_Active /end LOC_MEASUREMENT /begin REF_CHARACTERISTIC OUTc_b_EnblManualSparkCut OUTc_b_ManualSparkCut8 /end REF_CHARACTERISTIC /end FUNCTION
/begin FUNCTION Spark_output_driver "Group /ByModelHeirarchy/Gasoline/6.Output_Processing/Wired outputs/Injectors and Spark/Spark output driver" /begin LOC_MEASUREMENT SYS_NU_CurrCyl SYS_b_CurrCylValid /end LOC_MEASUREMENT /end FUNCTION
/begin FUNCTION Injectors_and_Spark "Group /ByModelHeirarchy/Gasoline/6.Output_Processing/Wired outputs/Injectors and Spark"
 /begin SUB_FUNCTION Fuel_Cut Fuel_Cut1 Fuel_Cut2 Fuel_Cut3 Injection_Output_Driver Manual_Spark_Cut Manual_Spark_Cut1 Manual_Spark_Cut2 Manual_Spark_Cut3 Manual_Spark_Cut4 Manual_Spark_Cut5 Manual_Spark_Cut6 Manual_Spark_Cut7 Spark_output_driver /end SUB_FUNCTION
 /begin LOC_MEASUREMENT OUT_b_Inj1_LSD_Active OUT_b_Inj2_LSD_Active OUT_b_Inj3_LSD_Active OUT_b_Inj4_LSD_Active /end LOC_MEASUREMENT
/end FUNCTION
/begin FUNCTION Turbo "Group /ByModelHeirarchy/Gasoline/6.Output_Processing/Wired outputs/Turbo" /begin REF_CHARACTERISTIC OUTc_Hz_TurCtrlFrq /end REF_CHARACTERISTIC /end FUNCTION
/begin FUNCTION Wired_outputs "Group /ByModelHeirarchy/Gasoline/6.Output_Processing/Wired outputs"
 /begin SUB_FUNCTION _5V_Sensor_Power_Supplies Auxiliary_Devices Combustion_criteria ETC_Output Highside_Outputs_and_Powertrai0 Injectors_and_Spark Turbo /end SUB_FUNCTION
 /begin REF_CHARACTERISTIC OUTc_b_FuelEnIgnoreSync OUTc_b_SpkEnIgnoreSync /end REF_CHARACTERISTIC
/end FUNCTION
/begin FUNCTION _6.Output_Processing "Group /ByModelHeirarchy/Gasoline/6.Output_Processing"
 /begin SUB_FUNCTION FaultExports Internal_Signals NVM1 OVR_AndExport84 OVR_AndExport79 Wired_outputs /end SUB_FUNCTION
/end FUNCTION
/begin FUNCTION Configure_CAN "Group /ByModelHeirarchy/Gasoline/Model Configuration & ECU Configuration /unnamed/ Status/ECU Configuration/Configure CAN" /begin LOC_MEASUREMENT SYS_e_CAN0_State SYS_e_CAN1_State SYS_e_CAN3_State /end LOC_MEASUREMENT /end FUNCTION
/begin FUNCTION Configure_J1939 "Group /ByModelHeirarchy/Gasoline/Model Configuration & ECU Configuration /unnamed/ Status/ECU Configuration/Configure J1939" /begin REF_CHARACTERISTIC exdv_ff_spn_set_d /end REF_CHARACTERISTIC /end FUNCTION
/begin FUNCTION ECU_Configuration "Group /ByModelHeirarchy/Gasoline/Model Configuration & ECU Configuration /unnamed/ Status/ECU Configuration" /begin SUB_FUNCTION Configure_CAN Configure_J1939 /end SUB_FUNCTION /end FUNCTION
/begin FUNCTION _Status "Group /ByModelHeirarchy/Gasoline/Model Configuration & ECU Configuration /unnamed/ Status" /begin SUB_FUNCTION ECU_Configuration /end SUB_FUNCTION /end FUNCTION
/begin FUNCTION unnamed2 "Group /ByModelHeirarchy/Gasoline/Model Configuration & ECU Configuration /unnamed" /begin SUB_FUNCTION _Status /end SUB_FUNCTION /end FUNCTION
/begin FUNCTION Model_Configuration___ECU_Conf0 "Group /ByModelHeirarchy/Gasoline/Model Configuration & ECU Configuration " /begin SUB_FUNCTION unnamed2 /end SUB_FUNCTION /end FUNCTION
/begin FUNCTION Gasoline "Group /ByModelHeirarchy/Gasoline"
 /begin SUB_FUNCTION _0.Engine_Config _1.Input_Processing _2.OBD _3.System_Diagnostics _4.Engine_Control _5.Aux_Controls _6.Output_Processing Model_Configuration___ECU_Conf0 /end SUB_FUNCTION
/end FUNCTION
/begin FUNCTION ByModelHeirarchy "Group /ByModelHeirarchy" /begin SUB_FUNCTION Gasoline /end SUB_FUNCTION /end FUNCTION
/begin FUNCTION Adaptives "Group /ByType/Adaptives"
 /begin REF_CHARACTERISTIC APPc_V_FullLearnDfltValAPP1 APPc_V_FullLearnDfltValAPP2 APPca_V_FullLearnDfltValAPP1 APPca_V_FullLearnDfltValAPP2 CALc_V_UoffsetDfltValue CALca_V_UoffsetDfltValue CLFm_NU_LTFT_x CLFm_NU_LTFT_y CLFm_NU_LTFT_z CLFma_NU_LTFT_z ETCc_NU_FullLearnDfltTP1 ETCc_NU_FullLearnDfltTP2 ETCc_NU_ZeroLearnDfltTP1 ETCc_NU_ZeroLearnDfltTP2 ETCc_deg_RestLearnDflt ETCca_NU_FullLearnDfltTP1 ETCca_NU_FullLearnDfltTP2 ETCca_NU_ZeroLearnDfltTP1 ETCca_NU_ZeroLearnDfltTP2 ETCca_deg_RestLearnDflt FCAc_L_AcumFuelConsumption FCAc_km_AcumDistance FCAca_L_AcumFuelConsumption FCAca_km_AcumDistance NVMc_NU_CyclesDflt NVMc_NU_DistanceCounterDflt NVMc_NU_DistanceCounterMILDflt NVMc_NU_EngineRuntimeDflt NVMc_NU_EngineRuntimeDflt2 NVMc_NU_HOURSDflt NVMc_NU_MILcontinousDflt NVMc_NU_WarmCyclesCounterDflt NVMca_NU_CyclesDflt NVMca_NU_DistanceCounterDflt NVMca_NU_DistanceCounterMILDflt NVMca_NU_EngineRuntimeDflt NVMca_NU_EngineRuntimeDflt2 NVMca_NU_HOURSDflt NVMca_NU_MILcontinousDflt NVMca_NU_WarmCyclesCounterDflt /end REF_CHARACTERISTIC
/end FUNCTION
/begin FUNCTION Arrays "Group /ByType/Arrays"
 /begin REF_CHARACTERISTIC AINv_C_AmbientTemp_TF AINv_C_CoolantTemp_TF AINv_C_ExTemp_TF AINv_C_FuelTemp_TF AINv_C_ManifoldTemp_TF AINv_NU_KnockFilterGain AINv_V_AmbientTemp_TF AINv_V_CoolantTemp_TF AINv_V_ExTemp_TF AINv_V_FuelPress_TF AINv_V_FuelTemp_TF AINv_V_ManifoldTemp_TF AINv_bar_FuelPress_TF AINv_deg_MAP_SampleAngles AINv_kHz_KnockFilterFrq AINv_us_KnockFilterIntegrator DTCv_NU_CALID DTCv_NU_ESN DTCv_NU_VIN INPv_pct_GearRatios SYSv_cnt_CylIndex SYSv_deg_TDC_Angles exdv_ff_spn_set_d /end REF_CHARACTERISTIC
/end FUNCTION
/begin FUNCTION Automatic "Group /ByType/Automatic"
 /begin LOC_MEASUREMENT mpl_app_build_day mpl_app_build_hour mpl_app_build_min mpl_app_build_month mpl_app_build_sec mpl_app_build_year mpl_app_ver_major mpl_app_ver_minor mpl_app_ver_sub mpl_boot_build_day mpl_boot_build_month mpl_boot_build_year mpl_boot_part_num_group mpl_boot_part_num_id mpl_boot_part_num_issue mpl_boot_part_num_letter mpl_boot_ver_major mpl_boot_ver_minor mpl_boot_ver_sub mpl_cpu_loaded mpl_cpu_loaded_1000ms mpl_cpu_loaded_50ms mpl_ecc_flash_address mpl_ecc_ram_address mpl_etpu_a_loaded mpl_etpu_b_loaded mpl_flp_div_by_zero mpl_flp_inexact mpl_flp_invalid mpl_flp_overflow mpl_flp_underflow mpl_hw_version mpl_max_cpu_loaded mpl_max_cpu_loaded_1000ms mpl_max_cpu_loaded_50ms mpl_max_etpu_a_loaded mpl_max_etpu_b_loaded mpl_max_used_stack mpl_mtt_pan_task mpl_mtt_pcp_client mpl_mtt_pcx_can_callback mpl_mtt_pcx_periodic mpl_mtt_pcx_qemptier mpl_mtt_pdc_worker_task mpl_mtt_pdg_client_task mpl_mtt_pdtc_client_task mpl_mtt_pfc_task mpl_mtt_pff_client mpl_mtt_pfs_client mpl_mtt_piso_client_task mpl_mtt_pj1939_client mpl_mtt_ppm_task mpl_mtt_psc_watchdog mpl_mtt_psp_periodic mpl_mtt_psp_receive mpl_mtt_pss_task mpl_mtt_pxs_task mpl_mtt_task_1000ms mpl_mtt_task_100ms mpl_mtt_task_10ms mpl_mtt_task_angular mpl_ovrc_pcp_client mpl_ovrc_pcx_can_callback mpl_ovrc_pcx_periodic mpl_ovrc_pcx_qemptier mpl_ovrc_pdc_worker_task mpl_ovrc_pdg_client_task mpl_ovrc_pdtc_client_task mpl_ovrc_pfc_task mpl_ovrc_pff_client mpl_ovrc_pfs_client mpl_ovrc_piso_client_task mpl_ovrc_pj1939_client mpl_ovrc_ppm_task mpl_ovrc_psc_watchdog mpl_ovrc_psp_periodic mpl_ovrc_pss_task mpl_ovrc_pxs_task mpl_ovrc_task_1000ms mpl_ovrc_task_100ms mpl_ovrc_task_10ms mpl_plat_build_day mpl_plat_build_month mpl_plat_build_year mpl_plat_part_num_group mpl_plat_part_num_id mpl_plat_part_num_issue mpl_plat_part_num_letter mpl_plat_ver_major mpl_plat_ver_minor mpl_plat_ver_sub mpl_prg_build_day mpl_prg_build_month mpl_prg_build_year mpl_prg_part_num_group mpl_prg_part_num_id mpl_prg_part_num_issue mpl_prg_part_num_letter mpl_prg_ver_major mpl_prg_ver_minor mpl_prg_ver_sub mpl_reset_count mpl_run_time mpl_tt_pan_task mpl_tt_pcp_client mpl_tt_pcx_can_callback mpl_tt_pcx_periodic mpl_tt_pcx_qemptier mpl_tt_pdc_worker_task mpl_tt_pdg_client_task mpl_tt_pdtc_client_task mpl_tt_pfc_task mpl_tt_pff_client mpl_tt_pfs_client mpl_tt_piso_client_task mpl_tt_pj1939_client mpl_tt_ppm_task mpl_tt_psc_watchdog mpl_tt_psp_periodic mpl_tt_psp_receive mpl_tt_pss_task mpl_tt_pxs_task mpl_tt_task_1000ms mpl_tt_task_100ms mpl_tt_task_10ms mpl_tt_task_angular mpl_unstable_reset_count /end LOC_MEASUREMENT
 /begin REF_CHARACTERISTIC isoc_emissions_report_min_sev isoc_override_service_03 isoc_override_service_07 isoc_override_service_0a mpls_app_build_time mpls_app_copyright mpls_app_description mpls_app_name mpls_app_version mpls_plat_build_time mpls_plat_copyright mpls_plat_target mpls_plat_version pj1939c_node_addr_0 svcc_ecu_config_seedkey_cal svcc_ecu_reprog_seedkey_cal /end REF_CHARACTERISTIC
/end FUNCTION
/begin FUNCTION Maps "Group /ByType/Maps"
 /begin REF_CHARACTERISTIC ADMm_C_ExahustTemplimp_x ADMm_C_ExahustTemplimp_z ADMm_NU_BoostIGain_x ADMm_NU_BoostIGain_y ADMm_NU_BoostIGain_z ADMm_NU_BoostLimit_x ADMm_NU_BoostLimit_z ADMm_NU_BoostPGain_x ADMm_NU_BoostPGain_y ADMm_NU_BoostPGain_z ADMm_NU_BoostPressTrgtFF_x ADMm_NU_BoostPressTrgtFF_y ADMm_NU_BoostPressTrgtFF_z ADMm_NU_ComprSurgeMap_x ADMm_NU_ComprSurgeMap_z ADMm_NU_CrankingVCP_x ADMm_NU_CrankingVCP_z ADMm_NU_FF_ThrottleTrgt_x ADMm_NU_FF_ThrottleTrgt_y ADMm_NU_FF_ThrottleTrgt_z ADMm_NU_ISFC_x ADMm_NU_ISFC_y ADMm_NU_ISFC_z ADMm_NU_LUT_ThCorr_x ADMm_NU_LUT_ThCorr_y ADMm_NU_LUT_ThCorr_z ADMm_NU_NominalDP_x ADMm_NU_NominalDP_y ADMm_NU_NominalDP_z ADMm_NU_ThrottleFlowToAng_x ADMm_NU_ThrottleFlowToAng_z ADMm_NU_ThrottleIGain_x ADMm_NU_ThrottleIGain_y ADMm_NU_ThrottleIGain_z ADMm_NU_ThrottlePGain_x ADMm_NU_ThrottlePGain_y ADMm_NU_ThrottlePGain_z ADMm_NU_VCP_Temp_x ADMm_NU_VCP_Temp_z ADMm_NU_VCP_ThCorr_x ADMm_NU_VCP_ThCorr_z ADMm_NU_VCP_Trgt_x ADMm_NU_VCP_Trgt_y ADMm_NU_VCP_Trgt_z AFRm_NU_BaseTrgt_x AFRm_NU_BaseTrgt_y AFRm_NU_BaseTrgt_z AFRm_NU_CSI_Trgt_x AFRm_NU_CSI_Trgt_y AFRm_NU_CSI_Trgt_z AFRm_NU_CrankingTrgt_x AFRm_NU_CrankingTrgt_y AFRm_NU_CrankingTrgt_z AFRm_NU_RampRate_x AFRm_NU_RampRate_z AINm_NU_FuelPress_x AINm_NU_FuelPress_z AINm_NU_KnockGain_x AINm_NU_KnockGain_z AINm_NU_KnockOfst_x AINm_NU_KnockOfst_z AINm_deg_KnockWinDur_x AINm_deg_KnockWinDur_z AINm_deg_KnockWinStartOfst_x AINm_deg_KnockWinStartOfst_z AMEm_NU_ChargeTempCF_x AMEm_NU_ChargeTempCF_y AMEm_NU_ChargeTempCF_z AMEm_NU_MAF_Ofst_x AMEm_NU_MAF_Ofst_y AMEm_NU_MAF_Ofst_z AMEm_NU_ResidualPress_x AMEm_NU_ResidualPress_z AMEm_NU_UseDemandTime_x AMEm_NU_UseDemandTime_y AMEm_NU_UseDemandTime_z AMEm_NU_UseMAF_x AMEm_NU_UseMAF_y AMEm_NU_UseMAF_z AMEm_NU_VolEff_x AMEm_NU_VolEff_y AMEm_NU_VolEff_z APPm_NU_DrvrTqDmndFallRate_x APPm_NU_DrvrTqDmndFallRate_y APPm_NU_DrvrTqDmndFallRate_z APPm_NU_DrvrTqDmndRiseRate_x APPm_NU_DrvrTqDmndRiseRate_y APPm_NU_DrvrTqDmndRiseRate_z APPm_NU_SpeedLimitGain_x APPm_NU_SpeedLimitGain_z APPm_Nm_DrvrTqDmndMapIdle_x APPm_Nm_DrvrTqDmndMapIdle_z APPm_Nm_DrvrTqDmndMap_1_x APPm_Nm_DrvrTqDmndMap_1_y APPm_Nm_DrvrTqDmndMap_1_z APPm_Nm_DrvrTqDmndMap_2_x APPm_Nm_DrvrTqDmndMap_2_y APPm_Nm_DrvrTqDmndMap_2_z APPm_Nm_DrvrTqDmndMap_3_x APPm_Nm_DrvrTqDmndMap_3_y APPm_Nm_DrvrTqDmndMap_3_z APPm_Nm_DrvrTqDmndMap_4_x APPm_Nm_DrvrTqDmndMap_4_y APPm_Nm_DrvrTqDmndMap_4_z APPm_Nm_DrvrTqDmndMap_5_x APPm_Nm_DrvrTqDmndMap_5_y APPm_Nm_DrvrTqDmndMap_5_z APPm_Nm_DrvrTqDmndMap_IDLE_x APPm_Nm_DrvrTqDmndMap_IDLE_y APPm_Nm_DrvrTqDmndMap_IDLE_z BAFm_NU_BaseFuelCI_x BAFm_NU_BaseFuelCI_y BAFm_NU_BaseFuelCI_z BAFm_NU_TransientFuelGain_x BAFm_NU_TransientFuelGain_y BAFm_NU_TransientFuelGain_z BASm_NU_CrankingSpark_x BASm_NU_CrankingSpark_y BASm_NU_CrankingSpark_z BASm_NU_MBT_SparkLowGradeFuel_x BASm_NU_MBT_SparkLowGradeFuel_y BASm_NU_MBT_SparkLowGradeFuel_z BASm_NU_MBT_Spark_x BASm_NU_MBT_Spark_y BASm_NU_MBT_Spark_z CLFm_NU_DGainFast_x CLFm_NU_DGainFast_y CLFm_NU_DGainFast_z CLFm_NU_DGainSlow_x CLFm_NU_DGainSlow_y CLFm_NU_DGainSlow_z CLFm_NU_DitherLeanFirings_x CLFm_NU_DitherLeanFirings_y CLFm_NU_DitherLeanFirings_z CLFm_NU_DitherRichFirings_x CLFm_NU_DitherRichFirings_y CLFm_NU_DitherRichFirings_z CLFm_NU_IGainFast_x CLFm_NU_IGainFast_y CLFm_NU_IGainFast_z CLFm_NU_IGainSlow_x CLFm_NU_IGainSlow_y CLFm_NU_IGainSlow_z CLFm_NU_PGainFast_x CLFm_NU_PGainFast_y CLFm_NU_PGainFast_z CLFm_NU_PGainSlow_x CLFm_NU_PGainSlow_y CLFm_NU_PGainSlow_z CPLm_NU_BoostLimit_x CPLm_NU_BoostLimit_z CRUm_NU_Effort_Torque_x CRUm_NU_Effort_Torque_z CTCm_NU_FuelEnrichment_x CTCm_NU_FuelEnrichment_y CTCm_NU_FuelEnrichment_z CTCm_NU_SparkRqst_x CTCm_NU_SparkRqst_y CTCm_NU_SparkRqst_z DFCm_NU_EntryThrsh_x DFCm_NU_EntryThrsh_z DFCm_NU_ExitThrsh_x DFCm_NU_ExitThrsh_z DINm_NU_MAF_x DINm_NU_MAF_z DRLm_NU_APP_ToADM_x DRLm_NU_APP_ToADM_y DRLm_NU_APP_ToADM_z DTCm_NU_TherMisfire_x DTCm_NU_TherMisfire_y DTCm_NU_TherMisfire_z EFPm_NU_FuelPumpDC_FF_x EFPm_NU_FuelPumpDC_FF_y EFPm_NU_FuelPumpDC_FF_z ELMm_NU_Alternator_Tq_x ELMm_NU_Alternator_Tq_z ELMm_NU_FrictionTq_x ELMm_NU_FrictionTq_y ELMm_NU_FrictionTq_z ELMm_NU_HVAC_Tq_x ELMm_NU_HVAC_Tq_z ELMm_NU_PwrStrTq_x ELMm_NU_PwrStrTq_z ELMm_NU_ZFFAN_Tq_x ELMm_NU_ZFFAN_Tq_z ERLm_NU_SparkRetard_x ERLm_NU_SparkRetard_z ETCm_NU_DGain_x ETCm_NU_DGain_y ETCm_NU_DGain_z ETCm_NU_DutyCycle_x ETCm_NU_DutyCycle_z ETCm_NU_FF_x ETCm_NU_FF_y ETCm_NU_FF_z ETCm_NU_Hyst_x ETCm_NU_Hyst_y ETCm_NU_Hyst_z ETCm_NU_IGain_x ETCm_NU_IGain_y ETCm_NU_IGain_z ETCm_NU_IRest_x ETCm_NU_IRest_y ETCm_NU_IRest_z ETCm_NU_PGain_x ETCm_NU_PGain_y ETCm_NU_PGain_z ETCm_NU_PRest_x ETCm_NU_PRest_y ETCm_NU_PRest_z ETCm_NU_VbCorr_x ETCm_NU_VbCorr_z ETCm_deg_CrankAmbTemp_x ETCm_deg_CrankAmbTemp_z FRPm_NU_DutyCycle_x FRPm_NU_DutyCycle_z HTRm_C_SensorTempA_x HTRm_C_SensorTempA_z HTRm_C_SensorTempB_x HTRm_C_SensorTempB_z HTRm_NU_SysVoltageCompA_x HTRm_NU_SysVoltageCompA_z HTRm_NU_SysVoltageCompB_x HTRm_NU_SysVoltageCompB_z IDLm_NU_AirDGainNeg_x IDLm_NU_AirDGainNeg_z IDLm_NU_AirDGainPos_x IDLm_NU_AirDGainPos_z IDLm_NU_AirIGainNeg_x IDLm_NU_AirIGainNeg_z IDLm_NU_AirIGainPos_x IDLm_NU_AirIGainPos_z IDLm_NU_AirPGainNeg_x IDLm_NU_AirPGainNeg_z IDLm_NU_AirPGainPos_x IDLm_NU_AirPGainPos_z IDLm_NU_Alternator_x IDLm_NU_Alternator_z IDLm_NU_EffortToAir_x IDLm_NU_EffortToAir_z IDLm_NU_EffortToSpark_x IDLm_NU_EffortToSpark_z IDLm_NU_EngineTemp_x IDLm_NU_EngineTemp_z IDLm_NU_IdlAC_FF_x IDLm_NU_IdlAC_FF_z IDLm_NU_IdlAir_FF_x IDLm_NU_IdlAir_FF_y IDLm_NU_IdlAir_FF_z IDLm_NU_SparkDGainNeg_x IDLm_NU_SparkDGainNeg_z IDLm_NU_SparkDGainPos_x IDLm_NU_SparkDGainPos_z IDLm_NU_SparkIGainNeg_x IDLm_NU_SparkIGainNeg_z IDLm_NU_SparkIGainPos_x IDLm_NU_SparkIGainPos_z IDLm_NU_SparkPGainNeg_x IDLm_NU_SparkPGainNeg_z IDLm_NU_SparkPGainPos_x IDLm_NU_SparkPGainPos_z IDLm_NU_TimeSinceStart_x IDLm_NU_TimeSinceStart_z IDLm_gps_IdlAirGEAR_FF_x IDLm_gps_IdlAirGEAR_FF_y IDLm_gps_IdlAirGEAR_FF_z IJTm_NU_CrankingSOI_Pulse1_x IJTm_NU_CrankingSOI_Pulse1_y IJTm_NU_CrankingSOI_Pulse1_z IJTm_NU_FuelFlowOffset_x IJTm_NU_FuelFlowOffset_y IJTm_NU_FuelFlowOffset_z IJTm_NU_FuelTempCF_x IJTm_NU_FuelTempCF_z IJTm_NU_InjectorFlowMapCmp_x IJTm_NU_InjectorFlowMapCmp_y IJTm_NU_InjectorFlowMapCmp_z IJTm_NU_InjectorFlowMapPFI_x IJTm_NU_InjectorFlowMapPFI_y IJTm_NU_InjectorFlowMapPFI_z IJTm_NU_OpeningDelayPFI_x IJTm_NU_OpeningDelayPFI_z IJTm_NU_RunningSOI_Pulse1_x IJTm_NU_RunningSOI_Pulse1_y IJTm_NU_RunningSOI_Pulse1_z KNKm_NU_EngSpdCorr_x KNKm_NU_EngSpdCorr_z KNKm_NU_RetardStep_x KNKm_NU_RetardStep_z KNKm_NU_SparkRetard_x KNKm_NU_SparkRetard_y KNKm_NU_SparkRetard_z KNKm_pct_DetectionThresh_x KNKm_pct_DetectionThresh_z LAMm_NU_LambdaA_x LAMm_NU_LambdaA_z LAMm_NU_LambdaB_x LAMm_NU_LambdaB_z OUTm_Hz_FreqUEGO_x OUTm_Hz_FreqUEGO_z OUTm_NU_EngSpd_x OUTm_NU_EngSpd_z OUTm_NU_VhSpd_x OUTm_NU_VhSpd_z RFCm_NU_PuddleVapTime_x RFCm_NU_PuddleVapTime_y RFCm_NU_PuddleVapTime_z RFCm_NU_WallWetFraction_x RFCm_NU_WallWetFraction_y RFCm_NU_WallWetFraction_z SPTm_NU_DwellTime_x SPTm_NU_DwellTime_z TARm_Nm_AirToTq_x TARm_Nm_AirToTq_y TARm_Nm_AirToTq_z TARm_Nm_IdlMAPToTq_x TARm_Nm_IdlMAPToTq_y TARm_Nm_IdlMAPToTq_z TARm_Nm_MAPToTq_x TARm_Nm_MAPToTq_y TARm_Nm_MAPToTq_z TARm_Nm_MaxTqTable_x TARm_Nm_MaxTqTable_y TARm_Nm_MaxTqTable_z TRFm_NU_EnrichmentRqst_x TRFm_NU_EnrichmentRqst_y TRFm_NU_EnrichmentRqst_z TRSm_NU_SparkRqst_x TRSm_NU_SparkRqst_y TRSm_NU_SparkRqst_z TURm_NU_EffortToDuty_x TURm_NU_EffortToDuty_z TURm_NU_FF1_x TURm_NU_FF1_y TURm_NU_FF1_z TURm_NU_FF_x TURm_NU_FF_y TURm_NU_FF_z VCPm_NU_CamDC_FF_x VCPm_NU_CamDC_FF_y VCPm_NU_CamDC_FF_z VCPm_NU_DutyCycle_x VCPm_NU_DutyCycle_z /end REF_CHARACTERISTIC
/end FUNCTION
/begin FUNCTION Scalars "Group /ByType/Scalars"
 /begin REF_CHARACTERISTIC ADMc_C_ComprNormRefTemp ADMc_NU_AlphaL1 ADMc_NU_AlphaL2 ADMc_NU_AlphaL3 ADMc_NU_AlphaL4 ADMc_NU_AlphaL5 ADMc_NU_AlphaL6 ADMc_NU_BoostITermMax ADMc_NU_BoostITermMin ADMc_NU_ComprSurgeProxLim ADMc_NU_ThRqstFallRate ADMc_NU_ThRqstRiseRate ADMc_NU_TqToMassAirFlowGain_k2 ADMc_RPM_TurSpdThrsh ADMc_b_ResetBoostITerm ADMc_b_ResetThrottleITerm ADMc_b_TurOverspeed ADMc_b_TurboCancelThrottleITerm ADMc_b_UseLUT_ThCorr ADMc_cm2_ComprInArea ADMc_cm2_ComprOutArea ADMc_deg_CorrThAngCranking ADMc_deg_DFC_ThAngTrgt ADMc_deg_ThrottleTrgt ADMc_e_VCP_Method ADMc_gps_AirDemandRAW ADMc_gps_BoostFB_ErrorDbnd ADMc_gps_MAF_Trgt ADMc_gps_ThrottleFB_Dbnd ADMc_kPa_BoostFB_Dbnd ADMc_kPa_BoostFB_Max ADMc_kPa_BoostFB_Min ADMc_kPa_BoostPressTrgt ADMc_kPa_ComprNormRefPress ADMc_kPa_CrankingBoostPressTrgt ADMc_kPa_SrgChkTrgtBoost ADMc_lam_MaxLimit ADMc_lam_MinLimit ADMc_o_AirDemand ADMc_o_AirDemandRAW ADMc_o_BoostPressTrgt ADMc_o_MAF_Trgt ADMc_o_ThrottleTrgt ADMc_o_TurOverspeed ADMc_o_TurboCancelThrottleITerm ADMc_o_VCP_Trgt ADMc_pct_AirDemand ADMc_pct_ThrottleFB_Dbnd ADMc_pct_ThrottleFB_Max ADMc_pct_ThrottleFB_Min ADMc_pct_ThrottleITermMax ADMc_pct_ThrottleITermMin ADMc_ret_DFC_VCP_Trgt ADMc_ret_VCP_FixedTrgt ADMc_ret_VCP_Trgt ADMc_s_OverspeedDbnc ADMc_s_SurgeDbnc ADMc_s_UseTurboDbnc AFRc_lam_BaseAFR_Trim AFRc_lam_BaseTrgt AFRc_lam_ExitDFCEnrichment AFRc_lam_FinalTrgt1 AFRc_lam_FinalTrgt2 AFRc_lam_TIT_EnrichDelta AFRc_lam_TableResult AFRc_lam_TrgtMax AFRc_lam_TrgtMin AFRc_o_BaseTrgt AFRc_o_FinalTrgt1 AFRc_o_FinalTrgt2 AFRc_o_TableResult AFRc_pct_EnrichLoadThresh AFRc_s_DelayEnrichDelta AFRc_s_HoldDFCOpenLoop AINc_A_HighsideCurrentMonOfst AINc_C_AmbientTemp AINc_C_AmbientTemp_Dflt AINc_C_AmbientTemp_Max AINc_C_AmbientTemp_Min AINc_C_CompOutTemp AINc_C_CoolantTemp AINc_C_CoolantTemp_Dflt AINc_C_CoolantTemp_Max AINc_C_CoolantTemp_Max_Begas AINc_C_CoolantTemp_Min AINc_C_CoolantTemp_Min_Begas AINc_C_ExTemp_Dflt AINc_C_ExTemp_Max AINc_C_ExTemp_Min AINc_C_ExhaustTemp AINc_C_FuelTemp AINc_C_FuelTemp_Dflt AINc_C_FuelTemp_Max AINc_C_FuelTemp_Min AINc_C_GLPTemp_Dflt AINc_C_ManifoldTemp AINc_C_ManifoldTemp_Dflt AINc_C_ManifoldTemp_Max AINc_C_ManifoldTemp_Min AINc_C_OilTemp AINc_HZ_acel_pdl2_dat_nok_FR AINc_HZ_acel_pdl2_dat_nok_RR AINc_HZ_pdl1_dat_nok_FR AINc_HZ_pdl1_dat_nok_RR AINc_Hz_AmbientTemp_BktFR AINc_Hz_AmbientTemp_BktRR AINc_Hz_Baro_BktFR AINc_Hz_Baro_BktRR AINc_Hz_CompOutPress_BktFR AINc_Hz_CompOutPress_BktRR AINc_Hz_CoolantTemp_BktFR AINc_Hz_CoolantTemp_BktRR AINc_Hz_ETC_fail_FR AINc_Hz_ETC_fail_RR AINc_Hz_ExTemp_BktFR AINc_Hz_ExTemp_BktRR AINc_Hz_FAPPress_BktFR AINc_Hz_FAPPress_BktRR AINc_Hz_FR_TurboErr AINc_Hz_FuelLevel1_LPF AINc_Hz_FuelLevel2_LPF AINc_Hz_FuelPress_BktFR AINc_Hz_FuelPress_BktRR AINc_Hz_FuelPress_LPF AINc_Hz_FuelTemp_BktFR AINc_Hz_FuelTemp_BktRR AINc_Hz_LB12_fail_FR AINc_Hz_LB12_fail_RR AINc_Hz_LB12_vl_FR AINc_Hz_LB12_vl_RR AINc_Hz_ManifoldTemp_BktFR AINc_Hz_ManifoldTemp_BktRR AINc_Hz_RT_TurboErr AINc_Hz_TP1_BktFR AINc_Hz_TP1_BktRR AINc_Hz_TP2_BktFR AINc_Hz_TP2_BktRR AINc_Hz_bat_dat_nok_FR AINc_Hz_bat_dat_nok_RR AINc_Hz_eng_oil_pres_dat_l3_FR AINc_Hz_eng_oil_pres_dat_l3_RR AINc_Hz_eng_oil_pres_oc_FR AINc_Hz_eng_oil_pres_oc_RR AINc_Hz_fuel_lvl_dat_FR AINc_Hz_fuel_lvl_dat_RR AINc_Hz_map_dath_FR AINc_Hz_map_dath_RR AINc_Hz_map_datl_FR AINc_Hz_map_datl_RR AINc_Hz_map_lh_FR AINc_Hz_map_lh_RR AINc_Hz_map_vh_FR AINc_Hz_map_vh_RR AINc_Hz_vsup_nok_FR AINc_Hz_vsup_nok_RR AINc_NU_APP1_Raw AINc_NU_APP2_Raw AINc_NU_AmbientTemp_BktHys AINc_NU_AmbientTemp_SlewLim AINc_NU_Baro_BktHys AINc_NU_Baro_Gain AINc_NU_Baro_SlewLim AINc_NU_CompOutPress_BktHys AINc_NU_CompOutPress_Gain AINc_NU_CompOutPress_SlewLim AINc_NU_CoolantTemp_BktHys AINc_NU_CoolantTemp_SlewLim AINc_NU_DOT_VMonGain AINc_NU_EngPower AINc_NU_ExTemp_BktHys AINc_NU_ExTemp_SlewLim AINc_NU_FAPPress_BktHys AINc_NU_FAPPress_Gain AINc_NU_FAPPress_SlewLim AINc_NU_FuelLevel1_Gain_PctToL AINc_NU_FuelLevel1_Gain_VToPct AINc_NU_FuelLevel2_Gain_PctToL AINc_NU_FuelLevel2_Gain_VToPct AINc_NU_FuelPress_BktHys AINc_NU_FuelPress_SlewLim AINc_NU_FuelTemp_BktHys AINc_NU_FuelTemp_SlewLim AINc_NU_HBridgeCurrentMonGain AINc_NU_HighsideCurrentMonGain AINc_NU_HighsideGain AINc_NU_MAP_Gain AINc_NU_MIL_Status AINc_NU_ManifoldTemp_BktHys AINc_NU_ManifoldTemp_SlewLim AINc_NU_MinRPMCaCr AINc_NU_TP1_BktHys AINc_NU_TP1_Dflt AINc_NU_TP1_Gain AINc_NU_TP1_Raw AINc_NU_TP1_SlewLim AINc_NU_TP2_BktHys AINc_NU_TP2_Dflt AINc_NU_TP2_Gain AINc_NU_TP2_Raw AINc_NU_TP2_SlewLim AINc_NU_VBattGain AINc_NU_VRefMonGain AINc_Nm_EngTor AINc_V_APP1_Max AINc_V_APP1_Min AINc_V_APP2_Max AINc_V_APP2_Min AINc_V_AmbientTemp_Max AINc_V_AmbientTemp_Min AINc_V_Baro_Max AINc_V_Baro_Min AINc_V_Baro_Ofst AINc_V_CompOutPress_Max AINc_V_CompOutPress_Min AINc_V_CompOutPress_Ofst AINc_V_CoolantTemp_Max AINc_V_CoolantTemp_Min AINc_V_EGO11 AINc_V_EGO12 AINc_V_EGO21 AINc_V_ExTemp_Max AINc_V_ExTemp_Min AINc_V_FAPPress_Max AINc_V_FAPPress_Min AINc_V_FAPPress_Ofst AINc_V_FuelLevel1_Ofst_PctToL AINc_V_FuelLevel1_Ofst_VToPct AINc_V_FuelLevel2_Ofst_PctToL AINc_V_FuelLevel2_Ofst_VToPct AINc_V_FuelPress_Max AINc_V_FuelPress_Min AINc_V_FuelTemp_Max AINc_V_FuelTemp_Min AINc_V_GLPHV AINc_V_HBridgeCurrentMonOfst AINc_V_LambErrorThres AINc_V_MAP_Dft AINc_V_MAP_OV AINc_V_MAP_Ofst AINc_V_MAP_UV AINc_V_ManifoldTemp_Max AINc_V_ManifoldTemp_Min AINc_V_TP1_Max AINc_V_TP1_Min AINc_V_TP1_Ofst AINc_V_TP2_Max AINc_V_TP2_Min AINc_V_TP2_Ofst AINc_V_VBatt AINc_V_VBattLow AINc_V_VBattTop AINc_adv_KnockRegionStartAng AINc_b_APP1_Valid AINc_b_APP2_Valid AINc_b_DC_start AINc_b_Eng_running AINc_b_IC_start AINc_b_KnockWinSPT_Ofst AINc_b_RealGear AINc_b_Tank2_Available AINc_b_UEGO1_Valid AINc_b_UEGO2_Valid AINc_b_UseHalfVBatt AINc_b_WU_start AINc_bar_FuelPress AINc_bar_FuelPressOvrd AINc_bar_FuelPress_Dflt AINc_bar_FuelPress_Max AINc_bar_FuelPress_Min AINc_cnt_CylIdxA AINc_cnt_CylIdxB AINc_e_MAP_SampleCylinder AINc_kPa_Baro AINc_kPa_Baro_Dflt AINc_kPa_Baro_Max AINc_kPa_Baro_Min AINc_kPa_CompOutPress AINc_kPa_CompOutPress_Dflt AINc_kPa_CompOutPress_Max AINc_kPa_CompOutPress_Min AINc_kPa_CompOutPress_Ofst AINc_kPa_FAP AINc_kPa_FAPPress_Dflt AINc_kPa_FAPPress_Max AINc_kPa_FAPPress_Min AINc_kPa_FuelPressDefault AINc_kPa_MAP AINc_kPa_MAPsThershold AINc_kPa_MAPuThershold AINc_kPa_OilPress AINc_lam_UEGO1 AINc_lam_UEGO2 AINc_o_APP1_Raw AINc_o_APP1_Valid AINc_o_APP2_Raw AINc_o_APP2_Valid AINc_o_AmbientTemp AINc_o_Baro AINc_o_CompOutPress AINc_o_CompOutTemp AINc_o_CoolantTemp AINc_o_CylIdxA AINc_o_CylIdxB AINc_o_Cylinder1_Knock AINc_o_Cylinder2_Knock AINc_o_Cylinder3_Knock AINc_o_Cylinder4_Knock AINc_o_DC_start AINc_o_EGO11 AINc_o_EGO12 AINc_o_EGO21 AINc_o_Eng_running AINc_o_ExhaustTemp AINc_o_FAP AINc_o_FuelPress AINc_o_FuelPressOvrd AINc_o_FuelTemp AINc_o_IC_start AINc_o_MAP AINc_o_MIL_Status AINc_o_ManifoldTemp AINc_o_OilPress AINc_o_OilTemp AINc_o_TP1_Raw AINc_o_TP2_Raw AINc_o_UEGO1 AINc_o_UEGO1_Valid AINc_o_UEGO2 AINc_o_UEGO2_Valid AINc_o_VBatt AINc_o_WU_start AINc_pct_Cylinder1_Knock AINc_pct_Cylinder2_Knock AINc_pct_Cylinder3_Knock AINc_pct_Cylinder4_Knock AINc_s_L1DeadTime AINc_s_L1ResetTime AINc_s_L2SBDeadTime AINc_s_L2SBResetTime AINc_s_NoSyncDelay AINc_s_SyncCranktime AINc_s_THRDeadTime AINc_s_THRResetTime AINc_s_TimeFuelLevel AINc_s_cyl_inj_RDT AINc_s_cyl_inj_SDT AMBc_b_OBDTempOK AMBc_o_OBDTempOK AMEc_C_ChargeTemp AMEc_Hz_ChargeTempLPF AMEc_Hz_LoadFiltCutoff AMEc_Hz_MassAirFlowLPF AMEc_NU_DmndHPF AMEc_b_EnableMAF AMEc_b_EnableSD AMEc_gps_FreshMassAirFlow AMEc_kPa_Baro AMEc_kPa_BaroMax AMEc_kPa_BaroMin AMEc_mg_FreshAirMass AMEc_o_Baro AMEc_o_ChargeTemp AMEc_o_FreshAirMass AMEc_o_FreshMassAirFlow AMEc_o_Load AMEc_o_VolEff AMEc_pct_DemandHPF_Thrsh AMEc_pct_Load AMEc_pct_VolEff AMEc_s_BaroLearnDbnc APPc_Hz_APP1_LPF APPc_Hz_APP2_LPF APPc_NU_APP1_ZeroCreepUpRate APPc_NU_APP2_ZeroCreepUpRate APPc_NU_EEC1TorqueMode APPc_NU_RPM2Hz APPc_NU_VehSpeed_Gain APPc_NU_VehSpeed_Ofst APPc_Nm_DrvrDmndTq APPc_Nm_DrvrTqDmndMax APPc_Nm_DrvrTqDmndMin APPc_V_FullLearnDfltValAPP1 APPc_V_FullLearnDfltValAPP2 APPc_V_FullLearnHiLimAPP1 APPc_V_FullLearnHiLimAPP2 APPc_V_FullLearnLoLimAPP1 APPc_V_FullLearnLoLimAPP2 APPc_V_ZeroLearnDfltValAPP1 APPc_V_ZeroLearnDfltValAPP2 APPc_V_ZeroLearnHiLimAPP1 APPc_V_ZeroLearnHiLimAPP2 APPc_V_ZeroLearnLoLimAPP1 APPc_V_ZeroLearnLoLimAPP2 APPc_b_APP1_Inverted APPc_b_APP2_Inverted APPc_b_BrakePedal_actv APPc_b_EEC1TorqueSelector APPc_b_Fault APPc_b_FullLearnEnbl APPc_b_ResetFaultLatch APPc_b_ResetNVM APPc_b_SpeedLimitActv APPc_b_UseTransGear APPc_b_idleRPMVh APPc_b_pedalmode APPc_e_PdlMode APPc_kmh_SpeedLimitSetpoint APPc_kph_VehSpeed APPc_kph_ZeroLearnSpdThrsh APPc_o_BrakePedal_actv APPc_o_Dmnd APPc_o_DrvrDmndTq APPc_o_Fault APPc_o_IN APPc_o_OUT APPc_o_PdlMode APPc_o_VehSpeed APPc_pct_APP1_Wgt APPc_pct_CorrFltLim APPc_pct_Dmnd APPc_pct_PdlModeFull APPc_pct_PdlModeHyst APPc_pct_PdlModeZero APPc_rpm_IN APPc_rpm_OUT APPc_s_CorrFltDelay APPca_V_FullLearnDfltValAPP1 APPca_V_FullLearnDfltValAPP2 BAFc_mg_FuelRqst1 BAFc_o_FuelRqst1 BARc_b_OBDPressOK BARc_o_OBDPressOK BASc_adv_BaseSpark BASc_cnt_KnockEventCalThrsh BASc_o_BaseSpark CALc_b_EnblCalibrationMode_A CALc_b_EnblCalibrationMode_B CALc_b_ResetUoffset_A CALc_b_ResetUoffset_B CINc_NU_EngOvrCtrMd_ESP CINc_NU_EngOvrCtrMd_TCM CINc_NU_OvrCtrMd_ESP CINc_NU_OvrCtrMd_TCM CINc_o_EngOvrCtrMd_ESP CINc_o_EngOvrCtrMd_TCM CINc_o_OvrCtrMd_ESP CINc_o_OvrCtrMd_TCM CINc_o_TqCtrRq_ESP CINc_o_TqCtrRq_TCM CINc_pct_TqCtrRq_ESP CINc_pct_TqCtrRq_TCM CLFc_C_LTFT_EngineTempMax CLFc_C_LTFT_EngineTempMin CLFc_Hz_DTermLPF CLFc_Hz_ErrorThrshLPF CLFc_NU_EngSpdHPF_TC CLFc_NU_LoadHPF_TC CLFc_NU_PID_GainScale CLFc_RPM_EngSpdHPF_Thrsh CLFc_b_AllowITermReset CLFc_b_DitherLamErrorActv CLFc_b_EnblDither CLFc_b_EnblFB1 CLFc_b_EnblFB2 CLFc_b_EnblLTFT1 CLFc_b_EnblLTFT2 CLFc_b_FB1_Active CLFc_b_FB2_Active CLFc_b_LTFT1_Reset CLFc_b_LTFT2_Reset CLFc_lam_FB1_Ctrl CLFc_lam_FB2_Ctrl CLFc_lam_FB_IMax CLFc_lam_FB_IMin CLFc_lam_FB_StableThrsh CLFc_lam_ITermResetThrsh CLFc_lam_LTFT1 CLFc_lam_LTFT2 CLFc_lam_LeanStep CLFc_lam_O2_Dither1 CLFc_lam_O2_Dither2 CLFc_lam_RichStep CLFc_lam_StoicThrshMax CLFc_lam_StoicThrshMin CLFc_lam_UEGO1_Max CLFc_lam_UEGO1_Min CLFc_lam_UEGO2_Max CLFc_lam_UEGO2_Min CLFc_o_DitherLamErrorActv CLFc_o_FB1_Active CLFc_o_FB1_Ctrl CLFc_o_FB2_Active CLFc_o_FB2_Ctrl CLFc_o_LTFT1 CLFc_o_LTFT2 CLFc_o_O2_Dither1 CLFc_o_O2_Dither2 CLFc_pct_LoadHPF_Thrsh CLFc_s_DitherActiveDbnc CLFc_s_DitherActiveHold CLFc_s_FB_StableDbnc CLFc_s_FB_UnstableDbnc CLFc_s_LTFT_ActiveDbnc CLFc_s_LTFT_RefreshPeriod CLFc_s_UEGO1_Dbnc CLFc_s_UEGO2_Dbnc CPLc_NU_RetardPGain CPLc_b_CutSpark CPLc_kPa_SparkCutOfst CPLc_o_CutSpark CPLc_o_SparkRetardRqst CPLc_ret_RetardMax CPLc_ret_SparkRetardRqst CRUc_NU_Calib CRUc_NU_CurrSpeed CRUc_NU_DGain CRUc_NU_IGain CRUc_NU_LimSpeed CRUc_NU_PGain CRUc_NU_TargetSpeed CRUc_NU_VehSpeed_Gain CRUc_NU_VehSpeed_Ofst CRUc_V_CruiserSET CRUc_b_Active CRUc_b_BrakeON CRUc_b_Cancel CRUc_b_ClunchON CRUc_b_DownSpeed CRUc_b_Enable CRUc_b_FootBrake CRUc_b_ParkingBrake CRUc_b_UpSpeed CRUc_o_Active CRUc_o_BrakeON CRUc_o_Cancel CRUc_o_ClunchON CRUc_o_CruiserSET CRUc_o_CurrSpeed CRUc_o_DownSpeed CRUc_o_Enable CRUc_o_FootBrake CRUc_o_LimSpeed CRUc_o_ParkingBrake CRUc_o_TargetSpeed CRUc_o_UpSpeed CTCc_b_UseEngineTemp CTCc_b_UseExhaustTemp CTCc_lam_FuelOfst CTCc_lam_FuelOfstMin CTCc_o_FuelOfst CTCc_o_SparkRqst CTCc_ret_SparkRqst CTCc_ret_SparkRqstMax DFCc_C_MinEngTemp DFCc_Hz_TqHPF_TC DFCc_Nm_TqEntryThrsh DFCc_Nm_TqExitThrsh DFCc_Nm_TqHPF_Thrsh DFCc_b_DTC_Condition DFCc_b_FuelCut DFCc_deg_MaxSparkRetard DFCc_o_DTC_Condition DFCc_o_FuelCut DFCc_o_SparkRetard DFCc_ret_SparkRetard DFCc_s_BurningDelay DFCc_s_FuelRampOutDelay DFCc_s_StartupDelay DIAc_NU_SpiCtrlCntsThresh DIAc_V_HtrNoRspnsURRstThrsh_A DIAc_V_HtrNoRspnsURRstThrsh_B DIAc_V_HtrNoRspnsURThrsh_A DIAc_V_HtrNoRspnsURThrsh_B DIAc_V_UA_OORHi DIAc_V_UA_OORLo DIAc_V_UR_OORHi DIAc_V_UR_OORLo DIAc_pct_HtrNoRspnsPWMThrsh DIAc_pct_SpiCtrl_BucketFallWgt DIAc_pct_SpiCtrl_BucketRiseWgt DIAc_s_HtrNoResponseDbnc DIAc_s_HtrNoResponseRstDbnc DIAc_s_OORHiDbnc DIAc_s_OORLoDbnc DINc_Hz_EngSpdLPF DINc_Hz_MAF_To DINc_NU_Gear DINc_NU_MAF_FallRate DINc_NU_MAF_RiseRate DINc_RPM_EngSpd DINc_RPM_TOSS DINc_V_L12SG DINc_b_AC_PressSw DINc_b_AC_ReqSw DINc_b_Belt DINc_b_CamPhaseValid DINc_b_Door DINc_b_EngSync DINc_b_Ign DINc_b_OilPrSw DINc_b_ParkingBrake DINc_b_PedalBrake DINc_b_RearGear DINc_deg_Tooth2AngHi DINc_deg_Tooth2AngLo DINc_deg_Tooth2BaseAng DINc_deg_Tooth3BaseAng DINc_deg_ValidCamDelta DINc_gps_MAF DINc_kph_VehSpd DINc_o_AC_PressSw DINc_o_AC_ReqSw DINc_o_AltLoad DINc_o_Belt DINc_o_CamPhase DINc_o_CamPhaseValid DINc_o_Door DINc_o_EngSpd DINc_o_EngSync DINc_o_Gear DINc_o_Ign DINc_o_MAF DINc_o_OilPrSw DINc_o_ParkingBrake DINc_o_PedalBrake DINc_o_RearGear DINc_o_TOSS DINc_o_VehSpd DINc_pct_AltLoad DINc_ret_CamPhase DINc_ret_CamPhaseMax DINc_s_TimeIgnitionON DINc_s_ValidCamDbnc1 DINc_s_ValidCamDbnc2 DRLc_b_UseDynoRqst DRLc_gps_DynoAirRqst DRLc_o_DynoAirRqst DTCc_C_DiagCata_MaxEGT DTCc_C_DiagCata_MinEGT DTCc_NU_CatalystTimeThreshold DTCc_NU_DC DTCc_NU_KNKButaneAlarm DTCc_NU_KNKButaneThr DTCc_NU_Seconds DTCc_NU_TestTime DTCc_NU_TimeRichLean DTCc_RPM_EntryThrshMisf DTCc_b_1_boostOC DTCc_b_1_lsol DTCc_b_1_sb DTCc_b_1_sg DTCc_b_2_boostOC DTCc_b_2_lsol DTCc_b_2_sb DTCc_b_2_sg DTCc_b_3_boostOC DTCc_b_3_lsol DTCc_b_3_sb DTCc_b_3_sg DTCc_b_4_boostOC DTCc_b_4_lsol DTCc_b_4_sb DTCc_b_4_sg DTCc_b_APP1_NonValidVoltage DTCc_b_APP2_NonValidVoltage DTCc_b_APP_CorrFLT DTCc_b_Air_HTemp DTCc_b_Air_TempHV DTCc_b_Air_TempLV DTCc_b_BARO_ErraticValue DTCc_b_BARO_PressHVoltage DTCc_b_BARO_PressLVoltage DTCc_b_BAT_VoltageOutofRange DTCc_b_CataCounting DTCc_b_Catalyst_A DTCc_b_CompIAT_HTemp DTCc_b_CompIAT_TempHV DTCc_b_CompIAT_TempLV DTCc_b_DM11Force DTCc_b_DiagCata_TestEnd DTCc_b_ECT_HTemp DTCc_b_ECT_LTemp DTCc_b_ECT_TempHVoltage DTCc_b_ECT_TempLVoltage DTCc_b_EGT_TempHV DTCc_b_EGT_TempLV DTCc_b_ETC_MotorFLT DTCc_b_EcuMemFault DTCc_b_EnableMIsfire DTCc_b_Exhaust_HTemp DTCc_b_FAP_Disconected DTCc_b_FAP_HPress DTCc_b_FalloCamShaft DTCc_b_FalloCramShaft DTCc_b_GLP1_HVoltage DTCc_b_GLP2_HVoltage DTCc_b_GLP_HPress DTCc_b_GLP_HTemp DTCc_b_GLP_LPress DTCc_b_GLP_LTemp DTCc_b_GLP_OL DTCc_b_GLP_TempHVoltage DTCc_b_GLP_TempLVoltage DTCc_b_HeatersA_OL DTCc_b_HeatersA_SB DTCc_b_HeatersA_SG DTCc_b_KNOCK_Cyl1 DTCc_b_KNOCK_Cyl2 DTCc_b_KNOCK_Cyl3 DTCc_b_KNOCK_Cyl4 DTCc_b_LB11CTFail DTCc_b_LB12OL DTCc_b_LB12SB DTCc_b_LambdaA_SB DTCc_b_LambdaA_SG DTCc_b_LambdaB11NOTValid DTCc_b_MAPAfterThInfraPress DTCc_b_MAPAfterThOverPress DTCc_b_MAPAfterThr_LV DTCc_b_MAPAftrThr_HV DTCc_b_MAPBefThroHV DTCc_b_MAPBefThroOL DTCc_b_MAPBeforeThroHPress DTCc_b_MAPBeforeThroLPress DTCc_b_Misfire_Bancada DTCc_b_Misfire_Cylinder_1 DTCc_b_Misfire_Cylinder_2 DTCc_b_Misfire_Cylinder_3 DTCc_b_Misfire_Cylinder_4 DTCc_b_NBValid DTCc_b_OIL_LPress DTCc_b_OIL_Sensor DTCc_b_OIL_SensorOL DTCc_b_Readiness DTCc_b_ResetKnockCounters DTCc_b_ResetNVM DTCc_b_ShutOffValveEngine_OL DTCc_b_ShutOffValveEngine_SG DTCc_b_Supply_VRefA DTCc_b_Supply_VRefB DTCc_b_Supply_VRefC DTCc_b_Supply_VRefD DTCc_b_THR_Motor_Fail DTCc_b_TP1_SensorHV DTCc_b_TP1_SensorLV DTCc_b_TP2_SensorHV DTCc_b_TP2_SensorLV DTCc_b_TP_CorrFLT DTCc_b_TurboError DTCc_cnt_KnockHIT DTCc_o_1_boostOC DTCc_o_1_lsol DTCc_o_1_sb DTCc_o_1_sg DTCc_o_2_boostOC DTCc_o_2_lsol DTCc_o_2_sb DTCc_o_2_sg DTCc_o_3_boostOC DTCc_o_3_lsol DTCc_o_3_sb DTCc_o_3_sg DTCc_o_4_boostOC DTCc_o_4_lsol DTCc_o_4_sb DTCc_o_4_sg DTCc_o_APP1_NonValidVoltage DTCc_o_APP2_NonValidVoltage DTCc_o_APP_CorrFLT DTCc_o_Air_HTemp DTCc_o_Air_TempHV DTCc_o_Air_TempLV DTCc_o_BARO_ErraticValue DTCc_o_BARO_PressHVoltage DTCc_o_BARO_PressLVoltage DTCc_o_BAT_VoltageOutofRange DTCc_o_BegasTime DTCc_o_CataCounting DTCc_o_Catalyst_A DTCc_o_CompIAT_HTemp DTCc_o_CompIAT_TempHV DTCc_o_CompIAT_TempLV DTCc_o_DM11Force DTCc_o_DiagCata_TestEnd DTCc_o_ECT_HTemp DTCc_o_ECT_LTemp DTCc_o_ECT_TempHVoltage DTCc_o_ECT_TempLVoltage DTCc_o_EGT_TempHV DTCc_o_EGT_TempLV DTCc_o_ETC_MotorFLT DTCc_o_EcuMemFault DTCc_o_EnableMIsfire DTCc_o_Exhaust_HTemp DTCc_o_FAP_Disconected DTCc_o_FAP_HPress DTCc_o_FalloCamShaft DTCc_o_FalloCramShaft DTCc_o_GLP1_HVoltage DTCc_o_GLP2_HVoltage DTCc_o_GLP_HPress DTCc_o_GLP_HTemp DTCc_o_GLP_LPress DTCc_o_GLP_LTemp DTCc_o_GLP_OL DTCc_o_GLP_TempHVoltage DTCc_o_GLP_TempLVoltage DTCc_o_HeatersA_OL DTCc_o_HeatersA_SB DTCc_o_HeatersA_SG DTCc_o_KNKButaneThr DTCc_o_KNOCK_Cyl1 DTCc_o_KNOCK_Cyl2 DTCc_o_KNOCK_Cyl3 DTCc_o_KNOCK_Cyl4 DTCc_o_LB11CTFail DTCc_o_LB12OL DTCc_o_LB12SB DTCc_o_LambdaA_SB DTCc_o_LambdaA_SG DTCc_o_LambdaB11NOTValid DTCc_o_MAPAfterThInfraPress DTCc_o_MAPAfterThOverPress DTCc_o_MAPAfterThr_LV DTCc_o_MAPAftrThr_HV DTCc_o_MAPBefThroHV DTCc_o_MAPBefThroOL DTCc_o_MAPBeforeThroHPress DTCc_o_MAPBeforeThroLPress DTCc_o_Misfire_Bancada DTCc_o_Misfire_Cylinder_1 DTCc_o_Misfire_Cylinder_2 DTCc_o_Misfire_Cylinder_3 DTCc_o_Misfire_Cylinder_4 DTCc_o_NBValid DTCc_o_OIL_LPress DTCc_o_OIL_Sensor DTCc_o_OIL_SensorOL DTCc_o_Readiness DTCc_o_ShutOffValveEngine_OL DTCc_o_ShutOffValveEngine_SG DTCc_o_Supply_VRefA DTCc_o_Supply_VRefB DTCc_o_Supply_VRefC DTCc_o_Supply_VRefD DTCc_o_THR_Motor_Fail DTCc_o_TP1_SensorHV DTCc_o_TP1_SensorLV DTCc_o_TP2_SensorHV DTCc_o_TP2_SensorLV DTCc_o_TP_CorrFLT DTCc_o_TestTime DTCc_o_TurboError DTCc_s_BegasTime DTCc_s_DiagCataActv_IdlDelay DTCc_s_DiagCata_RstDelay DTCc_s_ResetKnockPeriodic EFPc_NU_FuelPumpDGain EFPc_NU_FuelPumpErrROCThrsh EFPc_NU_FuelPumpIGain EFPc_NU_FuelPumpPGain EFPc_b_FuelPumpDC EFPc_b_FuelPumpResetITerm EFPc_b_NotStalled EFPc_b_RunFuelPump EFPc_bar_FRP_Trgt EFPc_bar_FuelPressMax EFPc_bar_FuelPressMin EFPc_bar_FuelPumpDbndLatchI EFPc_o_FuelPumpDC EFPc_o_NotStalled EFPc_o_RunFuelPump EFPc_pct_FuelPumpITermMax EFPc_pct_FuelPumpITermMin EFPc_pct_FuelPumpPID_Dbnd EFPc_pct_FuelPumpPID_Max EFPc_pct_FuelPumpPID_Min ELMc_Nm_AlternatorTq ELMc_Nm_Tq ELMc_o_AlternatorTq ELMc_o_Tq ERLc_NU_PGain ERLc_RPM_HardLimOfst ERLc_RPM_SoftLim ERLc_b_Active ERLc_b_CutFuel ERLc_b_CutSpark ERLc_o_Active ERLc_o_CutFuel ERLc_o_CutSpark ERLc_o_SparkRetard ERLc_o_TqMult ERLc_pct_HardLim ERLc_pct_TqMult ERLc_ret_SparkRetard ERMc_RPM_EnterCranking ERMc_RPM_EnterRunning ERMc_RPM_ExitCranking ERMc_RPM_ExitRunning ERMc_e_RunningMode ERMc_o_RunningMode ERMc_o_TimeSinceStart ERMc_s_TimeSinceStart ETCc_Hz_TP1_LPF ETCc_Hz_TP2_LPF ETCc_NU_FallRate ETCc_NU_FullLearnDfltTP1 ETCc_NU_FullLearnDfltTP2 ETCc_NU_FullLearnHiLimTP1 ETCc_NU_FullLearnHiLimTP2 ETCc_NU_FullLearnLoLimTP1 ETCc_NU_FullLearnLoLimTP2 ETCc_NU_Int_thd ETCc_NU_KickHPF_Tc ETCc_NU_KickHPF_Thrsh ETCc_NU_LFallRate ETCc_NU_LRiseRate ETCc_NU_RiseRate ETCc_NU_TP1_FullPos ETCc_NU_TP1_ZeroPos ETCc_NU_TP2_FullPos ETCc_NU_TP2_ZeroPos ETCc_NU_TP_DotThrsh ETCc_NU_TP_FallRateThrsh ETCc_NU_TP_RiseRateThrsh ETCc_NU_ZeroLearnDfltTP1 ETCc_NU_ZeroLearnDfltTP2 ETCc_NU_ZeroLearnHiLimTP1 ETCc_NU_ZeroLearnHiLimTP2 ETCc_NU_ZeroLearnLoLimTP1 ETCc_NU_ZeroLearnLoLimTP2 ETCc_b_AW_Enbl ETCc_b_AuthorityReduced ETCc_b_HystAxisStrategy ETCc_b_HystStrategy ETCc_b_ManualRangeRetry ETCc_b_RangeLearnEnbl ETCc_b_ResetNVM ETCc_b_RestDuringCranking ETCc_b_RestWhenStopped ETCc_b_TP1_Inverted ETCc_b_TP2_Inverted ETCc_b_UseCrankingPos ETCc_b_UsePedalDirectly ETCc_deg_AW_Thrsh ETCc_deg_ControlClosedCmd ETCc_deg_ControlOpenCmd ETCc_deg_FreezeITermDbnd ETCc_deg_FullClosed ETCc_deg_FullClosedErrorThrsh ETCc_deg_FullOpen ETCc_deg_FullOpenErrorThrsh ETCc_deg_Reset_thd ETCc_deg_RestLearnDflt ETCc_deg_RestMax ETCc_deg_RestMin ETCc_deg_RestPos ETCc_deg_RestPosITermDbnd ETCc_deg_RestPosThrsh ETCc_deg_ThRqstFiltd ETCc_o_AuthorityReduced ETCc_o_AvgTP ETCc_o_FB ETCc_o_MotorCmd ETCc_o_MotorCmdVb ETCc_o_RestPos ETCc_o_TP1_FullPos ETCc_o_TP1_ZeroPos ETCc_o_TP2_FullPos ETCc_o_TP2_ZeroPos ETCc_o_ThRqstFiltd ETCc_pct_AvgTP ETCc_pct_ContinuousDutyMax ETCc_pct_ContinuousDutyMin ETCc_pct_DMax ETCc_pct_DMin ETCc_pct_EMax ETCc_pct_EMin ETCc_pct_FB ETCc_pct_FB_Dbnd ETCc_pct_FB_Max ETCc_pct_FB_Min ETCc_pct_ForceClosedCmd ETCc_pct_ForceOpenCmd ETCc_pct_IMax ETCc_pct_IMin ETCc_pct_KickDuty ETCc_pct_Kick_Error ETCc_pct_MotorCmd ETCc_pct_MotorCmdVb ETCc_pct_TP_DeltaMax ETCc_s_ContinuousDutyDbnc ETCc_s_KickSignDbnc ETCc_s_Kick_hold ETCc_s_PowerupDelay ETCc_s_RangeCheckExpire ETCc_s_RestCrankingExpiration ETCc_s_TP_FallDelay ETCc_s_TP_FltDbnc ETCc_s_TP_RiseDelay ETCc_s_TP_StableDelay ETCca_NU_FullLearnDfltTP1 ETCca_NU_FullLearnDfltTP2 ETCca_NU_ZeroLearnDfltTP1 ETCca_NU_ZeroLearnDfltTP2 ETCca_deg_RestLearnDflt FCAc_b_ResetFuelAcum FCAc_b_ResetKmAcum FCAc_lpk_AverageFuelConsumption FCAc_o_AverageFuelConsumption FMGc_b_ForceFltReset FMGc_e_FltReset FMGc_o_FltReset HHTc_o_EGO11_HeaterDuty HHTc_o_EGO12_HeaterDuty HHTc_o_EGO21_HeaterDuty HHTc_o_EGO22_HeaterDuty HHTc_pct_EGO11_HeaterDuty HHTc_pct_EGO12_HeaterDuty HHTc_pct_EGO21_HeaterDuty HHTc_pct_EGO22_HeaterDuty HHTc_pct_RunningDuty HHTc_pct_WarmupDuty HHTc_s_Warmup HRWc_NU_VehSpeed_Gain HRWc_NU_VehSpeed_Ofst HTRc_C_OptimalSensorTemp_A HTRc_C_OptimalSensorTemp_B HTRc_C_WaterCondensTemp_A HTRc_C_WaterCondensTemp_B HTRc_NU_IGain_A HTRc_NU_IGain_B HTRc_NU_PGain_A HTRc_NU_PGain_B HTRc_NU_RefCurrEnum_A HTRc_NU_RefCurrEnum_B HTRc_b_EnblHeater_A HTRc_b_EnblHeater_B HTRc_b_EnblTempSensor_A HTRc_b_EnblTempSensor_B HTRc_pct_HeaterLimitCLPWMCmd_A HTRc_pct_HeaterLimitCLPWMCmd_B HTRc_pct_HeaterLimitOLPWMCmd_A HTRc_pct_HeaterLimitOLPWMCmd_B HTRc_pct_LinRampPWMCmd_A HTRc_pct_LinRampPWMCmd_B HTRc_pct_MaxDutyCyc HTRc_pct_OpenLoopLinRamp_A HTRc_pct_OpenLoopLinRamp_B HTRc_pct_PID_OutputMax_A HTRc_pct_PID_OutputMax_B HTRc_pct_WaterCondensPWMCmd_A HTRc_pct_WaterCondensPWMCmd_B HTRc_s_EngineStopTimeout HTRc_s_FaultFlagDbnc HTRc_s_OpenLoopWatrCondnsDbnc_A HTRc_s_OpenLoopWatrCondnsDbnc_B IDLc_C_AmbTemp IDLc_Hz_AlternatorTermLPF IDLc_Hz_ErrorLPF IDLc_NU_AirErrorROCThrsh IDLc_NU_AirIMax IDLc_NU_AirIMin IDLc_NU_AirPID_Dbnd IDLc_NU_AirPID_Max IDLc_NU_AirPID_Min IDLc_NU_AlternatorFallRate IDLc_NU_AlternatorRiseRate IDLc_NU_SparkErrorROCThrsh IDLc_NU_SparkIMax IDLc_NU_SparkIMin IDLc_NU_SparkPID_Dbnd IDLc_NU_SparkPID_Max IDLc_NU_SparkPID_Min IDLc_RPM_AC_Adder IDLc_RPM_AirErrorDbnd IDLc_RPM_DrivingAdder IDLc_RPM_ErrorActivationThrsh IDLc_RPM_ExitRPMAdder IDLc_RPM_ITermMaxError IDLc_RPM_ITermMinError IDLc_RPM_LimitErrorActThrsh IDLc_RPM_MaxIdlSpd IDLc_RPM_SparkErrorDbnd IDLc_RPM_SparkITermMaxError IDLc_RPM_SparkITermMinError IDLc_RPM_Trgt IDLc_b_Actv IDLc_b_ITermAutoReset IDLc_b_IgnoreTransGear IDLc_gps_Air IDLc_kph_DrivingThrsh IDLc_o_Actv IDLc_o_Air IDLc_o_Spark IDLc_o_Trgt IDLc_pct_AirGainScale IDLc_pct_SparkGainScale IDLc_ret_Spark IDLc_s_AC_Dbnc IDLc_s_Hold IDLc_s_HoldRPMAdder IDLc_s_StartupDelay IJTc_NU_FlowRateConstant IJTc_adv_SOC_Inj1 IJTc_adv_SOC_Inj2 IJTc_adv_SOC_Inj3 IJTc_adv_SOC_Inj4 IJTc_adv_SOC_Max IJTc_adv_SOC_Min IJTc_b_Inj1_InjectionSent IJTc_b_Inj2_InjectionSent IJTc_b_Inj3_InjectionSent IJTc_b_Inj4_InjectionSent IJTc_b_PrimingPulseEnable IJTc_b_UseFlowRateTable IJTc_cnt_PrimingPulses IJTc_mg_MaxInj IJTc_mg_MinInj IJTc_ms_ClosingDelayNoOverlap IJTc_ms_ClosingDelayWithOverlap IJTc_ms_Inj1 IJTc_ms_Inj2 IJTc_ms_Inj3 IJTc_ms_Inj4 IJTc_ms_OpeningDelayInj1 IJTc_ms_OpeningDelayInj2 IJTc_ms_OpeningDelayInj3 IJTc_ms_OpeningDelayInj4 IJTc_ms_OverlapOfst IJTc_ms_PrimingPulseFlowTime IJTc_o_Inj1_InjectionSent IJTc_o_Inj1_PulseDur IJTc_o_Inj2_InjectionSent IJTc_o_Inj2_PulseDur IJTc_o_Inj3_InjectionSent IJTc_o_Inj3_PulseDur IJTc_o_Inj4_InjectionSent IJTc_o_Inj4_PulseDur IJTc_o_OpeningDelayInj1 IJTc_o_OpeningDelayInj2 IJTc_o_OpeningDelayInj3 IJTc_o_OpeningDelayInj4 IJTc_o_SOC_Inj1 IJTc_o_SOC_Inj2 IJTc_o_SOC_Inj3 IJTc_o_SOC_Inj4 IJTc_pct_Inj1_Balancing IJTc_pct_Inj2_Balancing IJTc_pct_Inj3_Balancing IJTc_pct_Inj4_Balancing IJTc_s_MinCalculationSlack IJTc_s_PrimingPulseTimeout INPc_C_AmbientTemp INPc_C_CompOutTemp INPc_C_CoolantTemp INPc_C_ExhaustTemp INPc_C_FuelTemp INPc_C_ManifoldTemp INPc_C_OilTemp INPc_Hz_UaFiltConst INPc_Hz_UrFiltConst INPc_L_TotalFuelLevel_L INPc_NU_APP1_Raw INPc_NU_APP2_Raw INPc_NU_CrankSensorBias INPc_NU_CrankSensorType INPc_NU_TP1_Raw INPc_NU_TP2_Raw INPc_RPM_EngSpd INPc_V_EGO11 INPc_V_EGO21 INPc_V_FuelLevel1 INPc_V_FuelLevel2 INPc_V_VBatt INPc_b_AC_PressSw INPc_b_AC_Rqst INPc_b_EngSync INPc_b_Ign INPc_b_OilPrSw INPc_bar_FuelPress INPc_cnt_CrankTeethMissing INPc_cnt_TotalCrankTeeth INPc_e_TransGear INPc_gps_MAF INPc_kPa_Baro INPc_kPa_CompOutPress INPc_kPa_MAP INPc_kPa_OilPress INPc_kph_VehSpd INPc_lam_UEGO1 INPc_lam_UEGO2 INPc_nu_EngineSpeedCyl_1 INPc_nu_EngineSpeedCyl_2 INPc_nu_EngineSpeedCyl_3 INPc_nu_EngineSpeedCyl_4 INPc_nu_num_toothpost INPc_nu_num_toothpre INPc_nu_toothmodulo INPc_nu_toothpost INPc_nu_toothpre INPc_o_AC_PressSw INPc_o_AC_Rqst INPc_o_APP1_Raw INPc_o_APP2_Raw INPc_o_AltLoad INPc_o_AmbientTemp INPc_o_Baro INPc_o_CompOutPress INPc_o_CompOutTemp INPc_o_CoolantTemp INPc_o_Cylinder1_Knock INPc_o_Cylinder2_Knock INPc_o_Cylinder3_Knock INPc_o_Cylinder4_Knock INPc_o_EGO11 INPc_o_EGO21 INPc_o_EngSpd INPc_o_EngSync INPc_o_ExhaustTemp INPc_o_FuelLevel1 INPc_o_FuelLevel2 INPc_o_FuelPress INPc_o_FuelTemp INPc_o_GLPLevel1 INPc_o_GLPLevel2 INPc_o_Ign INPc_o_MAF INPc_o_MAP INPc_o_ManifoldTemp INPc_o_OilPrSw INPc_o_OilPress INPc_o_OilTemp INPc_o_PrefiltTotalFuelLevel INPc_o_TP1_Raw INPc_o_TP2_Raw INPc_o_TotalFuelLevel INPc_o_TotalFuelLevel_L INPc_o_TransGear INPc_o_UEGO1 INPc_o_UEGO2 INPc_o_VBatt INPc_o_VCP_Pos INPc_o_VehSpd INPc_pct_AltLoad INPc_pct_Cylinder1_Knock INPc_pct_Cylinder2_Knock INPc_pct_Cylinder3_Knock INPc_pct_Cylinder4_Knock INPc_pct_GLPLevel1 INPc_pct_GLPLevel2 INPc_pct_NeutralRatioHigh INPc_pct_NeutralRatioLow INPc_pct_PrefiltTotalFuelLevel INPc_pct_TotalFuelLevel INPc_ret_VCP_Pos INPc_s_DelayEnableMis INPc_s_MisfireDelay KNKc_adv_AdvanceStep KNKc_b_Enbl KNKc_lam_AFR_Lim KNKc_lam_AntiKnock KNKc_o_AFR_Lim KNKc_o_SparkMod KNKc_pct_LoadDetectionThers KNKc_ret_SensorBasedMax KNKc_ret_SparkMod KNKc_ret_SparkModMax KNKc_s_RetardHoldTime LAMc_C_SensorTempValidThresh_A LAMc_C_SensorTempValidThresh_B LAMc_NU_AmpFactorHyst_A LAMc_NU_AmpFactorHyst_B LOGc_NU_EEC14_FuelType LOGc_NU_ManualPump LOGc_PWM_BLOWER LOGc_PWM_PUMP LOGc_b_ACC1_gen LOGc_b_AEBS1_gen LOGc_b_EC1_CANA_ena LOGc_b_ENBOBD LOGc_b_EnableCanLog LOGc_b_EnableDM1 LOGc_b_ML_gen LOGc_b_RelePump1 LOGc_b_RelePump2 LOGc_b_VDC1_gen LOGc_b_VDC2_gen LOGc_b_VDHR_gen LOGc_b_ZF_Auto LOGc_b_ZF_auto_ena LOGc_b_ZF_man_ena LOGc_o_BLOWER LOGc_o_ENBOBD LOGc_o_ManualPump LOGc_o_PUMP LOGc_o_RelePump1 LOGc_o_RelePump2 LOGc_o_ZF_Auto LOGc_s_ResMisfCounter LOGc_s_SDG01_Period LOGc_s_TFrames NVMc_b_ResetDataCollected OBDc_b_BegasCVN OUTc_A_InjHoldCurrent OUTc_A_InjPeakCurrent OUTc_C_EFPFuelTemp OUTc_C_FAN_ZF OUTc_C_TempZF_off OUTc_C_TempZF_on OUTc_C_Thres_off OUTc_C_Thres_on OUTc_C_Visco_off_1st OUTc_C_Visco_off_2nd OUTc_C_Visco_on_1st OUTc_C_Visco_on_2nd OUTc_Hz_CompBypassFrq OUTc_Hz_EGO_HeaterFrq OUTc_Hz_ETC_HBridgeFrq OUTc_Hz_EngSpd OUTc_Hz_FreqStepsUEGOA OUTc_Hz_FreqUEGOA OUTc_Hz_FreqUEGO_A OUTc_Hz_LoThrshUEGOA OUTc_Hz_RampFreq_A OUTc_Hz_ShutOffValveFrq OUTc_Hz_TurCtrlFrq OUTc_Hz_VhSpd OUTc_NU_DM19CVN OUTc_NU_EngSpdFq_Type OUTc_NU_VhSpdFq_Type OUTc_V_VoltUEGOThrsh OUTc_b_18F00000 OUTc_b_18F00000_ena OUTc_b_18F0010B OUTc_b_18F0010B_ena OUTc_b_18FDC40B OUTc_b_18FDC40B_ena OUTc_b_18FE6E00 OUTc_b_18FE6E00_ena OUTc_b_18FEE100 OUTc_b_18FEE100_ena OUTc_b_18FEE600 OUTc_b_18FEE600_ena OUTc_b_18FEEE00 OUTc_b_18FEEE00_ena OUTc_b_BCM OUTc_b_BCM_ZF OUTc_b_BCM_ZF_ena OUTc_b_BCM_ena OUTc_b_CombustionAllCyls OUTc_b_DM19Request OUTc_b_EnableBankA_Inj OUTc_b_EnableBankB_Inj OUTc_b_EnableCCO OUTc_b_EnableHighsideY1 OUTc_b_EnableHighsideY5 OUTc_b_EnablePowerHold OUTc_b_EnablePowertrainRly OUTc_b_EnblManualFuelCut OUTc_b_EnblManualSparkCut OUTc_b_FuelEnIgnoreSync OUTc_b_InvertETC OUTc_b_MIL_LED OUTc_b_ManualFuelCut1 OUTc_b_ManualFuelCut2 OUTc_b_ManualFuelCut3 OUTc_b_ManualFuelCut4 OUTc_b_ManualSparkCut1 OUTc_b_ManualSparkCut2 OUTc_b_ManualSparkCut3 OUTc_b_ManualSparkCut4 OUTc_b_ManualSparkCut5 OUTc_b_ManualSparkCut6 OUTc_b_ManualSparkCut7 OUTc_b_ManualSparkCut8 OUTc_b_PT_RelayEnergized OUTc_b_PowerRelayIgnoreSync OUTc_b_ResetFltBankA OUTc_b_ResetFltBankB OUTc_b_ResetHighsideTrip OUTc_b_ResetOC_Trip OUTc_b_SpkEnIgnoreSync OUTc_b_TCO OUTc_b_TCO_ena OUTc_b_VISCO_1st OUTc_b_VISCO_2nd OUTc_b_VRefA_Enbl OUTc_b_VRefB_Enbl OUTc_b_VRefC_Enbl OUTc_b_VRefD_Enbl OUTc_b_VentiladorZF OUTc_km_Totaldistance OUTc_o_18F00000_ena OUTc_o_18F0010B_ena OUTc_o_18FDC40B_ena OUTc_o_18FE6E00_ena OUTc_o_18FEE100_ena OUTc_o_18FEE600_ena OUTc_o_18FEEE00_ena OUTc_o_BCM_ZF_ena OUTc_o_BCM_ena OUTc_o_CombustionAllCyls OUTc_o_DM19CVN OUTc_o_DM19Request OUTc_o_EngSpd OUTc_o_FAN_ZF OUTc_o_FreqUEGOA OUTc_o_MIL_LED OUTc_o_PT_RelayEnergized OUTc_o_TCO_ena OUTc_o_UEGO_HTR_DC_A OUTc_o_VISCO_1st OUTc_o_VISCO_2nd OUTc_o_VentiladorZF OUTc_o_VhSpd OUTc_pct_ActvLoadPumpThrs OUTc_pct_DC_StepsUEGOA OUTc_pct_DC_UEGO_A OUTc_pct_DeactvLoadPumpThrs OUTc_pct_EngSpd_Fq OUTc_pct_FuelMinLevel OUTc_pct_FuelReserve_1Tank OUTc_pct_FuelReserve_2Tank OUTc_pct_HiThrshUEGOA OUTc_pct_RampDC_A OUTc_pct_UEGO_HTR_DC_A OUTc_pct_VhSpd_Fq OUTc_s_ChangeTanksDelay OUTc_s_DbncStepsDC_UEGOA OUTc_s_DbncStepsDC_UEGOA2 OUTc_s_DbncStepsFreqUEGOA OUTc_s_DbncStepsFreqUEGOA2 OUTc_s_DynoMsg1_Period OUTc_s_DynoMsg2_Period OUTc_s_FuelLevelLimDelay OUTc_s_ShutdownDelay OUTc_s_SwichTankHold OUTc_s_ViscoOFFPulse OUTc_s_ViscoPeakPulse OUTc_us_CurrentLimitDither1 OUTc_us_CurrentLimitDither3 OUTc_us_InjPeakDuration REMc_C_OvertempThrsh REMc_C_TurbineShutdownThrsh REMc_C_TurbineWarningThrsh REMc_Nm_OvertempTqLimit REMc_Nm_TqLimit REMc_b_EnblCombustion REMc_b_PreventRunningReboot REMc_b_ResetTurbineShutdown REMc_b_StopCombustion REMc_e_TurbineState REMc_o_OvertempThrottleLimit REMc_o_StopCombustion REMc_o_TqLimit REMc_o_TurbineState REMc_pct_OvertempThrottleLimit REMc_s_PowerupDelay REMc_s_RunningRebootWindow REMc_s_TurbineTempDbnc RFCc_b_Enable RFCc_mg_FuelRqstDeltaThrsh RFCc_pct_MaxEnlean RFCc_pct_MaxEnrich RFCc_pct_PfInvThrsh RFCc_s_DbncTimer RFCc_s_ExpTimer SARc_NU_MBT_RiseRate SARc_adv_RunningSparkMax SARc_adv_RunningSparkMin SARc_adv_SparkAng SARc_o_SparkAng SOVc_b_OpenValve1 SOVc_b_OpenValve2 SOVc_o_OpenValve1 SOVc_o_OpenValve2 SPTc_adv_CoilOffAng SPTc_adv_CoilOnAng SPTc_b_UseHalfVBatt SPTc_ms_MinDwellTime SPTc_ms_MinOffTime SPTc_o_CoilOffAng SPTc_o_CoilOnAng STRc_b_ManualStarter STRc_o_ManualStarter SYSc_NU_CWG_GapRatioLongShort SYSc_NU_CWG_GapRatioShortLong SYSc_NU_CWG_NoiseRejRatioAcross SYSc_NU_CWG_NoiseRejRatioAfter SYSc_NU_CWG_NoiseRejRatioNormal SYSc_NU_CWG_NoiseRejRatioTOTth SYSc_NU_CWG_SkipTeeth SYSc_NU_CWG_StallDetRatioAcross SYSc_NU_CWG_StallDetRatioAfter SYSc_NU_CWG_StallDetRatioNorm SYSc_NU_CWG_StallDetRatioTOTth SYSc_NU_EngSyncReq SYSc_NU_MaxMissfire SYSc_Nm_ManualTqRqst SYSc_adv_ManualSparkOfst SYSc_b_CrankAngValid SYSc_b_ModuleReset SYSc_b_TransmitVIN SYSc_b_TurboPrsnt SYSc_b_UseAND SYSc_b_VCP SYSc_cc_EngDisp SYSc_cnt_NumOfCyls SYSc_deg_AngTaskCalc SYSc_deg_EngAngOfstReq SYSc_deg_SyncEndAngle SYSc_deg_SyncStartAngle SYSc_ms_CWG_FirstToothTimeout SYSc_ms_InjDeadTime SYSc_ms_MinInjTime SYSc_o_CrankAngValid SYSc_o_EngAngOfstReq SYSc_o_EngSyncReq SYSc_pct_ManualFuelTrim SYSc_ret_InjDropDeadAng TARc_Hz_BrakeTqLPF TARc_Hz_IdlAirToTqLPF TARc_NU_ClunkTqFallRate TARc_NU_ClunkTqRiseRate TARc_NU_RearAxleRatio TARc_NU_TqFallRate TARc_NU_TqRiseRate TARc_Nm_ClunkRegionMax TARc_Nm_ClunkRegionMin TARc_Nm_DFCTorque TARc_Nm_DTC_LimitTq TARc_Nm_EngReferenceTorque TARc_Nm_Max TARc_Nm_TqRqst TARc_b_DTC_TqLimit TARc_b_Disable_TQmodel TARc_b_EnableIdl_ELM TARc_b_LimpHome TARc_b_TqModelSelect TARc_kph_ClunkEnblVehSpd TARc_mm_WheelCircumference TARc_o_DTC_TqLimit TARc_o_LimpHome TARc_o_TqRqst TARc_s_DTC_LimitTime TARc_s_EEC1TimeTqSmooth TCOc_NU_VehSpeed_Gain TCOc_NU_VehSpeed_Ofst TRFc_NU_TqHPF_TC TRFc_Nm_FallingTransientThrsh TRFc_Nm_RisingTransientThrsh TRFc_RPM_CoolantTempEnblThrsh TRFc_RPM_EngSpdEnblThrsh TRFc_b_IdlDisable TRFc_lam_MaxEnrichment TRFc_lam_MinEnrichment TRFc_lam_Trim TRFc_o_Trim TRSc_NU_SparkFallRate TRSc_NU_TqHPF_TC TRSc_Nm_TqHPF_Thrsh TRSc_lam_AFR_EnblThrsh TRSc_o_SparkRqst TRSc_ret_SparkRqst TRSc_s_AFR_EnblDelay TSSc_b_OBDtimeOK TSSc_o_OBDtimeOK TSTc_b_StopKnockChanges TSTc_b_UseY14 TURc_NU_BoostPressErrROC_Thrsh TURc_NU_DGain TURc_NU_IGain TURc_NU_PGain TURc_b_AtMaxBoost TURc_b_AtMinBoost TURc_b_CompBypassValve TURc_b_FBTableUse TURc_b_ResetITerm TURc_b_UsePrRatioForCtrl TURc_kPa_DbndLatchI TURc_kPa_MechanicalSetpoint TURc_kPa_TurboErroThr TURc_o_AtMaxBoost TURc_o_AtMinBoost TURc_o_CompBypassValve TURc_o_TurCtrlDC TURc_pct_FB_EffortDbndMax TURc_pct_FB_EffortDbndMin TURc_pct_ITermMax TURc_pct_ITermMin TURc_pct_TurCtrlDC VCPc_NU_CamDGain VCPc_NU_CamErrROCThrsh VCPc_NU_CamIGain VCPc_NU_CamPGain VCPc_NU_TrgtFallRate VCPc_NU_TrgtRiseRate VCPc_adv_CamHiStop VCPc_adv_CamLoStop VCPc_b_CamResetITerm VCPc_deg_CamDbndLatchI VCPc_deg_CamHiLatchI VCPc_deg_CamLoLatchI VCPc_o_CamDC VCPc_pct_CamDC VCPc_pct_CamITermMax VCPc_pct_CamITermMin VCPc_pct_CamPID_Dbnd VCPc_pct_CamPID_Max VCPc_pct_CamPID_Min exdc_clear_unconditionally exdc_dm5c_obd_compliance /end REF_CHARACTERISTIC
/end FUNCTION
/begin FUNCTION Signals "Group /ByType/Signals"
 /begin LOC_MEASUREMENT ADM_NU_Alpha ADM_NU_BoostIGain ADM_NU_ComprInDens ADM_NU_ComprOutDens ADM_NU_ComprPressRatio ADM_NU_ComprSurgeProx ADM_NU_ISFC ADM_NU_SurgePressRatio ADM_NU_ThrottleIGain ADM_RPM_TurSpdCorr ADM_b_ComprSurge ADM_b_TurOverspeed ADM_b_TurboCancelThrottleITerm ADM_b_UseTurbo ADM_deg_EquationBasedThCorr ADM_deg_ThrottleTrgt ADM_deg_ThrottleTrgtRaw ADM_deg_VCP_ThCorr ADM_gps_AirDemandRAW ADM_gps_MAF_Corr ADM_gps_MAF_Trgt ADM_gps_MAF_TrgtErr ADM_gps_NominalMAF ADM_gps_TrgtFuelFlow ADM_kPa_BoostFB ADM_kPa_BoostFF ADM_kPa_BoostITerm ADM_kPa_BoostPTerm ADM_kPa_BoostPressTrgt ADM_kPa_BoostPressTrgtRaw ADM_kPa_BoostPressTrgtRawCorr ADM_kPa_ComprInDynPress ADM_kPa_ComprInPressTot ADM_kPa_ComprOutDynPress ADM_kPa_ComprOutPressTot ADM_kPa_NominalDP ADM_kW_TrgtPwr ADM_mps_ComprInVel ADM_mps_ComprOutVel ADM_pct_AirDemand ADM_pct_ThrottleEffortRaw ADM_pct_ThrottleFB ADM_pct_ThrottleITerm ADM_pct_ThrottlePGain ADM_pct_ThrottlePTerm ADM_ret_VCP_Trgt AFR_b_UseRateLim AFR_lam_BaseTrgt AFR_lam_CrankingTrgt AFR_lam_FinalTrgt1 AFR_lam_FinalTrgt2 AFR_lam_RampedTrgt AFR_lam_TableResult AIN_A_ETC_CurrentB AIN_A_Y1_Current AIN_A_Y5_Current AIN_C_AmbientTemp AIN_C_CompOutTemp AIN_C_CoolantTemp AIN_C_ExhaustTemp AIN_C_FuelTemp AIN_C_ManifoldTemp AIN_C_OilTemp AIN_NU_APP1_Raw AIN_NU_APP2_Raw AIN_NU_MIL_Status AIN_NU_TP1_Raw /end LOC_MEASUREMENT
 /begin REF_CHARACTERISTIC INPv_deg_CamTeethPositionsRaw /end REF_CHARACTERISTIC
/end FUNCTION
/end MODULE
/end PROJECT
