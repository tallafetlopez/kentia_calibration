ASAP2_VERSION 1 31
/begin PROJECT M670_Engine_Control_1.2.0_M670_000 "BeGas B430LG Turbocharged engine"
/begin HEADER "Begas Motor 2017-2022 (c)" VERSION "1_2_0" /end HEADER
/begin MODULE OpenECU_M670_000 ""
/* Scalar measurable for DDE 'ADM_NU_Alpha'. */
/begin MEASUREMENT ADM_NU_Alpha "Displayable" FLOAT32_IEEE CU_ADM_NU_ALPHA 1 100 0.0 0.0 ECU_ADDRESS 0x40003390 BYTE_ORDER MSB_FIRST /end MEASUREMENT
/begin COMPU_METHOD CU_ADM_NU_ALPHA "Conversion method for ADM_NU_Alpha" RAT_FUNC "%10.2" "NU" COEFFS 0.000000 1.000000 0.000000 0.000000 0.000000 1.000000 /end COMPU_METHOD
/* Scalar measurable for DDE 'ADM_NU_BoostIGain'. */
/begin MEASUREMENT ADM_NU_BoostIGain "Integral gain for MAF target feedback control" FLOAT32_IEEE CU_ADM_NU_BOOSTIGAIN 1 100 0.0 0.0 ECU_ADDRESS 0x400033cc BYTE_ORDER MSB_FIRST /end MEASUREMENT
/begin COMPU_METHOD CU_ADM_NU_BOOSTIGAIN "Conversion method for ADM_NU_BoostIGain" RAT_FUNC "%10.3" "NU" COEFFS 0.000000 1.000000 0.000000 0.000000 0.000000 1.000000 /end COMPU_METHOD
/* Scalar measurable for DDE 'ADM_NU_ComprInDens'. */
/begin MEASUREMENT ADM_NU_ComprInDens "(kg/m3) Air density estimate" FLOAT32_IEEE CU_ADM_NU_COMPRINDENS 1 100 0.0 0.0 ECU_ADDRESS 0x4000343c BYTE_ORDER MSB_FIRST /end MEASUREMENT
/begin COMPU_METHOD CU_ADM_NU_COMPRINDENS "Conversion method for ADM_NU_ComprInDens" RAT_FUNC "%10.3" "NU" COEFFS 0.000000 1.000000 0.000000 0.000000 0.000000 1.000000 /end COMPU_METHOD
/* Scalar measurable for DDE 'ADM_NU_ComprOutDens'. */
/begin MEASUREMENT ADM_NU_ComprOutDens "(kg/m3) Air density estimate" FLOAT32_IEEE CU_ADM_NU_COMPROUTDENS 1 100 0.0 0.0 ECU_ADDRESS 0x40003428 BYTE_ORDER MSB_FIRST /end MEASUREMENT
/begin COMPU_METHOD CU_ADM_NU_COMPROUTDENS "Conversion method for ADM_NU_ComprOutDens" RAT_FUNC "%10.3" "NU" COEFFS 0.000000 1.000000 0.000000 0.000000 0.000000 1.000000 /end COMPU_METHOD
/* Scalar measurable for DDE 'ADM_NU_ComprPressRatio'. */
/begin MEASUREMENT ADM_NU_ComprPressRatio "Estimated pressure ratio" FLOAT32_IEEE CU_ADM_NU_COMPRPRESSRATIO 1 100 0.0 0.0 ECU_ADDRESS 0x40003418 BYTE_ORDER MSB_FIRST /end MEASUREMENT
/begin COMPU_METHOD CU_ADM_NU_COMPRPRESSRATIO "Conversion method for ADM_NU_ComprPressRatio" RAT_FUNC "%10.2" "NU" COEFFS 0.000000 1.000000 0.000000 0.000000 0.000000 1.000000 /end COMPU_METHOD
/* Scalar measurable for DDE 'ADM_NU_ComprSurgeProx'. */
/begin MEASUREMENT ADM_NU_ComprSurgeProx "Pressure-ratio-delta between current operation and surge limit" FLOAT32_IEEE CU_ADM_NU_COMPRSURGEPROX 1 100 0.0 0.0 ECU_ADDRESS 0x40003414 BYTE_ORDER MSB_FIRST /end MEASUREMENT
/begin COMPU_METHOD CU_ADM_NU_COMPRSURGEPROX "Conversion method for ADM_NU_ComprSurgeProx" RAT_FUNC "%10.2" "NU" COEFFS 0.000000 1.000000 0.000000 0.000000 0.000000 1.000000 /end COMPU_METHOD
/* Scalar measurable for DDE 'ADM_NU_ISFC'. */
/begin MEASUREMENT ADM_NU_ISFC "(not defined)" FLOAT32_IEEE CU_ADM_NU_ISFC 1 100 0.0 0.0 ECU_ADDRESS 0x400033e4 BYTE_ORDER MSB_FIRST /end MEASUREMENT
/begin COMPU_METHOD CU_ADM_NU_ISFC "Conversion method for ADM_NU_ISFC" RAT_FUNC "%10.2" "NU" COEFFS 0.000000 1.000000 0.000000 0.000000 0.000000 1.000000 /end COMPU_METHOD
/* Scalar measurable for DDE 'ADM_NU_SurgePressRatio'. */
/begin MEASUREMENT ADM_NU_SurgePressRatio "map output displayable" FLOAT32_IEEE CU_ADM_NU_SURGEPRESSRATIO 1 100 0.0 0.0 ECU_ADDRESS 0x40003440 BYTE_ORDER MSB_FIRST /end MEASUREMENT
/begin COMPU_METHOD CU_ADM_NU_SURGEPRESSRATIO "Conversion method for ADM_NU_SurgePressRatio" RAT_FUNC "%10.2" "NU" COEFFS 0.000000 1.000000 0.000000 0.000000 0.000000 1.000000 /end COMPU_METHOD
/* Scalar measurable for DDE 'ADM_NU_ThrottleIGain'. */
/begin MEASUREMENT ADM_NU_ThrottleIGain "Integral gain for MAF target feedback control" FLOAT32_IEEE CU_ADM_NU_THROTTLEIGAIN 1 100 0.0 0.0 ECU_ADDRESS 0x400033b4 BYTE_ORDER MSB_FIRST /end MEASUREMENT
/begin COMPU_METHOD CU_ADM_NU_THROTTLEIGAIN "Conversion method for ADM_NU_ThrottleIGain" RAT_FUNC "%10.3" "NU" COEFFS 0.000000 1.000000 0.000000 0.000000 0.000000 1.000000 /end COMPU_METHOD
/* Scalar measurable for DDE 'ADM_RPM_TurSpdCorr'. */
/begin MEASUREMENT ADM_RPM_TurSpdCorr "Turboshaft speed corrected to standard compressor condition" FLOAT32_IEEE CU_ADM_RPM_TURSPDCORR 1 100 0.0 0.0 ECU_ADDRESS 0x40003410 BYTE_ORDER MSB_FIRST /end MEASUREMENT
/begin COMPU_METHOD CU_ADM_RPM_TURSPDCORR "Conversion method for ADM_RPM_TurSpdCorr" RAT_FUNC "%10.0" "RPM" COEFFS 0.000000 1.000000 0.000000 0.000000 0.000000 1.000000 /end COMPU_METHOD
/* Scalar measurable for DDE 'ADM_b_ComprSurge'. */
/begin MEASUREMENT ADM_b_ComprSurge "Surge detection result" UBYTE CU_ADM_B_COMPRSURGE 1 100 0.0 1.0 ECU_ADDRESS 0x40002ebd BYTE_ORDER MSB_FIRST /end MEASUREMENT
/begin COMPU_METHOD CU_ADM_B_COMPRSURGE "Conversion method for ADM_b_ComprSurge" RAT_FUNC "%10.0" "b" COEFFS 0.000000 1.000000 0.000000 0.000000 0.000000 1.000000 /end COMPU_METHOD
/* Scalar measurable for DDE 'ADM_b_TurboCancelThrottleITerm'. */
/begin MEASUREMENT ADM_b_TurboCancelThrottleITerm "Status displayable" UBYTE CU_ADM_B_TURBOCANCELTHROTTLEIT0 1 100 0.0 1.0 ECU_ADDRESS 0x40002eba BYTE_ORDER MSB_FIRST /end MEASUREMENT
/begin COMPU_METHOD CU_ADM_B_TURBOCANCELTHROTTLEIT0 "Conversion method for ADM_b_TurboCancelThrottleITerm" RAT_FUNC "%10.0" "b" COEFFS 0.000000 1.000000 0.000000 0.000000 0.000000 1.000000 /end COMPU_METHOD
/* Scalar measurable for DDE 'ADM_b_UseTurbo'. */
/begin MEASUREMENT ADM_b_UseTurbo "Flag to latch throttle control (ITerm) because Turbo is regulating the mass flow" UBYTE CU_ADM_B_USETURBO 1 100 0.0 1.0 ECU_ADDRESS 0x40002ebb BYTE_ORDER MSB_FIRST /end MEASUREMENT
/begin COMPU_METHOD CU_ADM_B_USETURBO "Conversion method for ADM_b_UseTurbo" RAT_FUNC "%10.0" "b" COEFFS 0.000000 1.000000 0.000000 0.000000 0.000000 1.000000 /end COMPU_METHOD
/* Scalar measurable for DDE 'ADM_deg_EquationBasedThCorr'. */
/begin MEASUREMENT ADM_deg_EquationBasedThCorr "Displayable" FLOAT32_IEEE CU_ADM_DEG_EQUATIONBASEDTHCORR 1 100 0.0 0.0 ECU_ADDRESS 0x4000338c BYTE_ORDER MSB_FIRST /end MEASUREMENT
/begin COMPU_METHOD CU_ADM_DEG_EQUATIONBASEDTHCORR "Conversion method for ADM_deg_EquationBasedThCorr" RAT_FUNC "%10.1" "deg" COEFFS 0.000000 1.000000 0.000000 0.000000 0.000000 1.000000 /end COMPU_METHOD
/* Scalar measurable for DDE 'ADM_deg_ThrottleTrgtRaw'. */
/begin MEASUREMENT ADM_deg_ThrottleTrgtRaw "Raw throttle blade angle target" FLOAT32_IEEE CU_ADM_DEG_THROTTLETRGTRAW 1 100 0.0 0.0 ECU_ADDRESS 0x4000339c BYTE_ORDER MSB_FIRST /end MEASUREMENT
/begin COMPU_METHOD CU_ADM_DEG_THROTTLETRGTRAW "Conversion method for ADM_deg_ThrottleTrgtRaw" RAT_FUNC "%10.2" "deg" COEFFS 0.000000 1.000000 0.000000 0.000000 0.000000 1.000000 /end COMPU_METHOD
/* Scalar measurable for DDE 'ADM_deg_VCP_ThCorr'. */
/begin MEASUREMENT ADM_deg_VCP_ThCorr "Throttle angle disturbance caused by VCP" FLOAT32_IEEE CU_ADM_DEG_VCP_THCORR 1 100 0.0 0.0 ECU_ADDRESS 0x40003388 BYTE_ORDER MSB_FIRST /end MEASUREMENT
/begin COMPU_METHOD CU_ADM_DEG_VCP_THCORR "Conversion method for ADM_deg_VCP_ThCorr" RAT_FUNC "%10.1" "deg" COEFFS 0.000000 1.000000 0.000000 0.000000 0.000000 1.000000 /end COMPU_METHOD
/* Scalar measurable for DDE 'ADM_gps_MAF_Corr'. */
/begin MEASUREMENT ADM_gps_MAF_Corr "Airflow corrected to standard compressor condition" FLOAT32_IEEE CU_ADM_GPS_MAF_CORR 1 100 0.0 0.0 ECU_ADDRESS 0x40003444 BYTE_ORDER MSB_FIRST /end MEASUREMENT
/begin COMPU_METHOD CU_ADM_GPS_MAF_CORR "Conversion method for ADM_gps_MAF_Corr" RAT_FUNC "%10.2" "gps" COEFFS 0.000000 1.000000 0.000000 0.000000 0.000000 1.000000 /end COMPU_METHOD
/* Scalar measurable for DDE 'ADM_gps_MAF_Trgt'. */
/begin MEASUREMENT ADM_gps_MAF_Trgt "Target mass air flow" FLOAT32_IEEE CU_ADM_GPS_MAF_TRGT 1 100 0.0 0.0 ECU_ADDRESS 0x400033d8 BYTE_ORDER MSB_FIRST /end MEASUREMENT
/begin COMPU_METHOD CU_ADM_GPS_MAF_TRGT "Conversion method for ADM_gps_MAF_Trgt" RAT_FUNC "%10.1" "gps" COEFFS 0.000000 1.000000 0.000000 0.000000 0.000000 1.000000 /end COMPU_METHOD
/* Scalar measurable for DDE 'ADM_gps_MAF_TrgtErr'. */
/begin MEASUREMENT ADM_gps_MAF_TrgtErr "MAF target error" FLOAT32_IEEE CU_ADM_GPS_MAF_TRGTERR 1 100 0.0 0.0 ECU_ADDRESS 0x400033d4 BYTE_ORDER MSB_FIRST /end MEASUREMENT
/begin COMPU_METHOD CU_ADM_GPS_MAF_TRGTERR "Conversion method for ADM_gps_MAF_TrgtErr" RAT_FUNC "%10.2" "gps" COEFFS 0.000000 1.000000 0.000000 0.000000 0.000000 1.000000 /end COMPU_METHOD
/* Scalar measurable for DDE 'ADM_gps_NominalMAF'. */
/begin MEASUREMENT ADM_gps_NominalMAF "Mass-flow reference for zero VCP" FLOAT32_IEEE CU_ADM_GPS_NOMINALMAF 1 100 0.0 0.0 ECU_ADDRESS 0x40003394 BYTE_ORDER MSB_FIRST /end MEASUREMENT
/begin COMPU_METHOD CU_ADM_GPS_NOMINALMAF "Conversion method for ADM_gps_NominalMAF" RAT_FUNC "%10.1" "gps" COEFFS 0.000000 1.000000 0.000000 0.000000 0.000000 1.000000 /end COMPU_METHOD
/* Scalar measurable for DDE 'ADM_gps_TrgtFuelFlow'. */
/begin MEASUREMENT ADM_gps_TrgtFuelFlow "Target fuel flow" FLOAT32_IEEE CU_ADM_GPS_TRGTFUELFLOW 1 100 0.0 0.0 ECU_ADDRESS 0x400033dc BYTE_ORDER MSB_FIRST /end MEASUREMENT
/begin COMPU_METHOD CU_ADM_GPS_TRGTFUELFLOW "Conversion method for ADM_gps_TrgtFuelFlow" RAT_FUNC "%10.3" "gps" COEFFS 0.000000 1.000000 0.000000 0.000000 0.000000 1.000000 /end COMPU_METHOD
/* Scalar measurable for DDE 'ADM_kPa_BoostFB'. */
/begin MEASUREMENT ADM_kPa_BoostFB "MAF PI control effort" FLOAT32_IEEE CU_ADM_KPA_BOOSTFB 1 100 0.0 0.0 ECU_ADDRESS 0x400033c4 BYTE_ORDER MSB_FIRST /end MEASUREMENT
/begin COMPU_METHOD CU_ADM_KPA_BOOSTFB "Conversion method for ADM_kPa_BoostFB" RAT_FUNC "%10.2" "kPa" COEFFS 0.000000 1.000000 0.000000 0.000000 0.000000 1.000000 /end COMPU_METHOD
/* Scalar measurable for DDE 'ADM_kPa_BoostFF'. */
/begin MEASUREMENT ADM_kPa_BoostFF "Feedforward manifold pressure target" FLOAT32_IEEE CU_ADM_KPA_BOOSTFF 1 100 0.0 0.0 ECU_ADDRESS 0x400033c0 BYTE_ORDER MSB_FIRST /end MEASUREMENT
/begin COMPU_METHOD CU_ADM_KPA_BOOSTFF "Conversion method for ADM_kPa_BoostFF" RAT_FUNC "%10.2" "kPa" COEFFS 0.000000 1.000000 0.000000 0.000000 0.000000 1.000000 /end COMPU_METHOD
/* Scalar measurable for DDE 'ADM_kPa_BoostITerm'. */
/begin MEASUREMENT ADM_kPa_BoostITerm "Integral effort for MAF target feedback control" FLOAT32_IEEE CU_ADM_KPA_BOOSTITERM 1 100 0.0 0.0 ECU_ADDRESS 0x400033c8 BYTE_ORDER MSB_FIRST /end MEASUREMENT
/begin COMPU_METHOD CU_ADM_KPA_BOOSTITERM "Conversion method for ADM_kPa_BoostITerm" RAT_FUNC "%10.2" "kPa" COEFFS 0.000000 1.000000 0.000000 0.000000 0.000000 1.000000 /end COMPU_METHOD
/* Scalar measurable for DDE 'ADM_kPa_BoostPTerm'. */
/begin MEASUREMENT ADM_kPa_BoostPTerm "Proportional effort for MAF target feedback control" FLOAT32_IEEE CU_ADM_KPA_BOOSTPTERM 1 100 0.0 0.0 ECU_ADDRESS 0x400033d0 BYTE_ORDER MSB_FIRST /end MEASUREMENT
/begin COMPU_METHOD CU_ADM_KPA_BOOSTPTERM "Conversion method for ADM_kPa_BoostPTerm" RAT_FUNC "%10.2" "kPa" COEFFS 0.000000 1.000000 0.000000 0.000000 0.000000 1.000000 /end COMPU_METHOD
/* Scalar measurable for DDE 'ADM_kPa_BoostPressTrgtRaw'. */
/begin MEASUREMENT ADM_kPa_BoostPressTrgtRaw "MAP target" FLOAT32_IEEE CU_ADM_KPA_BOOSTPRESSTRGTRAW 1 100 0.0 0.0 ECU_ADDRESS 0x400033bc BYTE_ORDER MSB_FIRST /end MEASUREMENT
/begin COMPU_METHOD CU_ADM_KPA_BOOSTPRESSTRGTRAW "Conversion method for ADM_kPa_BoostPressTrgtRaw" RAT_FUNC "%10.0" "kPa" COEFFS 0.000000 1.000000 0.000000 0.000000 0.000000 1.000000 /end COMPU_METHOD
/* Scalar measurable for DDE 'ADM_kPa_BoostPressTrgtRawCorr'. */
/begin MEASUREMENT ADM_kPa_BoostPressTrgtRawCorr "(not defined)" FLOAT32_IEEE CU_ADM_KPA_BOOSTPRESSTRGTRAWCO0 1 100 0.0 0.0 ECU_ADDRESS 0x400033b8 BYTE_ORDER MSB_FIRST /end MEASUREMENT
/begin COMPU_METHOD CU_ADM_KPA_BOOSTPRESSTRGTRAWCO0 "Conversion method for ADM_kPa_BoostPressTrgtRawCorr" RAT_FUNC "%10.2" "kPa" COEFFS 0.000000 1.000000 0.000000 0.000000 0.000000 1.000000 /end COMPU_METHOD
/* Scalar measurable for DDE 'ADM_kPa_ComprInDynPress'. */
/begin MEASUREMENT ADM_kPa_ComprInDynPress "Dynamic pressure term" FLOAT32_IEEE CU_ADM_KPA_COMPRINDYNPRESS 1 100 0.0 0.0 ECU_ADDRESS 0x40003430 BYTE_ORDER MSB_FIRST /end MEASUREMENT
/begin COMPU_METHOD CU_ADM_KPA_COMPRINDYNPRESS "Conversion method for ADM_kPa_ComprInDynPress" RAT_FUNC "%10.2" "kPa" COEFFS 0.000000 1.000000 0.000000 0.000000 0.000000 1.000000 /end COMPU_METHOD
/* Scalar measurable for DDE 'ADM_kPa_ComprInPressTot'. */
/begin MEASUREMENT ADM_kPa_ComprInPressTot "Total pressure estimate" FLOAT32_IEEE CU_ADM_KPA_COMPRINPRESSTOT 1 100 0.0 0.0 ECU_ADDRESS 0x4000342c BYTE_ORDER MSB_FIRST /end MEASUREMENT
/begin COMPU_METHOD CU_ADM_KPA_COMPRINPRESSTOT "Conversion method for ADM_kPa_ComprInPressTot" RAT_FUNC "%10.2" "kPa" COEFFS 0.000000 1.000000 0.000000 0.000000 0.000000 1.000000 /end COMPU_METHOD
/* Scalar measurable for DDE 'ADM_kPa_ComprOutDynPress'. */
/begin MEASUREMENT ADM_kPa_ComprOutDynPress "Dynamic pressure term" FLOAT32_IEEE CU_ADM_KPA_COMPROUTDYNPRESS 1 100 0.0 0.0 ECU_ADDRESS 0x40003420 BYTE_ORDER MSB_FIRST /end MEASUREMENT
/begin COMPU_METHOD CU_ADM_KPA_COMPROUTDYNPRESS "Conversion method for ADM_kPa_ComprOutDynPress" RAT_FUNC "%10.2" "kPa" COEFFS 0.000000 1.000000 0.000000 0.000000 0.000000 1.000000 /end COMPU_METHOD
/* Scalar measurable for DDE 'ADM_kPa_ComprOutPressTot'. */
/begin MEASUREMENT ADM_kPa_ComprOutPressTot "Total pressure estimate" FLOAT32_IEEE CU_ADM_KPA_COMPROUTPRESSTOT 1 100 0.0 0.0 ECU_ADDRESS 0x4000341c BYTE_ORDER MSB_FIRST /end MEASUREMENT
/begin COMPU_METHOD CU_ADM_KPA_COMPROUTPRESSTOT "Conversion method for ADM_kPa_ComprOutPressTot" RAT_FUNC "%10.2" "kPa" COEFFS 0.000000 1.000000 0.000000 0.000000 0.000000 1.000000 /end COMPU_METHOD
/* Scalar measurable for DDE 'ADM_kPa_NominalDP'. */
/begin MEASUREMENT ADM_kPa_NominalDP "Delta-Pressure calmap output displayable" FLOAT32_IEEE CU_ADM_KPA_NOMINALDP 1 100 0.0 0.0 ECU_ADDRESS 0x40003398 BYTE_ORDER MSB_FIRST /end MEASUREMENT
/begin COMPU_METHOD CU_ADM_KPA_NOMINALDP "Conversion method for ADM_kPa_NominalDP" RAT_FUNC "%10.1" "kPa" COEFFS 0.000000 1.000000 0.000000 0.000000 0.000000 1.000000 /end COMPU_METHOD
/* Scalar measurable for DDE 'ADM_kW_TrgtPwr'. */
/begin MEASUREMENT ADM_kW_TrgtPwr "Target power" FLOAT32_IEEE CU_ADM_KW_TRGTPWR 1 100 0.0 0.0 ECU_ADDRESS 0x400033e0 BYTE_ORDER MSB_FIRST /end MEASUREMENT
/begin COMPU_METHOD CU_ADM_KW_TRGTPWR "Conversion method for ADM_kW_TrgtPwr" RAT_FUNC "%10.2" "kW" COEFFS 0.000000 1.000000 0.000000 0.000000 0.000000 1.000000 /end COMPU_METHOD
/* Scalar measurable for DDE 'ADM_mps_ComprInVel'. */
/begin MEASUREMENT ADM_mps_ComprInVel "(m/s) Airstream velocity" FLOAT32_IEEE CU_ADM_MPS_COMPRINVEL 1 100 0.0 0.0 ECU_ADDRESS 0x40003438 BYTE_ORDER MSB_FIRST /end MEASUREMENT
/begin COMPU_METHOD CU_ADM_MPS_COMPRINVEL "Conversion method for ADM_mps_ComprInVel" RAT_FUNC "%10.2" "mps" COEFFS 0.000000 1.000000 0.000000 0.000000 0.000000 1.000000 /end COMPU_METHOD
/* Scalar measurable for DDE 'ADM_mps_ComprOutVel'. */
/begin MEASUREMENT ADM_mps_ComprOutVel "(m/s) Airstream velocity" FLOAT32_IEEE CU_ADM_MPS_COMPROUTVEL 1 100 0.0 0.0 ECU_ADDRESS 0x40003424 BYTE_ORDER MSB_FIRST /end MEASUREMENT
/begin COMPU_METHOD CU_ADM_MPS_COMPROUTVEL "Conversion method for ADM_mps_ComprOutVel" RAT_FUNC "%10.2" "mps" COEFFS 0.000000 1.000000 0.000000 0.000000 0.000000 1.000000 /end COMPU_METHOD
/* Scalar measurable for DDE 'ADM_pct_ThrottleEffortRaw'. */
/begin MEASUREMENT ADM_pct_ThrottleEffortRaw "Target throttle opening" FLOAT32_IEEE CU_ADM_PCT_THROTTLEEFFORTRAW 1 100 0.0 0.0 ECU_ADDRESS 0x400033a0 BYTE_ORDER MSB_FIRST /end MEASUREMENT
/begin COMPU_METHOD CU_ADM_PCT_THROTTLEEFFORTRAW "Conversion method for ADM_pct_ThrottleEffortRaw" RAT_FUNC "%10.3" "pct" COEFFS 0.000000 1.000000 0.000000 0.000000 0.000000 1.000000 /end COMPU_METHOD
/* Scalar measurable for DDE 'ADM_pct_ThrottleFB'. */
/begin MEASUREMENT ADM_pct_ThrottleFB "MAF PI control effort" FLOAT32_IEEE CU_ADM_PCT_THROTTLEFB 1 100 0.0 0.0 ECU_ADDRESS 0x400033a4 BYTE_ORDER MSB_FIRST /end MEASUREMENT
/begin COMPU_METHOD CU_ADM_PCT_THROTTLEFB "Conversion method for ADM_pct_ThrottleFB" RAT_FUNC "%10.2" "pct" COEFFS 0.000000 1.000000 0.000000 0.000000 0.000000 1.000000 /end COMPU_METHOD
/* Scalar measurable for DDE 'ADM_pct_ThrottleITerm'. */
/begin MEASUREMENT ADM_pct_ThrottleITerm "Integral effort for MAF target feedback control" FLOAT32_IEEE CU_ADM_PCT_THROTTLEITERM 1 100 0.0 0.0 ECU_ADDRESS 0x400033b0 BYTE_ORDER MSB_FIRST /end MEASUREMENT
/begin COMPU_METHOD CU_ADM_PCT_THROTTLEITERM "Conversion method for ADM_pct_ThrottleITerm" RAT_FUNC "%10.2" "pct" COEFFS 0.000000 1.000000 0.000000 0.000000 0.000000 1.000000 /end COMPU_METHOD
/* Scalar measurable for DDE 'ADM_pct_ThrottlePGain'. */
/begin MEASUREMENT ADM_pct_ThrottlePGain "Proportional gain for MAF target feedback control" FLOAT32_IEEE CU_ADM_PCT_THROTTLEPGAIN 1 100 0.0 0.0 ECU_ADDRESS 0x400033ac BYTE_ORDER MSB_FIRST /end MEASUREMENT
/begin COMPU_METHOD CU_ADM_PCT_THROTTLEPGAIN "Conversion method for ADM_pct_ThrottlePGain" RAT_FUNC "%10.3" "pct" COEFFS 0.000000 1.000000 0.000000 0.000000 0.000000 1.000000 /end COMPU_METHOD
/* Scalar measurable for DDE 'ADM_pct_ThrottlePTerm'. */
/begin MEASUREMENT ADM_pct_ThrottlePTerm "Proportional effort for MAF target feedback control" FLOAT32_IEEE CU_ADM_PCT_THROTTLEPTERM 1 100 0.0 0.0 ECU_ADDRESS 0x400033a8 BYTE_ORDER MSB_FIRST /end MEASUREMENT
/begin COMPU_METHOD CU_ADM_PCT_THROTTLEPTERM "Conversion method for ADM_pct_ThrottlePTerm" RAT_FUNC "%10.2" "pct" COEFFS 0.000000 1.000000 0.000000 0.000000 0.000000 1.000000 /end COMPU_METHOD
/* Scalar measurable for DDE 'AFR_b_UseRateLim'. */
/begin MEASUREMENT AFR_b_UseRateLim "Displayable" UBYTE CU_AFR_B_USERATELIM 1 100 0.0 1.0 ECU_ADDRESS 0x40002ebf BYTE_ORDER MSB_FIRST /end MEASUREMENT
/begin COMPU_METHOD CU_AFR_B_USERATELIM "Conversion method for AFR_b_UseRateLim" RAT_FUNC "%10.0" "b" COEFFS 0.000000 1.000000 0.000000 0.000000 0.000000 1.000000 /end COMPU_METHOD
/* Scalar measurable for DDE 'AFR_lam_BaseTrgt'. */
/begin MEASUREMENT AFR_lam_BaseTrgt "Base AFR target" FLOAT32_IEEE CU_AFR_LAM_BASETRGT 1 100 10.0 20.0 ECU_ADDRESS 0x400034b0 BYTE_ORDER MSB_FIRST /end MEASUREMENT
/begin COMPU_METHOD CU_AFR_LAM_BASETRGT "Conversion method for AFR_lam_BaseTrgt" RAT_FUNC "%10.3" "lam" COEFFS 0.000000 1.000000 0.000000 0.000000 0.000000 1.000000 /end COMPU_METHOD
/* Scalar measurable for DDE 'AFR_lam_CrankingTrgt'. */
/begin MEASUREMENT AFR_lam_CrankingTrgt "Cranking AFR target" FLOAT32_IEEE CU_AFR_LAM_CRANKINGTRGT 1 100 0.0 0.0 ECU_ADDRESS 0x40003540 BYTE_ORDER MSB_FIRST /end MEASUREMENT
/begin COMPU_METHOD CU_AFR_LAM_CRANKINGTRGT "Conversion method for AFR_lam_CrankingTrgt" RAT_FUNC "%10.2" "lam" COEFFS 0.000000 1.000000 0.000000 0.000000 0.000000 1.000000 /end COMPU_METHOD
/* Scalar measurable for DDE 'AFR_lam_RampedTrgt'. */
/begin MEASUREMENT AFR_lam_RampedTrgt "Ramped AFR target" FLOAT32_IEEE CU_AFR_LAM_RAMPEDTRGT 1 100 0.0 2.0 ECU_ADDRESS 0x400034b4 BYTE_ORDER MSB_FIRST /end MEASUREMENT
/begin COMPU_METHOD CU_AFR_LAM_RAMPEDTRGT "Conversion method for AFR_lam_RampedTrgt" RAT_FUNC "%10.2" "lam" COEFFS 0.000000 1.000000 0.000000 0.000000 0.000000 1.000000 /end COMPU_METHOD
/* Scalar measurable for DDE 'AFR_lam_TableResult'. */
/begin MEASUREMENT AFR_lam_TableResult "Map output displayable" FLOAT32_IEEE CU_AFR_LAM_TABLERESULT 1 100 10.0 20.0 ECU_ADDRESS 0x400034b8 BYTE_ORDER MSB_FIRST /end MEASUREMENT
/begin COMPU_METHOD CU_AFR_LAM_TABLERESULT "Conversion method for AFR_lam_TableResult" RAT_FUNC "%10.3" "lam" COEFFS 0.000000 1.000000 0.000000 0.000000 0.000000 1.000000 /end COMPU_METHOD
/* Scalar measurable for DDE 'AIN_A_ETC_CurrentB'. */
/begin MEASUREMENT AIN_A_ETC_CurrentB "Output current monitor" FLOAT32_IEEE CU_AIN_A_ETC_CURRENTB 1 100 0.0 0.0 ECU_ADDRESS 0x400037b0 BYTE_ORDER MSB_FIRST /end MEASUREMENT
/begin COMPU_METHOD CU_AIN_A_ETC_CURRENTB "Conversion method for AIN_A_ETC_CurrentB" RAT_FUNC "%10.3" "A" COEFFS 0.000000 1.000000 0.000000 0.000000 0.000000 1.000000 /end COMPU_METHOD
/* Scalar measurable for DDE 'AIN_A_Y1_Current'. */
/begin MEASUREMENT AIN_A_Y1_Current "Output current monitor" FLOAT32_IEEE CU_AIN_A_Y1_CURRENT 1 100 0.0 0.0 ECU_ADDRESS 0x400037ac BYTE_ORDER MSB_FIRST /end MEASUREMENT
/begin COMPU_METHOD CU_AIN_A_Y1_CURRENT "Conversion method for AIN_A_Y1_Current" RAT_FUNC "%10.3" "A" COEFFS 0.000000 1.000000 0.000000 0.000000 0.000000 1.000000 /end COMPU_METHOD
/* Scalar measurable for DDE 'AIN_A_Y5_Current'. */
/begin MEASUREMENT AIN_A_Y5_Current "Output current monitor" FLOAT32_IEEE CU_AIN_A_Y5_CURRENT 1 100 0.0 0.0 ECU_ADDRESS 0x400037a8 BYTE_ORDER MSB_FIRST /end MEASUREMENT
/begin COMPU_METHOD CU_AIN_A_Y5_CURRENT "Conversion method for AIN_A_Y5_Current" RAT_FUNC "%10.3" "A" COEFFS 0.000000 1.000000 0.000000 0.000000 0.000000 1.000000 /end COMPU_METHOD
/* Scalar measurable for DDE 'AIN_NU_MIL_Status'. */
/begin MEASUREMENT AIN_NU_MIL_Status "(not defined)" FLOAT32_IEEE CU_AIN_NU_MIL_STATUS 1 100 0.0 10.0 ECU_ADDRESS 0x40003670 BYTE_ORDER MSB_FIRST /end MEASUREMENT
/begin COMPU_METHOD CU_AIN_NU_MIL_STATUS "Conversion method for AIN_NU_MIL_Status" RAT_FUNC "%10.0" "NU" COEFFS 0.000000 1.000000 0.000000 0.000000 0.000000 1.000000 /end COMPU_METHOD
/* Scalar measurable for DDE 'AIN_V_Baro'. */
/begin MEASUREMENT AIN_V_Baro "Analog input value" FLOAT32_IEEE CU_AIN_V_BARO 1 100 0.0 0.0 ECU_ADDRESS 0x40003920 BYTE_ORDER MSB_FIRST /end MEASUREMENT
/begin COMPU_METHOD CU_AIN_V_BARO "Conversion method for AIN_V_Baro" RAT_FUNC "%10.3" "V" COEFFS 0.000000 1.000000 0.000000 0.000000 0.000000 1.000000 /end COMPU_METHOD
/* Scalar measurable for DDE 'AIN_V_CoolantTemp'. */
/begin MEASUREMENT AIN_V_CoolantTemp "Analog input value" FLOAT32_IEEE CU_AIN_V_COOLANTTEMP 1 100 0.0 0.0 ECU_ADDRESS 0x400038f8 BYTE_ORDER MSB_FIRST /end MEASUREMENT
/begin COMPU_METHOD CU_AIN_V_COOLANTTEMP "Conversion method for AIN_V_CoolantTemp" RAT_FUNC "%10.3" "V" COEFFS 0.000000 1.000000 0.000000 0.000000 0.000000 1.000000 /end COMPU_METHOD
/* Scalar measurable for DDE 'AIN_V_EGT'. */
/begin MEASUREMENT AIN_V_EGT "Analog input value" FLOAT32_IEEE CU_AIN_V_EGT 1 100 0.0 5.0 ECU_ADDRESS 0x400038f4 BYTE_ORDER MSB_FIRST /end MEASUREMENT
/begin COMPU_METHOD CU_AIN_V_EGT "Conversion method for AIN_V_EGT" RAT_FUNC "%10.3" "V" COEFFS 0.000000 1.000000 0.000000 0.000000 0.000000 1.000000 /end COMPU_METHOD
/* Scalar measurable for DDE 'AIN_V_ETC_MonA'. */
/begin MEASUREMENT AIN_V_ETC_MonA "Output monitor" FLOAT32_IEEE CU_AIN_V_ETC_MONA 1 100 0.0 0.0 ECU_ADDRESS 0x400037d0 BYTE_ORDER MSB_FIRST /end MEASUREMENT
/begin COMPU_METHOD CU_AIN_V_ETC_MONA "Conversion method for AIN_V_ETC_MonA" RAT_FUNC "%10.2" "V" COEFFS 0.000000 1.000000 0.000000 0.000000 0.000000 1.000000 /end COMPU_METHOD
/* Scalar measurable for DDE 'AIN_V_ETC_MonB'. */
/begin MEASUREMENT AIN_V_ETC_MonB "Output monitor" FLOAT32_IEEE CU_AIN_V_ETC_MONB 1 100 0.0 0.0 ECU_ADDRESS 0x400037c0 BYTE_ORDER MSB_FIRST /end MEASUREMENT
/begin COMPU_METHOD CU_AIN_V_ETC_MONB "Conversion method for AIN_V_ETC_MonB" RAT_FUNC "%10.2" "V" COEFFS 0.000000 1.000000 0.000000 0.000000 0.000000 1.000000 /end COMPU_METHOD
/* Scalar measurable for DDE 'AIN_V_FCV_Mon'. */
/begin MEASUREMENT AIN_V_FCV_Mon "Output monitor" FLOAT32_IEEE CU_AIN_V_FCV_MON 1 100 0.0 0.0 ECU_ADDRESS 0x400037bc BYTE_ORDER MSB_FIRST /end MEASUREMENT
/begin COMPU_METHOD CU_AIN_V_FCV_MON "Conversion method for AIN_V_FCV_Mon" RAT_FUNC "%10.2" "V" COEFFS 0.000000 1.000000 0.000000 0.000000 0.000000 1.000000 /end COMPU_METHOD
/* Scalar measurable for DDE 'AIN_V_FuelTempRaw'. */
/begin MEASUREMENT AIN_V_FuelTempRaw "Analog input value" FLOAT32_IEEE CU_AIN_V_FUELTEMPRAW 1 100 0.0 0.0 ECU_ADDRESS 0x400038e8 BYTE_ORDER MSB_FIRST /end MEASUREMENT
/begin COMPU_METHOD CU_AIN_V_FUELTEMPRAW "Conversion method for AIN_V_FuelTempRaw" RAT_FUNC "%10.3" "V" COEFFS 0.000000 1.000000 0.000000 0.000000 0.000000 1.000000 /end COMPU_METHOD
/* Scalar measurable for DDE 'AIN_V_Highside'. */
/begin MEASUREMENT AIN_V_Highside "Output monitor" FLOAT32_IEEE CU_AIN_V_HIGHSIDE 1 100 0.0 0.0 ECU_ADDRESS 0x400037a4 BYTE_ORDER MSB_FIRST /end MEASUREMENT
/begin COMPU_METHOD CU_AIN_V_HIGHSIDE "Conversion method for AIN_V_Highside" RAT_FUNC "%10.2" "V" COEFFS 0.000000 1.000000 0.000000 0.000000 0.000000 1.000000 /end COMPU_METHOD
/* Scalar measurable for DDE 'AIN_V_MAP_Raw'. */
/begin MEASUREMENT AIN_V_MAP_Raw "Raw value" FLOAT32_IEEE CU_AIN_V_MAP_RAW 1 100 0.0 0.0 ECU_ADDRESS 0x40003924 BYTE_ORDER MSB_FIRST /end MEASUREMENT
/begin COMPU_METHOD CU_AIN_V_MAP_RAW "Conversion method for AIN_V_MAP_Raw" RAT_FUNC "%10.3" "V" COEFFS 0.000000 1.000000 0.000000 0.000000 0.000000 1.000000 /end COMPU_METHOD
/* Scalar measurable for DDE 'AIN_V_ManifoldTemp'. */
/begin MEASUREMENT AIN_V_ManifoldTemp "Analog input value" FLOAT32_IEEE CU_AIN_V_MANIFOLDTEMP 1 100 -40.0 120.0 ECU_ADDRESS 0x400038c8 BYTE_ORDER MSB_FIRST /end MEASUREMENT
/begin COMPU_METHOD CU_AIN_V_MANIFOLDTEMP "Conversion method for AIN_V_ManifoldTemp" RAT_FUNC "%10.3" "V" COEFFS 0.000000 1.000000 0.000000 0.000000 0.000000 1.000000 /end COMPU_METHOD
/* Scalar measurable for DDE 'AIN_V_TP1'. */
/begin MEASUREMENT AIN_V_TP1 "Raw value" FLOAT32_IEEE CU_AIN_V_TP1 1 100 0.0 0.0 ECU_ADDRESS 0x400038b0 BYTE_ORDER MSB_FIRST /end MEASUREMENT
/begin COMPU_METHOD CU_AIN_V_TP1 "Conversion method for AIN_V_TP1" RAT_FUNC "%10.3" "V" COEFFS 0.000000 1.000000 0.000000 0.000000 0.000000 1.000000 /end COMPU_METHOD
/* Scalar measurable for DDE 'AIN_V_TP2'. */
/begin MEASUREMENT AIN_V_TP2 "Raw value" FLOAT32_IEEE CU_AIN_V_TP2 1 100 0.0 0.0 ECU_ADDRESS 0x400038ac BYTE_ORDER MSB_FIRST /end MEASUREMENT
/begin COMPU_METHOD CU_AIN_V_TP2 "Conversion method for AIN_V_TP2" RAT_FUNC "%10.3" "V" COEFFS 0.000000 1.000000 0.000000 0.000000 0.000000 1.000000 /end COMPU_METHOD
/* Scalar measurable for DDE 'AIN_V_VRefA'. */
/begin MEASUREMENT AIN_V_VRefA "Output monitor" FLOAT32_IEEE CU_AIN_V_VREFA 1 100 0.0 0.0 ECU_ADDRESS 0x400037dc BYTE_ORDER MSB_FIRST /end MEASUREMENT
/begin COMPU_METHOD CU_AIN_V_VREFA "Conversion method for AIN_V_VRefA" RAT_FUNC "%10.2" "V" COEFFS 0.000000 1.000000 0.000000 0.000000 0.000000 1.000000 /end COMPU_METHOD
/* Scalar measurable for DDE 'AIN_V_VRefB'. */
/begin MEASUREMENT AIN_V_VRefB "Output monitor" FLOAT32_IEEE CU_AIN_V_VREFB 1 100 0.0 0.0 ECU_ADDRESS 0x400037e0 BYTE_ORDER MSB_FIRST /end MEASUREMENT
/begin COMPU_METHOD CU_AIN_V_VREFB "Conversion method for AIN_V_VRefB" RAT_FUNC "%10.2" "V" COEFFS 0.000000 1.000000 0.000000 0.000000 0.000000 1.000000 /end COMPU_METHOD
/* Scalar measurable for DDE 'AIN_V_VRefC'. */
/begin MEASUREMENT AIN_V_VRefC "Output monitor" FLOAT32_IEEE CU_AIN_V_VREFC 1 100 0.0 0.0 ECU_ADDRESS 0x400037d8 BYTE_ORDER MSB_FIRST /end MEASUREMENT
/begin COMPU_METHOD CU_AIN_V_VREFC "Conversion method for AIN_V_VRefC" RAT_FUNC "%10.2" "V" COEFFS 0.000000 1.000000 0.000000 0.000000 0.000000 1.000000 /end COMPU_METHOD
/* Scalar measurable for DDE 'AIN_V_VRefD'. */
/begin MEASUREMENT AIN_V_VRefD "Output monitor" FLOAT32_IEEE CU_AIN_V_VREFD 1 100 0.0 0.0 ECU_ADDRESS 0x400037d4 BYTE_ORDER MSB_FIRST /end MEASUREMENT
/begin COMPU_METHOD CU_AIN_V_VREFD "Conversion method for AIN_V_VRefD" RAT_FUNC "%10.2" "V" COEFFS 0.000000 1.000000 0.000000 0.000000 0.000000 1.000000 /end COMPU_METHOD
/* Scalar measurable for DDE 'AIN_V_XL1_Mon'. */
/begin MEASUREMENT AIN_V_XL1_Mon "Output monitor" FLOAT32_IEEE CU_AIN_V_XL1_MON 1 100 0.0 0.0 ECU_ADDRESS 0x400037cc BYTE_ORDER MSB_FIRST /end MEASUREMENT
/begin COMPU_METHOD CU_AIN_V_XL1_MON "Conversion method for AIN_V_XL1_Mon" RAT_FUNC "%10.2" "V" COEFFS 0.000000 1.000000 0.000000 0.000000 0.000000 1.000000 /end COMPU_METHOD
/* Scalar measurable for DDE 'AIN_V_XM1_Mon'. */
/begin MEASUREMENT AIN_V_XM1_Mon "Output monitor" FLOAT32_IEEE CU_AIN_V_XM1_MON 1 100 0.0 0.0 ECU_ADDRESS 0x400037c8 BYTE_ORDER MSB_FIRST /end MEASUREMENT
/begin COMPU_METHOD CU_AIN_V_XM1_MON "Conversion method for AIN_V_XM1_Mon" RAT_FUNC "%10.2" "V" COEFFS 0.000000 1.000000 0.000000 0.000000 0.000000 1.000000 /end COMPU_METHOD
/* Scalar measurable for DDE 'AIN_V_Y29_Mon'. */
/begin MEASUREMENT AIN_V_Y29_Mon "Output monitor" FLOAT32_IEEE CU_AIN_V_Y29_MON 1 100 0.0 0.0 ECU_ADDRESS 0x400037b8 BYTE_ORDER MSB_FIRST /end MEASUREMENT
/begin COMPU_METHOD CU_AIN_V_Y29_MON "Conversion method for AIN_V_Y29_Mon" RAT_FUNC "%10.2" "V" COEFFS 0.000000 1.000000 0.000000 0.000000 0.000000 1.000000 /end COMPU_METHOD
/* Scalar measurable for DDE 'AIN_V_Y41_Mon'. */
/begin MEASUREMENT AIN_V_Y41_Mon "Output monitor" FLOAT32_IEEE CU_AIN_V_Y41_MON 1 100 0.0 0.0 ECU_ADDRESS 0x400037b4 BYTE_ORDER MSB_FIRST /end MEASUREMENT
/begin COMPU_METHOD CU_AIN_V_Y41_MON "Conversion method for AIN_V_Y41_Mon" RAT_FUNC "%10.2" "V" COEFFS 0.000000 1.000000 0.000000 0.000000 0.000000 1.000000 /end COMPU_METHOD
/* Scalar measurable for DDE 'AIN_V_Y42_Mon'. */
/begin MEASUREMENT AIN_V_Y42_Mon "Output monitor" FLOAT32_IEEE CU_AIN_V_Y42_MON 1 100 0.0 0.0 ECU_ADDRESS 0x400037c4 BYTE_ORDER MSB_FIRST /end MEASUREMENT
/begin COMPU_METHOD CU_AIN_V_Y42_MON "Conversion method for AIN_V_Y42_Mon" RAT_FUNC "%10.2" "V" COEFFS 0.000000 1.000000 0.000000 0.000000 0.000000 1.000000 /end COMPU_METHOD
/* Scalar measurable for DDE 'AIN_V_Y6_Mon'. */
/begin MEASUREMENT AIN_V_Y6_Mon "Output monitor" FLOAT32_IEEE CU_AIN_V_Y6_MON 1 100 0.0 0.0 ECU_ADDRESS 0x4000390c BYTE_ORDER MSB_FIRST /end MEASUREMENT
/begin COMPU_METHOD CU_AIN_V_Y6_MON "Conversion method for AIN_V_Y6_Mon" RAT_FUNC "%10.2" "V" COEFFS 0.000000 1.000000 0.000000 0.000000 0.000000 1.000000 /end COMPU_METHOD
/* Scalar measurable for DDE 'AIN_b_DC_start'. */
/begin MEASUREMENT AIN_b_DC_start "Displayable" UBYTE CU_AIN_B_DC_START 1 100 0.0 1.0 ECU_ADDRESS 0x40002f33 BYTE_ORDER MSB_FIRST /end MEASUREMENT
/begin COMPU_METHOD CU_AIN_B_DC_START "Conversion method for AIN_b_DC_start" RAT_FUNC "%10.0" "b" COEFFS 0.000000 1.000000 0.000000 0.000000 0.000000 1.000000 /end COMPU_METHOD
/* Scalar measurable for DDE 'AIN_b_Eng_running'. */
/begin MEASUREMENT AIN_b_Eng_running "Displayable" UBYTE CU_AIN_B_ENG_RUNNING 1 100 0.0 1.0 ECU_ADDRESS 0x40002f30 BYTE_ORDER MSB_FIRST /end MEASUREMENT
/begin COMPU_METHOD CU_AIN_B_ENG_RUNNING "Conversion method for AIN_b_Eng_running" RAT_FUNC "%10.0" "b" COEFFS 0.000000 1.000000 0.000000 0.000000 0.000000 1.000000 /end COMPU_METHOD
/* Scalar measurable for DDE 'AIN_b_IC_start'. */
/begin MEASUREMENT AIN_b_IC_start "Displayable" UBYTE CU_AIN_B_IC_START 1 100 0.0 1.0 ECU_ADDRESS 0x40002f31 BYTE_ORDER MSB_FIRST /end MEASUREMENT
/begin COMPU_METHOD CU_AIN_B_IC_START "Conversion method for AIN_b_IC_start" RAT_FUNC "%10.0" "b" COEFFS 0.000000 1.000000 0.000000 0.000000 0.000000 1.000000 /end COMPU_METHOD
/* Scalar measurable for DDE 'AIN_b_WU_start'. */
/begin MEASUREMENT AIN_b_WU_start "Displayable" UBYTE CU_AIN_B_WU_START 1 100 0.0 1.0 ECU_ADDRESS 0x40002f32 BYTE_ORDER MSB_FIRST /end MEASUREMENT
/begin COMPU_METHOD CU_AIN_B_WU_START "Conversion method for AIN_b_WU_start" RAT_FUNC "%10.0" "b" COEFFS 0.000000 1.000000 0.000000 0.000000 0.000000 1.000000 /end COMPU_METHOD
/* Scalar measurable for DDE 'AIN_s_DelayLambdas'. */
/begin MEASUREMENT AIN_s_DelayLambdas "Analog input value" FLOAT32_IEEE CU_AIN_S_DELAYLAMBDAS 1 100 0.0 5000.0 ECU_ADDRESS 0x400038fc BYTE_ORDER MSB_FIRST /end MEASUREMENT
/begin COMPU_METHOD CU_AIN_S_DELAYLAMBDAS "Conversion method for AIN_s_DelayLambdas" RAT_FUNC "%10.3" "s" COEFFS 0.000000 1.000000 0.000000 0.000000 0.000000 1.000000 /end COMPU_METHOD
/* Scalar measurable for DDE 'AMB_b_OBDTempOK'. */
/begin MEASUREMENT AMB_b_OBDTempOK "Displayable" UBYTE CU_AMB_B_OBDTEMPOK 1 100 0.0 1.0 ECU_ADDRESS 0x40002f37 BYTE_ORDER MSB_FIRST /end MEASUREMENT
/begin COMPU_METHOD CU_AMB_B_OBDTEMPOK "Conversion method for AMB_b_OBDTempOK" RAT_FUNC "%10.0" "b" COEFFS 0.000000 1.000000 0.000000 0.000000 0.000000 1.000000 /end COMPU_METHOD
/* Scalar measurable for DDE 'AME_C_ChargeTemp'. */
/begin MEASUREMENT AME_C_ChargeTemp "Charge temperature" FLOAT32_IEEE CU_AME_C_CHARGETEMP 1 100 0.0 0.0 ECU_ADDRESS 0x40003648 BYTE_ORDER MSB_FIRST /end MEASUREMENT
/begin COMPU_METHOD CU_AME_C_CHARGETEMP "Conversion method for AME_C_ChargeTemp" RAT_FUNC "%10.0" "C" COEFFS 0.000000 1.000000 0.000000 0.000000 0.000000 1.000000 /end COMPU_METHOD
/* Scalar measurable for DDE 'AME_C_ChargeTempDelta'. */
/begin MEASUREMENT AME_C_ChargeTempDelta "Difference between engine temp and intake manifold air temp (positive when engine is hotter than air)" FLOAT32_IEEE CU_AME_C_CHARGETEMPDELTA 1 100 0.0 0.0 ECU_ADDRESS 0x4000364c BYTE_ORDER MSB_FIRST /end MEASUREMENT
/begin COMPU_METHOD CU_AME_C_CHARGETEMPDELTA "Conversion method for AME_C_ChargeTempDelta" RAT_FUNC "%10.1" "C" COEFFS 0.000000 1.000000 0.000000 0.000000 0.000000 1.000000 /end COMPU_METHOD
/* Scalar measurable for DDE 'AME_b_LearnedBaro'. */
/begin MEASUREMENT AME_b_LearnedBaro "Status flag" UBYTE CU_AME_B_LEARNEDBARO 1 100 0.0 1.0 ECU_ADDRESS 0x40002eb9 BYTE_ORDER MSB_FIRST /end MEASUREMENT
/begin COMPU_METHOD CU_AME_B_LEARNEDBARO "Conversion method for AME_b_LearnedBaro" RAT_FUNC "%10.0" "b" COEFFS 0.000000 1.000000 0.000000 0.000000 0.000000 1.000000 /end COMPU_METHOD
/* Scalar measurable for DDE 'AME_b_Transient'. */
/begin MEASUREMENT AME_b_Transient "AME transient detected" UBYTE CU_AME_B_TRANSIENT 1 100 0.0 1.0 ECU_ADDRESS 0x40002ee5 BYTE_ORDER MSB_FIRST /end MEASUREMENT
/begin COMPU_METHOD CU_AME_B_TRANSIENT "Conversion method for AME_b_Transient" RAT_FUNC "%10.0" "b" COEFFS 0.000000 1.000000 0.000000 0.000000 0.000000 1.000000 /end COMPU_METHOD
/* Scalar measurable for DDE 'AME_cc_ChargeVol'. */
/begin MEASUREMENT AME_cc_ChargeVol "Volume of air charge" FLOAT32_IEEE CU_AME_CC_CHARGEVOL 1 100 0.0 2000.0 ECU_ADDRESS 0x40003654 BYTE_ORDER MSB_FIRST /end MEASUREMENT
/begin COMPU_METHOD CU_AME_CC_CHARGEVOL "Conversion method for AME_cc_ChargeVol" RAT_FUNC "%10.2" "cc" COEFFS 0.000000 1.000000 0.000000 0.000000 0.000000 1.000000 /end COMPU_METHOD
/* Scalar measurable for DDE 'AME_gps_FreshMassAirFlow'. */
/begin MEASUREMENT AME_gps_FreshMassAirFlow "Final estimate of fresh air quantity that enters the cylinder" FLOAT32_IEEE CU_AME_GPS_FRESHMASSAIRFLOW 1 100 0.0 0.0 ECU_ADDRESS 0x40003618 BYTE_ORDER MSB_FIRST /end MEASUREMENT
/begin COMPU_METHOD CU_AME_GPS_FRESHMASSAIRFLOW "Conversion method for AME_gps_FreshMassAirFlow" RAT_FUNC "%10.1" "gps" COEFFS 0.000000 1.000000 0.000000 0.000000 0.000000 1.000000 /end COMPU_METHOD
/* Scalar measurable for DDE 'AME_gps_IdealAirAtSTP'. */
/begin MEASUREMENT AME_gps_IdealAirAtSTP "Ideal airflow at STP for the current engine speed and displacement" FLOAT32_IEEE CU_AME_GPS_IDEALAIRATSTP 1 100 0.0 0.0 ECU_ADDRESS 0x40003614 BYTE_ORDER MSB_FIRST /end MEASUREMENT
/begin COMPU_METHOD CU_AME_GPS_IDEALAIRATSTP "Conversion method for AME_gps_IdealAirAtSTP" RAT_FUNC "%10.1" "gps" COEFFS 0.000000 1.000000 0.000000 0.000000 0.000000 1.000000 /end COMPU_METHOD
/* Scalar measurable for DDE 'AME_gps_MAF_Corr'. */
/begin MEASUREMENT AME_gps_MAF_Corr "MAF sensor after speed/load correction" FLOAT32_IEEE CU_AME_GPS_MAF_CORR 1 100 0.0 0.0 ECU_ADDRESS 0x40003630 BYTE_ORDER MSB_FIRST /end MEASUREMENT
/begin COMPU_METHOD CU_AME_GPS_MAF_CORR "Conversion method for AME_gps_MAF_Corr" RAT_FUNC "%10.1" "gps" COEFFS 0.000000 1.000000 0.000000 0.000000 0.000000 1.000000 /end COMPU_METHOD
/* Scalar measurable for DDE 'AME_gps_MAF_FreshMassAirFlow'. */
/begin MEASUREMENT AME_gps_MAF_FreshMassAirFlow "Mass air flow excluding EGR reported by MAF sensor" FLOAT32_IEEE CU_AME_GPS_MAF_FRESHMASSAIRFLOW 1 100 0.0 500.0 ECU_ADDRESS 0x4000362c BYTE_ORDER MSB_FIRST /end MEASUREMENT
/begin COMPU_METHOD CU_AME_GPS_MAF_FRESHMASSAIRFLOW "Conversion method for AME_gps_MAF_FreshMassAirFlow" RAT_FUNC "%10.1" "gps" COEFFS 0.000000 1.000000 0.000000 0.000000 0.000000 1.000000 /end COMPU_METHOD
/* Scalar measurable for DDE 'AME_gps_MassAirFlowUncorr'. */
/begin MEASUREMENT AME_gps_MassAirFlowUncorr "Airflow estimate before transient correction" FLOAT32_IEEE CU_AME_GPS_MASSAIRFLOWUNCORR 1 100 0.0 0.0 ECU_ADDRESS 0x40003628 BYTE_ORDER MSB_FIRST /end MEASUREMENT
/begin COMPU_METHOD CU_AME_GPS_MASSAIRFLOWUNCORR "Conversion method for AME_gps_MassAirFlowUncorr" RAT_FUNC "%10.2" "gps" COEFFS 0.000000 1.000000 0.000000 0.000000 0.000000 1.000000 /end COMPU_METHOD
/* Scalar measurable for DDE 'AME_gps_MassAirFlowUnfiltd'. */
/begin MEASUREMENT AME_gps_MassAirFlowUnfiltd "mass flow estimate before LPF" FLOAT32_IEEE CU_AME_GPS_MASSAIRFLOWUNFILTD 1 100 0.0 0.0 ECU_ADDRESS 0x4000361c BYTE_ORDER MSB_FIRST /end MEASUREMENT
/begin COMPU_METHOD CU_AME_GPS_MASSAIRFLOWUNFILTD "Conversion method for AME_gps_MassAirFlowUnfiltd" RAT_FUNC "%10.2" "gps" COEFFS 0.000000 1.000000 0.000000 0.000000 0.000000 1.000000 /end COMPU_METHOD
/* Scalar measurable for DDE 'AME_gps_SD_FreshMassAirFlow'. */
/begin MEASUREMENT AME_gps_SD_FreshMassAirFlow "Mass air flow excluding EGR calculated using speed density" FLOAT32_IEEE CU_AME_GPS_SD_FRESHMASSAIRFLOW 1 100 0.0 500.0 ECU_ADDRESS 0x4000363c BYTE_ORDER MSB_FIRST /end MEASUREMENT
/begin COMPU_METHOD CU_AME_GPS_SD_FRESHMASSAIRFLOW "Conversion method for AME_gps_SD_FreshMassAirFlow" RAT_FUNC "%10.1" "gps" COEFFS 0.000000 1.000000 0.000000 0.000000 0.000000 1.000000 /end COMPU_METHOD
/* Scalar measurable for DDE 'AME_gps_SD_MassAirFlow'. */
/begin MEASUREMENT AME_gps_SD_MassAirFlow "Mass air flow estimate from speed density calculation" FLOAT32_IEEE CU_AME_GPS_SD_MASSAIRFLOW 1 100 0.0 500.0 ECU_ADDRESS 0x40003640 BYTE_ORDER MSB_FIRST /end MEASUREMENT
/begin COMPU_METHOD CU_AME_GPS_SD_MASSAIRFLOW "Conversion method for AME_gps_SD_MassAirFlow" RAT_FUNC "%10.1" "gps" COEFFS 0.000000 1.000000 0.000000 0.000000 0.000000 1.000000 /end COMPU_METHOD
/* Scalar measurable for DDE 'AME_kPa_ChargePress'. */
/begin MEASUREMENT AME_kPa_ChargePress "Pressure of air charge" FLOAT32_IEEE CU_AME_KPA_CHARGEPRESS 1 100 0.0 200.0 ECU_ADDRESS 0x4000365c BYTE_ORDER MSB_FIRST /end MEASUREMENT
/begin COMPU_METHOD CU_AME_KPA_CHARGEPRESS "Conversion method for AME_kPa_ChargePress" RAT_FUNC "%10.2" "kPa" COEFFS 0.000000 1.000000 0.000000 0.000000 0.000000 1.000000 /end COMPU_METHOD
/* Scalar measurable for DDE 'AME_mg_SD_AirMassPerCyl'. */
/begin MEASUREMENT AME_mg_SD_AirMassPerCyl "Speed density calculated air mass per cylinder per firing" FLOAT32_IEEE CU_AME_MG_SD_AIRMASSPERCYL 1 100 0.0 500.0 ECU_ADDRESS 0x40003644 BYTE_ORDER MSB_FIRST /end MEASUREMENT
/begin COMPU_METHOD CU_AME_MG_SD_AIRMASSPERCYL "Conversion method for AME_mg_SD_AirMassPerCyl" RAT_FUNC "%10.0" "mg" COEFFS 0.000000 1.000000 0.000000 0.000000 0.000000 1.000000 /end COMPU_METHOD
/* Scalar measurable for DDE 'AME_pct_ChargeTempCF'. */
/begin MEASUREMENT AME_pct_ChargeTempCF "Charge temperature compensation factor" FLOAT32_IEEE CU_AME_PCT_CHARGETEMPCF 1 100 0.0 0.0 ECU_ADDRESS 0x40003650 BYTE_ORDER MSB_FIRST /end MEASUREMENT
/begin COMPU_METHOD CU_AME_PCT_CHARGETEMPCF "Conversion method for AME_pct_ChargeTempCF" RAT_FUNC "%10.2" "pct" COEFFS 0.000000 1.000000 0.000000 0.000000 0.000000 1.000000 /end COMPU_METHOD
/* Scalar measurable for DDE 'AME_pct_DemandHPF_Peak'. */
/begin MEASUREMENT AME_pct_DemandHPF_Peak "Peak value of demand HPF" FLOAT32_IEEE CU_AME_PCT_DEMANDHPF_PEAK 1 100 0.0 0.0 ECU_ADDRESS 0x40003620 BYTE_ORDER MSB_FIRST /end MEASUREMENT
/begin COMPU_METHOD CU_AME_PCT_DEMANDHPF_PEAK "Conversion method for AME_pct_DemandHPF_Peak" RAT_FUNC "%10.3" "pct" COEFFS 0.000000 1.000000 0.000000 0.000000 0.000000 1.000000 /end COMPU_METHOD
/* Scalar measurable for DDE 'AME_pct_DmndHPF'. */
/begin MEASUREMENT AME_pct_DmndHPF "Filtered air demand" FLOAT32_IEEE CU_AME_PCT_DMNDHPF 1 100 0.0 0.0 ECU_ADDRESS 0x40003624 BYTE_ORDER MSB_FIRST /end MEASUREMENT
/begin COMPU_METHOD CU_AME_PCT_DMNDHPF "Conversion method for AME_pct_DmndHPF" RAT_FUNC "%10.2" "pct" COEFFS 0.000000 1.000000 0.000000 0.000000 0.000000 1.000000 /end COMPU_METHOD
/* Scalar measurable for DDE 'AME_pct_MAF_Ofst'. */
/begin MEASUREMENT AME_pct_MAF_Ofst "Table output displayable" FLOAT32_IEEE CU_AME_PCT_MAF_OFST 1 100 0.0 0.0 ECU_ADDRESS 0x40003634 BYTE_ORDER MSB_FIRST /end MEASUREMENT
/begin COMPU_METHOD CU_AME_PCT_MAF_OFST "Conversion method for AME_pct_MAF_Ofst" RAT_FUNC "%10.2" "pct" COEFFS 0.000000 1.000000 0.000000 0.000000 0.000000 1.000000 /end COMPU_METHOD
/* Scalar measurable for DDE 'AME_pct_UseMAF'. */
/begin MEASUREMENT AME_pct_UseMAF "Airmass estimate selection displayable" FLOAT32_IEEE CU_AME_PCT_USEMAF 1 100 0.0 0.0 ECU_ADDRESS 0x40003638 BYTE_ORDER MSB_FIRST /end MEASUREMENT
/begin COMPU_METHOD CU_AME_PCT_USEMAF "Conversion method for AME_pct_UseMAF" RAT_FUNC "%10.2" "pct" COEFFS 0.000000 1.000000 0.000000 0.000000 0.000000 1.000000 /end COMPU_METHOD
/* Scalar measurable for DDE 'AME_pct_VolEff'. */
/begin MEASUREMENT AME_pct_VolEff "volumetric efficiency at current operating point" FLOAT32_IEEE CU_AME_PCT_VOLEFF 1 100 0.0 0.0 ECU_ADDRESS 0x40003658 BYTE_ORDER MSB_FIRST /end MEASUREMENT
/begin COMPU_METHOD CU_AME_PCT_VOLEFF "Conversion method for AME_pct_VolEff" RAT_FUNC "%10.2" "pct" COEFFS 0.000000 1.000000 0.000000 0.000000 0.000000 1.000000 /end COMPU_METHOD
/* Scalar measurable for DDE 'APP_Nm_DrvrTqDmndRaw'. */
/begin MEASUREMENT APP_Nm_DrvrTqDmndRaw "Raw driver torque demand" FLOAT32_IEEE CU_APP_NM_DRVRTQDMNDRAW 1 100 0.0 0.0 ECU_ADDRESS 0x40003590 BYTE_ORDER MSB_FIRST /end MEASUREMENT
/begin COMPU_METHOD CU_APP_NM_DRVRTQDMNDRAW "Conversion method for APP_Nm_DrvrTqDmndRaw" RAT_FUNC "%10.2" "Nm" COEFFS 0.000000 1.000000 0.000000 0.000000 0.000000 1.000000 /end COMPU_METHOD
/* Scalar measurable for DDE 'APP_V_APP1_Filtd'. */
/begin MEASUREMENT APP_V_APP1_Filtd "Filtered accelerator pedal position sensor signal 1" FLOAT32_IEEE CU_APP_V_APP1_FILTD 1 100 0.0 0.0 ECU_ADDRESS 0x400035d0 BYTE_ORDER MSB_FIRST /end MEASUREMENT
/begin COMPU_METHOD CU_APP_V_APP1_FILTD "Conversion method for APP_V_APP1_Filtd" RAT_FUNC "%10.3" "V" COEFFS 0.000000 1.000000 0.000000 0.000000 0.000000 1.000000 /end COMPU_METHOD
/* Scalar measurable for DDE 'APP_V_APP2_Filtd'. */
/begin MEASUREMENT APP_V_APP2_Filtd "Filtered accelerator pedal position sensor signal 2" FLOAT32_IEEE CU_APP_V_APP2_FILTD 1 100 0.0 0.0 ECU_ADDRESS 0x400035e4 BYTE_ORDER MSB_FIRST /end MEASUREMENT
/begin COMPU_METHOD CU_APP_V_APP2_FILTD "Conversion method for APP_V_APP2_Filtd" RAT_FUNC "%10.3" "V" COEFFS 0.000000 1.000000 0.000000 0.000000 0.000000 1.000000 /end COMPU_METHOD
/* Scalar measurable for DDE 'APP_V_FullLearnNewAPP1'. */
/begin MEASUREMENT APP_V_FullLearnNewAPP1 "Accelerator pedal position 1 new full pedal learn position" FLOAT32_IEEE CU_APP_V_FULLLEARNNEWAPP1 1 100 0.0 0.0 ECU_ADDRESS 0x400035c8 BYTE_ORDER MSB_FIRST /end MEASUREMENT
/begin COMPU_METHOD CU_APP_V_FULLLEARNNEWAPP1 "Conversion method for APP_V_FullLearnNewAPP1" RAT_FUNC "%10.3" "V" COEFFS 0.000000 1.000000 0.000000 0.000000 0.000000 1.000000 /end COMPU_METHOD
/* Scalar measurable for DDE 'APP_V_FullLearnNewAPP2'. */
/begin MEASUREMENT APP_V_FullLearnNewAPP2 "Accelerator pedal position 2 new full pedal learn position" FLOAT32_IEEE CU_APP_V_FULLLEARNNEWAPP2 1 100 0.0 0.0 ECU_ADDRESS 0x400035dc BYTE_ORDER MSB_FIRST /end MEASUREMENT
/begin COMPU_METHOD CU_APP_V_FULLLEARNNEWAPP2 "Conversion method for APP_V_FullLearnNewAPP2" RAT_FUNC "%10.3" "V" COEFFS 0.000000 1.000000 0.000000 0.000000 0.000000 1.000000 /end COMPU_METHOD
/* Scalar measurable for DDE 'APP_V_ZeroLearnPosAPP1'. */
/begin MEASUREMENT APP_V_ZeroLearnPosAPP1 "Zero pedal learned value for accelerator pedal position sensor 1" FLOAT32_IEEE CU_APP_V_ZEROLEARNPOSAPP1 1 100 0.0 0.0 ECU_ADDRESS 0x400035cc BYTE_ORDER MSB_FIRST /end MEASUREMENT
/begin COMPU_METHOD CU_APP_V_ZEROLEARNPOSAPP1 "Conversion method for APP_V_ZeroLearnPosAPP1" RAT_FUNC "%10.3" "V" COEFFS 0.000000 1.000000 0.000000 0.000000 0.000000 1.000000 /end COMPU_METHOD
/* Scalar measurable for DDE 'APP_V_ZeroLearnPosAPP2'. */
/begin MEASUREMENT APP_V_ZeroLearnPosAPP2 "Zero pedal learned value for accelerator pedal position sensor 2" FLOAT32_IEEE CU_APP_V_ZEROLEARNPOSAPP2 1 100 0.0 0.0 ECU_ADDRESS 0x400035e0 BYTE_ORDER MSB_FIRST /end MEASUREMENT
/begin COMPU_METHOD CU_APP_V_ZEROLEARNPOSAPP2 "Conversion method for APP_V_ZeroLearnPosAPP2" RAT_FUNC "%10.3" "V" COEFFS 0.000000 1.000000 0.000000 0.000000 0.000000 1.000000 /end COMPU_METHOD
/* Scalar measurable for DDE 'APP_b_BrakePedal_actv'. */
/begin MEASUREMENT APP_b_BrakePedal_actv "(not defined)" UBYTE CU_APP_B_BRAKEPEDAL_ACTV 1 100 0.0 1.0 ECU_ADDRESS 0x40002ed5 BYTE_ORDER MSB_FIRST /end MEASUREMENT
/begin COMPU_METHOD CU_APP_B_BRAKEPEDAL_ACTV "Conversion method for APP_b_BrakePedal_actv" RAT_FUNC "%10.0" "b" COEFFS 0.000000 1.000000 0.000000 0.000000 0.000000 1.000000 /end COMPU_METHOD
/* Scalar measurable for DDE 'APP_b_CorrFlt'. */
/begin MEASUREMENT APP_b_CorrFlt "Corr fault active flag" UBYTE CU_APP_B_CORRFLT 1 100 0.0 1.0 ECU_ADDRESS 0x40002ed6 BYTE_ORDER MSB_FIRST /end MEASUREMENT
/begin COMPU_METHOD CU_APP_B_CORRFLT "Conversion method for APP_b_CorrFlt" RAT_FUNC "%10.0" "b" COEFFS 0.000000 1.000000 0.000000 0.000000 0.000000 1.000000 /end COMPU_METHOD
/* Scalar measurable for DDE 'APP_b_EEC1TorqueMode'. */
/begin MEASUREMENT APP_b_EEC1TorqueMode "Lectura modo de par EEC1 activación IDL o APP" UBYTE CU_APP_B_EEC1TORQUEMODE 1 100 0.0 1.0 ECU_ADDRESS 0x40003168 BYTE_ORDER MSB_FIRST /end MEASUREMENT
/begin COMPU_METHOD CU_APP_B_EEC1TORQUEMODE "Conversion method for APP_b_EEC1TorqueMode" RAT_FUNC "%10.0" "b" COEFFS 0.000000 1.000000 0.000000 0.000000 0.000000 1.000000 /end COMPU_METHOD
/* Scalar measurable for DDE 'APP_b_ZeroLearnEnAPP1'. */
/begin MEASUREMENT APP_b_ZeroLearnEnAPP1 "Zero pedal learn enabled" UBYTE CU_APP_B_ZEROLEARNENAPP1 1 100 0.0 1.0 ECU_ADDRESS 0x40002ed8 BYTE_ORDER MSB_FIRST /end MEASUREMENT
/begin COMPU_METHOD CU_APP_B_ZEROLEARNENAPP1 "Conversion method for APP_b_ZeroLearnEnAPP1" RAT_FUNC "%10.0" "b" COEFFS 0.000000 1.000000 0.000000 0.000000 0.000000 1.000000 /end COMPU_METHOD
/* Scalar measurable for DDE 'APP_b_ZeroLearnEnAPP2'. */
/begin MEASUREMENT APP_b_ZeroLearnEnAPP2 "Zero pedal learn enabled" UBYTE CU_APP_B_ZEROLEARNENAPP2 1 100 0.0 1.0 ECU_ADDRESS 0x40002eda BYTE_ORDER MSB_FIRST /end MEASUREMENT
/begin COMPU_METHOD CU_APP_B_ZEROLEARNENAPP2 "Conversion method for APP_b_ZeroLearnEnAPP2" RAT_FUNC "%10.0" "b" COEFFS 0.000000 1.000000 0.000000 0.000000 0.000000 1.000000 /end COMPU_METHOD
/* Scalar measurable for DDE 'APP_kph_VehSpeed'. */
/begin MEASUREMENT APP_kph_VehSpeed "Condición 80KM/h speed limit" FLOAT32_IEEE CU_APP_KPH_VEHSPEED 1 100 0.0 0.0 ECU_ADDRESS 0x4000370c BYTE_ORDER MSB_FIRST /end MEASUREMENT
/begin COMPU_METHOD CU_APP_KPH_VEHSPEED "Conversion method for APP_kph_VehSpeed" RAT_FUNC "%10.2" "pct" COEFFS 0.000000 1.000000 0.000000 0.000000 0.000000 1.000000 /end COMPU_METHOD
/* Scalar measurable for DDE 'APP_pct_APP1'. */
/begin MEASUREMENT APP_pct_APP1 "Accelerator pedal position 1 percent" FLOAT32_IEEE CU_APP_PCT_APP1 1 100 0.0 0.0 ECU_ADDRESS 0x400035c0 BYTE_ORDER MSB_FIRST /end MEASUREMENT
/begin COMPU_METHOD CU_APP_PCT_APP1 "Conversion method for APP_pct_APP1" RAT_FUNC "%10.3" "pct" COEFFS 0.000000 1.000000 0.000000 0.000000 0.000000 1.000000 /end COMPU_METHOD
/* Scalar measurable for DDE 'APP_pct_APP2'. */
/begin MEASUREMENT APP_pct_APP2 "Accelerator pedal position 1 percent" FLOAT32_IEEE CU_APP_PCT_APP2 1 100 0.0 0.0 ECU_ADDRESS 0x400035d4 BYTE_ORDER MSB_FIRST /end MEASUREMENT
/begin COMPU_METHOD CU_APP_PCT_APP2 "Conversion method for APP_pct_APP2" RAT_FUNC "%10.3" "pct" COEFFS 0.000000 1.000000 0.000000 0.000000 0.000000 1.000000 /end COMPU_METHOD
/* Scalar measurable for DDE 'APP_rpm_IN'. */
/begin MEASUREMENT APP_rpm_IN "Displayable" FLOAT32_IEEE CU_APP_RPM_IN 1 100 0.0 0.0 ECU_ADDRESS 0x4000378c BYTE_ORDER MSB_FIRST /end MEASUREMENT
/begin COMPU_METHOD CU_APP_RPM_IN "Conversion method for APP_rpm_IN" RAT_FUNC "%10.0" "NU" COEFFS 0.000000 1.000000 0.000000 0.000000 0.000000 1.000000 /end COMPU_METHOD
/* Scalar measurable for DDE 'APP_rpm_OUT'. */
/begin MEASUREMENT APP_rpm_OUT "Displayable" FLOAT32_IEEE CU_APP_RPM_OUT 1 100 0.0 0.0 ECU_ADDRESS 0x40003790 BYTE_ORDER MSB_FIRST /end MEASUREMENT
/begin COMPU_METHOD CU_APP_RPM_OUT "Conversion method for APP_rpm_OUT" RAT_FUNC "%10.0" "NU" COEFFS 0.000000 1.000000 0.000000 0.000000 0.000000 1.000000 /end COMPU_METHOD
/* Scalar measurable for DDE 'BAF_NU_TrgtAFR1'. */
/begin MEASUREMENT BAF_NU_TrgtAFR1 "Target air fuel ratio" FLOAT32_IEEE CU_BAF_NU_TRGTAFR1 1 100 0.0 20.0 ECU_ADDRESS 0x400034a8 BYTE_ORDER MSB_FIRST /end MEASUREMENT
/begin COMPU_METHOD CU_BAF_NU_TRGTAFR1 "Conversion method for BAF_NU_TrgtAFR1" RAT_FUNC "%10.2" "NU" COEFFS 0.000000 1.000000 0.000000 0.000000 0.000000 1.000000 /end COMPU_METHOD
/* Scalar measurable for DDE 'BAF_mg_FuelRqst1Raw'. */
/begin MEASUREMENT BAF_mg_FuelRqst1Raw "(mg/cyl/firing) Raw torque-making fuel mass request" FLOAT32_IEEE CU_BAF_MG_FUELRQST1RAW 1 100 0.0 0.0 ECU_ADDRESS 0x400034a4 BYTE_ORDER MSB_FIRST /end MEASUREMENT
/begin COMPU_METHOD CU_BAF_MG_FUELRQST1RAW "Conversion method for BAF_mg_FuelRqst1Raw" RAT_FUNC "%10.2" "mg" COEFFS 0.000000 1.000000 0.000000 0.000000 0.000000 1.000000 /end COMPU_METHOD
/* Scalar measurable for DDE 'BAR_b_OBDPressOK'. */
/begin MEASUREMENT BAR_b_OBDPressOK "Displayable" UBYTE CU_BAR_B_OBDPRESSOK 1 100 0.0 1.0 ECU_ADDRESS 0x40002f35 BYTE_ORDER MSB_FIRST /end MEASUREMENT
/begin COMPU_METHOD CU_BAR_B_OBDPRESSOK "Conversion method for BAR_b_OBDPressOK" RAT_FUNC "%10.0" "b" COEFFS 0.000000 1.000000 0.000000 0.000000 0.000000 1.000000 /end COMPU_METHOD
/* Scalar measurable for DDE 'BAS_adv_CrankingSpark'. */
/begin MEASUREMENT BAS_adv_CrankingSpark "Cranking spark advance" FLOAT32_IEEE CU_BAS_ADV_CRANKINGSPARK 1 100 -40.0 0.0 ECU_ADDRESS 0x40003660 BYTE_ORDER MSB_FIRST /end MEASUREMENT
/begin COMPU_METHOD CU_BAS_ADV_CRANKINGSPARK "Conversion method for BAS_adv_CrankingSpark" RAT_FUNC "%10.1" "adv" COEFFS 0.000000 1.000000 0.000000 0.000000 0.000000 1.000000 /end COMPU_METHOD
/* Scalar measurable for DDE 'BAS_adv_MBT_Spark'. */
/begin MEASUREMENT BAS_adv_MBT_Spark "Running point displayable" FLOAT32_IEEE CU_BAS_ADV_MBT_SPARK 1 100 0.0 0.0 ECU_ADDRESS 0x40003608 BYTE_ORDER MSB_FIRST /end MEASUREMENT
/begin COMPU_METHOD CU_BAS_ADV_MBT_SPARK "Conversion method for BAS_adv_MBT_Spark" RAT_FUNC "%10.1" "adv" COEFFS 0.000000 1.000000 0.000000 0.000000 0.000000 1.000000 /end COMPU_METHOD
/* Scalar measurable for DDE 'BAS_adv_MBT_SparkLowGradeFuel'. */
/begin MEASUREMENT BAS_adv_MBT_SparkLowGradeFuel "Running point displayable" FLOAT32_IEEE CU_BAS_ADV_MBT_SPARKLOWGRADEFU0 1 100 0.0 0.0 ECU_ADDRESS 0x4000360c BYTE_ORDER MSB_FIRST /end MEASUREMENT
/begin COMPU_METHOD CU_BAS_ADV_MBT_SPARKLOWGRADEFU0 "Conversion method for BAS_adv_MBT_SparkLowGradeFuel" RAT_FUNC "%10.1" "adv" COEFFS 0.000000 1.000000 0.000000 0.000000 0.000000 1.000000 /end COMPU_METHOD
/* Scalar measurable for DDE 'BAS_b_LowGradeFuel'. */
/begin MEASUREMENT BAS_b_LowGradeFuel "Displayable" UBYTE CU_BAS_B_LOWGRADEFUEL 1 100 0.0 1.0 ECU_ADDRESS 0x40002ee3 BYTE_ORDER MSB_FIRST /end MEASUREMENT
/begin COMPU_METHOD CU_BAS_B_LOWGRADEFUEL "Conversion method for BAS_b_LowGradeFuel" RAT_FUNC "%10.0" "b" COEFFS 0.000000 1.000000 0.000000 0.000000 0.000000 1.000000 /end COMPU_METHOD
/* Scalar measurable for DDE 'BAS_cnt_KnockEvents'. */
/begin MEASUREMENT BAS_cnt_KnockEvents "Calibratable number of times Eng has knocked during one Eng duration" UWORD CU_BAS_CNT_KNOCKEVENTS 1 100 0.0 0.0 ECU_ADDRESS 0x4000302a BYTE_ORDER MSB_FIRST /end MEASUREMENT
/begin COMPU_METHOD CU_BAS_CNT_KNOCKEVENTS "Conversion method for BAS_cnt_KnockEvents" RAT_FUNC "%10.0" "cnt" COEFFS 0.000000 1.000000 0.000000 0.000000 0.000000 1.000000 /end COMPU_METHOD
/* Scalar measurable for DDE 'CIN_NU_EngOvrCtrMd_ESP_B'. */
/begin MEASUREMENT CIN_NU_EngOvrCtrMd_ESP_B "Displayable" FLOAT32_IEEE CU_CIN_NU_ENGOVRCTRMD_ESP_B 1 100 0.0 0.0 ECU_ADDRESS 0x40003708 BYTE_ORDER MSB_FIRST /end MEASUREMENT
/begin COMPU_METHOD CU_CIN_NU_ENGOVRCTRMD_ESP_B "Conversion method for CIN_NU_EngOvrCtrMd_ESP_B" RAT_FUNC "%10.0" "NU" COEFFS 0.000000 1.000000 0.000000 0.000000 0.000000 1.000000 /end COMPU_METHOD
/* Scalar measurable for DDE 'CIN_NU_EngOvrCtrMd_TCM_B'. */
/begin MEASUREMENT CIN_NU_EngOvrCtrMd_TCM_B "Displayable" FLOAT32_IEEE CU_CIN_NU_ENGOVRCTRMD_TCM_B 1 100 0.0 0.0 ECU_ADDRESS 0x40003704 BYTE_ORDER MSB_FIRST /end MEASUREMENT
/begin COMPU_METHOD CU_CIN_NU_ENGOVRCTRMD_TCM_B "Conversion method for CIN_NU_EngOvrCtrMd_TCM_B" RAT_FUNC "%10.0" "NU" COEFFS 0.000000 1.000000 0.000000 0.000000 0.000000 1.000000 /end COMPU_METHOD
/* Scalar measurable for DDE 'CIN_NU_OvrCtrMd_ESP_B'. */
/begin MEASUREMENT CIN_NU_OvrCtrMd_ESP_B "Displayable" FLOAT32_IEEE CU_CIN_NU_OVRCTRMD_ESP_B 1 100 0.0 0.0 ECU_ADDRESS 0x400036f4 BYTE_ORDER MSB_FIRST /end MEASUREMENT
/begin COMPU_METHOD CU_CIN_NU_OVRCTRMD_ESP_B "Conversion method for CIN_NU_OvrCtrMd_ESP_B" RAT_FUNC "%10.0" "NU" COEFFS 0.000000 1.000000 0.000000 0.000000 0.000000 1.000000 /end COMPU_METHOD
/* Scalar measurable for DDE 'CIN_NU_OvrCtrMd_TCM_B'. */
/begin MEASUREMENT CIN_NU_OvrCtrMd_TCM_B "Displayable" FLOAT32_IEEE CU_CIN_NU_OVRCTRMD_TCM_B 1 100 0.0 0.0 ECU_ADDRESS 0x400036fc BYTE_ORDER MSB_FIRST /end MEASUREMENT
/begin COMPU_METHOD CU_CIN_NU_OVRCTRMD_TCM_B "Conversion method for CIN_NU_OvrCtrMd_TCM_B" RAT_FUNC "%10.0" "NU" COEFFS 0.000000 1.000000 0.000000 0.000000 0.000000 1.000000 /end COMPU_METHOD
/* Scalar measurable for DDE 'CIN_pct_TqCtrRq_ESP_B'. */
/begin MEASUREMENT CIN_pct_TqCtrRq_ESP_B "Displayable" FLOAT32_IEEE CU_CIN_PCT_TQCTRRQ_ESP_B 1 100 0.0 0.0 ECU_ADDRESS 0x400036f8 BYTE_ORDER MSB_FIRST /end MEASUREMENT
/begin COMPU_METHOD CU_CIN_PCT_TQCTRRQ_ESP_B "Conversion method for CIN_pct_TqCtrRq_ESP_B" RAT_FUNC "%10.0" "pct" COEFFS 0.000000 1.000000 0.000000 0.000000 0.000000 1.000000 /end COMPU_METHOD
/* Scalar measurable for DDE 'CIN_pct_TqCtrRq_TCM_B'. */
/begin MEASUREMENT CIN_pct_TqCtrRq_TCM_B "Displayable" FLOAT32_IEEE CU_CIN_PCT_TQCTRRQ_TCM_B 1 100 0.0 0.0 ECU_ADDRESS 0x40003700 BYTE_ORDER MSB_FIRST /end MEASUREMENT
/begin COMPU_METHOD CU_CIN_PCT_TQCTRRQ_TCM_B "Conversion method for CIN_pct_TqCtrRq_TCM_B" RAT_FUNC "%10.0" "pct" COEFFS 0.000000 1.000000 0.000000 0.000000 0.000000 1.000000 /end COMPU_METHOD
/* Scalar measurable for DDE 'CLF_NU_DGainFast1'. */
/begin MEASUREMENT CLF_NU_DGainFast1 "Convenience displayable" FLOAT32_IEEE CU_CLF_NU_DGAINFAST1 1 100 0.0 0.0 ECU_ADDRESS 0x40003520 BYTE_ORDER MSB_FIRST /end MEASUREMENT
/begin COMPU_METHOD CU_CLF_NU_DGAINFAST1 "Conversion method for CLF_NU_DGainFast1" RAT_FUNC "%10.4" "NU" COEFFS 0.000000 1.000000 0.000000 0.000000 0.000000 1.000000 /end COMPU_METHOD
/* Scalar measurable for DDE 'CLF_NU_DGainFast2'. */
/begin MEASUREMENT CLF_NU_DGainFast2 "Convenience displayable" FLOAT32_IEEE CU_CLF_NU_DGAINFAST2 1 100 0.0 0.0 ECU_ADDRESS 0x400034f8 BYTE_ORDER MSB_FIRST /end MEASUREMENT
/begin COMPU_METHOD CU_CLF_NU_DGAINFAST2 "Conversion method for CLF_NU_DGainFast2" RAT_FUNC "%10.4" "NU" COEFFS 0.000000 1.000000 0.000000 0.000000 0.000000 1.000000 /end COMPU_METHOD
/* Scalar measurable for DDE 'CLF_NU_DGainSlow1'. */
/begin MEASUREMENT CLF_NU_DGainSlow1 "Convenience displayable" FLOAT32_IEEE CU_CLF_NU_DGAINSLOW1 1 100 0.0 0.0 ECU_ADDRESS 0x40003514 BYTE_ORDER MSB_FIRST /end MEASUREMENT
/begin COMPU_METHOD CU_CLF_NU_DGAINSLOW1 "Conversion method for CLF_NU_DGainSlow1" RAT_FUNC "%10.4" "NU" COEFFS 0.000000 1.000000 0.000000 0.000000 0.000000 1.000000 /end COMPU_METHOD
/* Scalar measurable for DDE 'CLF_NU_DGainSlow2'. */
/begin MEASUREMENT CLF_NU_DGainSlow2 "Convenience displayable" FLOAT32_IEEE CU_CLF_NU_DGAINSLOW2 1 100 0.0 0.0 ECU_ADDRESS 0x400034e8 BYTE_ORDER MSB_FIRST /end MEASUREMENT
/begin COMPU_METHOD CU_CLF_NU_DGAINSLOW2 "Conversion method for CLF_NU_DGainSlow2" RAT_FUNC "%10.4" "NU" COEFFS 0.000000 1.000000 0.000000 0.000000 0.000000 1.000000 /end COMPU_METHOD
/* Scalar measurable for DDE 'CLF_NU_FB1_ErrorDot'. */
/begin MEASUREMENT CLF_NU_FB1_ErrorDot "Error derivative" FLOAT32_IEEE CU_CLF_NU_FB1_ERRORDOT 1 100 0.0 0.0 ECU_ADDRESS 0x40003508 BYTE_ORDER MSB_FIRST /end MEASUREMENT
/begin COMPU_METHOD CU_CLF_NU_FB1_ERRORDOT "Conversion method for CLF_NU_FB1_ErrorDot" RAT_FUNC "%10.3" "NU" COEFFS 0.000000 1.000000 0.000000 0.000000 0.000000 1.000000 /end COMPU_METHOD
/* Scalar measurable for DDE 'CLF_NU_FB2_ErrorDot'. */
/begin MEASUREMENT CLF_NU_FB2_ErrorDot "Error derivative" FLOAT32_IEEE CU_CLF_NU_FB2_ERRORDOT 1 100 0.0 0.0 ECU_ADDRESS 0x400034d8 BYTE_ORDER MSB_FIRST /end MEASUREMENT
/begin COMPU_METHOD CU_CLF_NU_FB2_ERRORDOT "Conversion method for CLF_NU_FB2_ErrorDot" RAT_FUNC "%10.3" "NU" COEFFS 0.000000 1.000000 0.000000 0.000000 0.000000 1.000000 /end COMPU_METHOD
/* Scalar measurable for DDE 'CLF_NU_IGainFast1'. */
/begin MEASUREMENT CLF_NU_IGainFast1 "Convenience displayable" FLOAT32_IEEE CU_CLF_NU_IGAINFAST1 1 100 0.0 0.0 ECU_ADDRESS 0x40003524 BYTE_ORDER MSB_FIRST /end MEASUREMENT
/begin COMPU_METHOD CU_CLF_NU_IGAINFAST1 "Conversion method for CLF_NU_IGainFast1" RAT_FUNC "%10.4" "NU" COEFFS 0.000000 1.000000 0.000000 0.000000 0.000000 1.000000 /end COMPU_METHOD
/* Scalar measurable for DDE 'CLF_NU_IGainFast2'. */
/begin MEASUREMENT CLF_NU_IGainFast2 "Convenience displayable" FLOAT32_IEEE CU_CLF_NU_IGAINFAST2 1 100 0.0 0.0 ECU_ADDRESS 0x400034fc BYTE_ORDER MSB_FIRST /end MEASUREMENT
/begin COMPU_METHOD CU_CLF_NU_IGAINFAST2 "Conversion method for CLF_NU_IGainFast2" RAT_FUNC "%10.4" "NU" COEFFS 0.000000 1.000000 0.000000 0.000000 0.000000 1.000000 /end COMPU_METHOD
/* Scalar measurable for DDE 'CLF_NU_IGainSlow1'. */
/begin MEASUREMENT CLF_NU_IGainSlow1 "Convenience displayable" FLOAT32_IEEE CU_CLF_NU_IGAINSLOW1 1 100 0.0 0.0 ECU_ADDRESS 0x40003518 BYTE_ORDER MSB_FIRST /end MEASUREMENT
/begin COMPU_METHOD CU_CLF_NU_IGAINSLOW1 "Conversion method for CLF_NU_IGainSlow1" RAT_FUNC "%10.4" "NU" COEFFS 0.000000 1.000000 0.000000 0.000000 0.000000 1.000000 /end COMPU_METHOD
/* Scalar measurable for DDE 'CLF_NU_IGainSlow2'. */
/begin MEASUREMENT CLF_NU_IGainSlow2 "Convenience displayable" FLOAT32_IEEE CU_CLF_NU_IGAINSLOW2 1 100 0.0 0.0 ECU_ADDRESS 0x400034ec BYTE_ORDER MSB_FIRST /end MEASUREMENT
/begin COMPU_METHOD CU_CLF_NU_IGAINSLOW2 "Conversion method for CLF_NU_IGainSlow2" RAT_FUNC "%10.4" "NU" COEFFS 0.000000 1.000000 0.000000 0.000000 0.000000 1.000000 /end COMPU_METHOD
/* Scalar measurable for DDE 'CLF_NU_PGainFast1'. */
/begin MEASUREMENT CLF_NU_PGainFast1 "Convenience displayable" FLOAT32_IEEE CU_CLF_NU_PGAINFAST1 1 100 0.0 0.0 ECU_ADDRESS 0x40003528 BYTE_ORDER MSB_FIRST /end MEASUREMENT
/begin COMPU_METHOD CU_CLF_NU_PGAINFAST1 "Conversion method for CLF_NU_PGainFast1" RAT_FUNC "%10.4" "NU" COEFFS 0.000000 1.000000 0.000000 0.000000 0.000000 1.000000 /end COMPU_METHOD
/* Scalar measurable for DDE 'CLF_NU_PGainFast2'. */
/begin MEASUREMENT CLF_NU_PGainFast2 "Convenience displayable" FLOAT32_IEEE CU_CLF_NU_PGAINFAST2 1 100 0.0 0.0 ECU_ADDRESS 0x40003500 BYTE_ORDER MSB_FIRST /end MEASUREMENT
/begin COMPU_METHOD CU_CLF_NU_PGAINFAST2 "Conversion method for CLF_NU_PGainFast2" RAT_FUNC "%10.4" "NU" COEFFS 0.000000 1.000000 0.000000 0.000000 0.000000 1.000000 /end COMPU_METHOD
/* Scalar measurable for DDE 'CLF_NU_PGainSlow1'. */
/begin MEASUREMENT CLF_NU_PGainSlow1 "Convenience displayable" FLOAT32_IEEE CU_CLF_NU_PGAINSLOW1 1 100 0.0 0.0 ECU_ADDRESS 0x4000351c BYTE_ORDER MSB_FIRST /end MEASUREMENT
/begin COMPU_METHOD CU_CLF_NU_PGAINSLOW1 "Conversion method for CLF_NU_PGainSlow1" RAT_FUNC "%10.4" "NU" COEFFS 0.000000 1.000000 0.000000 0.000000 0.000000 1.000000 /end COMPU_METHOD
/* Scalar measurable for DDE 'CLF_NU_PGainSlow2'. */
/begin MEASUREMENT CLF_NU_PGainSlow2 "Convenience displayable" FLOAT32_IEEE CU_CLF_NU_PGAINSLOW2 1 100 0.0 0.0 ECU_ADDRESS 0x400034f0 BYTE_ORDER MSB_FIRST /end MEASUREMENT
/begin COMPU_METHOD CU_CLF_NU_PGAINSLOW2 "Conversion method for CLF_NU_PGainSlow2" RAT_FUNC "%10.4" "NU" COEFFS 0.000000 1.000000 0.000000 0.000000 0.000000 1.000000 /end COMPU_METHOD
/* Scalar measurable for DDE 'CLF_RPM_EngSpdHPF'. */
/begin MEASUREMENT CLF_RPM_EngSpdHPF "HPF result displayable" FLOAT32_IEEE CU_CLF_RPM_ENGSPDHPF 1 100 0.0 0.0 ECU_ADDRESS 0x40003538 BYTE_ORDER MSB_FIRST /end MEASUREMENT
/begin COMPU_METHOD CU_CLF_RPM_ENGSPDHPF "Conversion method for CLF_RPM_EngSpdHPF" RAT_FUNC "%10.1" "RPM" COEFFS 0.000000 1.000000 0.000000 0.000000 0.000000 1.000000 /end COMPU_METHOD
/* Scalar measurable for DDE 'CLF_b_Dither1Active'. */
/begin MEASUREMENT CLF_b_Dither1Active "Displayable" UBYTE CU_CLF_B_DITHER1ACTIVE 1 100 0.0 1.0 ECU_ADDRESS 0x40002eb7 BYTE_ORDER MSB_FIRST /end MEASUREMENT
/begin COMPU_METHOD CU_CLF_B_DITHER1ACTIVE "Conversion method for CLF_b_Dither1Active" RAT_FUNC "%10.0" "b" COEFFS 0.000000 1.000000 0.000000 0.000000 0.000000 1.000000 /end COMPU_METHOD
/* Scalar measurable for DDE 'CLF_b_Dither1Lean'. */
/begin MEASUREMENT CLF_b_Dither1Lean "Displayable" UBYTE CU_CLF_B_DITHER1LEAN 1 100 0.0 1.0 ECU_ADDRESS 0x40002e6b BYTE_ORDER MSB_FIRST /end MEASUREMENT
/begin COMPU_METHOD CU_CLF_B_DITHER1LEAN "Conversion method for CLF_b_Dither1Lean" RAT_FUNC "%10.0" "b" COEFFS 0.000000 1.000000 0.000000 0.000000 0.000000 1.000000 /end COMPU_METHOD
/* Scalar measurable for DDE 'CLF_b_Dither1Rich'. */
/begin MEASUREMENT CLF_b_Dither1Rich "Displayable" UBYTE CU_CLF_B_DITHER1RICH 1 100 0.0 1.0 ECU_ADDRESS 0x40002e6a BYTE_ORDER MSB_FIRST /end MEASUREMENT
/begin COMPU_METHOD CU_CLF_B_DITHER1RICH "Conversion method for CLF_b_Dither1Rich" RAT_FUNC "%10.0" "b" COEFFS 0.000000 1.000000 0.000000 0.000000 0.000000 1.000000 /end COMPU_METHOD
/* Scalar measurable for DDE 'CLF_b_Dither2Active'. */
/begin MEASUREMENT CLF_b_Dither2Active "Displayable" UBYTE CU_CLF_B_DITHER2ACTIVE 1 100 0.0 1.0 ECU_ADDRESS 0x40002eb6 BYTE_ORDER MSB_FIRST /end MEASUREMENT
/begin COMPU_METHOD CU_CLF_B_DITHER2ACTIVE "Conversion method for CLF_b_Dither2Active" RAT_FUNC "%10.0" "b" COEFFS 0.000000 1.000000 0.000000 0.000000 0.000000 1.000000 /end COMPU_METHOD
/* Scalar measurable for DDE 'CLF_b_Dither2Lean'. */
/begin MEASUREMENT CLF_b_Dither2Lean "Displayable" UBYTE CU_CLF_B_DITHER2LEAN 1 100 0.0 1.0 ECU_ADDRESS 0x40002e6d BYTE_ORDER MSB_FIRST /end MEASUREMENT
/begin COMPU_METHOD CU_CLF_B_DITHER2LEAN "Conversion method for CLF_b_Dither2Lean" RAT_FUNC "%10.0" "b" COEFFS 0.000000 1.000000 0.000000 0.000000 0.000000 1.000000 /end COMPU_METHOD
/* Scalar measurable for DDE 'CLF_b_Dither2Rich'. */
/begin MEASUREMENT CLF_b_Dither2Rich "Displayable" UBYTE CU_CLF_B_DITHER2RICH 1 100 0.0 1.0 ECU_ADDRESS 0x40002e6c BYTE_ORDER MSB_FIRST /end MEASUREMENT
/begin COMPU_METHOD CU_CLF_B_DITHER2RICH "Conversion method for CLF_b_Dither2Rich" RAT_FUNC "%10.0" "b" COEFFS 0.000000 1.000000 0.000000 0.000000 0.000000 1.000000 /end COMPU_METHOD
/* Scalar measurable for DDE 'CLF_b_DitherLamErrorActv'. */
/begin MEASUREMENT CLF_b_DitherLamErrorActv "Displayable" UBYTE CU_CLF_B_DITHERLAMERRORACTV 1 100 0.0 1.0 ECU_ADDRESS 0x40002ecd BYTE_ORDER MSB_FIRST /end MEASUREMENT
/begin COMPU_METHOD CU_CLF_B_DITHERLAMERRORACTV "Conversion method for CLF_b_DitherLamErrorActv" RAT_FUNC "%10.0" "b" COEFFS 0.000000 1.000000 0.000000 0.000000 0.000000 1.000000 /end COMPU_METHOD
/* Scalar measurable for DDE 'CLF_b_FB1_Enbld'. */
/begin MEASUREMENT CLF_b_FB1_Enbld "FB status" UBYTE CU_CLF_B_FB1_ENBLD 1 100 0.0 1.0 ECU_ADDRESS 0x40002ecb BYTE_ORDER MSB_FIRST /end MEASUREMENT
/begin COMPU_METHOD CU_CLF_B_FB1_ENBLD "Conversion method for CLF_b_FB1_Enbld" RAT_FUNC "%10.0" "b" COEFFS 0.000000 1.000000 0.000000 0.000000 0.000000 1.000000 /end COMPU_METHOD
/* Scalar measurable for DDE 'CLF_b_FB2_Enbld'. */
/begin MEASUREMENT CLF_b_FB2_Enbld "FB status" UBYTE CU_CLF_B_FB2_ENBLD 1 100 0.0 1.0 ECU_ADDRESS 0x40002ec6 BYTE_ORDER MSB_FIRST /end MEASUREMENT
/begin COMPU_METHOD CU_CLF_B_FB2_ENBLD "Conversion method for CLF_b_FB2_Enbld" RAT_FUNC "%10.0" "b" COEFFS 0.000000 1.000000 0.000000 0.000000 0.000000 1.000000 /end COMPU_METHOD
/* Scalar measurable for DDE 'CLF_b_FastFB1'. */
/begin MEASUREMENT CLF_b_FastFB1 "State displayable" UBYTE CU_CLF_B_FASTFB1 1 100 0.0 1.0 ECU_ADDRESS 0x40002e67 BYTE_ORDER MSB_FIRST /end MEASUREMENT
/begin COMPU_METHOD CU_CLF_B_FASTFB1 "Conversion method for CLF_b_FastFB1" RAT_FUNC "%10.0" "b" COEFFS 0.000000 1.000000 0.000000 0.000000 0.000000 1.000000 /end COMPU_METHOD
/* Scalar measurable for DDE 'CLF_b_FastFB2'. */
/begin MEASUREMENT CLF_b_FastFB2 "State displayable" UBYTE CU_CLF_B_FASTFB2 1 100 0.0 1.0 ECU_ADDRESS 0x40002e69 BYTE_ORDER MSB_FIRST /end MEASUREMENT
/begin COMPU_METHOD CU_CLF_B_FASTFB2 "Conversion method for CLF_b_FastFB2" RAT_FUNC "%10.0" "b" COEFFS 0.000000 1.000000 0.000000 0.000000 0.000000 1.000000 /end COMPU_METHOD
/* Scalar measurable for DDE 'CLF_b_InitialFB1_Stable'. */
/begin MEASUREMENT CLF_b_InitialFB1_Stable "Displayable" UBYTE CU_CLF_B_INITIALFB1_STABLE 1 100 0.0 1.0 ECU_ADDRESS 0x40002eca BYTE_ORDER MSB_FIRST /end MEASUREMENT
/begin COMPU_METHOD CU_CLF_B_INITIALFB1_STABLE "Conversion method for CLF_b_InitialFB1_Stable" RAT_FUNC "%10.0" "b" COEFFS 0.000000 1.000000 0.000000 0.000000 0.000000 1.000000 /end COMPU_METHOD
/* Scalar measurable for DDE 'CLF_b_InitialFB2_Stable'. */
/begin MEASUREMENT CLF_b_InitialFB2_Stable "Displayable" UBYTE CU_CLF_B_INITIALFB2_STABLE 1 100 0.0 1.0 ECU_ADDRESS 0x40002ec5 BYTE_ORDER MSB_FIRST /end MEASUREMENT
/begin COMPU_METHOD CU_CLF_B_INITIALFB2_STABLE "Conversion method for CLF_b_InitialFB2_Stable" RAT_FUNC "%10.0" "b" COEFFS 0.000000 1.000000 0.000000 0.000000 0.000000 1.000000 /end COMPU_METHOD
/* Scalar measurable for DDE 'CLF_b_LTFT1_Active'. */
/begin MEASUREMENT CLF_b_LTFT1_Active "LTFT criteria met" UBYTE CU_CLF_B_LTFT1_ACTIVE 1 100 0.0 1.0 ECU_ADDRESS 0x40002ec8 BYTE_ORDER MSB_FIRST /end MEASUREMENT
/begin COMPU_METHOD CU_CLF_B_LTFT1_ACTIVE "Conversion method for CLF_b_LTFT1_Active" RAT_FUNC "%10.0" "b" COEFFS 0.000000 1.000000 0.000000 0.000000 0.000000 1.000000 /end COMPU_METHOD
/* Scalar measurable for DDE 'CLF_b_LTFT1_AdaptFlag'. */
/begin MEASUREMENT CLF_b_LTFT1_AdaptFlag "Adapt status displayable" UBYTE CU_CLF_B_LTFT1_ADAPTFLAG 1 100 0.0 1.0 ECU_ADDRESS 0x40002ec7 BYTE_ORDER MSB_FIRST /end MEASUREMENT
/begin COMPU_METHOD CU_CLF_B_LTFT1_ADAPTFLAG "Conversion method for CLF_b_LTFT1_AdaptFlag" RAT_FUNC "%10.0" "b" COEFFS 0.000000 1.000000 0.000000 0.000000 0.000000 1.000000 /end COMPU_METHOD
/* Scalar measurable for DDE 'CLF_b_LTFT2_Active'. */
/begin MEASUREMENT CLF_b_LTFT2_Active "LTFT criteria met" UBYTE CU_CLF_B_LTFT2_ACTIVE 1 100 0.0 1.0 ECU_ADDRESS 0x40002ec3 BYTE_ORDER MSB_FIRST /end MEASUREMENT
/begin COMPU_METHOD CU_CLF_B_LTFT2_ACTIVE "Conversion method for CLF_b_LTFT2_Active" RAT_FUNC "%10.0" "b" COEFFS 0.000000 1.000000 0.000000 0.000000 0.000000 1.000000 /end COMPU_METHOD
/* Scalar measurable for DDE 'CLF_b_LTFT2_AdaptFlag'. */
/begin MEASUREMENT CLF_b_LTFT2_AdaptFlag "Adapt status displayable" UBYTE CU_CLF_B_LTFT2_ADAPTFLAG 1 100 0.0 1.0 ECU_ADDRESS 0x40002ec2 BYTE_ORDER MSB_FIRST /end MEASUREMENT
/begin COMPU_METHOD CU_CLF_B_LTFT2_ADAPTFLAG "Conversion method for CLF_b_LTFT2_AdaptFlag" RAT_FUNC "%10.0" "b" COEFFS 0.000000 1.000000 0.000000 0.000000 0.000000 1.000000 /end COMPU_METHOD
/* Scalar measurable for DDE 'CLF_b_SlowFB1'. */
/begin MEASUREMENT CLF_b_SlowFB1 "State displayable" UBYTE CU_CLF_B_SLOWFB1 1 100 0.0 1.0 ECU_ADDRESS 0x40002e66 BYTE_ORDER MSB_FIRST /end MEASUREMENT
/begin COMPU_METHOD CU_CLF_B_SLOWFB1 "Conversion method for CLF_b_SlowFB1" RAT_FUNC "%10.0" "b" COEFFS 0.000000 1.000000 0.000000 0.000000 0.000000 1.000000 /end COMPU_METHOD
/* Scalar measurable for DDE 'CLF_b_SlowFB1_Unstable'. */
/begin MEASUREMENT CLF_b_SlowFB1_Unstable "Displayable" UBYTE CU_CLF_B_SLOWFB1_UNSTABLE 1 100 0.0 1.0 ECU_ADDRESS 0x40002ec9 BYTE_ORDER MSB_FIRST /end MEASUREMENT
/begin COMPU_METHOD CU_CLF_B_SLOWFB1_UNSTABLE "Conversion method for CLF_b_SlowFB1_Unstable" RAT_FUNC "%10.0" "b" COEFFS 0.000000 1.000000 0.000000 0.000000 0.000000 1.000000 /end COMPU_METHOD
/* Scalar measurable for DDE 'CLF_b_SlowFB2'. */
/begin MEASUREMENT CLF_b_SlowFB2 "State displayable" UBYTE CU_CLF_B_SLOWFB2 1 100 0.0 1.0 ECU_ADDRESS 0x40002e68 BYTE_ORDER MSB_FIRST /end MEASUREMENT
/begin COMPU_METHOD CU_CLF_B_SLOWFB2 "Conversion method for CLF_b_SlowFB2" RAT_FUNC "%10.0" "b" COEFFS 0.000000 1.000000 0.000000 0.000000 0.000000 1.000000 /end COMPU_METHOD
/* Scalar measurable for DDE 'CLF_b_SlowFB2_Unstable'. */
/begin MEASUREMENT CLF_b_SlowFB2_Unstable "Displayable" UBYTE CU_CLF_B_SLOWFB2_UNSTABLE 1 100 0.0 1.0 ECU_ADDRESS 0x40002ec4 BYTE_ORDER MSB_FIRST /end MEASUREMENT
/begin COMPU_METHOD CU_CLF_B_SLOWFB2_UNSTABLE "Conversion method for CLF_b_SlowFB2_Unstable" RAT_FUNC "%10.0" "b" COEFFS 0.000000 1.000000 0.000000 0.000000 0.000000 1.000000 /end COMPU_METHOD
/* Scalar measurable for DDE 'CLF_cnt_LeanFiringsRqst1'. */
/begin MEASUREMENT CLF_cnt_LeanFiringsRqst1 "Map output displayable" UBYTE CU_CLF_CNT_LEANFIRINGSRQST1 1 100 0.0 0.0 ECU_ADDRESS 0x40002fe5 BYTE_ORDER MSB_FIRST /end MEASUREMENT
/begin COMPU_METHOD CU_CLF_CNT_LEANFIRINGSRQST1 "Conversion method for CLF_cnt_LeanFiringsRqst1" RAT_FUNC "%10.0" "cnt" COEFFS 0.000000 1.000000 0.000000 0.000000 0.000000 1.000000 /end COMPU_METHOD
/* Scalar measurable for DDE 'CLF_cnt_LeanFiringsRqst2'. */
/begin MEASUREMENT CLF_cnt_LeanFiringsRqst2 "Map output displayable" UBYTE CU_CLF_CNT_LEANFIRINGSRQST2 1 100 0.0 0.0 ECU_ADDRESS 0x40002fe3 BYTE_ORDER MSB_FIRST /end MEASUREMENT
/begin COMPU_METHOD CU_CLF_CNT_LEANFIRINGSRQST2 "Conversion method for CLF_cnt_LeanFiringsRqst2" RAT_FUNC "%10.0" "cnt" COEFFS 0.000000 1.000000 0.000000 0.000000 0.000000 1.000000 /end COMPU_METHOD
/* Scalar measurable for DDE 'CLF_cnt_RichFiringsRqst1'. */
/begin MEASUREMENT CLF_cnt_RichFiringsRqst1 "Map output displayable" UBYTE CU_CLF_CNT_RICHFIRINGSRQST1 1 100 0.0 0.0 ECU_ADDRESS 0x40002fe6 BYTE_ORDER MSB_FIRST /end MEASUREMENT
/begin COMPU_METHOD CU_CLF_CNT_RICHFIRINGSRQST1 "Conversion method for CLF_cnt_RichFiringsRqst1" RAT_FUNC "%10.0" "cnt" COEFFS 0.000000 1.000000 0.000000 0.000000 0.000000 1.000000 /end COMPU_METHOD
/* Scalar measurable for DDE 'CLF_cnt_RichFiringsRqst2'. */
/begin MEASUREMENT CLF_cnt_RichFiringsRqst2 "Map output displayable" UBYTE CU_CLF_CNT_RICHFIRINGSRQST2 1 100 0.0 0.0 ECU_ADDRESS 0x40002fe4 BYTE_ORDER MSB_FIRST /end MEASUREMENT
/begin COMPU_METHOD CU_CLF_CNT_RICHFIRINGSRQST2 "Conversion method for CLF_cnt_RichFiringsRqst2" RAT_FUNC "%10.0" "cnt" COEFFS 0.000000 1.000000 0.000000 0.000000 0.000000 1.000000 /end COMPU_METHOD
/* Scalar measurable for DDE 'CLF_lam_DTermLPF1'. */
/begin MEASUREMENT CLF_lam_DTermLPF1 "LPF result displayable" FLOAT32_IEEE CU_CLF_LAM_DTERMLPF1 1 100 0.0 0.0 ECU_ADDRESS 0x4000350c BYTE_ORDER MSB_FIRST /end MEASUREMENT
/begin COMPU_METHOD CU_CLF_LAM_DTERMLPF1 "Conversion method for CLF_lam_DTermLPF1" RAT_FUNC "%10.3" "lam" COEFFS 0.000000 1.000000 0.000000 0.000000 0.000000 1.000000 /end COMPU_METHOD
/* Scalar measurable for DDE 'CLF_lam_DTermLPF2'. */
/begin MEASUREMENT CLF_lam_DTermLPF2 "LPF result displayable" FLOAT32_IEEE CU_CLF_LAM_DTERMLPF2 1 100 0.0 0.0 ECU_ADDRESS 0x400034dc BYTE_ORDER MSB_FIRST /end MEASUREMENT
/begin COMPU_METHOD CU_CLF_LAM_DTERMLPF2 "Conversion method for CLF_lam_DTermLPF2" RAT_FUNC "%10.3" "lam" COEFFS 0.000000 1.000000 0.000000 0.000000 0.000000 1.000000 /end COMPU_METHOD
/* Scalar measurable for DDE 'CLF_lam_Error1ThrshLPF'. */
/begin MEASUREMENT CLF_lam_Error1ThrshLPF "LPF result displayable" FLOAT32_IEEE CU_CLF_LAM_ERROR1THRSHLPF 1 100 0.0 0.0 ECU_ADDRESS 0x40003530 BYTE_ORDER MSB_FIRST /end MEASUREMENT
/begin COMPU_METHOD CU_CLF_LAM_ERROR1THRSHLPF "Conversion method for CLF_lam_Error1ThrshLPF" RAT_FUNC "%10.3" "lam" COEFFS 0.000000 1.000000 0.000000 0.000000 0.000000 1.000000 /end COMPU_METHOD
/* Scalar measurable for DDE 'CLF_lam_Error2ThrshLPF'. */
/begin MEASUREMENT CLF_lam_Error2ThrshLPF "LPF result displayable" FLOAT32_IEEE CU_CLF_LAM_ERROR2THRSHLPF 1 100 0.0 0.0 ECU_ADDRESS 0x400034f4 BYTE_ORDER MSB_FIRST /end MEASUREMENT
/begin COMPU_METHOD CU_CLF_LAM_ERROR2THRSHLPF "Conversion method for CLF_lam_Error2ThrshLPF" RAT_FUNC "%10.3" "lam" COEFFS 0.000000 1.000000 0.000000 0.000000 0.000000 1.000000 /end COMPU_METHOD
/* Scalar measurable for DDE 'CLF_lam_FB1_Error'. */
/begin MEASUREMENT CLF_lam_FB1_Error "Displayable" FLOAT32_IEEE CU_CLF_LAM_FB1_ERROR 1 100 0.0 0.0 ECU_ADDRESS 0x4000353c BYTE_ORDER MSB_FIRST /end MEASUREMENT
/begin COMPU_METHOD CU_CLF_LAM_FB1_ERROR "Conversion method for CLF_lam_FB1_Error" RAT_FUNC "%10.3" "lam" COEFFS 0.000000 1.000000 0.000000 0.000000 0.000000 1.000000 /end COMPU_METHOD
/* Scalar measurable for DDE 'CLF_lam_FB1_ITerm'. */
/begin MEASUREMENT CLF_lam_FB1_ITerm "PID effort displayable" FLOAT32_IEEE CU_CLF_LAM_FB1_ITERM 1 100 0.0 0.0 ECU_ADDRESS 0x4000352c BYTE_ORDER MSB_FIRST /end MEASUREMENT
/begin COMPU_METHOD CU_CLF_LAM_FB1_ITERM "Conversion method for CLF_lam_FB1_ITerm" RAT_FUNC "%10.3" "lam" COEFFS 0.000000 1.000000 0.000000 0.000000 0.000000 1.000000 /end COMPU_METHOD
/* Scalar measurable for DDE 'CLF_lam_FB1_PTerm'. */
/begin MEASUREMENT CLF_lam_FB1_PTerm "PID effort displayable" FLOAT32_IEEE CU_CLF_LAM_FB1_PTERM 1 100 0.0 0.0 ECU_ADDRESS 0x40003510 BYTE_ORDER MSB_FIRST /end MEASUREMENT
/begin COMPU_METHOD CU_CLF_LAM_FB1_PTERM "Conversion method for CLF_lam_FB1_PTerm" RAT_FUNC "%10.3" "lam" COEFFS 0.000000 1.000000 0.000000 0.000000 0.000000 1.000000 /end COMPU_METHOD
/* Scalar measurable for DDE 'CLF_lam_FB2_Error'. */
/begin MEASUREMENT CLF_lam_FB2_Error "Displayable" FLOAT32_IEEE CU_CLF_LAM_FB2_ERROR 1 100 0.0 0.0 ECU_ADDRESS 0x40003504 BYTE_ORDER MSB_FIRST /end MEASUREMENT
/begin COMPU_METHOD CU_CLF_LAM_FB2_ERROR "Conversion method for CLF_lam_FB2_Error" RAT_FUNC "%10.3" "lam" COEFFS 0.000000 1.000000 0.000000 0.000000 0.000000 1.000000 /end COMPU_METHOD
/* Scalar measurable for DDE 'CLF_lam_FB2_ITerm'. */
/begin MEASUREMENT CLF_lam_FB2_ITerm "PID effort displayable" FLOAT32_IEEE CU_CLF_LAM_FB2_ITERM 1 100 0.0 0.0 ECU_ADDRESS 0x400034e0 BYTE_ORDER MSB_FIRST /end MEASUREMENT
/begin COMPU_METHOD CU_CLF_LAM_FB2_ITERM "Conversion method for CLF_lam_FB2_ITerm" RAT_FUNC "%10.3" "lam" COEFFS 0.000000 1.000000 0.000000 0.000000 0.000000 1.000000 /end COMPU_METHOD
/* Scalar measurable for DDE 'CLF_lam_FB2_PTerm'. */
/begin MEASUREMENT CLF_lam_FB2_PTerm "PID effort displayable" FLOAT32_IEEE CU_CLF_LAM_FB2_PTERM 1 100 0.0 0.0 ECU_ADDRESS 0x400034e4 BYTE_ORDER MSB_FIRST /end MEASUREMENT
/begin COMPU_METHOD CU_CLF_LAM_FB2_PTERM "Conversion method for CLF_lam_FB2_PTerm" RAT_FUNC "%10.3" "lam" COEFFS 0.000000 1.000000 0.000000 0.000000 0.000000 1.000000 /end COMPU_METHOD
/* Scalar measurable for DDE 'CLF_lam_UEGO1_DitherAvg'. */
/begin MEASUREMENT CLF_lam_UEGO1_DitherAvg "Sensor value averaged across the most recent dither period" FLOAT32_IEEE CU_CLF_LAM_UEGO1_DITHERAVG 1 100 0.0 0.0 ECU_ADDRESS 0x4000337c BYTE_ORDER MSB_FIRST /end MEASUREMENT
/begin COMPU_METHOD CU_CLF_LAM_UEGO1_DITHERAVG "Conversion method for CLF_lam_UEGO1_DitherAvg" RAT_FUNC "%10.3" "lam" COEFFS 0.000000 1.000000 0.000000 0.000000 0.000000 1.000000 /end COMPU_METHOD
/* Scalar measurable for DDE 'CLF_lam_UEGO2_DitherAvg'. */
/begin MEASUREMENT CLF_lam_UEGO2_DitherAvg "Sensor value averaged across the most recent dither period" FLOAT32_IEEE CU_CLF_LAM_UEGO2_DITHERAVG 1 100 0.0 0.0 ECU_ADDRESS 0x40003378 BYTE_ORDER MSB_FIRST /end MEASUREMENT
/begin COMPU_METHOD CU_CLF_LAM_UEGO2_DITHERAVG "Conversion method for CLF_lam_UEGO2_DitherAvg" RAT_FUNC "%10.3" "lam" COEFFS 0.000000 1.000000 0.000000 0.000000 0.000000 1.000000 /end COMPU_METHOD
/* Scalar measurable for DDE 'CLF_pct_LoadHPF'. */
/begin MEASUREMENT CLF_pct_LoadHPF "HPF result displayable" FLOAT32_IEEE CU_CLF_PCT_LOADHPF 1 100 0.0 0.0 ECU_ADDRESS 0x40003534 BYTE_ORDER MSB_FIRST /end MEASUREMENT
/begin COMPU_METHOD CU_CLF_PCT_LOADHPF "Conversion method for CLF_pct_LoadHPF" RAT_FUNC "%10.3" "pct" COEFFS 0.000000 1.000000 0.000000 0.000000 0.000000 1.000000 /end COMPU_METHOD
/* Scalar measurable for DDE 'CPL_kPa_BoostDelta'. */
/begin MEASUREMENT CPL_kPa_BoostDelta "Difference between MAP and current boost limit (positive implies overboost)" FLOAT32_IEEE CU_CPL_KPA_BOOSTDELTA 1 100 0.0 0.0 ECU_ADDRESS 0x4000345c BYTE_ORDER MSB_FIRST /end MEASUREMENT
/begin COMPU_METHOD CU_CPL_KPA_BOOSTDELTA "Conversion method for CPL_kPa_BoostDelta" RAT_FUNC "%10.0" "kPa" COEFFS 0.000000 1.000000 0.000000 0.000000 0.000000 1.000000 /end COMPU_METHOD
/* Scalar measurable for DDE 'CRU_NU_CurrSpeed'. */
/begin MEASUREMENT CRU_NU_CurrSpeed "(not defined)" FLOAT32_IEEE CU_CRU_NU_CURRSPEED 1 100 0.0 250.0 ECU_ADDRESS 0x400035fc BYTE_ORDER MSB_FIRST /end MEASUREMENT
/begin COMPU_METHOD CU_CRU_NU_CURRSPEED "Conversion method for CRU_NU_CurrSpeed" RAT_FUNC "%10.0" "NU" COEFFS 0.000000 1.000000 0.000000 0.000000 0.000000 1.000000 /end COMPU_METHOD
/* Scalar measurable for DDE 'CRU_NU_LimSpeed'. */
/begin MEASUREMENT CRU_NU_LimSpeed "(not defined)" FLOAT32_IEEE CU_CRU_NU_LIMSPEED 1 100 0.0 250.0 ECU_ADDRESS 0x400035f0 BYTE_ORDER MSB_FIRST /end MEASUREMENT
/begin COMPU_METHOD CU_CRU_NU_LIMSPEED "Conversion method for CRU_NU_LimSpeed" RAT_FUNC "%10.0" "NU" COEFFS 0.000000 1.000000 0.000000 0.000000 0.000000 1.000000 /end COMPU_METHOD
/* Scalar measurable for DDE 'CRU_NU_TargetSpeed'. */
/begin MEASUREMENT CRU_NU_TargetSpeed "(not defined)" FLOAT32_IEEE CU_CRU_NU_TARGETSPEED 1 100 0.0 250.0 ECU_ADDRESS 0x400035ec BYTE_ORDER MSB_FIRST /end MEASUREMENT
/begin COMPU_METHOD CU_CRU_NU_TARGETSPEED "Conversion method for CRU_NU_TargetSpeed" RAT_FUNC "%10.0" "NU" COEFFS 0.000000 1.000000 0.000000 0.000000 0.000000 1.000000 /end COMPU_METHOD
/* Scalar measurable for DDE 'CRU_V_CruiserSET'. */
/begin MEASUREMENT CRU_V_CruiserSET "(not defined)" FLOAT32_IEEE CU_CRU_V_CRUISERSET 1 100 0.0 0.0 ECU_ADDRESS 0x400035f4 BYTE_ORDER MSB_FIRST /end MEASUREMENT
/begin COMPU_METHOD CU_CRU_V_CRUISERSET "Conversion method for CRU_V_CruiserSET" RAT_FUNC "%10.2" "V" COEFFS 0.000000 1.000000 0.000000 0.000000 0.000000 1.000000 /end COMPU_METHOD
/* Scalar measurable for DDE 'CRU_b_Active'. */
/begin MEASUREMENT CRU_b_Active "(not defined)" UBYTE CU_CRU_B_ACTIVE 1 100 0.0 1.0 ECU_ADDRESS 0x400035f8 BYTE_ORDER MSB_FIRST /end MEASUREMENT
/begin COMPU_METHOD CU_CRU_B_ACTIVE "Conversion method for CRU_b_Active" RAT_FUNC "%10.0" "NU" COEFFS 0.000000 1.000000 0.000000 0.000000 0.000000 1.000000 /end COMPU_METHOD
/* Scalar measurable for DDE 'CRU_b_BrakeON'. */
/begin MEASUREMENT CRU_b_BrakeON "(not defined)" UBYTE CU_CRU_B_BRAKEON 1 100 0.0 1.0 ECU_ADDRESS 0x40002ee0 BYTE_ORDER MSB_FIRST /end MEASUREMENT
/begin COMPU_METHOD CU_CRU_B_BRAKEON "Conversion method for CRU_b_BrakeON" RAT_FUNC "%10.0" "NU" COEFFS 0.000000 1.000000 0.000000 0.000000 0.000000 1.000000 /end COMPU_METHOD
/* Scalar measurable for DDE 'CRU_b_Cancel'. */
/begin MEASUREMENT CRU_b_Cancel "(not defined)" UBYTE CU_CRU_B_CANCEL 1 100 0.0 1.0 ECU_ADDRESS 0x40002ede BYTE_ORDER MSB_FIRST /end MEASUREMENT
/begin COMPU_METHOD CU_CRU_B_CANCEL "Conversion method for CRU_b_Cancel" RAT_FUNC "%10.0" "NU" COEFFS 0.000000 1.000000 0.000000 0.000000 0.000000 1.000000 /end COMPU_METHOD
/* Scalar measurable for DDE 'CRU_b_ClunchON'. */
/begin MEASUREMENT CRU_b_ClunchON "(not defined)" UBYTE CU_CRU_B_CLUNCHON 1 100 0.0 1.0 ECU_ADDRESS 0x40002edf BYTE_ORDER MSB_FIRST /end MEASUREMENT
/begin COMPU_METHOD CU_CRU_B_CLUNCHON "Conversion method for CRU_b_ClunchON" RAT_FUNC "%10.0" "NU" COEFFS 0.000000 1.000000 0.000000 0.000000 0.000000 1.000000 /end COMPU_METHOD
/* Scalar measurable for DDE 'CRU_b_DownSpeed'. */
/begin MEASUREMENT CRU_b_DownSpeed "(not defined)" UBYTE CU_CRU_B_DOWNSPEED 1 100 0.0 1.0 ECU_ADDRESS 0x40002edc BYTE_ORDER MSB_FIRST /end MEASUREMENT
/begin COMPU_METHOD CU_CRU_B_DOWNSPEED "Conversion method for CRU_b_DownSpeed" RAT_FUNC "%10.0" "NU" COEFFS 0.000000 1.000000 0.000000 0.000000 0.000000 1.000000 /end COMPU_METHOD
/* Scalar measurable for DDE 'CRU_b_Enable'. */
/begin MEASUREMENT CRU_b_Enable "(not defined)" UBYTE CU_CRU_B_ENABLE 1 100 0.0 1.0 ECU_ADDRESS 0x40002edb BYTE_ORDER MSB_FIRST /end MEASUREMENT
/begin COMPU_METHOD CU_CRU_B_ENABLE "Conversion method for CRU_b_Enable" RAT_FUNC "%10.0" "NU" COEFFS 0.000000 1.000000 0.000000 0.000000 0.000000 1.000000 /end COMPU_METHOD
/* Scalar measurable for DDE 'CRU_b_FootBrake'. */
/begin MEASUREMENT CRU_b_FootBrake "(not defined)" UBYTE CU_CRU_B_FOOTBRAKE 1 100 0.0 1.0 ECU_ADDRESS 0x40002eb4 BYTE_ORDER MSB_FIRST /end MEASUREMENT
/begin COMPU_METHOD CU_CRU_B_FOOTBRAKE "Conversion method for CRU_b_FootBrake" RAT_FUNC "%10.0" "NU" COEFFS 0.000000 1.000000 0.000000 0.000000 0.000000 1.000000 /end COMPU_METHOD
/* Scalar measurable for DDE 'CRU_b_ParkingBrake'. */
/begin MEASUREMENT CRU_b_ParkingBrake "(not defined)" UBYTE CU_CRU_B_PARKINGBRAKE 1 100 0.0 1.0 ECU_ADDRESS 0x40002eb5 BYTE_ORDER MSB_FIRST /end MEASUREMENT
/begin COMPU_METHOD CU_CRU_B_PARKINGBRAKE "Conversion method for CRU_b_ParkingBrake" RAT_FUNC "%10.0" "NU" COEFFS 0.000000 1.000000 0.000000 0.000000 0.000000 1.000000 /end COMPU_METHOD
/* Scalar measurable for DDE 'CRU_b_UpSpeed'. */
/begin MEASUREMENT CRU_b_UpSpeed "(not defined)" UBYTE CU_CRU_B_UPSPEED 1 100 0.0 1.0 ECU_ADDRESS 0x40002edd BYTE_ORDER MSB_FIRST /end MEASUREMENT
/begin COMPU_METHOD CU_CRU_B_UPSPEED "Conversion method for CRU_b_UpSpeed" RAT_FUNC "%10.0" "NU" COEFFS 0.000000 1.000000 0.000000 0.000000 0.000000 1.000000 /end COMPU_METHOD
/* Scalar measurable for DDE 'CTC_lam_FuelEnrichment'. */
/begin MEASUREMENT CTC_lam_FuelEnrichment "Raw charge temp fuel modifier angle" FLOAT32_IEEE CU_CTC_LAM_FUELENRICHMENT 1 100 0.0 0.0 ECU_ADDRESS 0x400034c0 BYTE_ORDER MSB_FIRST /end MEASUREMENT
/begin COMPU_METHOD CU_CTC_LAM_FUELENRICHMENT "Conversion method for CTC_lam_FuelEnrichment" RAT_FUNC "%10.3" "lam" COEFFS 0.000000 1.000000 0.000000 0.000000 0.000000 1.000000 /end COMPU_METHOD
/* Scalar measurable for DDE 'CTC_ret_SparkRqstRaw'. */
/begin MEASUREMENT CTC_ret_SparkRqstRaw "Raw charge temp spark modifier angle" FLOAT32_IEEE CU_CTC_RET_SPARKRQSTRAW 1 100 0.0 0.0 ECU_ADDRESS 0x40003490 BYTE_ORDER MSB_FIRST /end MEASUREMENT
/begin COMPU_METHOD CU_CTC_RET_SPARKRQSTRAW "Conversion method for CTC_ret_SparkRqstRaw" RAT_FUNC "%10.2" "ret" COEFFS 0.000000 1.000000 0.000000 0.000000 0.000000 1.000000 /end COMPU_METHOD
/* Scalar measurable for DDE 'CruiseTorqueRequestRaw_Nm'. */
/begin MEASUREMENT CruiseTorqueRequestRaw_Nm "(not defined)" FLOAT32_IEEE CU_CRUISETORQUEREQUESTRAW_NM 1 100 -10000.0 10000.0 ECU_ADDRESS 0x400035e8 BYTE_ORDER MSB_FIRST /end MEASUREMENT
/begin COMPU_METHOD CU_CRUISETORQUEREQUESTRAW_NM "Conversion method for CruiseTorqueRequestRaw_Nm" RAT_FUNC "%10.2" "NU" COEFFS 0.000000 1.000000 0.000000 0.000000 0.000000 1.000000 /end COMPU_METHOD
/* Scalar measurable for DDE 'Cruiser_State'. */
/begin MEASUREMENT Cruiser_State "CRUISE STATES" FLOAT32_IEEE CU_CRUISER_STATE 1 100 -10.0 10.0 ECU_ADDRESS 0x40003158 BYTE_ORDER MSB_FIRST /end MEASUREMENT
/begin COMPU_METHOD CU_CRUISER_STATE "Conversion method for Cruiser_State" RAT_FUNC "%10.0" "NU" COEFFS 0.000000 1.000000 0.000000 0.000000 0.000000 1.000000 /end COMPU_METHOD
/* Scalar measurable for DDE 'DFC_RPM_EntryThrsh'. */
/begin MEASUREMENT DFC_RPM_EntryThrsh "DFC enable engine speed threshold value" FLOAT32_IEEE CU_DFC_RPM_ENTRYTHRSH 1 100 0.0 0.0 ECU_ADDRESS 0x4000354c BYTE_ORDER MSB_FIRST /end MEASUREMENT
/begin COMPU_METHOD CU_DFC_RPM_ENTRYTHRSH "Conversion method for DFC_RPM_EntryThrsh" RAT_FUNC "%10.0" "RPM" COEFFS 0.000000 1.000000 0.000000 0.000000 0.000000 1.000000 /end COMPU_METHOD
/* Scalar measurable for DDE 'DFC_RPM_ExitThrsh'. */
/begin MEASUREMENT DFC_RPM_ExitThrsh "DFC disable engine speed threshold value" FLOAT32_IEEE CU_DFC_RPM_EXITTHRSH 1 100 0.0 0.0 ECU_ADDRESS 0x40003548 BYTE_ORDER MSB_FIRST /end MEASUREMENT
/begin COMPU_METHOD CU_DFC_RPM_EXITTHRSH "Conversion method for DFC_RPM_ExitThrsh" RAT_FUNC "%10.0" "RPM" COEFFS 0.000000 1.000000 0.000000 0.000000 0.000000 1.000000 /end COMPU_METHOD
/* Scalar measurable for DDE 'DFC_b_DTC_Condition'. */
/begin MEASUREMENT DFC_b_DTC_Condition "Displayable" UBYTE CU_DFC_B_DTC_CONDITION 1 100 0.0 1.0 ECU_ADDRESS 0x40002ed0 BYTE_ORDER MSB_FIRST /end MEASUREMENT
/begin COMPU_METHOD CU_DFC_B_DTC_CONDITION "Conversion method for DFC_b_DTC_Condition" RAT_FUNC "%10.0" "b" COEFFS 0.000000 1.000000 0.000000 0.000000 0.000000 1.000000 /end COMPU_METHOD
/* Scalar measurable for DDE 'DFC_e_State'. */
/begin MEASUREMENT DFC_e_State "DFC state" UBYTE CU_DFC_E_STATE 1 100 0.0 0.0 ECU_ADDRESS 0x40002fe2 BYTE_ORDER MSB_FIRST /end MEASUREMENT
/begin COMPU_METHOD CU_DFC_E_STATE "Conversion method for DFC_e_State" TAB_VERB "%12.0" "e" COMPU_TAB_REF CT_DFC_E_STATE /end COMPU_METHOD
/begin COMPU_VTAB CT_DFC_E_STATE "Conversion method for DFC_e_State" TAB_VERB 3 0 "DFCk_e_Inactive" 1 "DFCk_e_RetardSpark" 3 "DFCk_e_CutFuel" /end COMPU_VTAB
/* Scalar measurable for DDE 'DIN_b_Y13_SB_OL'. */
/begin MEASUREMENT DIN_b_Y13_SB_OL "(not defined)" UBYTE CU_DIN_B_Y13_SB_OL 1 100 0.0 1.0 ECU_ADDRESS 0x40002f3f BYTE_ORDER MSB_FIRST /end MEASUREMENT
/begin COMPU_METHOD CU_DIN_B_Y13_SB_OL "Conversion method for DIN_b_Y13_SB_OL" RAT_FUNC "%10.0" "b" COEFFS 0.000000 1.000000 0.000000 0.000000 0.000000 1.000000 /end COMPU_METHOD
/* Scalar measurable for DDE 'DIN_b_Y17_Enabled'. */
/begin MEASUREMENT DIN_b_Y17_Enabled "(not defined)" UBYTE CU_DIN_B_Y17_ENABLED 1 100 0.0 1.0 ECU_ADDRESS 0x40002f4a BYTE_ORDER MSB_FIRST /end MEASUREMENT
/begin COMPU_METHOD CU_DIN_B_Y17_ENABLED "Conversion method for DIN_b_Y17_Enabled" RAT_FUNC "%10.0" "b" COEFFS 0.000000 1.000000 0.000000 0.000000 0.000000 1.000000 /end COMPU_METHOD
/* Scalar measurable for DDE 'DIN_b_Y17_Fault'. */
/begin MEASUREMENT DIN_b_Y17_Fault "(not defined)" UBYTE CU_DIN_B_Y17_FAULT 1 100 0.0 1.0 ECU_ADDRESS 0x40002f49 BYTE_ORDER MSB_FIRST /end MEASUREMENT
/begin COMPU_METHOD CU_DIN_B_Y17_FAULT "Conversion method for DIN_b_Y17_Fault" RAT_FUNC "%10.0" "b" COEFFS 0.000000 1.000000 0.000000 0.000000 0.000000 1.000000 /end COMPU_METHOD
/* Scalar measurable for DDE 'DIN_b_Y17_OFF_OL'. */
/begin MEASUREMENT DIN_b_Y17_OFF_OL "(not defined)" UBYTE CU_DIN_B_Y17_OFF_OL 1 100 0.0 1.0 ECU_ADDRESS 0x40002f48 BYTE_ORDER MSB_FIRST /end MEASUREMENT
/begin COMPU_METHOD CU_DIN_B_Y17_OFF_OL "Conversion method for DIN_b_Y17_OFF_OL" RAT_FUNC "%10.0" "b" COEFFS 0.000000 1.000000 0.000000 0.000000 0.000000 1.000000 /end COMPU_METHOD
/* Scalar measurable for DDE 'DIN_b_Y17_ON_OL'. */
/begin MEASUREMENT DIN_b_Y17_ON_OL "(not defined)" UBYTE CU_DIN_B_Y17_ON_OL 1 100 0.0 1.0 ECU_ADDRESS 0x40002f47 BYTE_ORDER MSB_FIRST /end MEASUREMENT
/begin COMPU_METHOD CU_DIN_B_Y17_ON_OL "Conversion method for DIN_b_Y17_ON_OL" RAT_FUNC "%10.0" "b" COEFFS 0.000000 1.000000 0.000000 0.000000 0.000000 1.000000 /end COMPU_METHOD
/* Scalar measurable for DDE 'DIN_b_Y17_OV'. */
/begin MEASUREMENT DIN_b_Y17_OV "(not defined)" UBYTE CU_DIN_B_Y17_OV 1 100 0.0 1.0 ECU_ADDRESS 0x40002f46 BYTE_ORDER MSB_FIRST /end MEASUREMENT
/begin COMPU_METHOD CU_DIN_B_Y17_OV "Conversion method for DIN_b_Y17_OV" RAT_FUNC "%10.0" "b" COEFFS 0.000000 1.000000 0.000000 0.000000 0.000000 1.000000 /end COMPU_METHOD
/* Scalar measurable for DDE 'DIN_b_Y17_Reset'. */
/begin MEASUREMENT DIN_b_Y17_Reset "(not defined)" UBYTE CU_DIN_B_Y17_RESET 1 100 0.0 1.0 ECU_ADDRESS 0x40002f45 BYTE_ORDER MSB_FIRST /end MEASUREMENT
/begin COMPU_METHOD CU_DIN_B_Y17_RESET "Conversion method for DIN_b_Y17_Reset" RAT_FUNC "%10.0" "b" COEFFS 0.000000 1.000000 0.000000 0.000000 0.000000 1.000000 /end COMPU_METHOD
/* Scalar measurable for DDE 'DIN_b_Y17_SB'. */
/begin MEASUREMENT DIN_b_Y17_SB "(not defined)" UBYTE CU_DIN_B_Y17_SB 1 100 0.0 1.0 ECU_ADDRESS 0x40002f43 BYTE_ORDER MSB_FIRST /end MEASUREMENT
/begin COMPU_METHOD CU_DIN_B_Y17_SB "Conversion method for DIN_b_Y17_SB" RAT_FUNC "%10.0" "b" COEFFS 0.000000 1.000000 0.000000 0.000000 0.000000 1.000000 /end COMPU_METHOD
/* Scalar measurable for DDE 'DIN_b_Y17_SB_Tested'. */
/begin MEASUREMENT DIN_b_Y17_SB_Tested "(not defined)" UBYTE CU_DIN_B_Y17_SB_TESTED 1 100 0.0 1.0 ECU_ADDRESS 0x40002f44 BYTE_ORDER MSB_FIRST /end MEASUREMENT
/begin COMPU_METHOD CU_DIN_B_Y17_SB_TESTED "Conversion method for DIN_b_Y17_SB_Tested" RAT_FUNC "%10.0" "b" COEFFS 0.000000 1.000000 0.000000 0.000000 0.000000 1.000000 /end COMPU_METHOD
/* Scalar measurable for DDE 'DIN_b_Y17_SG'. */
/begin MEASUREMENT DIN_b_Y17_SG "(not defined)" UBYTE CU_DIN_B_Y17_SG 1 100 0.0 1.0 ECU_ADDRESS 0x40002f42 BYTE_ORDER MSB_FIRST /end MEASUREMENT
/begin COMPU_METHOD CU_DIN_B_Y17_SG "Conversion method for DIN_b_Y17_SG" RAT_FUNC "%10.0" "b" COEFFS 0.000000 1.000000 0.000000 0.000000 0.000000 1.000000 /end COMPU_METHOD
/* Scalar measurable for DDE 'DIN_b_Y17_SG_OL'. */
/begin MEASUREMENT DIN_b_Y17_SG_OL "(not defined)" UBYTE CU_DIN_B_Y17_SG_OL 1 100 0.0 1.0 ECU_ADDRESS 0x40002f41 BYTE_ORDER MSB_FIRST /end MEASUREMENT
/begin COMPU_METHOD CU_DIN_B_Y17_SG_OL "Conversion method for DIN_b_Y17_SG_OL" RAT_FUNC "%10.0" "b" COEFFS 0.000000 1.000000 0.000000 0.000000 0.000000 1.000000 /end COMPU_METHOD
/* Scalar measurable for DDE 'DRL_b_Active'. */
/begin MEASUREMENT DRL_b_Active "Displayable" UBYTE CU_DRL_B_ACTIVE 1 100 0.0 1.0 ECU_ADDRESS 0x40002ebc BYTE_ORDER MSB_FIRST /end MEASUREMENT
/begin COMPU_METHOD CU_DRL_B_ACTIVE "Conversion method for DRL_b_Active" RAT_FUNC "%10.0" "b" COEFFS 0.000000 1.000000 0.000000 0.000000 0.000000 1.000000 /end COMPU_METHOD
/* Scalar measurable for DDE 'DTC_b_APP_CorrFLT'. */
/begin MEASUREMENT DTC_b_APP_CorrFLT "DTC133" UBYTE CU_DTC_B_APP_CORRFLT 1 100 0.0 1.0 ECU_ADDRESS 0x40002eb8 BYTE_ORDER MSB_FIRST /end MEASUREMENT
/begin COMPU_METHOD CU_DTC_B_APP_CORRFLT "Conversion method for DTC_b_APP_CorrFLT" RAT_FUNC "%10.0" "b" COEFFS 0.000000 1.000000 0.000000 0.000000 0.000000 1.000000 /end COMPU_METHOD
/* Scalar measurable for DDE 'DTC_b_DM11Force'. */
/begin MEASUREMENT DTC_b_DM11Force "DTC168" UBYTE CU_DTC_B_DM11FORCE 1 100 0.0 1.0 ECU_ADDRESS 0x40002f2e BYTE_ORDER MSB_FIRST /end MEASUREMENT
/begin COMPU_METHOD CU_DTC_B_DM11FORCE "Conversion method for DTC_b_DM11Force" RAT_FUNC "%10.0" "b" COEFFS 0.000000 1.000000 0.000000 0.000000 0.000000 1.000000 /end COMPU_METHOD
/* Scalar measurable for DDE 'DTC_b_DM37request'. */
/begin MEASUREMENT DTC_b_DM37request "DTC168" UBYTE CU_DTC_B_DM37REQUEST 1 100 0.0 1.0 ECU_ADDRESS 0x40002efb BYTE_ORDER MSB_FIRST /end MEASUREMENT
/begin COMPU_METHOD CU_DTC_B_DM37REQUEST "Conversion method for DTC_b_DM37request" RAT_FUNC "%10.0" "b" COEFFS 0.000000 1.000000 0.000000 0.000000 0.000000 1.000000 /end COMPU_METHOD
/* Scalar measurable for DDE 'DTC_b_LB12OL'. */
/begin MEASUREMENT DTC_b_LB12OL "DTC31" UBYTE CU_DTC_B_LB12OL 1 100 0.0 1.0 ECU_ADDRESS 0x40002fbe BYTE_ORDER MSB_FIRST /end MEASUREMENT
/begin COMPU_METHOD CU_DTC_B_LB12OL "Conversion method for DTC_b_LB12OL" RAT_FUNC "%10.0" "b" COEFFS 0.000000 1.000000 0.000000 0.000000 0.000000 1.000000 /end COMPU_METHOD
/* Scalar measurable for DDE 'DTC_b_LB12SB'. */
/begin MEASUREMENT DTC_b_LB12SB "DTC33" UBYTE CU_DTC_B_LB12SB 1 100 0.0 1.0 ECU_ADDRESS 0x40002fbc BYTE_ORDER MSB_FIRST /end MEASUREMENT
/begin COMPU_METHOD CU_DTC_B_LB12SB "Conversion method for DTC_b_LB12SB" RAT_FUNC "%10.0" "b" COEFFS 0.000000 1.000000 0.000000 0.000000 0.000000 1.000000 /end COMPU_METHOD
/* Scalar measurable for DDE 'DTC_b_Readiness'. */
/begin MEASUREMENT DTC_b_Readiness "(not defined)" UBYTE CU_DTC_B_READINESS 1 100 0.0 1.0 ECU_ADDRESS 0x40002f2f BYTE_ORDER MSB_FIRST /end MEASUREMENT
/begin COMPU_METHOD CU_DTC_B_READINESS "Conversion method for DTC_b_Readiness" RAT_FUNC "%10.0" "b" COEFFS 0.000000 1.000000 0.000000 0.000000 0.000000 1.000000 /end COMPU_METHOD
/* Scalar measurable for DDE 'DTC_b_ShutOffValveEngine_SG'. */
/begin MEASUREMENT DTC_b_ShutOffValveEngine_SG "SG" UBYTE CU_DTC_B_SHUTOFFVALVEENGINE_SG 1 100 0.0 1.0 ECU_ADDRESS 0x40002fbf BYTE_ORDER MSB_FIRST /end MEASUREMENT
/begin COMPU_METHOD CU_DTC_B_SHUTOFFVALVEENGINE_SG "Conversion method for DTC_b_ShutOffValveEngine_SG" RAT_FUNC "%10.0" "b" COEFFS 0.000000 1.000000 0.000000 0.000000 0.000000 1.000000 /end COMPU_METHOD
/* Scalar measurable for DDE 'DTC_b_Supply_VRefA'. */
/begin MEASUREMENT DTC_b_Supply_VRefA "DTC162" UBYTE CU_DTC_B_SUPPLY_VREFA 1 100 0.0 1.0 ECU_ADDRESS 0x40002f64 BYTE_ORDER MSB_FIRST /end MEASUREMENT
/begin COMPU_METHOD CU_DTC_B_SUPPLY_VREFA "Conversion method for DTC_b_Supply_VRefA" RAT_FUNC "%10.0" "b" COEFFS 0.000000 1.000000 0.000000 0.000000 0.000000 1.000000 /end COMPU_METHOD
/* Scalar measurable for DDE 'DTC_b_Supply_VRefB'. */
/begin MEASUREMENT DTC_b_Supply_VRefB "DTC161" UBYTE CU_DTC_B_SUPPLY_VREFB 1 100 0.0 1.0 ECU_ADDRESS 0x40002f65 BYTE_ORDER MSB_FIRST /end MEASUREMENT
/begin COMPU_METHOD CU_DTC_B_SUPPLY_VREFB "Conversion method for DTC_b_Supply_VRefB" RAT_FUNC "%10.0" "b" COEFFS 0.000000 1.000000 0.000000 0.000000 0.000000 1.000000 /end COMPU_METHOD
/* Scalar measurable for DDE 'DTC_b_Supply_VRefC'. */
/begin MEASUREMENT DTC_b_Supply_VRefC "DTC163" UBYTE CU_DTC_B_SUPPLY_VREFC 1 100 0.0 1.0 ECU_ADDRESS 0x40002f63 BYTE_ORDER MSB_FIRST /end MEASUREMENT
/begin COMPU_METHOD CU_DTC_B_SUPPLY_VREFC "Conversion method for DTC_b_Supply_VRefC" RAT_FUNC "%10.0" "b" COEFFS 0.000000 1.000000 0.000000 0.000000 0.000000 1.000000 /end COMPU_METHOD
/* Scalar measurable for DDE 'DTC_b_Supply_VRefD'. */
/begin MEASUREMENT DTC_b_Supply_VRefD "DTC175" UBYTE CU_DTC_B_SUPPLY_VREFD 1 100 0.0 1.0 ECU_ADDRESS 0x40002f62 BYTE_ORDER MSB_FIRST /end MEASUREMENT
/begin COMPU_METHOD CU_DTC_B_SUPPLY_VREFD "Conversion method for DTC_b_Supply_VRefD" RAT_FUNC "%10.0" "b" COEFFS 0.000000 1.000000 0.000000 0.000000 0.000000 1.000000 /end COMPU_METHOD
/* Scalar measurable for DDE 'DTC_s_BegasTime'. */
/begin MEASUREMENT DTC_s_BegasTime "(not defined)" FLOAT32_IEEE CU_DTC_S_BEGASTIME 1 100 0.0 100000.0 ECU_ADDRESS 0x4000396c BYTE_ORDER MSB_FIRST /end MEASUREMENT
/begin COMPU_METHOD CU_DTC_S_BEGASTIME "Conversion method for DTC_s_BegasTime" RAT_FUNC "%10.0" "s" COEFFS 0.000000 1.000000 0.000000 0.000000 0.000000 1.000000 /end COMPU_METHOD
/* Scalar measurable for DDE 'FMG_e_FltReset'. */
/begin MEASUREMENT FMG_e_FltReset "Displayable- global fault management control signal, sent to each FBM" UBYTE CU_FMG_E_FLTRESET 1 100 0.0 0.0 ECU_ADDRESS 0x40003013 BYTE_ORDER MSB_FIRST /end MEASUREMENT
/begin COMPU_METHOD CU_FMG_E_FLTRESET "Conversion method for FMG_e_FltReset" RAT_FUNC "%10.0" "e" COEFFS 0.000000 1.000000 0.000000 0.000000 0.000000 1.000000 /end COMPU_METHOD
/* Scalar measurable for DDE 'INP_cnt_IgnCount'. */
/begin MEASUREMENT INP_cnt_IgnCount "Cuenta Ignition" UWORD CU_INP_CNT_IGNCOUNT 1 100 1.0 65535.0 ECU_ADDRESS 0x40003028 BYTE_ORDER MSB_FIRST /end MEASUREMENT
/begin COMPU_METHOD CU_INP_CNT_IGNCOUNT "Conversion method for INP_cnt_IgnCount" RAT_FUNC "%10.0" "cnt" COEFFS 0.000000 1.000000 0.000000 0.000000 0.000000 1.000000 /end COMPU_METHOD
/* Scalar measurable for DDE 'LOG_NU_TqCvLuEngg'. */
/begin MEASUREMENT LOG_NU_TqCvLuEngg "(not defined)" FLOAT32_IEEE CU_LOG_NU_TQCVLUENGG 1 100 0.0 0.0 ECU_ADDRESS 0x4000379c BYTE_ORDER MSB_FIRST /end MEASUREMENT
/begin COMPU_METHOD CU_LOG_NU_TQCVLUENGG "Conversion method for LOG_NU_TqCvLuEngg" RAT_FUNC "%10.0" "NU" COEFFS 0.000000 1.000000 0.000000 0.000000 0.000000 1.000000 /end COMPU_METHOD
/* Scalar measurable for DDE 'LOG_NU_TransDrvEngg'. */
/begin MEASUREMENT LOG_NU_TransDrvEngg "(not defined)" FLOAT32_IEEE CU_LOG_NU_TRANSDRVENGG 1 100 0.0 0.0 ECU_ADDRESS 0x400037a0 BYTE_ORDER MSB_FIRST /end MEASUREMENT
/begin COMPU_METHOD CU_LOG_NU_TRANSDRVENGG "Conversion method for LOG_NU_TransDrvEngg" RAT_FUNC "%10.0" "NU" COEFFS 0.000000 1.000000 0.000000 0.000000 0.000000 1.000000 /end COMPU_METHOD
/* Scalar measurable for DDE 'LOG_NU_TransShftPrcs'. */
/begin MEASUREMENT LOG_NU_TransShftPrcs "(not defined)" FLOAT32_IEEE CU_LOG_NU_TRANSSHFTPRCS 1 100 0.0 0.0 ECU_ADDRESS 0x40003798 BYTE_ORDER MSB_FIRST /end MEASUREMENT
/begin COMPU_METHOD CU_LOG_NU_TRANSSHFTPRCS "Conversion method for LOG_NU_TransShftPrcs" RAT_FUNC "%10.0" "NU" COEFFS 0.000000 1.000000 0.000000 0.000000 0.000000 1.000000 /end COMPU_METHOD
/* Scalar measurable for DDE 'LOG_b_EC1_state'. */
/begin MEASUREMENT LOG_b_EC1_state "(not defined)" UBYTE CU_LOG_B_EC1_STATE 1 100 0.0 1.0 ECU_ADDRESS 0x40002e7c BYTE_ORDER MSB_FIRST /end MEASUREMENT
/begin COMPU_METHOD CU_LOG_B_EC1_STATE "Conversion method for LOG_b_EC1_state" RAT_FUNC "%10.0" "b" COEFFS 0.000000 1.000000 0.000000 0.000000 0.000000 1.000000 /end COMPU_METHOD
/* Scalar measurable for DDE 'LOG_b_ENBOBD'. */
/begin MEASUREMENT LOG_b_ENBOBD "Displayable" UBYTE CU_LOG_B_ENBOBD 1 100 0.0 1.0 ECU_ADDRESS 0x40002f34 BYTE_ORDER MSB_FIRST /end MEASUREMENT
/begin COMPU_METHOD CU_LOG_B_ENBOBD "Conversion method for LOG_b_ENBOBD" RAT_FUNC "%10.0" "b" COEFFS 0.000000 1.000000 0.000000 0.000000 0.000000 1.000000 /end COMPU_METHOD
/* Scalar measurable for DDE 'LOG_b_ZF_Auto'. */
/begin MEASUREMENT LOG_b_ZF_Auto "(not defined)" UBYTE CU_LOG_B_ZF_AUTO 1 100 0.0 1.0 ECU_ADDRESS 0x40002e8e BYTE_ORDER MSB_FIRST /end MEASUREMENT
/begin COMPU_METHOD CU_LOG_B_ZF_AUTO "Conversion method for LOG_b_ZF_Auto" RAT_FUNC "%10.0" "b" COEFFS 0.000000 1.000000 0.000000 0.000000 0.000000 1.000000 /end COMPU_METHOD
/* Scalar measurable for DDE 'LOG_pct_PercentClutchSlip'. */
/begin MEASUREMENT LOG_pct_PercentClutchSlip "Displayable" FLOAT32_IEEE CU_LOG_PCT_PERCENTCLUTCHSLIP 1 100 0.0 0.0 ECU_ADDRESS 0x40003794 BYTE_ORDER MSB_FIRST /end MEASUREMENT
/begin COMPU_METHOD CU_LOG_PCT_PERCENTCLUTCHSLIP "Conversion method for LOG_pct_PercentClutchSlip" RAT_FUNC "%10.0" "pct" COEFFS 0.000000 1.000000 0.000000 0.000000 0.000000 1.000000 /end COMPU_METHOD
/* Scalar measurable for DDE 'LOG_s_EC1_counter'. */
/begin MEASUREMENT LOG_s_EC1_counter "(not defined)" FLOAT32_IEEE CU_LOG_S_EC1_COUNTER 1 100 0.0 0.0 ECU_ADDRESS 0x40003164 BYTE_ORDER MSB_FIRST /end MEASUREMENT
/begin COMPU_METHOD CU_LOG_S_EC1_COUNTER "Conversion method for LOG_s_EC1_counter" RAT_FUNC "%10.1" "s" COEFFS 0.000000 1.000000 0.000000 0.000000 0.000000 1.000000 /end COMPU_METHOD
/* Scalar measurable for DDE 'Log_b_TPDT1'. */
/begin MEASUREMENT Log_b_TPDT1 "Displayable- global fault management control signal, sent to each FBM" UBYTE CU_LOG_B_TPDT1 1 100 0.0 1.0 ECU_ADDRESS 0x40002e7a BYTE_ORDER MSB_FIRST /end MEASUREMENT
/begin COMPU_METHOD CU_LOG_B_TPDT1 "Conversion method for Log_b_TPDT1" RAT_FUNC "%10.0" "b" COEFFS 0.000000 1.000000 0.000000 0.000000 0.000000 1.000000 /end COMPU_METHOD
/* Scalar measurable for DDE 'Log_b_TPDT2'. */
/begin MEASUREMENT Log_b_TPDT2 "Displayable- global fault management control signal, sent to each FBM" UBYTE CU_LOG_B_TPDT2 1 100 0.0 1.0 ECU_ADDRESS 0x40002e79 BYTE_ORDER MSB_FIRST /end MEASUREMENT
/begin COMPU_METHOD CU_LOG_B_TPDT2 "Conversion method for Log_b_TPDT2" RAT_FUNC "%10.0" "b" COEFFS 0.000000 1.000000 0.000000 0.000000 0.000000 1.000000 /end COMPU_METHOD
/* Scalar measurable for DDE 'Log_b_TPDT3'. */
/begin MEASUREMENT Log_b_TPDT3 "Displayable- global fault management control signal, sent to each FBM" UBYTE CU_LOG_B_TPDT3 1 100 0.0 1.0 ECU_ADDRESS 0x40002e78 BYTE_ORDER MSB_FIRST /end MEASUREMENT
/begin COMPU_METHOD CU_LOG_B_TPDT3 "Conversion method for Log_b_TPDT3" RAT_FUNC "%10.0" "b" COEFFS 0.000000 1.000000 0.000000 0.000000 0.000000 1.000000 /end COMPU_METHOD
/* Scalar measurable for DDE 'Log_b_TPDT4'. */
/begin MEASUREMENT Log_b_TPDT4 "Displayable- global fault management control signal, sent to each FBM" UBYTE CU_LOG_B_TPDT4 1 100 0.0 1.0 ECU_ADDRESS 0x40002e77 BYTE_ORDER MSB_FIRST /end MEASUREMENT
/begin COMPU_METHOD CU_LOG_B_TPDT4 "Conversion method for Log_b_TPDT4" RAT_FUNC "%10.0" "b" COEFFS 0.000000 1.000000 0.000000 0.000000 0.000000 1.000000 /end COMPU_METHOD
/* Scalar measurable for DDE 'Log_b_TPDT5'. */
/begin MEASUREMENT Log_b_TPDT5 "Displayable- global fault management control signal, sent to each FBM" UBYTE CU_LOG_B_TPDT5 1 100 0.0 1.0 ECU_ADDRESS 0x40002e76 BYTE_ORDER MSB_FIRST /end MEASUREMENT
/begin COMPU_METHOD CU_LOG_B_TPDT5 "Conversion method for Log_b_TPDT5" RAT_FUNC "%10.0" "b" COEFFS 0.000000 1.000000 0.000000 0.000000 0.000000 1.000000 /end COMPU_METHOD
/* Scalar measurable for DDE 'Log_b_TPDT6'. */
/begin MEASUREMENT Log_b_TPDT6 "Displayable- global fault management control signal, sent to each FBM" UBYTE CU_LOG_B_TPDT6 1 100 0.0 1.0 ECU_ADDRESS 0x40002e75 BYTE_ORDER MSB_FIRST /end MEASUREMENT
/begin COMPU_METHOD CU_LOG_B_TPDT6 "Conversion method for Log_b_TPDT6" RAT_FUNC "%10.0" "b" COEFFS 0.000000 1.000000 0.000000 0.000000 0.000000 1.000000 /end COMPU_METHOD
/* Scalar measurable for DDE 'OUT_NU_BankA_Faults'. */
/begin MEASUREMENT OUT_NU_BankA_Faults "Fault status bits" UBYTE CU_OUT_NU_BANKA_FAULTS 1 100 0.0 0.0 ECU_ADDRESS 0x4000301d BYTE_ORDER MSB_FIRST /end MEASUREMENT
/begin COMPU_METHOD CU_OUT_NU_BANKA_FAULTS "Conversion method for OUT_NU_BankA_Faults" RAT_FUNC "%10.0" "NU" COEFFS 0.000000 1.000000 0.000000 0.000000 0.000000 1.000000 /end COMPU_METHOD
/* Scalar measurable for DDE 'OUT_NU_DM19CVN'. */
/begin MEASUREMENT OUT_NU_DM19CVN "Fuel Pump PWM signal frequency" ULONG CU_OUT_NU_DM19CVN 1 100 0.0 4294967295.0 ECU_ADDRESS 0x40003054 BYTE_ORDER MSB_FIRST /end MEASUREMENT
/begin COMPU_METHOD CU_OUT_NU_DM19CVN "Conversion method for OUT_NU_DM19CVN" RAT_FUNC "%10.0" "NU" COEFFS 0.000000 1.000000 0.000000 0.000000 0.000000 1.000000 /end COMPU_METHOD
/* Scalar measurable for DDE 'OUT_NU_FCV_Faults'. */
/begin MEASUREMENT OUT_NU_FCV_Faults "Fault status bits" UBYTE CU_OUT_NU_FCV_FAULTS 1 100 0.0 0.0 ECU_ADDRESS 0x40003016 BYTE_ORDER MSB_FIRST /end MEASUREMENT
/begin COMPU_METHOD CU_OUT_NU_FCV_FAULTS "Conversion method for OUT_NU_FCV_Faults" RAT_FUNC "%10.0" "NU" COEFFS 0.000000 1.000000 0.000000 0.000000 0.000000 1.000000 /end COMPU_METHOD
/* Scalar measurable for DDE 'OUT_NU_INJ_A1_Faults'. */
/begin MEASUREMENT OUT_NU_INJ_A1_Faults "Fault status bits" UBYTE CU_OUT_NU_INJ_A1_FAULTS 1 100 0.0 0.0 ECU_ADDRESS 0x4000301c BYTE_ORDER MSB_FIRST /end MEASUREMENT
/begin COMPU_METHOD CU_OUT_NU_INJ_A1_FAULTS "Conversion method for OUT_NU_INJ_A1_Faults" RAT_FUNC "%10.0" "NU" COEFFS 0.000000 1.000000 0.000000 0.000000 0.000000 1.000000 /end COMPU_METHOD
/* Scalar measurable for DDE 'OUT_NU_INJ_A2_Faults'. */
/begin MEASUREMENT OUT_NU_INJ_A2_Faults "Fault status bits" UBYTE CU_OUT_NU_INJ_A2_FAULTS 1 100 0.0 0.0 ECU_ADDRESS 0x4000301b BYTE_ORDER MSB_FIRST /end MEASUREMENT
/begin COMPU_METHOD CU_OUT_NU_INJ_A2_FAULTS "Conversion method for OUT_NU_INJ_A2_Faults" RAT_FUNC "%10.0" "NU" COEFFS 0.000000 1.000000 0.000000 0.000000 0.000000 1.000000 /end COMPU_METHOD
/* Scalar measurable for DDE 'OUT_NU_INJ_A3_Faults'. */
/begin MEASUREMENT OUT_NU_INJ_A3_Faults "Fault status bits" UBYTE CU_OUT_NU_INJ_A3_FAULTS 1 100 0.0 0.0 ECU_ADDRESS 0x40003019 BYTE_ORDER MSB_FIRST /end MEASUREMENT
/begin COMPU_METHOD CU_OUT_NU_INJ_A3_FAULTS "Conversion method for OUT_NU_INJ_A3_Faults" RAT_FUNC "%10.0" "NU" COEFFS 0.000000 1.000000 0.000000 0.000000 0.000000 1.000000 /end COMPU_METHOD
/* Scalar measurable for DDE 'OUT_NU_INJ_A4_Faults'. */
/begin MEASUREMENT OUT_NU_INJ_A4_Faults "Fault status bits" UBYTE CU_OUT_NU_INJ_A4_FAULTS 1 100 0.0 0.0 ECU_ADDRESS 0x4000301a BYTE_ORDER MSB_FIRST /end MEASUREMENT
/begin COMPU_METHOD CU_OUT_NU_INJ_A4_FAULTS "Conversion method for OUT_NU_INJ_A4_Faults" RAT_FUNC "%10.0" "NU" COEFFS 0.000000 1.000000 0.000000 0.000000 0.000000 1.000000 /end COMPU_METHOD
/* Scalar measurable for DDE 'OUT_b_BCM_ZF_ena'. */
/begin MEASUREMENT OUT_b_BCM_ZF_ena "Value of enable BCM" UBYTE CU_OUT_B_BCM_ZF_ENA 1 100 0.0 1.0 ECU_ADDRESS 0x40002e8c BYTE_ORDER MSB_FIRST /end MEASUREMENT
/begin COMPU_METHOD CU_OUT_B_BCM_ZF_ENA "Conversion method for OUT_b_BCM_ZF_ena" RAT_FUNC "%10.0" "NU" COEFFS 0.000000 1.000000 0.000000 0.000000 0.000000 1.000000 /end COMPU_METHOD
/* Scalar measurable for DDE 'OUT_b_BCM_ena'. */
/begin MEASUREMENT OUT_b_BCM_ena "Value of enable BCM" UBYTE CU_OUT_B_BCM_ENA 1 100 0.0 1.0 ECU_ADDRESS 0x40002e8d BYTE_ORDER MSB_FIRST /end MEASUREMENT
/begin COMPU_METHOD CU_OUT_B_BCM_ENA "Conversion method for OUT_b_BCM_ena" RAT_FUNC "%10.0" "NU" COEFFS 0.000000 1.000000 0.000000 0.000000 0.000000 1.000000 /end COMPU_METHOD
/* Scalar measurable for DDE 'OUT_b_DM19Request'. */
/begin MEASUREMENT OUT_b_DM19Request "ZF Fan" UBYTE CU_OUT_B_DM19REQUEST 1 100 0.0 1.0 ECU_ADDRESS 0x40002f09 BYTE_ORDER MSB_FIRST /end MEASUREMENT
/begin COMPU_METHOD CU_OUT_B_DM19REQUEST "Conversion method for OUT_b_DM19Request" RAT_FUNC "%10.0" "b" COEFFS 0.000000 1.000000 0.000000 0.000000 0.000000 1.000000 /end COMPU_METHOD
/* Scalar measurable for DDE 'OUT_b_FCV_OC'. */
/begin MEASUREMENT OUT_b_FCV_OC "Output overcurrent trip flag" UBYTE CU_OUT_B_FCV_OC 1 100 0.0 1.0 ECU_ADDRESS 0x40002f50 BYTE_ORDER MSB_FIRST /end MEASUREMENT
/begin COMPU_METHOD CU_OUT_B_FCV_OC "Conversion method for OUT_b_FCV_OC" RAT_FUNC "%10.0" "b" COEFFS 0.000000 1.000000 0.000000 0.000000 0.000000 1.000000 /end COMPU_METHOD
/* Scalar measurable for DDE 'OUT_b_HEGO11_Heater_OC'. */
/begin MEASUREMENT OUT_b_HEGO11_Heater_OC "Output overcurrent trip flag" UBYTE CU_OUT_B_HEGO11_HEATER_OC 1 100 0.0 1.0 ECU_ADDRESS 0x40002f4f BYTE_ORDER MSB_FIRST /end MEASUREMENT
/begin COMPU_METHOD CU_OUT_B_HEGO11_HEATER_OC "Conversion method for OUT_b_HEGO11_Heater_OC" RAT_FUNC "%10.0" "b" COEFFS 0.000000 1.000000 0.000000 0.000000 0.000000 1.000000 /end COMPU_METHOD
/* Scalar measurable for DDE 'OUT_b_HEGO12_Heater_OC'. */
/begin MEASUREMENT OUT_b_HEGO12_Heater_OC "Output overcurrent trip flag" UBYTE CU_OUT_B_HEGO12_HEATER_OC 1 100 0.0 1.0 ECU_ADDRESS 0x40002f4d BYTE_ORDER MSB_FIRST /end MEASUREMENT
/begin COMPU_METHOD CU_OUT_B_HEGO12_HEATER_OC "Conversion method for OUT_b_HEGO12_Heater_OC" RAT_FUNC "%10.0" "b" COEFFS 0.000000 1.000000 0.000000 0.000000 0.000000 1.000000 /end COMPU_METHOD
/* Scalar measurable for DDE 'OUT_b_HEGO21_Heater_OC'. */
/begin MEASUREMENT OUT_b_HEGO21_Heater_OC "Output overcurrent trip flag" UBYTE CU_OUT_B_HEGO21_HEATER_OC 1 100 0.0 1.0 ECU_ADDRESS 0x40002f4e BYTE_ORDER MSB_FIRST /end MEASUREMENT
/begin COMPU_METHOD CU_OUT_B_HEGO21_HEATER_OC "Conversion method for OUT_b_HEGO21_Heater_OC" RAT_FUNC "%10.0" "b" COEFFS 0.000000 1.000000 0.000000 0.000000 0.000000 1.000000 /end COMPU_METHOD
/* Scalar measurable for DDE 'OUT_b_InjHighsideOC'. */
/begin MEASUREMENT OUT_b_InjHighsideOC "Injector highside overcurrent trip flag" UBYTE CU_OUT_B_INJHIGHSIDEOC 1 100 0.0 1.0 ECU_ADDRESS 0x40002f51 BYTE_ORDER MSB_FIRST /end MEASUREMENT
/begin COMPU_METHOD CU_OUT_B_INJHIGHSIDEOC "Conversion method for OUT_b_InjHighsideOC" RAT_FUNC "%10.0" "b" COEFFS 0.000000 1.000000 0.000000 0.000000 0.000000 1.000000 /end COMPU_METHOD
/* Scalar measurable for DDE 'OUT_b_MIL_LED'. */
/begin MEASUREMENT OUT_b_MIL_LED "MIL Led" UBYTE CU_OUT_B_MIL_LED 1 100 0.0 1.0 ECU_ADDRESS 0x40002f2c BYTE_ORDER MSB_FIRST /end MEASUREMENT
/begin COMPU_METHOD CU_OUT_B_MIL_LED "Conversion method for OUT_b_MIL_LED" RAT_FUNC "%10.0" "b" COEFFS 0.000000 1.000000 0.000000 0.000000 0.000000 1.000000 /end COMPU_METHOD
/* Scalar measurable for DDE 'OUT_b_UEGOB_Heater_OC'. */
/begin MEASUREMENT OUT_b_UEGOB_Heater_OC "Output overcurrent trip flag" UBYTE CU_OUT_B_UEGOB_HEATER_OC 1 100 0.0 1.0 ECU_ADDRESS 0x40002f40 BYTE_ORDER MSB_FIRST /end MEASUREMENT
/begin COMPU_METHOD CU_OUT_B_UEGOB_HEATER_OC "Conversion method for OUT_b_UEGOB_Heater_OC" RAT_FUNC "%10.0" "b" COEFFS 0.000000 1.000000 0.000000 0.000000 0.000000 1.000000 /end COMPU_METHOD
/* Scalar measurable for DDE 'OUT_b_Y1_OC'. */
/begin MEASUREMENT OUT_b_Y1_OC "Highside output overcurrent trip flag" UBYTE CU_OUT_B_Y1_OC 1 100 0.0 1.0 ECU_ADDRESS 0x40002f4c BYTE_ORDER MSB_FIRST /end MEASUREMENT
/begin COMPU_METHOD CU_OUT_B_Y1_OC "Conversion method for OUT_b_Y1_OC" RAT_FUNC "%10.0" "b" COEFFS 0.000000 1.000000 0.000000 0.000000 0.000000 1.000000 /end COMPU_METHOD
/* Scalar measurable for DDE 'OUT_b_Y5_OC'. */
/begin MEASUREMENT OUT_b_Y5_OC "Highside output overcurrent trip flag" UBYTE CU_OUT_B_Y5_OC 1 100 0.0 1.0 ECU_ADDRESS 0x40002f4b BYTE_ORDER MSB_FIRST /end MEASUREMENT
/begin COMPU_METHOD CU_OUT_B_Y5_OC "Conversion method for OUT_b_Y5_OC" RAT_FUNC "%10.0" "b" COEFFS 0.000000 1.000000 0.000000 0.000000 0.000000 1.000000 /end COMPU_METHOD
/* Scalar measurable for DDE 'OUT_cnt_BankA_SPI_Flts'. */
/begin MEASUREMENT OUT_cnt_BankA_SPI_Flts "Displayable" ULONG CU_OUT_CNT_BANKA_SPI_FLTS 1 100 0.0 0.0 ECU_ADDRESS 0x4000306c BYTE_ORDER MSB_FIRST /end MEASUREMENT
/begin COMPU_METHOD CU_OUT_CNT_BANKA_SPI_FLTS "Conversion method for OUT_cnt_BankA_SPI_Flts" RAT_FUNC "%10.0" "cnt" COEFFS 0.000000 1.000000 0.000000 0.000000 0.000000 1.000000 /end COMPU_METHOD
/* Scalar measurable for DDE 'OUT_cnt_BankB_SPI_Flts'. */
/begin MEASUREMENT OUT_cnt_BankB_SPI_Flts "Displayable" ULONG CU_OUT_CNT_BANKB_SPI_FLTS 1 100 0.0 0.0 ECU_ADDRESS 0x40003068 BYTE_ORDER MSB_FIRST /end MEASUREMENT
/begin COMPU_METHOD CU_OUT_CNT_BANKB_SPI_FLTS "Conversion method for OUT_cnt_BankB_SPI_Flts" RAT_FUNC "%10.0" "cnt" COEFFS 0.000000 1.000000 0.000000 0.000000 0.000000 1.000000 /end COMPU_METHOD
/* Scalar measurable for DDE 'PIDEffort'. */
/begin MEASUREMENT PIDEffort "PID" FLOAT32_IEEE CU_PIDEFFORT 1 100 -10000.0 10000.0 ECU_ADDRESS 0x40003160 READ_WRITE BYTE_ORDER MSB_FIRST /end MEASUREMENT
/begin COMPU_METHOD CU_PIDEFFORT "Conversion method for PIDEffort" RAT_FUNC "%10.2" "NU" COEFFS 0.000000 1.000000 0.000000 0.000000 0.000000 1.000000 /end COMPU_METHOD
/* Scalar measurable for DDE 'REM_Nm_TqLimit'. */
/begin MEASUREMENT REM_Nm_TqLimit "Displayable" FLOAT32_IEEE CU_REM_NM_TQLIMIT 1 100 0.0 0.0 ECU_ADDRESS 0x400036ec BYTE_ORDER MSB_FIRST /end MEASUREMENT
/begin COMPU_METHOD CU_REM_NM_TQLIMIT "Conversion method for REM_Nm_TqLimit" RAT_FUNC "%10.1" "Nm" COEFFS 0.000000 1.000000 0.000000 0.000000 0.000000 1.000000 /end COMPU_METHOD
/* Scalar measurable for DDE 'REM_b_StopCombustion'. */
/begin MEASUREMENT REM_b_StopCombustion "Displayable" UBYTE CU_REM_B_STOPCOMBUSTION 1 100 0.0 1.0 ECU_ADDRESS 0x40002f2a BYTE_ORDER MSB_FIRST /end MEASUREMENT
/begin COMPU_METHOD CU_REM_B_STOPCOMBUSTION "Conversion method for REM_b_StopCombustion" RAT_FUNC "%10.0" "b" COEFFS 0.000000 1.000000 0.000000 0.000000 0.000000 1.000000 /end COMPU_METHOD
/* Scalar measurable for DDE 'REM_e_TurbineState'. */
/begin MEASUREMENT REM_e_TurbineState "Turbo status" UBYTE CU_REM_E_TURBINESTATE 1 100 0.0 2.0 ECU_ADDRESS 0x40003015 BYTE_ORDER MSB_FIRST /end MEASUREMENT
/begin COMPU_METHOD CU_REM_E_TURBINESTATE "Conversion method for REM_e_TurbineState" TAB_VERB "%12.0" "e" COMPU_TAB_REF CT_REM_E_TURBINESTATE /end COMPU_METHOD
/begin COMPU_VTAB CT_REM_E_TURBINESTATE "Conversion method for REM_e_TurbineState" TAB_VERB 3 0 "REMk_e_TurbineNormal" 1 "REMk_e_TurbineTempWarning" 2 "REMk_e_TurbineOvertempShutdown" /end COMPU_VTAB
/* Scalar measurable for DDE 'REM_pct_OvertempThrottleLimit'. */
/begin MEASUREMENT REM_pct_OvertempThrottleLimit "Displayable" FLOAT32_IEEE CU_REM_PCT_OVERTEMPTHROTTLELIM0 1 100 0.0 0.0 ECU_ADDRESS 0x40003690 BYTE_ORDER MSB_FIRST /end MEASUREMENT
/begin COMPU_METHOD CU_REM_PCT_OVERTEMPTHROTTLELIM0 "Conversion method for REM_pct_OvertempThrottleLimit" RAT_FUNC "%10.2" "pct" COEFFS 0.000000 1.000000 0.000000 0.000000 0.000000 1.000000 /end COMPU_METHOD
/* Scalar measurable for DDE 'RFC_mg_Inj1'. */
/begin MEASUREMENT RFC_mg_Inj1 "Displayable" FLOAT32_IEEE CU_RFC_MG_INJ1 1 100 0.0 0.0 ECU_ADDRESS 0x40003310 BYTE_ORDER MSB_FIRST /end MEASUREMENT
/begin COMPU_METHOD CU_RFC_MG_INJ1 "Conversion method for RFC_mg_Inj1" RAT_FUNC "%10.2" "mg" COEFFS 0.000000 1.000000 0.000000 0.000000 0.000000 1.000000 /end COMPU_METHOD
/* Scalar measurable for DDE 'RFC_mg_Inj2'. */
/begin MEASUREMENT RFC_mg_Inj2 "Displayable" FLOAT32_IEEE CU_RFC_MG_INJ2 1 100 0.0 0.0 ECU_ADDRESS 0x4000330c BYTE_ORDER MSB_FIRST /end MEASUREMENT
/begin COMPU_METHOD CU_RFC_MG_INJ2 "Conversion method for RFC_mg_Inj2" RAT_FUNC "%10.2" "mg" COEFFS 0.000000 1.000000 0.000000 0.000000 0.000000 1.000000 /end COMPU_METHOD
/* Scalar measurable for DDE 'RFC_mg_Inj3'. */
/begin MEASUREMENT RFC_mg_Inj3 "Displayable" FLOAT32_IEEE CU_RFC_MG_INJ3 1 100 0.0 0.0 ECU_ADDRESS 0x40003308 BYTE_ORDER MSB_FIRST /end MEASUREMENT
/begin COMPU_METHOD CU_RFC_MG_INJ3 "Conversion method for RFC_mg_Inj3" RAT_FUNC "%10.2" "mg" COEFFS 0.000000 1.000000 0.000000 0.000000 0.000000 1.000000 /end COMPU_METHOD
/* Scalar measurable for DDE 'RFC_mg_Inj4'. */
/begin MEASUREMENT RFC_mg_Inj4 "Displayable" FLOAT32_IEEE CU_RFC_MG_INJ4 1 100 0.0 0.0 ECU_ADDRESS 0x40003304 BYTE_ORDER MSB_FIRST /end MEASUREMENT
/begin COMPU_METHOD CU_RFC_MG_INJ4 "Conversion method for RFC_mg_Inj4" RAT_FUNC "%10.2" "mg" COEFFS 0.000000 1.000000 0.000000 0.000000 0.000000 1.000000 /end COMPU_METHOD
/* Scalar measurable for DDE 'SYS_EngSpedDelta1'. */
/begin MEASUREMENT SYS_EngSpedDelta1 "(not defined)" FLOAT32_IEEE CU_SYS_ENGSPEDDELTA1 1 100 -10000.0 10000.0 ECU_ADDRESS 0x400030b0 BYTE_ORDER MSB_FIRST /end MEASUREMENT
/begin COMPU_METHOD CU_SYS_ENGSPEDDELTA1 "Conversion method for SYS_EngSpedDelta1" RAT_FUNC "%10.3" "RPM" COEFFS 0.000000 1.000000 0.000000 0.000000 0.000000 1.000000 /end COMPU_METHOD
/* Scalar measurable for DDE 'SYS_EngSpedDelta2'. */
/begin MEASUREMENT SYS_EngSpedDelta2 "(not defined)" FLOAT32_IEEE CU_SYS_ENGSPEDDELTA2 1 100 -10000.0 10000.0 ECU_ADDRESS 0x400030a0 BYTE_ORDER MSB_FIRST /end MEASUREMENT
/begin COMPU_METHOD CU_SYS_ENGSPEDDELTA2 "Conversion method for SYS_EngSpedDelta2" RAT_FUNC "%10.3" "RPM" COEFFS 0.000000 1.000000 0.000000 0.000000 0.000000 1.000000 /end COMPU_METHOD
/* Scalar measurable for DDE 'SYS_EngSpedDelta3'. */
/begin MEASUREMENT SYS_EngSpedDelta3 "(not defined)" FLOAT32_IEEE CU_SYS_ENGSPEDDELTA3 1 100 -10000.0 10000.0 ECU_ADDRESS 0x40003090 BYTE_ORDER MSB_FIRST /end MEASUREMENT
/begin COMPU_METHOD CU_SYS_ENGSPEDDELTA3 "Conversion method for SYS_EngSpedDelta3" RAT_FUNC "%10.3" "RPM" COEFFS 0.000000 1.000000 0.000000 0.000000 0.000000 1.000000 /end COMPU_METHOD
/* Scalar measurable for DDE 'SYS_EngSpedDelta4'. */
/begin MEASUREMENT SYS_EngSpedDelta4 "(not defined)" FLOAT32_IEEE CU_SYS_ENGSPEDDELTA4 1 100 -10000.0 10000.0 ECU_ADDRESS 0x40003080 BYTE_ORDER MSB_FIRST /end MEASUREMENT
/begin COMPU_METHOD CU_SYS_ENGSPEDDELTA4 "Conversion method for SYS_EngSpedDelta4" RAT_FUNC "%10.3" "RPM" COEFFS 0.000000 1.000000 0.000000 0.000000 0.000000 1.000000 /end COMPU_METHOD
/* Scalar measurable for DDE 'SYS_us_LoopA_Task'. */
/begin MEASUREMENT SYS_us_LoopA_Task "Duration of periodic task (last measured valued)" ULONG CU_SYS_US_LOOPA_TASK 1 100 0.0 0.0 ECU_ADDRESS 0x40003064 BYTE_ORDER MSB_FIRST /end MEASUREMENT
/begin COMPU_METHOD CU_SYS_US_LOOPA_TASK "Conversion method for SYS_us_LoopA_Task" RAT_FUNC "%10.0" "us" COEFFS 0.000000 1.000000 0.000000 0.000000 0.000000 1.000000 /end COMPU_METHOD
/* Scalar measurable for DDE 'SYS_us_LoopA_TaskMax'. */
/begin MEASUREMENT SYS_us_LoopA_TaskMax "Duration of periodic task (maximum since power up)" ULONG CU_SYS_US_LOOPA_TASKMAX 1 100 0.0 0.0 ECU_ADDRESS 0x4000305c BYTE_ORDER MSB_FIRST /end MEASUREMENT
/begin COMPU_METHOD CU_SYS_US_LOOPA_TASKMAX "Conversion method for SYS_us_LoopA_TaskMax" RAT_FUNC "%10.0" "us" COEFFS 0.000000 1.000000 0.000000 0.000000 0.000000 1.000000 /end COMPU_METHOD
/* Scalar measurable for DDE 'TSS_b_OBDtimeOK'. */
/begin MEASUREMENT TSS_b_OBDtimeOK "Displayable" UBYTE CU_TSS_B_OBDTIMEOK 1 100 0.0 1.0 ECU_ADDRESS 0x40002f36 BYTE_ORDER MSB_FIRST /end MEASUREMENT
/begin COMPU_METHOD CU_TSS_B_OBDTIMEOK "Conversion method for TSS_b_OBDtimeOK" RAT_FUNC "%10.0" "b" COEFFS 0.000000 1.000000 0.000000 0.000000 0.000000 1.000000 /end COMPU_METHOD
/* Scalar measurable for DDE 'exd_NU_awlstatus'. */
/begin MEASUREMENT exd_NU_awlstatus "(not defined)" FLOAT32_IEEE CU_EXD_NU_AWLSTATUS 1 100 0.0 3.0 ECU_ADDRESS 0x40003680 BYTE_ORDER MSB_FIRST /end MEASUREMENT
/begin COMPU_METHOD CU_EXD_NU_AWLSTATUS "Conversion method for exd_NU_awlstatus" RAT_FUNC "%10.0" "NU" COEFFS 0.000000 1.000000 0.000000 0.000000 0.000000 1.000000 /end COMPU_METHOD
/* Scalar measurable for DDE 'exd_NU_milstatus'. */
/begin MEASUREMENT exd_NU_milstatus "(not defined)" FLOAT32_IEEE CU_EXD_NU_MILSTATUS 1 100 0.0 3.0 ECU_ADDRESS 0x40003688 BYTE_ORDER MSB_FIRST /end MEASUREMENT
/begin COMPU_METHOD CU_EXD_NU_MILSTATUS "Conversion method for exd_NU_milstatus" RAT_FUNC "%10.0" "NU" COEFFS 0.000000 1.000000 0.000000 0.000000 0.000000 1.000000 /end COMPU_METHOD
/* Scalar measurable for DDE 'exd_NU_prlstatus'. */
/begin MEASUREMENT exd_NU_prlstatus "(not defined)" FLOAT32_IEEE CU_EXD_NU_PRLSTATUS 1 100 0.0 3.0 ECU_ADDRESS 0x4000367c BYTE_ORDER MSB_FIRST /end MEASUREMENT
/begin COMPU_METHOD CU_EXD_NU_PRLSTATUS "Conversion method for exd_NU_prlstatus" RAT_FUNC "%10.0" "NU" COEFFS 0.000000 1.000000 0.000000 0.000000 0.000000 1.000000 /end COMPU_METHOD
/* Scalar measurable for DDE 'exd_NU_rslstatus'. */
/begin MEASUREMENT exd_NU_rslstatus "(not defined)" FLOAT32_IEEE CU_EXD_NU_RSLSTATUS 1 100 0.0 3.0 ECU_ADDRESS 0x40003684 BYTE_ORDER MSB_FIRST /end MEASUREMENT
/begin COMPU_METHOD CU_EXD_NU_RSLSTATUS "Conversion method for exd_NU_rslstatus" RAT_FUNC "%10.0" "NU" COEFFS 0.000000 1.000000 0.000000 0.000000 0.000000 1.000000 /end COMPU_METHOD
/* Scalar measurable for DDE 'exd_b_DM11cleared'. */
/begin MEASUREMENT exd_b_DM11cleared "Override flag" UBYTE CU_EXD_B_DM11CLEARED 1 100 0.0 1.0 ECU_ADDRESS 0x40002f2d BYTE_ORDER MSB_FIRST /end MEASUREMENT
/begin COMPU_METHOD CU_EXD_B_DM11CLEARED "Conversion method for exd_b_DM11cleared" RAT_FUNC "%10.0" "b" COEFFS 0.000000 1.000000 0.000000 0.000000 0.000000 1.000000 /end COMPU_METHOD
/* Scalar measurable for DDE 'exd_b_DTCscleared'. */
/begin MEASUREMENT exd_b_DTCscleared "Override flag" UBYTE CU_EXD_B_DTCSCLEARED 1 100 0.0 1.0 ECU_ADDRESS 0x4000368c BYTE_ORDER MSB_FIRST /end MEASUREMENT
/begin COMPU_METHOD CU_EXD_B_DTCSCLEARED "Conversion method for exd_b_DTCscleared" RAT_FUNC "%10.0" "b" COEFFS 0.000000 1.000000 0.000000 0.000000 0.000000 1.000000 /end COMPU_METHOD
/* Scalar measurable for DDE 'ext_NU_activmode'. */
/begin MEASUREMENT ext_NU_activmode "(not defined)" FLOAT32_IEEE CU_EXT_NU_ACTIVMODE 1 100 0.0 3.0 ECU_ADDRESS 0x40003012 BYTE_ORDER MSB_FIRST /end MEASUREMENT
/begin COMPU_METHOD CU_EXT_NU_ACTIVMODE "Conversion method for ext_NU_activmode" RAT_FUNC "%10.0" "NU" COEFFS 0.000000 1.000000 0.000000 0.000000 0.000000 1.000000 /end COMPU_METHOD
/* Scalar measurable for DDE 'ext_NU_b1constinuous'. */
/begin MEASUREMENT ext_NU_b1constinuous "(not defined)" FLOAT32_IEEE CU_EXT_NU_B1CONSTINUOUS 1 100 0.0 4294967295.0 ECU_ADDRESS 0x40003048 BYTE_ORDER MSB_FIRST /end MEASUREMENT
/begin COMPU_METHOD CU_EXT_NU_B1CONSTINUOUS "Conversion method for ext_NU_b1constinuous" RAT_FUNC "%10.1" "NU" COEFFS 0.000000 1.000000 0.000000 0.000000 0.000000 1.000000 /end COMPU_METHOD
/* Scalar measurable for DDE 'ext_NU_b1cumulative'. */
/begin MEASUREMENT ext_NU_b1cumulative "(not defined)" FLOAT32_IEEE CU_EXT_NU_B1CUMULATIVE 1 100 0.0 4294967295.0 ECU_ADDRESS 0x4000304c BYTE_ORDER MSB_FIRST /end MEASUREMENT
/begin COMPU_METHOD CU_EXT_NU_B1CUMULATIVE "Conversion method for ext_NU_b1cumulative" RAT_FUNC "%10.1" "NU" COEFFS 0.000000 1.000000 0.000000 0.000000 0.000000 1.000000 /end COMPU_METHOD
/* Scalar measurable for DDE 'ext_NU_milcumulative'. */
/begin MEASUREMENT ext_NU_milcumulative "(not defined)" FLOAT32_IEEE CU_EXT_NU_MILCUMULATIVE 1 100 0.0 4294967295.0 ECU_ADDRESS 0x40003050 BYTE_ORDER MSB_FIRST /end MEASUREMENT
/begin COMPU_METHOD CU_EXT_NU_MILCUMULATIVE "Conversion method for ext_NU_milcumulative" RAT_FUNC "%10.1" "NU" COEFFS 0.000000 1.000000 0.000000 0.000000 0.000000 1.000000 /end COMPU_METHOD
/* Scalar measurable for DDE 'sys_app_code_day'. */
/begin MEASUREMENT sys_app_code_day "Day the application code was built." UWORD CU_SYS_APP_CODE_DAY 1 100 0.0 0.0 ECU_ADDRESS 0x4000314c BYTE_ORDER MSB_FIRST /end MEASUREMENT
/begin COMPU_METHOD CU_SYS_APP_CODE_DAY "Conversion method for sys_app_code_day" RAT_FUNC "%10.0" "(not defined)" COEFFS 0.000000 1.000000 0.000000 0.000000 0.000000 1.000000 /end COMPU_METHOD
/* Scalar measurable for DDE 'sys_app_code_major_ver'. */
/begin MEASUREMENT sys_app_code_major_ver "Major version of the application code." UWORD CU_SYS_APP_CODE_MAJOR_VER 1 100 0.0 0.0 ECU_ADDRESS 0x40003148 BYTE_ORDER MSB_FIRST /end MEASUREMENT
/begin COMPU_METHOD CU_SYS_APP_CODE_MAJOR_VER "Conversion method for sys_app_code_major_ver" RAT_FUNC "%10.0" "(not defined)" COEFFS 0.000000 1.000000 0.000000 0.000000 0.000000 1.000000 /end COMPU_METHOD
/* Scalar measurable for DDE 'sys_app_code_minor_ver'. */
/begin MEASUREMENT sys_app_code_minor_ver "Minor version of the application code." UWORD CU_SYS_APP_CODE_MINOR_VER 1 100 0.0 0.0 ECU_ADDRESS 0x40003144 BYTE_ORDER MSB_FIRST /end MEASUREMENT
/begin COMPU_METHOD CU_SYS_APP_CODE_MINOR_VER "Conversion method for sys_app_code_minor_ver" RAT_FUNC "%10.0" "(not defined)" COEFFS 0.000000 1.000000 0.000000 0.000000 0.000000 1.000000 /end COMPU_METHOD
/* Scalar measurable for DDE 'sys_app_code_month'. */
/begin MEASUREMENT sys_app_code_month "Month the application code was built." UWORD CU_SYS_APP_CODE_MONTH 1 100 0.0 0.0 ECU_ADDRESS 0x40003150 BYTE_ORDER MSB_FIRST /end MEASUREMENT
/begin COMPU_METHOD CU_SYS_APP_CODE_MONTH "Conversion method for sys_app_code_month" RAT_FUNC "%10.0" "(not defined)" COEFFS 0.000000 1.000000 0.000000 0.000000 0.000000 1.000000 /end COMPU_METHOD
/* Scalar measurable for DDE 'sys_app_code_subminor_ver'. */
/begin MEASUREMENT sys_app_code_subminor_ver "Sub-minor version of the application code." UWORD CU_SYS_APP_CODE_SUBMINOR_VER 1 100 0.0 0.0 ECU_ADDRESS 0x40003140 BYTE_ORDER MSB_FIRST /end MEASUREMENT
/begin COMPU_METHOD CU_SYS_APP_CODE_SUBMINOR_VER "Conversion method for sys_app_code_subminor_ver" RAT_FUNC "%10.0" "(not defined)" COEFFS 0.000000 1.000000 0.000000 0.000000 0.000000 1.000000 /end COMPU_METHOD
/* Scalar measurable for DDE 'sys_app_code_year'. */
/begin MEASUREMENT sys_app_code_year "Year the application code was built." UWORD CU_SYS_APP_CODE_YEAR 1 100 0.0 0.0 ECU_ADDRESS 0x40003154 BYTE_ORDER MSB_FIRST /end MEASUREMENT
/begin COMPU_METHOD CU_SYS_APP_CODE_YEAR "Conversion method for sys_app_code_year" RAT_FUNC "%10.0" "(not defined)" COEFFS 0.000000 1.000000 0.000000 0.000000 0.000000 1.000000 /end COMPU_METHOD
/* Scalar measurable for DDE 'sys_cpu_loading'. */
/begin MEASUREMENT sys_cpu_loading "CPU loading seen in last 50ms" UBYTE CU_SYS_CPU_LOADING 1 100 0.0 0.0 ECU_ADDRESS 0x40003018 BYTE_ORDER MSB_FIRST /end MEASUREMENT
/begin COMPU_METHOD CU_SYS_CPU_LOADING "Conversion method for sys_cpu_loading" RAT_FUNC "%10.0" "%" COEFFS 0.000000 1.000000 0.000000 0.000000 0.000000 1.000000 /end COMPU_METHOD
/* Scalar measurable for DDE 'sys_cpu_loading_max'. */
/begin MEASUREMENT sys_cpu_loading_max "Maximum CPU loading seen in any 50ms period" UBYTE CU_SYS_CPU_LOADING_MAX 1 100 0.0 0.0 ECU_ADDRESS 0x40003017 BYTE_ORDER MSB_FIRST /end MEASUREMENT
/begin COMPU_METHOD CU_SYS_CPU_LOADING_MAX "Conversion method for sys_cpu_loading_max" RAT_FUNC "%10.0" "%" COEFFS 0.000000 1.000000 0.000000 0.000000 0.000000 1.000000 /end COMPU_METHOD
/* Scalar measurable for DDE 'sys_stack_used'. */
/begin MEASUREMENT sys_stack_used "Amount of used stack" ULONG CU_SYS_STACK_USED 1 100 0.0 0.0 ECU_ADDRESS 0x40003060 BYTE_ORDER MSB_FIRST /end MEASUREMENT
/begin COMPU_METHOD CU_SYS_STACK_USED "Conversion method for sys_stack_used" RAT_FUNC "%10.0" "B" COEFFS 0.000000 1.000000 0.000000 0.000000 0.000000 1.000000 /end COMPU_METHOD
/begin FUNCTION BankA_injector_faults "Group /ByModelHeirarchy/Gasoline/1.Input_Processing/Monitors/BankA injector faults" /begin SUB_FUNCTION Z18_faults Z29_faults Z30_faults Z41_faults /end SUB_FUNCTION
 /begin LOC_MEASUREMENT OUT_NU_BankA_Faults OUT_NU_INJ_A1_Faults OUT_NU_INJ_A2_Faults OUT_NU_INJ_A3_Faults OUT_NU_INJ_A4_Faults OUT_b_InjHighsideOC OUT_cnt_BankA_SPI_Flts OUT_cnt_BankB_SPI_Flts /end LOC_MEASUREMENT
/end FUNCTION
/begin FUNCTION CPU_Status "Group /ByModelHeirarchy/Gasoline/1.Input_Processing/Monitors/ECU Status/CPU Status"
 /begin LOC_MEASUREMENT SYS_us_LoopA_Task SYS_us_LoopA_TaskMax sys_cpu_loading sys_cpu_loading_max sys_stack_used /end LOC_MEASUREMENT
/end FUNCTION
/begin FUNCTION ECU_Status "Group /ByModelHeirarchy/Gasoline/1.Input_Processing/Monitors/ECU Status" /begin SUB_FUNCTION CPU_Status /end SUB_FUNCTION /end FUNCTION
/begin FUNCTION OVR_AndExport317 "Group /ByModelHeirarchy/Gasoline/1.Input_Processing/Monitors/LB12_Open_Load/OVR_AndExport34" /begin LOC_MEASUREMENT DTC_b_LB12OL /end LOC_MEASUREMENT /begin REF_CHARACTERISTIC DTCc_b_LB12OL DTCc_o_LB12OL /end REF_CHARACTERISTIC /end FUNCTION
/begin FUNCTION LB12_Open_Load "Group /ByModelHeirarchy/Gasoline/1.Input_Processing/Monitors/LB12_Open_Load" /begin SUB_FUNCTION OVR_AndExport317 /end SUB_FUNCTION
 /begin REF_CHARACTERISTIC AINc_Hz_LB12_fail_FR AINc_Hz_LB12_fail_RR AINc_V_LambErrorThres /end REF_CHARACTERISTIC
/end FUNCTION
/begin FUNCTION OVR_AndExport318 "Group /ByModelHeirarchy/Gasoline/1.Input_Processing/Monitors/LB12_a_GND/OVR_AndExport34" /begin LOC_MEASUREMENT DTC_b_ShutOffValveEngine_SG /end LOC_MEASUREMENT /begin REF_CHARACTERISTIC DTCc_b_ShutOffValveEngine_SG DTCc_o_ShutOffValveEngine_SG /end REF_CHARACTERISTIC /end FUNCTION
/begin FUNCTION LB12_a_GND "Group /ByModelHeirarchy/Gasoline/1.Input_Processing/Monitors/LB12_a_GND" /begin SUB_FUNCTION OVR_AndExport318 /end SUB_FUNCTION /begin REF_CHARACTERISTIC AINc_Hz_LB12_vl_FR AINc_Hz_LB12_vl_RR DINc_V_L12SG /end REF_CHARACTERISTIC /end FUNCTION
/begin FUNCTION OVR_AndExport29 "Group /ByModelHeirarchy/Gasoline/1.Input_Processing/Monitors/OVR_AndExport1" /begin LOC_MEASUREMENT DTC_b_Supply_VRefB /end LOC_MEASUREMENT /begin REF_CHARACTERISTIC DTCc_b_Supply_VRefB DTCc_o_Supply_VRefB /end REF_CHARACTERISTIC /end FUNCTION
/begin FUNCTION OVR_AndExport30 "Group /ByModelHeirarchy/Gasoline/1.Input_Processing/Monitors/OVR_AndExport2" /begin LOC_MEASUREMENT DTC_b_LB12SB /end LOC_MEASUREMENT /begin REF_CHARACTERISTIC DTCc_b_LB12SB DTCc_o_LB12SB /end REF_CHARACTERISTIC /end FUNCTION
/begin FUNCTION OVR_AndExport31 "Group /ByModelHeirarchy/Gasoline/1.Input_Processing/Monitors/OVR_AndExport3" /begin LOC_MEASUREMENT DTC_b_Supply_VRefC /end LOC_MEASUREMENT /begin REF_CHARACTERISTIC DTCc_b_Supply_VRefC DTCc_o_Supply_VRefC /end REF_CHARACTERISTIC /end FUNCTION
/begin FUNCTION OVR_AndExport319 "Group /ByModelHeirarchy/Gasoline/1.Input_Processing/Monitors/OVR_AndExport34" /begin LOC_MEASUREMENT DTC_b_Supply_VRefA /end LOC_MEASUREMENT /begin REF_CHARACTERISTIC DTCc_b_Supply_VRefA DTCc_o_Supply_VRefA /end REF_CHARACTERISTIC /end FUNCTION
/begin FUNCTION OVR_AndExport49 "Group /ByModelHeirarchy/Gasoline/1.Input_Processing/Monitors/OVR_AndExport4" /begin LOC_MEASUREMENT DTC_b_Supply_VRefD /end LOC_MEASUREMENT /begin REF_CHARACTERISTIC DTCc_b_Supply_VRefD DTCc_o_Supply_VRefD /end REF_CHARACTERISTIC /end FUNCTION
/begin FUNCTION Monitors "Group /ByModelHeirarchy/Gasoline/1.Input_Processing/Monitors"
 /begin SUB_FUNCTION BankA_injector_faults ECU_Status LB12_Open_Load LB12_a_GND OVR_AndExport29 OVR_AndExport30 OVR_AndExport31 OVR_AndExport319 OVR_AndExport49 /end SUB_FUNCTION
 /begin LOC_MEASUREMENT AIN_A_ETC_CurrentB AIN_A_Y1_Current AIN_A_Y5_Current AIN_V_ETC_MonA AIN_V_ETC_MonB AIN_V_FCV_Mon AIN_V_Highside AIN_V_VRefA AIN_V_VRefB AIN_V_VRefC AIN_V_VRefD AIN_V_XL1_Mon AIN_V_XM1_Mon AIN_V_Y29_Mon AIN_V_Y41_Mon AIN_V_Y42_Mon AIN_V_Y6_Mon DIN_b_Y13_SB_OL DIN_b_Y17_Enabled DIN_b_Y17_Fault DIN_b_Y17_OFF_OL DIN_b_Y17_ON_OL DIN_b_Y17_OV DIN_b_Y17_Reset DIN_b_Y17_SB DIN_b_Y17_SB_Tested DIN_b_Y17_SG DIN_b_Y17_SG_OL OUT_NU_FCV_Faults OUT_b_FCV_OC OUT_b_HEGO11_Heater_OC OUT_b_HEGO12_Heater_OC OUT_b_HEGO21_Heater_OC OUT_b_UEGOB_Heater_OC OUT_b_Y1_OC OUT_b_Y5_OC /end LOC_MEASUREMENT
 /begin REF_CHARACTERISTIC AINc_A_HighsideCurrentMonOfst AINc_Hz_vsup_nok_FR AINc_Hz_vsup_nok_RR AINc_NU_DOT_VMonGain AINc_NU_HBridgeCurrentMonGain AINc_NU_HighsideCurrentMonGain AINc_NU_HighsideGain AINc_NU_VRefMonGain AINc_V_HBridgeCurrentMonOfst AINc_s_L2SBDeadTime AINc_s_L2SBResetTime /end REF_CHARACTERISTIC
/end FUNCTION
/begin FUNCTION OVR_AndExport32 "Group /ByModelHeirarchy/Gasoline/1.Input_Processing/OVR_AndExport1" /begin LOC_MEASUREMENT APP_kph_VehSpeed /end LOC_MEASUREMENT /begin REF_CHARACTERISTIC APPc_kph_VehSpeed APPc_o_VehSpeed /end REF_CHARACTERISTIC /end FUNCTION
/begin FUNCTION OVR_AndExport351 "Group /ByModelHeirarchy/Gasoline/1.Input_Processing/OVR_AndExport35" /begin LOC_MEASUREMENT DTC_s_BegasTime /end LOC_MEASUREMENT /begin REF_CHARACTERISTIC DTCc_o_BegasTime DTCc_s_BegasTime /end REF_CHARACTERISTIC /end FUNCTION
/begin FUNCTION OVR_AndExport33 "Group /ByModelHeirarchy/Gasoline/1.Input_Processing/Speed Meter/OVR_AndExport1" /begin LOC_MEASUREMENT APP_rpm_IN /end LOC_MEASUREMENT /begin REF_CHARACTERISTIC APPc_o_IN APPc_rpm_IN /end REF_CHARACTERISTIC /end FUNCTION
/begin FUNCTION OVR_AndExport271 "Group /ByModelHeirarchy/Gasoline/1.Input_Processing/Speed Meter/OVR_AndExport27" /begin LOC_MEASUREMENT APP_rpm_OUT /end LOC_MEASUREMENT /begin REF_CHARACTERISTIC APPc_o_OUT APPc_rpm_OUT /end REF_CHARACTERISTIC /end FUNCTION
/begin FUNCTION Speed_Meter "Group /ByModelHeirarchy/Gasoline/1.Input_Processing/Speed Meter" /begin SUB_FUNCTION OVR_AndExport33 OVR_AndExport271 /end SUB_FUNCTION
 /begin LOC_MEASUREMENT LOG_NU_TqCvLuEngg LOG_NU_TransDrvEngg LOG_NU_TransShftPrcs LOG_pct_PercentClutchSlip /end LOC_MEASUREMENT
 /begin REF_CHARACTERISTIC APPc_NU_RPM2Hz APPc_NU_VehSpeed_Gain APPc_NU_VehSpeed_Ofst /end REF_CHARACTERISTIC
/end FUNCTION
/begin FUNCTION Actuator_Feedback "Group /ByModelHeirarchy/Gasoline/1.Input_Processing/bin/Actuator Feedback" /begin LOC_MEASUREMENT AIN_V_TP1 AIN_V_TP2 /end LOC_MEASUREMENT /end FUNCTION
/begin FUNCTION Air "Group /ByModelHeirarchy/Gasoline/1.Input_Processing/bin/Air" /begin LOC_MEASUREMENT AIN_V_Baro AIN_V_MAP_Raw AIN_V_ManifoldTemp /end LOC_MEASUREMENT /end FUNCTION
/begin FUNCTION CAN_Messages1 "Group /ByModelHeirarchy/Gasoline/1.Input_Processing/bin/CAN Messages1"
 /begin LOC_MEASUREMENT CIN_NU_EngOvrCtrMd_ESP_B CIN_NU_EngOvrCtrMd_TCM_B CIN_NU_OvrCtrMd_ESP_B CIN_NU_OvrCtrMd_TCM_B CIN_pct_TqCtrRq_ESP_B CIN_pct_TqCtrRq_TCM_B /end LOC_MEASUREMENT
/end FUNCTION
/begin FUNCTION Engine_Mechanical_State1 "Group /ByModelHeirarchy/Gasoline/1.Input_Processing/bin/Engine Mechanical State1"
 /begin LOC_MEASUREMENT SYS_EngSpedDelta1 SYS_EngSpedDelta2 SYS_EngSpedDelta3 SYS_EngSpedDelta4 /end LOC_MEASUREMENT
/end FUNCTION
/begin FUNCTION Engine_Temp "Group /ByModelHeirarchy/Gasoline/1.Input_Processing/bin/Engine Temp" /begin LOC_MEASUREMENT AIN_V_CoolantTemp /end LOC_MEASUREMENT /end FUNCTION
/begin FUNCTION Exhaust "Group /ByModelHeirarchy/Gasoline/1.Input_Processing/bin/Exhaust" /begin LOC_MEASUREMENT AIN_V_EGT /end LOC_MEASUREMENT /end FUNCTION
/begin FUNCTION Fuel "Group /ByModelHeirarchy/Gasoline/1.Input_Processing/bin/Fuel" /begin LOC_MEASUREMENT AIN_V_FuelTempRaw /end LOC_MEASUREMENT /end FUNCTION
/begin FUNCTION System_Faults2 "Group /ByModelHeirarchy/Gasoline/1.Input_Processing/bin/System Faults2"
 /begin LOC_MEASUREMENT AIN_V_XL1_Mon AIN_V_XM1_Mon AIN_V_Y29_Mon AIN_V_Y41_Mon AIN_V_Y42_Mon AIN_V_Y6_Mon /end LOC_MEASUREMENT
/end FUNCTION
/begin FUNCTION bin "Group /ByModelHeirarchy/Gasoline/1.Input_Processing/bin"
 /begin SUB_FUNCTION Actuator_Feedback Air CAN_Messages1 Engine_Mechanical_State1 Engine_Temp Exhaust Fuel System_Faults2 /end SUB_FUNCTION
 /begin LOC_MEASUREMENT AIN_s_DelayLambdas /end LOC_MEASUREMENT
/end FUNCTION
/begin FUNCTION _1.Input_Processing "Group /ByModelHeirarchy/Gasoline/1.Input_Processing"
 /begin SUB_FUNCTION Analog_inputs Angular_speed_input CAN_inputs DTCs Digital_Inputs Horometer1 Input_Arbitration Misfire_Thres_Map2 Monitors OVR_AndExport32 OVR_AndExport351 Speed_Meter bin /end SUB_FUNCTION
/end FUNCTION
/begin FUNCTION Begas_DTC1 "Group /ByModelHeirarchy/Gasoline/2.OBD/Begas_DTC1" /begin LOC_MEASUREMENT INP_cnt_IgnCount /end LOC_MEASUREMENT /end FUNCTION
/begin FUNCTION ClearAllDTCsDM11 "Group /ByModelHeirarchy/Gasoline/2.OBD/ClearAllDTCsDM11" /begin LOC_MEASUREMENT exd_b_DTCscleared /end LOC_MEASUREMENT /end FUNCTION
/begin FUNCTION LogEnable10 "Group /ByModelHeirarchy/Gasoline/2.OBD/DM1/LogEnable10" /begin REF_CHARACTERISTIC LOGc_b_EnableCanLog LOGc_b_EnableDM1 /end REF_CHARACTERISTIC /end FUNCTION
/begin FUNCTION DM1 "Group /ByModelHeirarchy/Gasoline/2.OBD/DM1" /begin SUB_FUNCTION LogEnable10 /end SUB_FUNCTION /end FUNCTION
/begin FUNCTION OVR_AndExport34 "Group /ByModelHeirarchy/Gasoline/2.OBD/DM11/OVR_AndExport2" /begin LOC_MEASUREMENT DTC_b_DM11Force /end LOC_MEASUREMENT /begin REF_CHARACTERISTIC DTCc_b_DM11Force DTCc_o_DM11Force /end REF_CHARACTERISTIC /end FUNCTION
/begin FUNCTION DM11 "Group /ByModelHeirarchy/Gasoline/2.OBD/DM11" /begin SUB_FUNCTION OVR_AndExport34 /end SUB_FUNCTION /begin LOC_MEASUREMENT exd_b_DM11cleared /end LOC_MEASUREMENT /begin REF_CHARACTERISTIC exdc_clear_unconditionally /end REF_CHARACTERISTIC /end FUNCTION
/begin FUNCTION CVN_Begas "Group /ByModelHeirarchy/Gasoline/2.OBD/DM19/CVN_Begas" /begin REF_CHARACTERISTIC DTCv_NU_CALID /end REF_CHARACTERISTIC /end FUNCTION
/begin FUNCTION CVN_Real "Group /ByModelHeirarchy/Gasoline/2.OBD/DM19/CVN_Real"
 /begin LOC_MEASUREMENT sys_app_code_day sys_app_code_major_ver sys_app_code_minor_ver sys_app_code_month sys_app_code_subminor_ver sys_app_code_year /end LOC_MEASUREMENT
/end FUNCTION
/begin FUNCTION OVR_AndExport35 "Group /ByModelHeirarchy/Gasoline/2.OBD/DM19/OVR_AndExport1" /begin LOC_MEASUREMENT OUT_NU_DM19CVN /end LOC_MEASUREMENT /begin REF_CHARACTERISTIC OUTc_NU_DM19CVN OUTc_o_DM19CVN /end REF_CHARACTERISTIC /end FUNCTION
/begin FUNCTION OVR_AndExport36 "Group /ByModelHeirarchy/Gasoline/2.OBD/DM19/OVR_AndExport2" /begin LOC_MEASUREMENT OUT_b_DM19Request /end LOC_MEASUREMENT /begin REF_CHARACTERISTIC OUTc_b_DM19Request OUTc_o_DM19Request /end REF_CHARACTERISTIC /end FUNCTION
/begin FUNCTION DM19 "Group /ByModelHeirarchy/Gasoline/2.OBD/DM19" /begin SUB_FUNCTION CVN_Begas CVN_Real OVR_AndExport35 OVR_AndExport36 /end SUB_FUNCTION /begin REF_CHARACTERISTIC OBDc_b_BegasCVN /end REF_CHARACTERISTIC /end FUNCTION
/begin FUNCTION Distance_Counter "Group /ByModelHeirarchy/Gasoline/2.OBD/DM21/Distance_Counter" /begin REF_CHARACTERISTIC NVMc_NU_DistanceCounterDflt NVMca_NU_DistanceCounterDflt /end REF_CHARACTERISTIC /end FUNCTION
/begin FUNCTION Distance_CounterMIL "Group /ByModelHeirarchy/Gasoline/2.OBD/DM21/Distance_CounterMIL"
 /begin REF_CHARACTERISTIC NVMc_NU_DistanceCounterMILDflt NVMca_NU_DistanceCounterMILDflt /end REF_CHARACTERISTIC
/end FUNCTION
/begin FUNCTION Reset_Out "Group /ByModelHeirarchy/Gasoline/2.OBD/DM21/Reset_Out" /begin REF_CHARACTERISTIC DTCc_b_ResetNVM /end REF_CHARACTERISTIC /end FUNCTION
/begin FUNCTION TimeSinceEnabled "Group /ByModelHeirarchy/Gasoline/2.OBD/DM21/TimeSinceEnabled" /begin REF_CHARACTERISTIC NVMc_NU_EngineRuntimeDflt2 NVMca_NU_EngineRuntimeDflt2 /end REF_CHARACTERISTIC /end FUNCTION
/begin FUNCTION DM21 "Group /ByModelHeirarchy/Gasoline/2.OBD/DM21"
 /begin SUB_FUNCTION Distance_Counter Distance_CounterMIL Reset_Out TimeSinceEnabled /end SUB_FUNCTION
/end FUNCTION
/begin FUNCTION DM37 "Group /ByModelHeirarchy/Gasoline/2.OBD/DM37" /begin LOC_MEASUREMENT DTC_b_DM37request /end LOC_MEASUREMENT /end FUNCTION
/begin FUNCTION DM5 "Group /ByModelHeirarchy/Gasoline/2.OBD/DM5" /begin REF_CHARACTERISTIC exdc_dm5c_obd_compliance /end REF_CHARACTERISTIC /end FUNCTION
/begin FUNCTION LogEnable11 "Group /ByModelHeirarchy/Gasoline/2.OBD/LogEnable1" /begin REF_CHARACTERISTIC LOGc_b_EnableCanLog /end REF_CHARACTERISTIC /end FUNCTION
/begin FUNCTION MIL_Continous "Group /ByModelHeirarchy/Gasoline/2.OBD/MIL_Continous"
 /begin REF_CHARACTERISTIC DTCc_NU_DC DTCc_NU_Seconds DTCc_b_ResetNVM NVMc_NU_CyclesDflt NVMc_NU_HOURSDflt NVMc_NU_MILcontinousDflt NVMca_NU_CyclesDflt NVMca_NU_HOURSDflt NVMca_NU_MILcontinousDflt /end REF_CHARACTERISTIC
/end FUNCTION
/begin FUNCTION OVR_AndExport361 "Group /ByModelHeirarchy/Gasoline/2.OBD/OBD Enable/OVR_AndExport36" /begin LOC_MEASUREMENT TSS_b_OBDtimeOK /end LOC_MEASUREMENT /begin REF_CHARACTERISTIC TSSc_b_OBDtimeOK TSSc_o_OBDtimeOK /end REF_CHARACTERISTIC /end FUNCTION
/begin FUNCTION OVR_AndExport371 "Group /ByModelHeirarchy/Gasoline/2.OBD/OBD Enable/OVR_AndExport37" /begin LOC_MEASUREMENT AMB_b_OBDTempOK /end LOC_MEASUREMENT /begin REF_CHARACTERISTIC AMBc_b_OBDTempOK AMBc_o_OBDTempOK /end REF_CHARACTERISTIC /end FUNCTION
/begin FUNCTION OVR_AndExport382 "Group /ByModelHeirarchy/Gasoline/2.OBD/OBD Enable/OVR_AndExport38" /begin LOC_MEASUREMENT BAR_b_OBDPressOK /end LOC_MEASUREMENT /begin REF_CHARACTERISTIC BARc_b_OBDPressOK BARc_o_OBDPressOK /end REF_CHARACTERISTIC /end FUNCTION
/begin FUNCTION OBD_Enable "Group /ByModelHeirarchy/Gasoline/2.OBD/OBD Enable" /begin SUB_FUNCTION OVR_AndExport361 OVR_AndExport371 OVR_AndExport382 /end SUB_FUNCTION /end FUNCTION
/begin FUNCTION OVR_AndExport37 "Group /ByModelHeirarchy/Gasoline/2.OBD/OVR_AndExport1" /begin LOC_MEASUREMENT AIN_b_WU_start /end LOC_MEASUREMENT /begin REF_CHARACTERISTIC AINc_b_WU_start AINc_o_WU_start /end REF_CHARACTERISTIC /end FUNCTION
/begin FUNCTION OVR_AndExport38 "Group /ByModelHeirarchy/Gasoline/2.OBD/OVR_AndExport2" /begin LOC_MEASUREMENT AIN_NU_MIL_Status /end LOC_MEASUREMENT /begin REF_CHARACTERISTIC AINc_NU_MIL_Status AINc_o_MIL_Status /end REF_CHARACTERISTIC /end FUNCTION
/begin FUNCTION OVR_AndExport39 "Group /ByModelHeirarchy/Gasoline/2.OBD/OVR_AndExport3" /begin LOC_MEASUREMENT AIN_b_DC_start /end LOC_MEASUREMENT /begin REF_CHARACTERISTIC AINc_b_DC_start AINc_o_DC_start /end REF_CHARACTERISTIC /end FUNCTION
/begin FUNCTION OVR_AndExport40 "Group /ByModelHeirarchy/Gasoline/2.OBD/OVR_AndExport4" /begin LOC_MEASUREMENT AIN_b_IC_start /end LOC_MEASUREMENT /begin REF_CHARACTERISTIC AINc_b_IC_start AINc_o_IC_start /end REF_CHARACTERISTIC /end FUNCTION
/begin FUNCTION OVR_AndExport41 "Group /ByModelHeirarchy/Gasoline/2.OBD/OVR_AndExport5" /begin LOC_MEASUREMENT DTC_b_Readiness /end LOC_MEASUREMENT /begin REF_CHARACTERISTIC DTCc_b_Readiness DTCc_o_Readiness /end REF_CHARACTERISTIC /end FUNCTION
/begin FUNCTION OVR_AndExport67 "Group /ByModelHeirarchy/Gasoline/2.OBD/OVR_AndExport6" /begin LOC_MEASUREMENT OUT_b_MIL_LED /end LOC_MEASUREMENT /begin REF_CHARACTERISTIC OUTc_b_MIL_LED OUTc_o_MIL_LED /end REF_CHARACTERISTIC /end FUNCTION
/begin FUNCTION OVR_AndExport76 "Group /ByModelHeirarchy/Gasoline/2.OBD/OVR_AndExport7" /begin LOC_MEASUREMENT AIN_b_Eng_running /end LOC_MEASUREMENT /begin REF_CHARACTERISTIC AINc_b_Eng_running AINc_o_Eng_running /end REF_CHARACTERISTIC /end FUNCTION
/begin FUNCTION OVR_AndExport84 "Group /ByModelHeirarchy/Gasoline/2.OBD/OVR_AndExport8" /begin LOC_MEASUREMENT LOG_b_ENBOBD /end LOC_MEASUREMENT /begin REF_CHARACTERISTIC LOGc_b_ENBOBD LOGc_o_ENBOBD /end REF_CHARACTERISTIC /end FUNCTION
/begin FUNCTION VIN_Info "Group /ByModelHeirarchy/Gasoline/2.OBD/VIN/VIN_Info" /begin REF_CHARACTERISTIC DTCv_NU_VIN /end REF_CHARACTERISTIC /end FUNCTION
/begin FUNCTION VIN "Group /ByModelHeirarchy/Gasoline/2.OBD/VIN" /begin SUB_FUNCTION VIN_Info /end SUB_FUNCTION /begin REF_CHARACTERISTIC SYSc_b_TransmitVIN /end REF_CHARACTERISTIC /end FUNCTION
/begin FUNCTION _2.OBD "Group /ByModelHeirarchy/Gasoline/2.OBD"
 /begin SUB_FUNCTION Begas_DTC1 ClearAllDTCsDM11 DM1 DM11 DM19 DM21 DM37 DM5 LogEnable11 MIL_Continous OBD_Enable OVR_AndExport37 OVR_AndExport38 OVR_AndExport39 OVR_AndExport40 OVR_AndExport41 OVR_AndExport67 OVR_AndExport76 OVR_AndExport84 VIN /end SUB_FUNCTION
 /begin LOC_MEASUREMENT exd_NU_awlstatus exd_NU_milstatus exd_NU_prlstatus exd_NU_rslstatus ext_NU_activmode ext_NU_b1constinuous ext_NU_b1cumulative ext_NU_milcumulative /end LOC_MEASUREMENT
 /begin REF_CHARACTERISTIC DTCc_b_ResetNVM NVMc_NU_WarmCyclesCounterDflt NVMca_NU_WarmCyclesCounterDflt /end REF_CHARACTERISTIC
/end FUNCTION
/begin FUNCTION LogEnable "Group /ByModelHeirarchy/Gasoline/3.System_Diagnostics/CANLOG-SDG/LogEnable" /begin REF_CHARACTERISTIC LOGc_b_EnableCanLog /end REF_CHARACTERISTIC /end FUNCTION
/begin FUNCTION CANLOG_SDG "Group /ByModelHeirarchy/Gasoline/3.System_Diagnostics/CANLOG-SDG" /begin SUB_FUNCTION LogEnable /end SUB_FUNCTION /begin REF_CHARACTERISTIC LOGc_s_SDG01_Period /end REF_CHARACTERISTIC /end FUNCTION
/begin FUNCTION Fault_Management "Group /ByModelHeirarchy/Gasoline/3.System_Diagnostics/Fault Management" /begin REF_CHARACTERISTIC FMGc_b_ForceFltReset /end REF_CHARACTERISTIC /end FUNCTION
/begin FUNCTION OVR_AndExport42 "Group /ByModelHeirarchy/Gasoline/3.System_Diagnostics/OVR_AndExport1" /begin LOC_MEASUREMENT FMG_e_FltReset /end LOC_MEASUREMENT /begin REF_CHARACTERISTIC FMGc_e_FltReset FMGc_o_FltReset /end REF_CHARACTERISTIC /end FUNCTION
/begin FUNCTION OVR_AndExport43 "Group /ByModelHeirarchy/Gasoline/3.System_Diagnostics/OVR_AndExport2" /begin LOC_MEASUREMENT REM_pct_OvertempThrottleLimit /end LOC_MEASUREMENT
 /begin REF_CHARACTERISTIC REMc_o_OvertempThrottleLimit REMc_pct_OvertempThrottleLimit /end REF_CHARACTERISTIC
/end FUNCTION
/begin FUNCTION OVR_AndExport44 "Group /ByModelHeirarchy/Gasoline/3.System_Diagnostics/OVR_AndExport3" /begin LOC_MEASUREMENT REM_e_TurbineState /end LOC_MEASUREMENT /begin REF_CHARACTERISTIC REMc_e_TurbineState REMc_o_TurbineState /end REF_CHARACTERISTIC /end FUNCTION
/begin FUNCTION OVR_AndExport45 "Group /ByModelHeirarchy/Gasoline/3.System_Diagnostics/OVR_AndExport4" /begin LOC_MEASUREMENT REM_Nm_TqLimit /end LOC_MEASUREMENT /begin REF_CHARACTERISTIC REMc_Nm_TqLimit REMc_o_TqLimit /end REF_CHARACTERISTIC /end FUNCTION
/begin FUNCTION OVR_AndExport94 "Group /ByModelHeirarchy/Gasoline/3.System_Diagnostics/OVR_AndExport9" /begin LOC_MEASUREMENT REM_b_StopCombustion /end LOC_MEASUREMENT /begin REF_CHARACTERISTIC REMc_b_StopCombustion REMc_o_StopCombustion /end REF_CHARACTERISTIC /end FUNCTION
/begin FUNCTION Engine_running_reboot "Group /ByModelHeirarchy/Gasoline/3.System_Diagnostics/Remedial Actions/Engine-running-reboot" /begin REF_CHARACTERISTIC REMc_b_PreventRunningReboot REMc_s_RunningRebootWindow /end REF_CHARACTERISTIC /end FUNCTION
/begin FUNCTION Remedial_Actions "Group /ByModelHeirarchy/Gasoline/3.System_Diagnostics/Remedial Actions" /begin SUB_FUNCTION Engine_running_reboot /end SUB_FUNCTION
 /begin REF_CHARACTERISTIC REMc_C_OvertempThrsh REMc_C_TurbineShutdownThrsh REMc_C_TurbineWarningThrsh REMc_Nm_OvertempTqLimit REMc_b_EnblCombustion REMc_b_ResetTurbineShutdown REMc_pct_OvertempThrottleLimit REMc_s_PowerupDelay REMc_s_TurbineTempDbnc TARc_Nm_Max /end REF_CHARACTERISTIC
/end FUNCTION
/begin FUNCTION _3.System_Diagnostics "Group /ByModelHeirarchy/Gasoline/3.System_Diagnostics"
 /begin SUB_FUNCTION CANLOG_SDG Fault_Management OVR_AndExport42 OVR_AndExport43 OVR_AndExport44 OVR_AndExport45 OVR_AndExport94 Remedial_Actions /end SUB_FUNCTION
/end FUNCTION
/begin FUNCTION Calculate_Load "Group /ByModelHeirarchy/Gasoline/4.Engine_Control/ADM/Calculate Load" /begin REF_CHARACTERISTIC SYSc_cc_EngDisp /end REF_CHARACTERISTIC /end FUNCTION
/begin FUNCTION OVR_AndExport143 "Group /ByModelHeirarchy/Gasoline/4.Engine_Control/ADM/OVR_AndExport14" /begin LOC_MEASUREMENT ADM_gps_MAF_Trgt /end LOC_MEASUREMENT /begin REF_CHARACTERISTIC ADMc_gps_MAF_Trgt ADMc_o_MAF_Trgt /end REF_CHARACTERISTIC /end FUNCTION
/begin FUNCTION Corrected_Parameters "Group /ByModelHeirarchy/Gasoline/4.Engine_Control/ADM/Surge and Overspeed detection/Corrected Parameters" /begin LOC_MEASUREMENT ADM_RPM_TurSpdCorr ADM_gps_MAF_Corr /end LOC_MEASUREMENT /begin REF_CHARACTERISTIC ADMc_C_ComprNormRefTemp ADMc_kPa_ComprNormRefPress /end REF_CHARACTERISTIC /end FUNCTION
/begin FUNCTION Pressure_Ratio_Across_Compress0 "Group /ByModelHeirarchy/Gasoline/4.Engine_Control/ADM/Surge and Overspeed detection/Pressure Ratio Across Compressor"
 /begin LOC_MEASUREMENT ADM_NU_ComprInDens ADM_NU_ComprOutDens ADM_NU_ComprPressRatio ADM_kPa_ComprInDynPress ADM_kPa_ComprInPressTot ADM_kPa_ComprOutDynPress ADM_kPa_ComprOutPressTot ADM_mps_ComprInVel ADM_mps_ComprOutVel /end LOC_MEASUREMENT
 /begin REF_CHARACTERISTIC ADMc_cm2_ComprInArea ADMc_cm2_ComprOutArea /end REF_CHARACTERISTIC
/end FUNCTION
/begin FUNCTION Surge_detection "Group /ByModelHeirarchy/Gasoline/4.Engine_Control/ADM/Surge and Overspeed detection/Surge detection"
 /begin LOC_MEASUREMENT ADM_NU_ComprSurgeProx ADM_NU_SurgePressRatio ADM_b_ComprSurge /end LOC_MEASUREMENT
 /begin REF_CHARACTERISTIC ADMc_NU_ComprSurgeProxLim ADMc_s_SurgeDbnc ADMm_NU_ComprSurgeMap_x ADMm_NU_ComprSurgeMap_z /end REF_CHARACTERISTIC
/end FUNCTION
/begin FUNCTION Surge_and_Overspeed_detection "Group /ByModelHeirarchy/Gasoline/4.Engine_Control/ADM/Surge and Overspeed detection"
 /begin SUB_FUNCTION Corrected_Parameters Pressure_Ratio_Across_Compress0 Surge_detection /end SUB_FUNCTION
 /begin REF_CHARACTERISTIC ADMc_RPM_TurSpdThrsh ADMc_kPa_SrgChkTrgtBoost ADMc_s_OverspeedDbnc /end REF_CHARACTERISTIC
/end FUNCTION
/begin FUNCTION Boost_Request_Limits "Group /ByModelHeirarchy/Gasoline/4.Engine_Control/ADM/Throttle and Turbo Targets/Boost Request Limits" /begin REF_CHARACTERISTIC ADMm_NU_BoostLimit_x ADMm_NU_BoostLimit_z /end REF_CHARACTERISTIC /end FUNCTION
/begin FUNCTION OVR_AndExport144 "Group /ByModelHeirarchy/Gasoline/4.Engine_Control/ADM/Throttle and Turbo Targets/MAF Feedback Control  Throttle/ITerm/OVR_AndExport14" /begin LOC_MEASUREMENT ADM_b_TurboCancelThrottleITerm /end LOC_MEASUREMENT
 /begin REF_CHARACTERISTIC ADMc_b_TurboCancelThrottleITerm ADMc_o_TurboCancelThrottleITerm /end REF_CHARACTERISTIC
/end FUNCTION
/begin FUNCTION ITerm "Group /ByModelHeirarchy/Gasoline/4.Engine_Control/ADM/Throttle and Turbo Targets/MAF Feedback Control  Throttle/ITerm" /begin SUB_FUNCTION OVR_AndExport144 /end SUB_FUNCTION /begin LOC_MEASUREMENT ADM_NU_ThrottleIGain /end LOC_MEASUREMENT
 /begin REF_CHARACTERISTIC ADMc_b_ResetThrottleITerm ADMc_gps_ThrottleFB_Dbnd ADMc_pct_ThrottleITermMax ADMc_pct_ThrottleITermMin ADMm_NU_ThrottleIGain_x ADMm_NU_ThrottleIGain_y ADMm_NU_ThrottleIGain_z /end REF_CHARACTERISTIC
/end FUNCTION
/begin FUNCTION MAF_Feedback_Control__Throttle "Group /ByModelHeirarchy/Gasoline/4.Engine_Control/ADM/Throttle and Turbo Targets/MAF Feedback Control  Throttle" /begin SUB_FUNCTION ITerm /end SUB_FUNCTION
 /begin LOC_MEASUREMENT ADM_pct_ThrottleFB ADM_pct_ThrottleITerm ADM_pct_ThrottlePGain ADM_pct_ThrottlePTerm /end LOC_MEASUREMENT
 /begin REF_CHARACTERISTIC ADMc_pct_ThrottleFB_Dbnd ADMc_pct_ThrottleFB_Max ADMc_pct_ThrottleFB_Min ADMm_NU_ThrottlePGain_x ADMm_NU_ThrottlePGain_y ADMm_NU_ThrottlePGain_z /end REF_CHARACTERISTIC
/end FUNCTION
/begin FUNCTION ITerm1 "Group /ByModelHeirarchy/Gasoline/4.Engine_Control/ADM/Throttle and Turbo Targets/MAF Feedback Control  Turbo/ITerm" /begin LOC_MEASUREMENT ADM_NU_BoostIGain /end LOC_MEASUREMENT
 /begin REF_CHARACTERISTIC ADMc_NU_BoostITermMax ADMc_NU_BoostITermMin ADMc_b_ResetBoostITerm ADMc_gps_BoostFB_ErrorDbnd ADMm_NU_BoostIGain_x ADMm_NU_BoostIGain_y ADMm_NU_BoostIGain_z /end REF_CHARACTERISTIC
/end FUNCTION
/begin FUNCTION MAF_Feedback_Control__Turbo "Group /ByModelHeirarchy/Gasoline/4.Engine_Control/ADM/Throttle and Turbo Targets/MAF Feedback Control  Turbo" /begin SUB_FUNCTION ITerm1 /end SUB_FUNCTION /begin LOC_MEASUREMENT ADM_kPa_BoostFB ADM_kPa_BoostITerm ADM_kPa_BoostPTerm /end LOC_MEASUREMENT
 /begin REF_CHARACTERISTIC ADMc_kPa_BoostFB_Dbnd ADMc_kPa_BoostFB_Max ADMc_kPa_BoostFB_Min ADMm_NU_BoostPGain_x ADMm_NU_BoostPGain_y ADMm_NU_BoostPGain_z /end REF_CHARACTERISTIC
/end FUNCTION
/begin FUNCTION Throttle_and_Turbo_Targets "Group /ByModelHeirarchy/Gasoline/4.Engine_Control/ADM/Throttle and Turbo Targets"
 /begin SUB_FUNCTION Boost_Request_Limits MAF_Feedback_Control__Throttle MAF_Feedback_Control__Turbo /end SUB_FUNCTION
 /begin LOC_MEASUREMENT ADM_b_UseTurbo ADM_gps_MAF_TrgtErr ADM_kPa_BoostFF ADM_kPa_BoostPressTrgtRaw ADM_pct_ThrottleEffortRaw /end LOC_MEASUREMENT
 /begin REF_CHARACTERISTIC ADMc_NU_ThRqstFallRate ADMc_NU_ThRqstRiseRate ADMc_s_UseTurboDbnc ADMm_NU_BoostPressTrgtFF_x ADMm_NU_BoostPressTrgtFF_y ADMm_NU_BoostPressTrgtFF_z ADMm_NU_FF_ThrottleTrgt_x ADMm_NU_FF_ThrottleTrgt_y ADMm_NU_FF_ThrottleTrgt_z SYSc_b_TurboPrsnt /end REF_CHARACTERISTIC
/end FUNCTION
/begin FUNCTION Torque_to_MAF_Trgt "Group /ByModelHeirarchy/Gasoline/4.Engine_Control/ADM/Torque to MAF Trgt" /begin LOC_MEASUREMENT ADM_NU_ISFC ADM_gps_TrgtFuelFlow ADM_kW_TrgtPwr /end LOC_MEASUREMENT
 /begin REF_CHARACTERISTIC ADMc_NU_TqToMassAirFlowGain_k2 ADMc_lam_MaxLimit ADMc_lam_MinLimit ADMm_NU_ISFC_x ADMm_NU_ISFC_y ADMm_NU_ISFC_z /end REF_CHARACTERISTIC
/end FUNCTION
/begin FUNCTION VCP_Target "Group /ByModelHeirarchy/Gasoline/4.Engine_Control/ADM/VCP Target"
 /begin REF_CHARACTERISTIC ADMc_e_VCP_Method ADMc_ret_VCP_FixedTrgt ADMm_NU_CrankingVCP_x ADMm_NU_CrankingVCP_z ADMm_NU_VCP_Temp_x ADMm_NU_VCP_Temp_z ADMm_NU_VCP_Trgt_x ADMm_NU_VCP_Trgt_y ADMm_NU_VCP_Trgt_z /end REF_CHARACTERISTIC
/end FUNCTION
/begin FUNCTION Alpha "Group /ByModelHeirarchy/Gasoline/4.Engine_Control/ADM/VCP impact on Throttle/Alpha" /begin LOC_MEASUREMENT ADM_NU_Alpha /end LOC_MEASUREMENT
 /begin REF_CHARACTERISTIC ADMc_NU_AlphaL1 ADMc_NU_AlphaL2 ADMc_NU_AlphaL3 ADMc_NU_AlphaL4 ADMc_NU_AlphaL5 ADMc_NU_AlphaL6 /end REF_CHARACTERISTIC
/end FUNCTION
/begin FUNCTION LUT_based_correction "Group /ByModelHeirarchy/Gasoline/4.Engine_Control/ADM/VCP impact on Throttle/LUT-based correction" /begin LOC_MEASUREMENT ADM_kPa_NominalDP /end LOC_MEASUREMENT
 /begin REF_CHARACTERISTIC ADMm_NU_LUT_ThCorr_x ADMm_NU_LUT_ThCorr_y ADMm_NU_LUT_ThCorr_z ADMm_NU_NominalDP_x ADMm_NU_NominalDP_y ADMm_NU_NominalDP_z /end REF_CHARACTERISTIC
/end FUNCTION
/begin FUNCTION VCP_impact_on_Throttle "Group /ByModelHeirarchy/Gasoline/4.Engine_Control/ADM/VCP impact on Throttle" /begin SUB_FUNCTION Alpha LUT_based_correction /end SUB_FUNCTION
 /begin LOC_MEASUREMENT ADM_deg_EquationBasedThCorr ADM_deg_VCP_ThCorr ADM_gps_NominalMAF /end LOC_MEASUREMENT
 /begin REF_CHARACTERISTIC ADMc_NU_AlphaL1 ADMc_NU_AlphaL2 ADMc_NU_AlphaL5 ADMc_b_UseLUT_ThCorr ADMm_NU_VCP_ThCorr_x ADMm_NU_VCP_ThCorr_z SYSc_b_VCP /end REF_CHARACTERISTIC
/end FUNCTION
/begin FUNCTION ADM "Group /ByModelHeirarchy/Gasoline/4.Engine_Control/ADM"
 /begin SUB_FUNCTION Calculate_Load OVR_AndExport143 Surge_and_Overspeed_detection Throttle_and_Turbo_Targets Torque_to_MAF_Trgt VCP_Target VCP_impact_on_Throttle /end SUB_FUNCTION
 /begin LOC_MEASUREMENT ADM_deg_ThrottleTrgtRaw ADM_kPa_BoostPressTrgtRawCorr /end LOC_MEASUREMENT
 /begin REF_CHARACTERISTIC ADMc_deg_CorrThAngCranking ADMc_deg_DFC_ThAngTrgt ADMc_kPa_CrankingBoostPressTrgt ADMc_ret_DFC_VCP_Trgt ADMm_NU_ThrottleFlowToAng_x ADMm_NU_ThrottleFlowToAng_z /end REF_CHARACTERISTIC
/end FUNCTION
/begin FUNCTION LogEnable7 "Group /ByModelHeirarchy/Gasoline/4.Engine_Control/AF1_OK/LogEnable7" /begin REF_CHARACTERISTIC LOGc_b_EnableCanLog /end REF_CHARACTERISTIC /end FUNCTION
/begin FUNCTION AF1_OK "Group /ByModelHeirarchy/Gasoline/4.Engine_Control/AF1_OK" /begin SUB_FUNCTION LogEnable7 /end SUB_FUNCTION /end FUNCTION
/begin FUNCTION OVR_AndExport46 "Group /ByModelHeirarchy/Gasoline/4.Engine_Control/AFR/OVR_AndExport1" /begin LOC_MEASUREMENT AFR_lam_TableResult /end LOC_MEASUREMENT /begin REF_CHARACTERISTIC AFRc_lam_TableResult AFRc_o_TableResult /end REF_CHARACTERISTIC /end FUNCTION
/begin FUNCTION OVR_AndExport44 "Group /ByModelHeirarchy/Gasoline/4.Engine_Control/AFR/OVR_AndExport44" /begin LOC_MEASUREMENT AFR_lam_BaseTrgt /end LOC_MEASUREMENT /begin REF_CHARACTERISTIC AFRc_lam_BaseTrgt AFRc_o_BaseTrgt /end REF_CHARACTERISTIC /end FUNCTION
/begin FUNCTION Protecci__n_por_sobrecalentami0 "Group /ByModelHeirarchy/Gasoline/4.Engine_Control/AFR/Protección por sobrecalentamiento por plena carga continua" /begin REF_CHARACTERISTIC AFRc_pct_EnrichLoadThresh AFRc_s_DelayEnrichDelta /end REF_CHARACTERISTIC /end FUNCTION
/begin FUNCTION Transition_to_running_AFR "Group /ByModelHeirarchy/Gasoline/4.Engine_Control/AFR/Transition to running AFR" /begin LOC_MEASUREMENT AFR_b_UseRateLim AFR_lam_RampedTrgt /end LOC_MEASUREMENT /begin REF_CHARACTERISTIC AFRm_NU_RampRate_x AFRm_NU_RampRate_z /end REF_CHARACTERISTIC /end FUNCTION
/begin FUNCTION AFR "Group /ByModelHeirarchy/Gasoline/4.Engine_Control/AFR"
 /begin SUB_FUNCTION OVR_AndExport46 OVR_AndExport44 Protecci__n_por_sobrecalentami0 Transition_to_running_AFR /end SUB_FUNCTION
 /begin LOC_MEASUREMENT AFR_lam_CrankingTrgt /end LOC_MEASUREMENT
 /begin REF_CHARACTERISTIC AFRc_lam_ExitDFCEnrichment AFRc_lam_TIT_EnrichDelta AFRc_lam_TrgtMax AFRc_lam_TrgtMin AFRc_s_HoldDFCOpenLoop AFRm_NU_BaseTrgt_x AFRm_NU_BaseTrgt_y AFRm_NU_BaseTrgt_z AFRm_NU_CSI_Trgt_x AFRm_NU_CSI_Trgt_y AFRm_NU_CSI_Trgt_z AFRm_NU_CrankingTrgt_x AFRm_NU_CrankingTrgt_y AFRm_NU_CrankingTrgt_z /end REF_CHARACTERISTIC
/end FUNCTION
/begin FUNCTION LogEnable4 "Group /ByModelHeirarchy/Gasoline/4.Engine_Control/AMB_OK/LogEnable4" /begin REF_CHARACTERISTIC LOGc_b_EnableCanLog /end REF_CHARACTERISTIC /end FUNCTION
/begin FUNCTION AMB_OK "Group /ByModelHeirarchy/Gasoline/4.Engine_Control/AMB_OK" /begin SUB_FUNCTION LogEnable4 /end SUB_FUNCTION /end FUNCTION
/begin FUNCTION Airflow_based_Load "Group /ByModelHeirarchy/Gasoline/4.Engine_Control/AME/Airflow-based Load" /begin LOC_MEASUREMENT AME_gps_IdealAirAtSTP /end LOC_MEASUREMENT /begin REF_CHARACTERISTIC AMEc_Hz_LoadFiltCutoff SYSc_cc_EngDisp /end REF_CHARACTERISTIC /end FUNCTION
/begin FUNCTION Engine_stopped__Baro_determina0 "Group /ByModelHeirarchy/Gasoline/4.Engine_Control/AME/Engine-stopped  Baro determination" /begin LOC_MEASUREMENT AME_b_LearnedBaro /end LOC_MEASUREMENT /begin REF_CHARACTERISTIC AMEc_kPa_BaroMax AMEc_kPa_BaroMin AMEc_s_BaroLearnDbnc /end REF_CHARACTERISTIC /end FUNCTION
/begin FUNCTION MAF_Corrections "Group /ByModelHeirarchy/Gasoline/4.Engine_Control/AME/MAF Corrections" /begin LOC_MEASUREMENT AME_gps_MAF_Corr AME_pct_MAF_Ofst /end LOC_MEASUREMENT /begin REF_CHARACTERISTIC AMEm_NU_MAF_Ofst_x AMEm_NU_MAF_Ofst_y AMEm_NU_MAF_Ofst_z /end REF_CHARACTERISTIC /end FUNCTION
/begin FUNCTION OVR_AndExport261 "Group /ByModelHeirarchy/Gasoline/4.Engine_Control/AME/OVR_AndExport26" /begin LOC_MEASUREMENT AME_gps_FreshMassAirFlow /end LOC_MEASUREMENT /begin REF_CHARACTERISTIC AMEc_gps_FreshMassAirFlow AMEc_o_FreshMassAirFlow /end REF_CHARACTERISTIC /end FUNCTION
/begin FUNCTION Select_Estimate "Group /ByModelHeirarchy/Gasoline/4.Engine_Control/AME/Select Estimate"
 /begin REF_CHARACTERISTIC AMEc_b_EnableMAF AMEc_b_EnableSD AMEm_NU_UseMAF_x AMEm_NU_UseMAF_y AMEm_NU_UseMAF_z /end REF_CHARACTERISTIC
/end FUNCTION
/begin FUNCTION Charge_Pressure "Group /ByModelHeirarchy/Gasoline/4.Engine_Control/AME/Speed Density airflow/Charge Pressure" /begin LOC_MEASUREMENT AME_kPa_ChargePress /end LOC_MEASUREMENT /begin REF_CHARACTERISTIC AMEm_NU_ResidualPress_x AMEm_NU_ResidualPress_z /end REF_CHARACTERISTIC /end FUNCTION
/begin FUNCTION OVR_AndExport252 "Group /ByModelHeirarchy/Gasoline/4.Engine_Control/AME/Speed Density airflow/Charge Temp/OVR_AndExport25" /begin LOC_MEASUREMENT AME_C_ChargeTemp /end LOC_MEASUREMENT /begin REF_CHARACTERISTIC AMEc_C_ChargeTemp AMEc_o_ChargeTemp /end REF_CHARACTERISTIC /end FUNCTION
/begin FUNCTION Charge_Temp "Group /ByModelHeirarchy/Gasoline/4.Engine_Control/AME/Speed Density airflow/Charge Temp" /begin SUB_FUNCTION OVR_AndExport252 /end SUB_FUNCTION /begin LOC_MEASUREMENT AME_C_ChargeTempDelta AME_pct_ChargeTempCF /end LOC_MEASUREMENT
 /begin REF_CHARACTERISTIC AMEc_Hz_ChargeTempLPF AMEm_NU_ChargeTempCF_x AMEm_NU_ChargeTempCF_y AMEm_NU_ChargeTempCF_z /end REF_CHARACTERISTIC
/end FUNCTION
/begin FUNCTION Charge_Volume "Group /ByModelHeirarchy/Gasoline/4.Engine_Control/AME/Speed Density airflow/Charge Volume" /begin LOC_MEASUREMENT AME_cc_ChargeVol /end LOC_MEASUREMENT /begin REF_CHARACTERISTIC SYSc_cc_EngDisp SYSc_cnt_NumOfCyls /end REF_CHARACTERISTIC /end FUNCTION
/begin FUNCTION GasEqn "Group /ByModelHeirarchy/Gasoline/4.Engine_Control/AME/Speed Density airflow/GasEqn" /begin LOC_MEASUREMENT AME_mg_SD_AirMassPerCyl /end LOC_MEASUREMENT /end FUNCTION
/begin FUNCTION OVR_AndExport124 "Group /ByModelHeirarchy/Gasoline/4.Engine_Control/AME/Speed Density airflow/VolumetricEfficiency/OVR_AndExport12" /begin LOC_MEASUREMENT AME_pct_VolEff /end LOC_MEASUREMENT /begin REF_CHARACTERISTIC AMEc_o_VolEff AMEc_pct_VolEff /end REF_CHARACTERISTIC /end FUNCTION
/begin FUNCTION VolumetricEfficiency "Group /ByModelHeirarchy/Gasoline/4.Engine_Control/AME/Speed Density airflow/VolumetricEfficiency" /begin SUB_FUNCTION OVR_AndExport124 /end SUB_FUNCTION /begin REF_CHARACTERISTIC AMEm_NU_VolEff_x AMEm_NU_VolEff_y AMEm_NU_VolEff_z /end REF_CHARACTERISTIC /end FUNCTION
/begin FUNCTION mg_per_firing_to_gps "Group /ByModelHeirarchy/Gasoline/4.Engine_Control/AME/Speed Density airflow/mg-per-firing to gps" /begin REF_CHARACTERISTIC SYSc_cnt_NumOfCyls /end REF_CHARACTERISTIC /end FUNCTION
/begin FUNCTION Speed_Density_airflow "Group /ByModelHeirarchy/Gasoline/4.Engine_Control/AME/Speed Density airflow"
 /begin SUB_FUNCTION Charge_Pressure Charge_Temp Charge_Volume GasEqn VolumetricEfficiency mg_per_firing_to_gps /end SUB_FUNCTION
 /begin LOC_MEASUREMENT AME_gps_SD_MassAirFlow /end LOC_MEASUREMENT
/end FUNCTION
/begin FUNCTION Transient_Correction "Group /ByModelHeirarchy/Gasoline/4.Engine_Control/AME/Transient Correction" /begin LOC_MEASUREMENT AME_b_Transient AME_pct_DemandHPF_Peak AME_pct_DmndHPF /end LOC_MEASUREMENT
 /begin REF_CHARACTERISTIC AMEc_NU_DmndHPF AMEc_pct_DemandHPF_Thrsh AMEm_NU_UseDemandTime_x AMEm_NU_UseDemandTime_y AMEm_NU_UseDemandTime_z /end REF_CHARACTERISTIC
/end FUNCTION
/begin FUNCTION gps_to_mg_per_firing "Group /ByModelHeirarchy/Gasoline/4.Engine_Control/AME/gps to mg per firing" /begin REF_CHARACTERISTIC SYSc_cnt_NumOfCyls /end REF_CHARACTERISTIC /end FUNCTION
/begin FUNCTION AME "Group /ByModelHeirarchy/Gasoline/4.Engine_Control/AME"
 /begin SUB_FUNCTION Airflow_based_Load Engine_stopped__Baro_determina0 MAF_Corrections OVR_AndExport261 Select_Estimate Speed_Density_airflow Transient_Correction gps_to_mg_per_firing /end SUB_FUNCTION
 /begin LOC_MEASUREMENT AME_gps_MAF_FreshMassAirFlow AME_gps_MassAirFlowUncorr AME_gps_MassAirFlowUnfiltd AME_gps_SD_FreshMassAirFlow AME_pct_UseMAF /end LOC_MEASUREMENT
 /begin REF_CHARACTERISTIC AMEc_Hz_MassAirFlowLPF /end REF_CHARACTERISTIC
/end FUNCTION
/begin FUNCTION If_Action_Subsystem "Group /ByModelHeirarchy/Gasoline/4.Engine_Control/APP/Arbitration/Arbitration/If Action Subsystem" /begin REF_CHARACTERISTIC APPc_pct_APP1_Wgt /end REF_CHARACTERISTIC /end FUNCTION
/begin FUNCTION Arbitration1 "Group /ByModelHeirarchy/Gasoline/4.Engine_Control/APP/Arbitration/Arbitration" /begin SUB_FUNCTION If_Action_Subsystem /end SUB_FUNCTION /end FUNCTION
/begin FUNCTION OVR_AndExport320 "Group /ByModelHeirarchy/Gasoline/4.Engine_Control/APP/Arbitration/Correlation/OVR_AndExport34" /begin LOC_MEASUREMENT DTC_b_APP_CorrFLT /end LOC_MEASUREMENT /begin REF_CHARACTERISTIC DTCc_b_APP_CorrFLT DTCc_o_APP_CorrFLT /end REF_CHARACTERISTIC /end FUNCTION
/begin FUNCTION Correlation "Group /ByModelHeirarchy/Gasoline/4.Engine_Control/APP/Arbitration/Correlation" /begin SUB_FUNCTION OVR_AndExport320 /end SUB_FUNCTION /begin LOC_MEASUREMENT APP_b_CorrFlt /end LOC_MEASUREMENT /begin REF_CHARACTERISTIC APPc_pct_CorrFltLim APPc_s_CorrFltDelay /end REF_CHARACTERISTIC /end FUNCTION
/begin FUNCTION OVR_AndExport47 "Group /ByModelHeirarchy/Gasoline/4.Engine_Control/APP/Arbitration/OVR_AndExport2" /begin LOC_MEASUREMENT APP_b_BrakePedal_actv /end LOC_MEASUREMENT /begin REF_CHARACTERISTIC APPc_b_BrakePedal_actv APPc_o_BrakePedal_actv /end REF_CHARACTERISTIC /end FUNCTION
/begin FUNCTION Speed_Limit "Group /ByModelHeirarchy/Gasoline/4.Engine_Control/APP/Arbitration/Speed Limit"
 /begin REF_CHARACTERISTIC APPc_b_SpeedLimitActv APPc_kmh_SpeedLimitSetpoint APPm_NU_SpeedLimitGain_x APPm_NU_SpeedLimitGain_z /end REF_CHARACTERISTIC
/end FUNCTION
/begin FUNCTION Arbitration "Group /ByModelHeirarchy/Gasoline/4.Engine_Control/APP/Arbitration" /begin SUB_FUNCTION Arbitration1 Correlation OVR_AndExport47 Speed_Limit /end SUB_FUNCTION /begin REF_CHARACTERISTIC APPc_b_ResetFaultLatch /end REF_CHARACTERISTIC /end FUNCTION
/begin FUNCTION Convert_to_Torque "Group /ByModelHeirarchy/Gasoline/4.Engine_Control/APP/Convert to Torque" /begin LOC_MEASUREMENT APP_Nm_DrvrTqDmndRaw /end LOC_MEASUREMENT
 /begin REF_CHARACTERISTIC APPc_Nm_DrvrTqDmndMax APPc_Nm_DrvrTqDmndMin APPc_b_UseTransGear APPc_b_idleRPMVh APPc_b_pedalmode APPm_NU_DrvrTqDmndFallRate_x APPm_NU_DrvrTqDmndFallRate_y APPm_NU_DrvrTqDmndFallRate_z APPm_NU_DrvrTqDmndRiseRate_x APPm_NU_DrvrTqDmndRiseRate_y APPm_NU_DrvrTqDmndRiseRate_z APPm_Nm_DrvrTqDmndMapIdle_x APPm_Nm_DrvrTqDmndMapIdle_z APPm_Nm_DrvrTqDmndMap_1_x APPm_Nm_DrvrTqDmndMap_1_y APPm_Nm_DrvrTqDmndMap_1_z APPm_Nm_DrvrTqDmndMap_2_x APPm_Nm_DrvrTqDmndMap_2_y APPm_Nm_DrvrTqDmndMap_2_z APPm_Nm_DrvrTqDmndMap_3_x APPm_Nm_DrvrTqDmndMap_3_y APPm_Nm_DrvrTqDmndMap_3_z APPm_Nm_DrvrTqDmndMap_4_x APPm_Nm_DrvrTqDmndMap_4_y APPm_Nm_DrvrTqDmndMap_4_z APPm_Nm_DrvrTqDmndMap_5_x APPm_Nm_DrvrTqDmndMap_5_y APPm_Nm_DrvrTqDmndMap_5_z APPm_Nm_DrvrTqDmndMap_IDLE_x APPm_Nm_DrvrTqDmndMap_IDLE_y APPm_Nm_DrvrTqDmndMap_IDLE_z /end REF_CHARACTERISTIC
/end FUNCTION
/begin FUNCTION EnableFullPdlLearn "Group /ByModelHeirarchy/Gasoline/4.Engine_Control/APP/Learn-Scale-NVM/EnableFullPdlLearn"
 /begin REF_CHARACTERISTIC APPc_V_FullLearnHiLimAPP1 APPc_V_FullLearnHiLimAPP2 APPc_V_FullLearnLoLimAPP1 APPc_V_FullLearnLoLimAPP2 APPc_b_FullLearnEnbl /end REF_CHARACTERISTIC
/end FUNCTION
/begin FUNCTION EnableZeroPdlLearn "Group /ByModelHeirarchy/Gasoline/4.Engine_Control/APP/Learn-Scale-NVM/EnableZeroPdlLearn" /begin LOC_MEASUREMENT APP_b_ZeroLearnEnAPP1 APP_b_ZeroLearnEnAPP2 /end LOC_MEASUREMENT
 /begin REF_CHARACTERISTIC APPc_V_ZeroLearnHiLimAPP1 APPc_V_ZeroLearnHiLimAPP2 APPc_V_ZeroLearnLoLimAPP1 APPc_V_ZeroLearnLoLimAPP2 APPc_kph_ZeroLearnSpdThrsh /end REF_CHARACTERISTIC
/end FUNCTION
/begin FUNCTION APP1_Full_Adapt "Group /ByModelHeirarchy/Gasoline/4.Engine_Control/APP/Learn-Scale-NVM/LearnFullPdl/APP1_Full_Adapt" /begin REF_CHARACTERISTIC APPc_V_FullLearnDfltValAPP1 APPca_V_FullLearnDfltValAPP1 /end REF_CHARACTERISTIC /end FUNCTION
/begin FUNCTION APP2_Full_Adapt "Group /ByModelHeirarchy/Gasoline/4.Engine_Control/APP/Learn-Scale-NVM/LearnFullPdl/APP2_Full_Adapt" /begin REF_CHARACTERISTIC APPc_V_FullLearnDfltValAPP2 APPca_V_FullLearnDfltValAPP2 /end REF_CHARACTERISTIC /end FUNCTION
/begin FUNCTION LearnFullPdl "Group /ByModelHeirarchy/Gasoline/4.Engine_Control/APP/Learn-Scale-NVM/LearnFullPdl" /begin SUB_FUNCTION APP1_Full_Adapt APP2_Full_Adapt /end SUB_FUNCTION /begin LOC_MEASUREMENT APP_V_FullLearnNewAPP1 APP_V_FullLearnNewAPP2 /end LOC_MEASUREMENT
 /begin REF_CHARACTERISTIC APPc_V_FullLearnDfltValAPP1 APPc_V_ZeroLearnDfltValAPP2 APPca_V_FullLearnDfltValAPP1 /end REF_CHARACTERISTIC
/end FUNCTION
/begin FUNCTION LearnZeroPdl "Group /ByModelHeirarchy/Gasoline/4.Engine_Control/APP/Learn-Scale-NVM/LearnZeroPdl" /begin LOC_MEASUREMENT APP_V_ZeroLearnPosAPP1 APP_V_ZeroLearnPosAPP2 /end LOC_MEASUREMENT
 /begin REF_CHARACTERISTIC APPc_NU_APP1_ZeroCreepUpRate APPc_NU_APP2_ZeroCreepUpRate APPc_V_ZeroLearnDfltValAPP1 APPc_V_ZeroLearnDfltValAPP2 /end REF_CHARACTERISTIC
/end FUNCTION
/begin FUNCTION apply_xfr "Group /ByModelHeirarchy/Gasoline/4.Engine_Control/APP/Learn-Scale-NVM/apply xfr" /begin REF_CHARACTERISTIC APPc_b_APP1_Inverted /end REF_CHARACTERISTIC /end FUNCTION
/begin FUNCTION apply_xfr1 "Group /ByModelHeirarchy/Gasoline/4.Engine_Control/APP/Learn-Scale-NVM/apply xfr1" /begin REF_CHARACTERISTIC APPc_b_APP2_Inverted /end REF_CHARACTERISTIC /end FUNCTION
/begin FUNCTION Learn_Scale_NVM "Group /ByModelHeirarchy/Gasoline/4.Engine_Control/APP/Learn-Scale-NVM"
 /begin SUB_FUNCTION EnableFullPdlLearn EnableZeroPdlLearn LearnFullPdl LearnZeroPdl apply_xfr apply_xfr1 /end SUB_FUNCTION
 /begin LOC_MEASUREMENT APP_pct_APP1 APP_pct_APP2 /end LOC_MEASUREMENT
/end FUNCTION
/begin FUNCTION APP "Group /ByModelHeirarchy/Gasoline/4.Engine_Control/APP" /begin SUB_FUNCTION Arbitration Convert_to_Torque Learn_Scale_NVM /end SUB_FUNCTION /begin LOC_MEASUREMENT APP_V_APP1_Filtd APP_V_APP2_Filtd /end LOC_MEASUREMENT
 /begin REF_CHARACTERISTIC APPc_Hz_APP1_LPF APPc_Hz_APP2_LPF APPc_pct_PdlModeFull APPc_pct_PdlModeHyst APPc_pct_PdlModeZero /end REF_CHARACTERISTIC
/end FUNCTION
/begin FUNCTION OVR_AndExport48 "Group /ByModelHeirarchy/Gasoline/4.Engine_Control/Auto/OVR_AndExport1" /begin LOC_MEASUREMENT LOG_b_ZF_Auto /end LOC_MEASUREMENT /begin REF_CHARACTERISTIC LOGc_b_ZF_Auto LOGc_o_ZF_Auto /end REF_CHARACTERISTIC /end FUNCTION
/begin FUNCTION Auto "Group /ByModelHeirarchy/Gasoline/4.Engine_Control/Auto" /begin SUB_FUNCTION OVR_AndExport48 /end SUB_FUNCTION /begin REF_CHARACTERISTIC LOGc_b_ZF_auto_ena /end REF_CHARACTERISTIC /end FUNCTION
/begin FUNCTION mgps_to_mg_per_firing "Group /ByModelHeirarchy/Gasoline/4.Engine_Control/BAF/mgps to mg-per-firing" /begin REF_CHARACTERISTIC SYSc_cnt_NumOfCyls /end REF_CHARACTERISTIC /end FUNCTION
/begin FUNCTION BAF "Group /ByModelHeirarchy/Gasoline/4.Engine_Control/BAF" /begin SUB_FUNCTION mgps_to_mg_per_firing /end SUB_FUNCTION /begin LOC_MEASUREMENT BAF_NU_TrgtAFR1 BAF_mg_FuelRqst1Raw /end LOC_MEASUREMENT
 /begin REF_CHARACTERISTIC BAFm_NU_BaseFuelCI_x BAFm_NU_BaseFuelCI_y BAFm_NU_BaseFuelCI_z BAFm_NU_TransientFuelGain_x BAFm_NU_TransientFuelGain_y BAFm_NU_TransientFuelGain_z /end REF_CHARACTERISTIC
/end FUNCTION
/begin FUNCTION BAS "Group /ByModelHeirarchy/Gasoline/4.Engine_Control/BAS"
 /begin LOC_MEASUREMENT BAS_adv_CrankingSpark BAS_adv_MBT_Spark BAS_adv_MBT_SparkLowGradeFuel BAS_b_LowGradeFuel BAS_cnt_KnockEvents /end LOC_MEASUREMENT
 /begin REF_CHARACTERISTIC BASc_cnt_KnockEventCalThrsh BASm_NU_CrankingSpark_x BASm_NU_CrankingSpark_y BASm_NU_CrankingSpark_z BASm_NU_MBT_SparkLowGradeFuel_x BASm_NU_MBT_SparkLowGradeFuel_y BASm_NU_MBT_SparkLowGradeFuel_z BASm_NU_MBT_Spark_x BASm_NU_MBT_Spark_y BASm_NU_MBT_Spark_z /end REF_CHARACTERISTIC
/end FUNCTION
/begin FUNCTION LogEnable8 "Group /ByModelHeirarchy/Gasoline/4.Engine_Control/BCM/LogEnable8" /begin REF_CHARACTERISTIC LOGc_b_EnableCanLog /end REF_CHARACTERISTIC /end FUNCTION
/begin FUNCTION OVR_AndExport49 "Group /ByModelHeirarchy/Gasoline/4.Engine_Control/BCM/OVR_AndExport1" /begin LOC_MEASUREMENT OUT_b_BCM_ena /end LOC_MEASUREMENT /begin REF_CHARACTERISTIC OUTc_b_BCM_ena OUTc_o_BCM_ena /end REF_CHARACTERISTIC /end FUNCTION
/begin FUNCTION OVR_AndExport50 "Group /ByModelHeirarchy/Gasoline/4.Engine_Control/BCM/OVR_AndExport2" /begin LOC_MEASUREMENT OUT_b_BCM_ZF_ena /end LOC_MEASUREMENT /begin REF_CHARACTERISTIC OUTc_b_BCM_ZF_ena OUTc_o_BCM_ZF_ena /end REF_CHARACTERISTIC /end FUNCTION
/begin FUNCTION BCM "Group /ByModelHeirarchy/Gasoline/4.Engine_Control/BCM" /begin SUB_FUNCTION LogEnable8 OVR_AndExport49 OVR_AndExport50 /end SUB_FUNCTION /begin REF_CHARACTERISTIC OUTc_b_BCM OUTc_b_BCM_ZF /end REF_CHARACTERISTIC /end FUNCTION
/begin FUNCTION LogEnable101 "Group /ByModelHeirarchy/Gasoline/4.Engine_Control/Begas_Herko-LCD/LogEnable10" /begin REF_CHARACTERISTIC LOGc_b_EnableCanLog /end REF_CHARACTERISTIC /end FUNCTION
/begin FUNCTION Begas_Herko_LCD "Group /ByModelHeirarchy/Gasoline/4.Engine_Control/Begas_Herko-LCD" /begin SUB_FUNCTION LogEnable101 /end SUB_FUNCTION /end FUNCTION
/begin FUNCTION CI1 "Group /ByModelHeirarchy/Gasoline/4.Engine_Control/CI/CI" /begin REF_CHARACTERISTIC DTCv_NU_ESN /end REF_CHARACTERISTIC /end FUNCTION
/begin FUNCTION CI "Group /ByModelHeirarchy/Gasoline/4.Engine_Control/CI" /begin SUB_FUNCTION CI1 /end SUB_FUNCTION /end FUNCTION
/begin FUNCTION Custom_PID "Group /ByModelHeirarchy/Gasoline/4.Engine_Control/CLF  upstream UEGO/Custom PID"
 /begin LOC_MEASUREMENT CLF_NU_FB1_ErrorDot CLF_lam_DTermLPF1 CLF_lam_FB1_ITerm CLF_lam_FB1_PTerm /end LOC_MEASUREMENT
 /begin REF_CHARACTERISTIC CLFc_Hz_DTermLPF CLFc_b_AllowITermReset CLFc_lam_FB_IMax CLFc_lam_FB_IMin CLFc_lam_ITermResetThrsh /end REF_CHARACTERISTIC
/end FUNCTION
/begin FUNCTION Custom_PID1 "Group /ByModelHeirarchy/Gasoline/4.Engine_Control/CLF  upstream UEGO/Custom PID1"
 /begin LOC_MEASUREMENT CLF_NU_FB2_ErrorDot CLF_lam_DTermLPF2 CLF_lam_FB2_ITerm CLF_lam_FB2_PTerm /end LOC_MEASUREMENT
 /begin REF_CHARACTERISTIC CLFc_Hz_DTermLPF CLFc_b_AllowITermReset CLFc_lam_FB_IMax CLFc_lam_FB_IMin CLFc_lam_ITermResetThrsh /end REF_CHARACTERISTIC
/end FUNCTION
/begin FUNCTION Speed_to_firings "Group /ByModelHeirarchy/Gasoline/4.Engine_Control/CLF  upstream UEGO/Dither pattern generation/Speed to firings" /begin REF_CHARACTERISTIC SYSc_cnt_NumOfCyls /end REF_CHARACTERISTIC /end FUNCTION
/begin FUNCTION Dither_pattern_generation "Group /ByModelHeirarchy/Gasoline/4.Engine_Control/CLF  upstream UEGO/Dither pattern generation" /begin SUB_FUNCTION Speed_to_firings /end SUB_FUNCTION
 /begin LOC_MEASUREMENT CLF_b_Dither1Active CLF_b_Dither1Lean CLF_b_Dither1Rich CLF_cnt_LeanFiringsRqst1 CLF_cnt_RichFiringsRqst1 /end LOC_MEASUREMENT
 /begin REF_CHARACTERISTIC CLFc_b_EnblDither CLFc_lam_LeanStep CLFc_lam_RichStep CLFc_lam_StoicThrshMax CLFc_lam_StoicThrshMin CLFc_s_DitherActiveDbnc CLFc_s_DitherActiveHold CLFm_NU_DitherLeanFirings_x CLFm_NU_DitherLeanFirings_y CLFm_NU_DitherLeanFirings_z CLFm_NU_DitherRichFirings_x CLFm_NU_DitherRichFirings_y CLFm_NU_DitherRichFirings_z /end REF_CHARACTERISTIC
/end FUNCTION
/begin FUNCTION Speed_to_firings1 "Group /ByModelHeirarchy/Gasoline/4.Engine_Control/CLF  upstream UEGO/Dither pattern generation1/Speed to firings" /begin REF_CHARACTERISTIC SYSc_cnt_NumOfCyls /end REF_CHARACTERISTIC /end FUNCTION
/begin FUNCTION Dither_pattern_generation1 "Group /ByModelHeirarchy/Gasoline/4.Engine_Control/CLF  upstream UEGO/Dither pattern generation1" /begin SUB_FUNCTION Speed_to_firings1 /end SUB_FUNCTION
 /begin LOC_MEASUREMENT CLF_b_Dither1Active CLF_b_Dither2Active CLF_b_Dither2Lean CLF_b_Dither2Rich CLF_cnt_LeanFiringsRqst2 CLF_cnt_RichFiringsRqst2 /end LOC_MEASUREMENT
 /begin REF_CHARACTERISTIC CLFc_b_EnblDither CLFc_lam_LeanStep CLFc_lam_RichStep CLFc_lam_StoicThrshMax CLFc_lam_StoicThrshMin CLFc_s_DitherActiveDbnc CLFm_NU_DitherLeanFirings_x CLFm_NU_DitherLeanFirings_y CLFm_NU_DitherLeanFirings_z CLFm_NU_DitherRichFirings_x CLFm_NU_DitherRichFirings_y CLFm_NU_DitherRichFirings_z /end REF_CHARACTERISTIC
/end FUNCTION
/begin FUNCTION Enablement_criteria "Group /ByModelHeirarchy/Gasoline/4.Engine_Control/CLF  upstream UEGO/Enablement criteria"
 /begin LOC_MEASUREMENT CLF_RPM_EngSpdHPF CLF_b_FB1_Enbld CLF_b_FB2_Enbld CLF_pct_LoadHPF /end LOC_MEASUREMENT
 /begin REF_CHARACTERISTIC CLFc_NU_EngSpdHPF_TC CLFc_NU_LoadHPF_TC CLFc_RPM_EngSpdHPF_Thrsh CLFc_b_EnblFB1 CLFc_b_EnblFB2 CLFc_lam_UEGO1_Max CLFc_lam_UEGO1_Min CLFc_lam_UEGO2_Max CLFc_lam_UEGO2_Min CLFc_pct_LoadHPF_Thrsh CLFc_s_UEGO1_Dbnc CLFc_s_UEGO2_Dbnc /end REF_CHARACTERISTIC
/end FUNCTION
/begin FUNCTION Gain_Scheduling "Group /ByModelHeirarchy/Gasoline/4.Engine_Control/CLF  upstream UEGO/Gain Scheduling"
 /begin LOC_MEASUREMENT CLF_NU_DGainFast1 CLF_NU_DGainSlow1 CLF_NU_IGainFast1 CLF_NU_IGainSlow1 CLF_NU_PGainFast1 CLF_NU_PGainSlow1 /end LOC_MEASUREMENT
 /begin REF_CHARACTERISTIC CLFc_NU_PID_GainScale CLFm_NU_DGainFast_x CLFm_NU_DGainFast_y CLFm_NU_DGainFast_z CLFm_NU_DGainSlow_x CLFm_NU_DGainSlow_y CLFm_NU_DGainSlow_z CLFm_NU_IGainFast_x CLFm_NU_IGainFast_y CLFm_NU_IGainFast_z CLFm_NU_IGainSlow_x CLFm_NU_IGainSlow_y CLFm_NU_IGainSlow_z CLFm_NU_PGainFast_x CLFm_NU_PGainFast_y CLFm_NU_PGainFast_z CLFm_NU_PGainSlow_x CLFm_NU_PGainSlow_y CLFm_NU_PGainSlow_z /end REF_CHARACTERISTIC
/end FUNCTION
/begin FUNCTION Gain_Scheduling1 "Group /ByModelHeirarchy/Gasoline/4.Engine_Control/CLF  upstream UEGO/Gain Scheduling1"
 /begin LOC_MEASUREMENT CLF_NU_DGainFast2 CLF_NU_DGainSlow2 CLF_NU_IGainFast2 CLF_NU_IGainSlow2 CLF_NU_PGainFast2 CLF_NU_PGainSlow2 /end LOC_MEASUREMENT
 /begin REF_CHARACTERISTIC CLFc_NU_PID_GainScale CLFm_NU_DGainFast_x CLFm_NU_DGainFast_y CLFm_NU_DGainFast_z CLFm_NU_DGainSlow_x CLFm_NU_DGainSlow_y CLFm_NU_DGainSlow_z CLFm_NU_IGainFast_x CLFm_NU_IGainFast_y CLFm_NU_IGainFast_z CLFm_NU_IGainSlow_x CLFm_NU_IGainSlow_y CLFm_NU_IGainSlow_z CLFm_NU_PGainFast_x CLFm_NU_PGainFast_y CLFm_NU_PGainFast_z CLFm_NU_PGainSlow_x CLFm_NU_PGainSlow_y CLFm_NU_PGainSlow_z /end REF_CHARACTERISTIC
/end FUNCTION
/begin FUNCTION Long_Term_Fuel_Trim "Group /ByModelHeirarchy/Gasoline/4.Engine_Control/CLF  upstream UEGO/Long-Term Fuel Trim" /begin LOC_MEASUREMENT CLF_b_LTFT1_Active CLF_b_LTFT1_AdaptFlag /end LOC_MEASUREMENT
 /begin REF_CHARACTERISTIC CLFc_C_LTFT_EngineTempMax CLFc_C_LTFT_EngineTempMin CLFc_b_EnblLTFT1 CLFc_s_LTFT_ActiveDbnc CLFc_s_LTFT_RefreshPeriod /end REF_CHARACTERISTIC
/end FUNCTION
/begin FUNCTION Long_Term_Fuel_Trim1 "Group /ByModelHeirarchy/Gasoline/4.Engine_Control/CLF  upstream UEGO/Long-Term Fuel Trim1" /begin LOC_MEASUREMENT CLF_b_LTFT2_Active CLF_b_LTFT2_AdaptFlag /end LOC_MEASUREMENT
 /begin REF_CHARACTERISTIC CLFc_C_LTFT_EngineTempMax CLFc_C_LTFT_EngineTempMin CLFc_b_EnblLTFT2 CLFc_s_LTFT_ActiveDbnc CLFc_s_LTFT_RefreshPeriod /end REF_CHARACTERISTIC
/end FUNCTION
/begin FUNCTION NVM "Group /ByModelHeirarchy/Gasoline/4.Engine_Control/CLF  upstream UEGO/NVM"
 /begin REF_CHARACTERISTIC CLFc_b_LTFT1_Reset CLFm_NU_LTFT_x CLFm_NU_LTFT_y CLFm_NU_LTFT_z CLFma_NU_LTFT_z /end REF_CHARACTERISTIC
/end FUNCTION
/begin FUNCTION NVM1 "Group /ByModelHeirarchy/Gasoline/4.Engine_Control/CLF  upstream UEGO/NVM1"
 /begin REF_CHARACTERISTIC CLFc_b_LTFT2_Reset CLFm_NU_LTFT_x CLFm_NU_LTFT_y CLFm_NU_LTFT_z CLFma_NU_LTFT_z /end REF_CHARACTERISTIC
/end FUNCTION
/begin FUNCTION OVR_AndExport51 "Group /ByModelHeirarchy/Gasoline/4.Engine_Control/CLF  upstream UEGO/OVR_AndExport1" /begin LOC_MEASUREMENT CLF_b_DitherLamErrorActv /end LOC_MEASUREMENT /begin REF_CHARACTERISTIC CLFc_b_DitherLamErrorActv CLFc_o_DitherLamErrorActv /end REF_CHARACTERISTIC /end FUNCTION
/begin FUNCTION Transition_criteria "Group /ByModelHeirarchy/Gasoline/4.Engine_Control/CLF  upstream UEGO/Transition criteria"
 /begin LOC_MEASUREMENT CLF_b_InitialFB1_Stable CLF_b_SlowFB1_Unstable CLF_lam_Error1ThrshLPF /end LOC_MEASUREMENT
 /begin REF_CHARACTERISTIC CLFc_Hz_ErrorThrshLPF CLFc_lam_FB_StableThrsh CLFc_s_FB_StableDbnc CLFc_s_FB_UnstableDbnc /end REF_CHARACTERISTIC
/end FUNCTION
/begin FUNCTION Transition_criteria1 "Group /ByModelHeirarchy/Gasoline/4.Engine_Control/CLF  upstream UEGO/Transition criteria1"
 /begin LOC_MEASUREMENT CLF_b_InitialFB2_Stable CLF_b_SlowFB2_Unstable CLF_lam_Error2ThrshLPF /end LOC_MEASUREMENT
 /begin REF_CHARACTERISTIC CLFc_Hz_ErrorThrshLPF CLFc_lam_FB_StableThrsh CLFc_s_FB_StableDbnc CLFc_s_FB_UnstableDbnc /end REF_CHARACTERISTIC
/end FUNCTION
/begin FUNCTION CLF__upstream_UEGO "Group /ByModelHeirarchy/Gasoline/4.Engine_Control/CLF  upstream UEGO"
 /begin SUB_FUNCTION Custom_PID Custom_PID1 Dither_pattern_generation Dither_pattern_generation1 Enablement_criteria Gain_Scheduling Gain_Scheduling1 Long_Term_Fuel_Trim Long_Term_Fuel_Trim1 NVM NVM1 OVR_AndExport51 Transition_criteria Transition_criteria1 /end SUB_FUNCTION
 /begin LOC_MEASUREMENT CLF_b_FastFB1 CLF_b_FastFB2 CLF_b_SlowFB1 CLF_b_SlowFB2 CLF_lam_FB1_Error CLF_lam_FB2_Error CLF_lam_UEGO1_DitherAvg CLF_lam_UEGO2_DitherAvg /end LOC_MEASUREMENT
/end FUNCTION
/begin FUNCTION CPL "Group /ByModelHeirarchy/Gasoline/4.Engine_Control/CPL" /begin LOC_MEASUREMENT CPL_kPa_BoostDelta /end LOC_MEASUREMENT
 /begin REF_CHARACTERISTIC CPLc_NU_RetardPGain CPLc_kPa_SparkCutOfst CPLc_ret_RetardMax CPLm_NU_BoostLimit_x CPLm_NU_BoostLimit_z /end REF_CHARACTERISTIC
/end FUNCTION
/begin FUNCTION CTC "Group /ByModelHeirarchy/Gasoline/4.Engine_Control/CTC" /begin LOC_MEASUREMENT CTC_lam_FuelEnrichment CTC_ret_SparkRqstRaw /end LOC_MEASUREMENT
 /begin REF_CHARACTERISTIC CTCc_b_UseEngineTemp CTCc_b_UseExhaustTemp CTCc_lam_FuelOfstMin CTCc_ret_SparkRqstMax CTCm_NU_FuelEnrichment_x CTCm_NU_FuelEnrichment_y CTCm_NU_FuelEnrichment_z CTCm_NU_SparkRqst_x CTCm_NU_SparkRqst_y CTCm_NU_SparkRqst_z /end REF_CHARACTERISTIC
/end FUNCTION
/begin FUNCTION CCVS_Cruiser "Group /ByModelHeirarchy/Gasoline/4.Engine_Control/Cruiser_Begas/CCVS_Cruiser" /begin REF_CHARACTERISTIC CRUc_NU_VehSpeed_Gain CRUc_NU_VehSpeed_Ofst /end REF_CHARACTERISTIC /end FUNCTION
/begin FUNCTION LogEnable18 "Group /ByModelHeirarchy/Gasoline/4.Engine_Control/Cruiser_Begas/LogEnable18" /begin REF_CHARACTERISTIC LOGc_b_EnableCanLog /end REF_CHARACTERISTIC /end FUNCTION
/begin FUNCTION OVR_AndExport52 "Group /ByModelHeirarchy/Gasoline/4.Engine_Control/Cruiser_Begas/OVR_AndExport1" /begin LOC_MEASUREMENT CRU_NU_CurrSpeed /end LOC_MEASUREMENT /begin REF_CHARACTERISTIC CRUc_NU_CurrSpeed CRUc_o_CurrSpeed /end REF_CHARACTERISTIC /end FUNCTION
/begin FUNCTION OVR_AndExport53 "Group /ByModelHeirarchy/Gasoline/4.Engine_Control/Cruiser_Begas/OVR_AndExport2" /begin LOC_MEASUREMENT CRU_b_ParkingBrake /end LOC_MEASUREMENT /begin REF_CHARACTERISTIC CRUc_b_ParkingBrake CRUc_o_ParkingBrake /end REF_CHARACTERISTIC /end FUNCTION
/begin FUNCTION OVR_AndExport54 "Group /ByModelHeirarchy/Gasoline/4.Engine_Control/Cruiser_Begas/OVR_AndExport3" /begin LOC_MEASUREMENT CRU_V_CruiserSET /end LOC_MEASUREMENT /begin REF_CHARACTERISTIC CRUc_V_CruiserSET CRUc_o_CruiserSET /end REF_CHARACTERISTIC /end FUNCTION
/begin FUNCTION OVR_AndExport372 "Group /ByModelHeirarchy/Gasoline/4.Engine_Control/Cruiser_Begas/OVR_AndExport37" /begin LOC_MEASUREMENT CRU_b_Active /end LOC_MEASUREMENT /begin REF_CHARACTERISTIC CRUc_b_Active CRUc_o_Active /end REF_CHARACTERISTIC /end FUNCTION
/begin FUNCTION OVR_AndExport383 "Group /ByModelHeirarchy/Gasoline/4.Engine_Control/Cruiser_Begas/OVR_AndExport38" /begin LOC_MEASUREMENT CRU_b_UpSpeed /end LOC_MEASUREMENT /begin REF_CHARACTERISTIC CRUc_b_UpSpeed CRUc_o_UpSpeed /end REF_CHARACTERISTIC /end FUNCTION
/begin FUNCTION OVR_AndExport392 "Group /ByModelHeirarchy/Gasoline/4.Engine_Control/Cruiser_Begas/OVR_AndExport39" /begin LOC_MEASUREMENT CRU_b_DownSpeed /end LOC_MEASUREMENT /begin REF_CHARACTERISTIC CRUc_b_DownSpeed CRUc_o_DownSpeed /end REF_CHARACTERISTIC /end FUNCTION
/begin FUNCTION OVR_AndExport55 "Group /ByModelHeirarchy/Gasoline/4.Engine_Control/Cruiser_Begas/OVR_AndExport4" /begin LOC_MEASUREMENT CRU_b_FootBrake /end LOC_MEASUREMENT /begin REF_CHARACTERISTIC CRUc_b_FootBrake CRUc_o_FootBrake /end REF_CHARACTERISTIC /end FUNCTION
/begin FUNCTION OVR_AndExport42 "Group /ByModelHeirarchy/Gasoline/4.Engine_Control/Cruiser_Begas/OVR_AndExport42" /begin LOC_MEASUREMENT CRU_b_Enable /end LOC_MEASUREMENT /begin REF_CHARACTERISTIC CRUc_b_Enable CRUc_o_Enable /end REF_CHARACTERISTIC /end FUNCTION
/begin FUNCTION OVR_AndExport48 "Group /ByModelHeirarchy/Gasoline/4.Engine_Control/Cruiser_Begas/OVR_AndExport48" /begin LOC_MEASUREMENT CRU_NU_TargetSpeed /end LOC_MEASUREMENT /begin REF_CHARACTERISTIC CRUc_NU_TargetSpeed CRUc_o_TargetSpeed /end REF_CHARACTERISTIC /end FUNCTION
/begin FUNCTION OVR_AndExport49 "Group /ByModelHeirarchy/Gasoline/4.Engine_Control/Cruiser_Begas/OVR_AndExport49" /begin LOC_MEASUREMENT CRU_NU_LimSpeed /end LOC_MEASUREMENT /begin REF_CHARACTERISTIC CRUc_NU_LimSpeed CRUc_o_LimSpeed /end REF_CHARACTERISTIC /end FUNCTION
/begin FUNCTION OVR_AndExport53 "Group /ByModelHeirarchy/Gasoline/4.Engine_Control/Cruiser_Begas/OVR_AndExport53" /begin LOC_MEASUREMENT CRU_b_BrakeON /end LOC_MEASUREMENT /begin REF_CHARACTERISTIC CRUc_b_BrakeON CRUc_o_BrakeON /end REF_CHARACTERISTIC /end FUNCTION
/begin FUNCTION OVR_AndExport54 "Group /ByModelHeirarchy/Gasoline/4.Engine_Control/Cruiser_Begas/OVR_AndExport54" /begin LOC_MEASUREMENT CRU_b_ClunchON /end LOC_MEASUREMENT /begin REF_CHARACTERISTIC CRUc_b_ClunchON CRUc_o_ClunchON /end REF_CHARACTERISTIC /end FUNCTION
/begin FUNCTION OVR_AndExport59 "Group /ByModelHeirarchy/Gasoline/4.Engine_Control/Cruiser_Begas/OVR_AndExport59" /begin LOC_MEASUREMENT CRU_b_Cancel /end LOC_MEASUREMENT /begin REF_CHARACTERISTIC CRUc_b_Cancel CRUc_o_Cancel /end REF_CHARACTERISTIC /end FUNCTION
/begin FUNCTION PID_Controller "Group /ByModelHeirarchy/Gasoline/4.Engine_Control/Cruiser_Begas/PID_Controller"
 /begin REF_CHARACTERISTIC CRUc_NU_Calib CRUc_NU_DGain CRUc_NU_IGain CRUc_NU_PGain ETCc_pct_IMax ETCc_pct_IMin /end REF_CHARACTERISTIC
/end FUNCTION
/begin FUNCTION Cruiser_Begas "Group /ByModelHeirarchy/Gasoline/4.Engine_Control/Cruiser_Begas"
 /begin SUB_FUNCTION CCVS_Cruiser LogEnable18 OVR_AndExport52 OVR_AndExport53 OVR_AndExport54 OVR_AndExport372 OVR_AndExport383 OVR_AndExport392 OVR_AndExport55 OVR_AndExport42 OVR_AndExport48 OVR_AndExport49 OVR_AndExport53 OVR_AndExport54 OVR_AndExport59 PID_Controller /end SUB_FUNCTION
 /begin LOC_MEASUREMENT CruiseTorqueRequestRaw_Nm Cruiser_State PIDEffort /end LOC_MEASUREMENT
 /begin REF_CHARACTERISTIC CRUm_NU_Effort_Torque_x CRUm_NU_Effort_Torque_z /end REF_CHARACTERISTIC
/end FUNCTION
/begin FUNCTION LogEnable12 "Group /ByModelHeirarchy/Gasoline/4.Engine_Control/DATALOGGER_HERKO/LogEnable1" /begin REF_CHARACTERISTIC LOGc_b_EnableCanLog /end REF_CHARACTERISTIC /end FUNCTION
/begin FUNCTION LogEnable102 "Group /ByModelHeirarchy/Gasoline/4.Engine_Control/DATALOGGER_HERKO/LogEnable10" /begin REF_CHARACTERISTIC LOGc_b_EnableCanLog /end REF_CHARACTERISTIC /end FUNCTION
/begin FUNCTION LogEnable11 "Group /ByModelHeirarchy/Gasoline/4.Engine_Control/DATALOGGER_HERKO/LogEnable11" /begin REF_CHARACTERISTIC LOGc_b_EnableCanLog /end REF_CHARACTERISTIC /end FUNCTION
/begin FUNCTION LogEnable12 "Group /ByModelHeirarchy/Gasoline/4.Engine_Control/DATALOGGER_HERKO/LogEnable12" /begin REF_CHARACTERISTIC LOGc_b_EnableCanLog /end REF_CHARACTERISTIC /end FUNCTION
/begin FUNCTION LogEnable13 "Group /ByModelHeirarchy/Gasoline/4.Engine_Control/DATALOGGER_HERKO/LogEnable13" /begin REF_CHARACTERISTIC LOGc_b_EnableCanLog /end REF_CHARACTERISTIC /end FUNCTION
/begin FUNCTION LogEnable14 "Group /ByModelHeirarchy/Gasoline/4.Engine_Control/DATALOGGER_HERKO/LogEnable14" /begin REF_CHARACTERISTIC LOGc_b_EnableCanLog /end REF_CHARACTERISTIC /end FUNCTION
/begin FUNCTION LogEnable15 "Group /ByModelHeirarchy/Gasoline/4.Engine_Control/DATALOGGER_HERKO/LogEnable15" /begin REF_CHARACTERISTIC LOGc_b_EnableCanLog /end REF_CHARACTERISTIC /end FUNCTION
/begin FUNCTION LogEnable2 "Group /ByModelHeirarchy/Gasoline/4.Engine_Control/DATALOGGER_HERKO/LogEnable2" /begin REF_CHARACTERISTIC LOGc_b_EnableCanLog /end REF_CHARACTERISTIC /end FUNCTION
/begin FUNCTION LogEnable3 "Group /ByModelHeirarchy/Gasoline/4.Engine_Control/DATALOGGER_HERKO/LogEnable3" /begin REF_CHARACTERISTIC LOGc_b_EnableCanLog /end REF_CHARACTERISTIC /end FUNCTION
/begin FUNCTION LogEnable41 "Group /ByModelHeirarchy/Gasoline/4.Engine_Control/DATALOGGER_HERKO/LogEnable4" /begin REF_CHARACTERISTIC LOGc_b_EnableCanLog /end REF_CHARACTERISTIC /end FUNCTION
/begin FUNCTION LogEnable5 "Group /ByModelHeirarchy/Gasoline/4.Engine_Control/DATALOGGER_HERKO/LogEnable5" /begin REF_CHARACTERISTIC LOGc_b_EnableCanLog /end REF_CHARACTERISTIC /end FUNCTION
/begin FUNCTION LogEnable61 "Group /ByModelHeirarchy/Gasoline/4.Engine_Control/DATALOGGER_HERKO/LogEnable6" /begin REF_CHARACTERISTIC LOGc_b_EnableCanLog /end REF_CHARACTERISTIC /end FUNCTION
/begin FUNCTION LogEnable71 "Group /ByModelHeirarchy/Gasoline/4.Engine_Control/DATALOGGER_HERKO/LogEnable7" /begin REF_CHARACTERISTIC LOGc_b_EnableCanLog /end REF_CHARACTERISTIC /end FUNCTION
/begin FUNCTION LogEnable81 "Group /ByModelHeirarchy/Gasoline/4.Engine_Control/DATALOGGER_HERKO/LogEnable8" /begin REF_CHARACTERISTIC LOGc_b_EnableCanLog /end REF_CHARACTERISTIC /end FUNCTION
/begin FUNCTION LogEnable9 "Group /ByModelHeirarchy/Gasoline/4.Engine_Control/DATALOGGER_HERKO/LogEnable9" /begin REF_CHARACTERISTIC LOGc_b_EnableCanLog /end REF_CHARACTERISTIC /end FUNCTION
/begin FUNCTION DATALOGGER_HERKO "Group /ByModelHeirarchy/Gasoline/4.Engine_Control/DATALOGGER_HERKO"
 /begin SUB_FUNCTION LogEnable12 LogEnable102 LogEnable11 LogEnable12 LogEnable13 LogEnable14 LogEnable15 LogEnable2 LogEnable3 LogEnable41 LogEnable5 LogEnable61 LogEnable71 LogEnable81 LogEnable9 /end SUB_FUNCTION
/end FUNCTION
/begin FUNCTION LogEnable103 "Group /ByModelHeirarchy/Gasoline/4.Engine_Control/DD/LogEnable10" /begin REF_CHARACTERISTIC LOGc_b_EnableCanLog /end REF_CHARACTERISTIC /end FUNCTION
/begin FUNCTION Subsystem1 "Group /ByModelHeirarchy/Gasoline/4.Engine_Control/DD/Subsystem"
 /begin REF_CHARACTERISTIC AINc_b_Tank2_Available OUTc_pct_FuelReserve_1Tank OUTc_pct_FuelReserve_2Tank /end REF_CHARACTERISTIC
/end FUNCTION
/begin FUNCTION DD "Group /ByModelHeirarchy/Gasoline/4.Engine_Control/DD" /begin SUB_FUNCTION LogEnable103 Subsystem1 /end SUB_FUNCTION /end FUNCTION
/begin FUNCTION OVR_AndExport85 "Group /ByModelHeirarchy/Gasoline/4.Engine_Control/DFC/OVR_AndExport8" /begin LOC_MEASUREMENT DFC_b_DTC_Condition /end LOC_MEASUREMENT /begin REF_CHARACTERISTIC DFCc_b_DTC_Condition DFCc_o_DTC_Condition /end REF_CHARACTERISTIC /end FUNCTION
/begin FUNCTION DFC "Group /ByModelHeirarchy/Gasoline/4.Engine_Control/DFC" /begin SUB_FUNCTION OVR_AndExport85 /end SUB_FUNCTION /begin LOC_MEASUREMENT DFC_RPM_EntryThrsh DFC_RPM_ExitThrsh DFC_e_State /end LOC_MEASUREMENT
 /begin REF_CHARACTERISTIC DFCc_C_MinEngTemp DFCc_Hz_TqHPF_TC DFCc_Nm_TqEntryThrsh DFCc_Nm_TqExitThrsh DFCc_Nm_TqHPF_Thrsh DFCc_deg_MaxSparkRetard DFCc_s_BurningDelay DFCc_s_FuelRampOutDelay DFCc_s_StartupDelay DFCm_NU_EntryThrsh_x DFCm_NU_EntryThrsh_z DFCm_NU_ExitThrsh_x DFCm_NU_ExitThrsh_z /end REF_CHARACTERISTIC
/end FUNCTION
/begin FUNCTION Displayables1 "Group /ByModelHeirarchy/Gasoline/4.Engine_Control/Displayables" /begin LOC_MEASUREMENT RFC_mg_Inj1 RFC_mg_Inj2 RFC_mg_Inj3 RFC_mg_Inj4 /end LOC_MEASUREMENT /end FUNCTION
/begin FUNCTION Dyno_requested_load "Group /ByModelHeirarchy/Gasoline/4.Engine_Control/Dyno-requested load" /begin LOC_MEASUREMENT DRL_b_Active /end LOC_MEASUREMENT
 /begin REF_CHARACTERISTIC DRLc_b_UseDynoRqst DRLm_NU_APP_ToADM_x DRLm_NU_APP_ToADM_y DRLm_NU_APP_ToADM_z /end REF_CHARACTERISTIC
/end FUNCTION
/begin FUNCTION LogEnable1 "Group /ByModelHeirarchy/Gasoline/4.Engine_Control/DynoMessages/LogEnable" /begin REF_CHARACTERISTIC LOGc_b_EnableCanLog /end REF_CHARACTERISTIC /end FUNCTION
/begin FUNCTION LogEnable13 "Group /ByModelHeirarchy/Gasoline/4.Engine_Control/DynoMessages/LogEnable1" /begin REF_CHARACTERISTIC LOGc_b_EnableCanLog /end REF_CHARACTERISTIC /end FUNCTION
/begin FUNCTION DynoMessages "Group /ByModelHeirarchy/Gasoline/4.Engine_Control/DynoMessages" /begin SUB_FUNCTION LogEnable1 LogEnable13 /end SUB_FUNCTION /begin REF_CHARACTERISTIC OUTc_s_DynoMsg1_Period OUTc_s_DynoMsg2_Period /end REF_CHARACTERISTIC /end FUNCTION
/begin FUNCTION delay_200ms1 "Group /ByModelHeirarchy/Gasoline/4.Engine_Control/EC1/delay_200ms1" /begin REF_CHARACTERISTIC LOGc_s_TFrames /end REF_CHARACTERISTIC /end FUNCTION
/begin FUNCTION delay_200ms10 "Group /ByModelHeirarchy/Gasoline/4.Engine_Control/EC1/delay_200ms10" /begin REF_CHARACTERISTIC LOGc_s_TFrames /end REF_CHARACTERISTIC /end FUNCTION
/begin FUNCTION delay_200ms11 "Group /ByModelHeirarchy/Gasoline/4.Engine_Control/EC1/delay_200ms11" /begin REF_CHARACTERISTIC LOGc_s_TFrames /end REF_CHARACTERISTIC /end FUNCTION
/begin FUNCTION delay_200ms12 "Group /ByModelHeirarchy/Gasoline/4.Engine_Control/EC1/delay_200ms12" /begin REF_CHARACTERISTIC LOGc_s_TFrames /end REF_CHARACTERISTIC /end FUNCTION
/begin FUNCTION delay_200ms2 "Group /ByModelHeirarchy/Gasoline/4.Engine_Control/EC1/delay_200ms2" /begin REF_CHARACTERISTIC LOGc_s_TFrames /end REF_CHARACTERISTIC /end FUNCTION
/begin FUNCTION delay_200ms9 "Group /ByModelHeirarchy/Gasoline/4.Engine_Control/EC1/delay_200ms9" /begin REF_CHARACTERISTIC LOGc_s_TFrames /end REF_CHARACTERISTIC /end FUNCTION
/begin FUNCTION EC1 "Group /ByModelHeirarchy/Gasoline/4.Engine_Control/EC1"
 /begin SUB_FUNCTION delay_200ms1 delay_200ms10 delay_200ms11 delay_200ms12 delay_200ms2 delay_200ms9 /end SUB_FUNCTION
 /begin LOC_MEASUREMENT LOG_b_EC1_state LOG_s_EC1_counter Log_b_TPDT1 Log_b_TPDT2 Log_b_TPDT3 Log_b_TPDT4 Log_b_TPDT5 Log_b_TPDT6 /end LOC_MEASUREMENT
 /begin REF_CHARACTERISTIC LOGc_b_EC1_CANA_ena /end REF_CHARACTERISTIC
/end FUNCTION
/begin FUNCTION EEC141 "Group /ByModelHeirarchy/Gasoline/4.Engine_Control/EEC14/EEC14" /begin REF_CHARACTERISTIC LOGc_NU_EEC14_FuelType /end REF_CHARACTERISTIC /end FUNCTION
/begin FUNCTION LogEnable104 "Group /ByModelHeirarchy/Gasoline/4.Engine_Control/EEC14/LogEnable10" /begin REF_CHARACTERISTIC LOGc_b_EnableCanLog /end REF_CHARACTERISTIC /end FUNCTION
/begin FUNCTION EEC14 "Group /ByModelHeirarchy/Gasoline/4.Engine_Control/EEC14" /begin SUB_FUNCTION EEC141 LogEnable104 /end SUB_FUNCTION /end FUNCTION
/begin FUNCTION EEC1 "Group /ByModelHeirarchy/Gasoline/4.Engine_Control/EEC1_OK/EEC1" /begin LOC_MEASUREMENT APP_b_EEC1TorqueMode /end LOC_MEASUREMENT /begin REF_CHARACTERISTIC APPc_NU_EEC1TorqueMode APPc_b_EEC1TorqueSelector /end REF_CHARACTERISTIC /end FUNCTION
/begin FUNCTION LogEnable62 "Group /ByModelHeirarchy/Gasoline/4.Engine_Control/EEC1_OK/LogEnable6" /begin REF_CHARACTERISTIC LOGc_b_EnableCanLog /end REF_CHARACTERISTIC /end FUNCTION
/begin FUNCTION EEC1_OK "Group /ByModelHeirarchy/Gasoline/4.Engine_Control/EEC1_OK" /begin SUB_FUNCTION EEC1 LogEnable62 /end SUB_FUNCTION /end FUNCTION
/begin FUNCTION LogEnable91 "Group /ByModelHeirarchy/Gasoline/4.Engine_Control/EEC2_OK/LogEnable9" /begin REF_CHARACTERISTIC LOGc_b_EnableCanLog /end REF_CHARACTERISTIC /end FUNCTION
/begin FUNCTION EEC2_OK "Group /ByModelHeirarchy/Gasoline/4.Engine_Control/EEC2_OK" /begin SUB_FUNCTION LogEnable91 /end SUB_FUNCTION /end FUNCTION
/begin FUNCTION LogEnable105 "Group /ByModelHeirarchy/Gasoline/4.Engine_Control/EEC3_OK/LogEnable10" /begin REF_CHARACTERISTIC LOGc_b_EnableCanLog /end REF_CHARACTERISTIC /end FUNCTION
/begin FUNCTION EEC3_OK "Group /ByModelHeirarchy/Gasoline/4.Engine_Control/EEC3_OK" /begin SUB_FUNCTION LogEnable105 /end SUB_FUNCTION /end FUNCTION
/begin FUNCTION LogEnable82 "Group /ByModelHeirarchy/Gasoline/4.Engine_Control/EFL/LogEnable8" /begin REF_CHARACTERISTIC LOGc_b_EnableCanLog /end REF_CHARACTERISTIC /end FUNCTION
/begin FUNCTION EFL "Group /ByModelHeirarchy/Gasoline/4.Engine_Control/EFL" /begin SUB_FUNCTION LogEnable82 /end SUB_FUNCTION /end FUNCTION
/begin FUNCTION LogEnable83 "Group /ByModelHeirarchy/Gasoline/4.Engine_Control/EGF1_OK/LogEnable8" /begin REF_CHARACTERISTIC LOGc_b_EnableCanLog /end REF_CHARACTERISTIC /end FUNCTION
/end MODULE
/end PROJECT
