ASAP2_VERSION 1 31
/begin PROJECT M670_Engine_Control_1.2.0_M670_000 "BeGas B430LG Turbocharged engine"
/begin HEADER "Begas Motor 2017-2022 (c)" VERSION "1_2_0" /end HEADER
/begin MODULE OpenECU_M670_000 ""
/* Scalar measurable for DDE 'DTC_NU_KNKButaneThr'. */
/begin MEASUREMENT DTC_NU_KNKButaneThr "(not defined)" FLOAT32_IEEE CU_DTC_NU_KNKBUTANETHR 1 100 0.0 0.0 ECU_ADDRESS 0x400032c8 BYTE_ORDER MSB_FIRST /end MEASUREMENT
/begin COMPU_METHOD CU_DTC_NU_KNKBUTANETHR "Conversion method for DTC_NU_KNKButaneThr" RAT_FUNC "%10.2" "ret" COEFFS 0.000000 1.000000 0.000000 0.000000 0.000000 1.000000 /end COMPU_METHOD
/* Scalar measurable for DDE 'DTC_NU_TestTime'. */
/begin MEASUREMENT DTC_NU_TestTime "(not defined)" FLOAT32_IEEE CU_DTC_NU_TESTTIME 1 100 0.0 1000000.0 ECU_ADDRESS 0x40003904 BYTE_ORDER MSB_FIRST /end MEASUREMENT
/begin COMPU_METHOD CU_DTC_NU_TESTTIME "Conversion method for DTC_NU_TestTime" RAT_FUNC "%10.0" "s" COEFFS 0.000000 1.000000 0.000000 0.000000 0.000000 1.000000 /end COMPU_METHOD
/* Scalar measurable for DDE 'DTC_b_1_boostOC'. */
/begin MEASUREMENT DTC_b_1_boostOC "DTC62" UBYTE CU_DTC_B_1_BOOSTOC 1 100 0.0 1.0 ECU_ADDRESS 0x40002f5f BYTE_ORDER MSB_FIRST /end MEASUREMENT
/begin COMPU_METHOD CU_DTC_B_1_BOOSTOC "Conversion method for DTC_b_1_boostOC" RAT_FUNC "%10.0" "b" COEFFS 0.000000 1.000000 0.000000 0.000000 0.000000 1.000000 /end COMPU_METHOD
/* Scalar measurable for DDE 'DTC_b_1_lsol'. */
/begin MEASUREMENT DTC_b_1_lsol "DTC44" UBYTE CU_DTC_B_1_LSOL 1 100 0.0 1.0 ECU_ADDRESS 0x40002f61 BYTE_ORDER MSB_FIRST /end MEASUREMENT
/begin COMPU_METHOD CU_DTC_B_1_LSOL "Conversion method for DTC_b_1_lsol" RAT_FUNC "%10.0" "b" COEFFS 0.000000 1.000000 0.000000 0.000000 0.000000 1.000000 /end COMPU_METHOD
/* Scalar measurable for DDE 'DTC_b_1_sb'. */
/begin MEASUREMENT DTC_b_1_sb "DTC60" UBYTE CU_DTC_B_1_SB 1 100 0.0 1.0 ECU_ADDRESS 0x40002f60 BYTE_ORDER MSB_FIRST /end MEASUREMENT
/begin COMPU_METHOD CU_DTC_B_1_SB "Conversion method for DTC_b_1_sb" RAT_FUNC "%10.0" "b" COEFFS 0.000000 1.000000 0.000000 0.000000 0.000000 1.000000 /end COMPU_METHOD
/* Scalar measurable for DDE 'DTC_b_1_sg'. */
/begin MEASUREMENT DTC_b_1_sg "DTC68" UBYTE CU_DTC_B_1_SG 1 100 0.0 1.0 ECU_ADDRESS 0x40002f5e BYTE_ORDER MSB_FIRST /end MEASUREMENT
/begin COMPU_METHOD CU_DTC_B_1_SG "Conversion method for DTC_b_1_sg" RAT_FUNC "%10.0" "b" COEFFS 0.000000 1.000000 0.000000 0.000000 0.000000 1.000000 /end COMPU_METHOD
/* Scalar measurable for DDE 'DTC_b_2_boostOC'. */
/begin MEASUREMENT DTC_b_2_boostOC "DTC62" UBYTE CU_DTC_B_2_BOOSTOC 1 100 0.0 1.0 ECU_ADDRESS 0x40002f5b BYTE_ORDER MSB_FIRST /end MEASUREMENT
/begin COMPU_METHOD CU_DTC_B_2_BOOSTOC "Conversion method for DTC_b_2_boostOC" RAT_FUNC "%10.0" "b" COEFFS 0.000000 1.000000 0.000000 0.000000 0.000000 1.000000 /end COMPU_METHOD
/* Scalar measurable for DDE 'DTC_b_2_lsol'. */
/begin MEASUREMENT DTC_b_2_lsol "DTC43" UBYTE CU_DTC_B_2_LSOL 1 100 0.0 1.0 ECU_ADDRESS 0x40002f5d BYTE_ORDER MSB_FIRST /end MEASUREMENT
/begin COMPU_METHOD CU_DTC_B_2_LSOL "Conversion method for DTC_b_2_lsol" RAT_FUNC "%10.0" "b" COEFFS 0.000000 1.000000 0.000000 0.000000 0.000000 1.000000 /end COMPU_METHOD
/* Scalar measurable for DDE 'DTC_b_2_sb'. */
/begin MEASUREMENT DTC_b_2_sb "DTC59" UBYTE CU_DTC_B_2_SB 1 100 0.0 1.0 ECU_ADDRESS 0x40002f5c BYTE_ORDER MSB_FIRST /end MEASUREMENT
/begin COMPU_METHOD CU_DTC_B_2_SB "Conversion method for DTC_b_2_sb" RAT_FUNC "%10.0" "b" COEFFS 0.000000 1.000000 0.000000 0.000000 0.000000 1.000000 /end COMPU_METHOD
/* Scalar measurable for DDE 'DTC_b_2_sg'. */
/begin MEASUREMENT DTC_b_2_sg "DTC67" UBYTE CU_DTC_B_2_SG 1 100 0.0 1.0 ECU_ADDRESS 0x40002f5a BYTE_ORDER MSB_FIRST /end MEASUREMENT
/begin COMPU_METHOD CU_DTC_B_2_SG "Conversion method for DTC_b_2_sg" RAT_FUNC "%10.0" "b" COEFFS 0.000000 1.000000 0.000000 0.000000 0.000000 1.000000 /end COMPU_METHOD
/* Scalar measurable for DDE 'DTC_b_3_boostOC'. */
/begin MEASUREMENT DTC_b_3_boostOC "DTC62" UBYTE CU_DTC_B_3_BOOSTOC 1 100 0.0 1.0 ECU_ADDRESS 0x40002f53 BYTE_ORDER MSB_FIRST /end MEASUREMENT
/begin COMPU_METHOD CU_DTC_B_3_BOOSTOC "Conversion method for DTC_b_3_boostOC" RAT_FUNC "%10.0" "b" COEFFS 0.000000 1.000000 0.000000 0.000000 0.000000 1.000000 /end COMPU_METHOD
/* Scalar measurable for DDE 'DTC_b_3_lsol'. */
/begin MEASUREMENT DTC_b_3_lsol "DTC45" UBYTE CU_DTC_B_3_LSOL 1 100 0.0 1.0 ECU_ADDRESS 0x40002f55 BYTE_ORDER MSB_FIRST /end MEASUREMENT
/begin COMPU_METHOD CU_DTC_B_3_LSOL "Conversion method for DTC_b_3_lsol" RAT_FUNC "%10.0" "b" COEFFS 0.000000 1.000000 0.000000 0.000000 0.000000 1.000000 /end COMPU_METHOD
/* Scalar measurable for DDE 'DTC_b_3_sb'. */
/begin MEASUREMENT DTC_b_3_sb "DTC61" UBYTE CU_DTC_B_3_SB 1 100 0.0 1.0 ECU_ADDRESS 0x40002f54 BYTE_ORDER MSB_FIRST /end MEASUREMENT
/begin COMPU_METHOD CU_DTC_B_3_SB "Conversion method for DTC_b_3_sb" RAT_FUNC "%10.0" "b" COEFFS 0.000000 1.000000 0.000000 0.000000 0.000000 1.000000 /end COMPU_METHOD
/* Scalar measurable for DDE 'DTC_b_3_sg'. */
/begin MEASUREMENT DTC_b_3_sg "DTC69" UBYTE CU_DTC_B_3_SG 1 100 0.0 1.0 ECU_ADDRESS 0x40002f52 BYTE_ORDER MSB_FIRST /end MEASUREMENT
/begin COMPU_METHOD CU_DTC_B_3_SG "Conversion method for DTC_b_3_sg" RAT_FUNC "%10.0" "b" COEFFS 0.000000 1.000000 0.000000 0.000000 0.000000 1.000000 /end COMPU_METHOD
/* Scalar measurable for DDE 'DTC_b_4_boostOC'. */
/begin MEASUREMENT DTC_b_4_boostOC "DTC62" UBYTE CU_DTC_B_4_BOOSTOC 1 100 0.0 1.0 ECU_ADDRESS 0x40002f58 BYTE_ORDER MSB_FIRST /end MEASUREMENT
/begin COMPU_METHOD CU_DTC_B_4_BOOSTOC "Conversion method for DTC_b_4_boostOC" RAT_FUNC "%10.0" "b" COEFFS 0.000000 1.000000 0.000000 0.000000 0.000000 1.000000 /end COMPU_METHOD
/* Scalar measurable for DDE 'DTC_b_4_lsol'. */
/begin MEASUREMENT DTC_b_4_lsol "DTC46" UBYTE CU_DTC_B_4_LSOL 1 100 0.0 1.0 ECU_ADDRESS 0x40002f59 BYTE_ORDER MSB_FIRST /end MEASUREMENT
/begin COMPU_METHOD CU_DTC_B_4_LSOL "Conversion method for DTC_b_4_lsol" RAT_FUNC "%10.0" "b" COEFFS 0.000000 1.000000 0.000000 0.000000 0.000000 1.000000 /end COMPU_METHOD
/* Scalar measurable for DDE 'DTC_b_4_sb'. */
/begin MEASUREMENT DTC_b_4_sb "DTC62" UBYTE CU_DTC_B_4_SB 1 100 0.0 1.0 ECU_ADDRESS 0x40002f57 BYTE_ORDER MSB_FIRST /end MEASUREMENT
/begin COMPU_METHOD CU_DTC_B_4_SB "Conversion method for DTC_b_4_sb" RAT_FUNC "%10.0" "b" COEFFS 0.000000 1.000000 0.000000 0.000000 0.000000 1.000000 /end COMPU_METHOD
/* Scalar measurable for DDE 'DTC_b_4_sg'. */
/begin MEASUREMENT DTC_b_4_sg "DTC70" UBYTE CU_DTC_B_4_SG 1 100 0.0 1.0 ECU_ADDRESS 0x40002f56 BYTE_ORDER MSB_FIRST /end MEASUREMENT
/begin COMPU_METHOD CU_DTC_B_4_SG "Conversion method for DTC_b_4_sg" RAT_FUNC "%10.0" "b" COEFFS 0.000000 1.000000 0.000000 0.000000 0.000000 1.000000 /end COMPU_METHOD
/* Scalar measurable for DDE 'DTC_b_APP1_NonValidVoltage'. */
/begin MEASUREMENT DTC_b_APP1_NonValidVoltage "DTC150" UBYTE CU_DTC_B_APP1_NONVALIDVOLTAGE 1 100 0.0 1.0 ECU_ADDRESS 0x40002fcb BYTE_ORDER MSB_FIRST /end MEASUREMENT
/begin COMPU_METHOD CU_DTC_B_APP1_NONVALIDVOLTAGE "Conversion method for DTC_b_APP1_NonValidVoltage" RAT_FUNC "%10.0" "b" COEFFS 0.000000 1.000000 0.000000 0.000000 0.000000 1.000000 /end COMPU_METHOD
/* Scalar measurable for DDE 'DTC_b_APP2_NonValidVoltage'. */
/begin MEASUREMENT DTC_b_APP2_NonValidVoltage "DTC151" UBYTE CU_DTC_B_APP2_NONVALIDVOLTAGE 1 100 0.0 1.0 ECU_ADDRESS 0x40002fca BYTE_ORDER MSB_FIRST /end MEASUREMENT
/begin COMPU_METHOD CU_DTC_B_APP2_NONVALIDVOLTAGE "Conversion method for DTC_b_APP2_NonValidVoltage" RAT_FUNC "%10.0" "b" COEFFS 0.000000 1.000000 0.000000 0.000000 0.000000 1.000000 /end COMPU_METHOD
/* Scalar measurable for DDE 'DTC_b_APP_CorrFLT'. */
/begin MEASUREMENT DTC_b_APP_CorrFLT "DTC133" UBYTE CU_DTC_B_APP_CORRFLT 1 100 0.0 1.0 ECU_ADDRESS 0x40002eb8 BYTE_ORDER MSB_FIRST /end MEASUREMENT
/begin COMPU_METHOD CU_DTC_B_APP_CORRFLT "Conversion method for DTC_b_APP_CorrFLT" RAT_FUNC "%10.0" "b" COEFFS 0.000000 1.000000 0.000000 0.000000 0.000000 1.000000 /end COMPU_METHOD
/* Scalar measurable for DDE 'DTC_b_Air_HTemp'. */
/begin MEASUREMENT DTC_b_Air_HTemp "DTC118" UBYTE CU_DTC_B_AIR_HTEMP 1 100 0.0 1.0 ECU_ADDRESS 0x40002fcd BYTE_ORDER MSB_FIRST /end MEASUREMENT
/begin COMPU_METHOD CU_DTC_B_AIR_HTEMP "Conversion method for DTC_b_Air_HTemp" RAT_FUNC "%10.0" "b" COEFFS 0.000000 1.000000 0.000000 0.000000 0.000000 1.000000 /end COMPU_METHOD
/* Scalar measurable for DDE 'DTC_b_Air_TempHV'. */
/begin MEASUREMENT DTC_b_Air_TempHV "DTC117" UBYTE CU_DTC_B_AIR_TEMPHV 1 100 0.0 1.0 ECU_ADDRESS 0x40002fce BYTE_ORDER MSB_FIRST /end MEASUREMENT
/begin COMPU_METHOD CU_DTC_B_AIR_TEMPHV "Conversion method for DTC_b_Air_TempHV" RAT_FUNC "%10.0" "b" COEFFS 0.000000 1.000000 0.000000 0.000000 0.000000 1.000000 /end COMPU_METHOD
/* Scalar measurable for DDE 'DTC_b_Air_TempLV'. */
/begin MEASUREMENT DTC_b_Air_TempLV "DTC116" UBYTE CU_DTC_B_AIR_TEMPLV 1 100 0.0 1.0 ECU_ADDRESS 0x40002fcf BYTE_ORDER MSB_FIRST /end MEASUREMENT
/begin COMPU_METHOD CU_DTC_B_AIR_TEMPLV "Conversion method for DTC_b_Air_TempLV" RAT_FUNC "%10.0" "b" COEFFS 0.000000 1.000000 0.000000 0.000000 0.000000 1.000000 /end COMPU_METHOD
/* Scalar measurable for DDE 'DTC_b_BARO_ErraticValue'. */
/begin MEASUREMENT DTC_b_BARO_ErraticValue "DTC203" UBYTE CU_DTC_B_BARO_ERRATICVALUE 1 100 0.0 1.0 ECU_ADDRESS 0x40002fc2 BYTE_ORDER MSB_FIRST /end MEASUREMENT
/begin COMPU_METHOD CU_DTC_B_BARO_ERRATICVALUE "Conversion method for DTC_b_BARO_ErraticValue" RAT_FUNC "%10.0" "b" COEFFS 0.000000 1.000000 0.000000 0.000000 0.000000 1.000000 /end COMPU_METHOD
/* Scalar measurable for DDE 'DTC_b_BARO_PressHVoltage'. */
/begin MEASUREMENT DTC_b_BARO_PressHVoltage "DTC123" UBYTE CU_DTC_B_BARO_PRESSHVOLTAGE 1 100 0.0 1.0 ECU_ADDRESS 0x40002fc3 BYTE_ORDER MSB_FIRST /end MEASUREMENT
/begin COMPU_METHOD CU_DTC_B_BARO_PRESSHVOLTAGE "Conversion method for DTC_b_BARO_PressHVoltage" RAT_FUNC "%10.0" "b" COEFFS 0.000000 1.000000 0.000000 0.000000 0.000000 1.000000 /end COMPU_METHOD
/* Scalar measurable for DDE 'DTC_b_BARO_PressLVoltage'. */
/begin MEASUREMENT DTC_b_BARO_PressLVoltage "DTC122" UBYTE CU_DTC_B_BARO_PRESSLVOLTAGE 1 100 0.0 1.0 ECU_ADDRESS 0x40002fc4 BYTE_ORDER MSB_FIRST /end MEASUREMENT
/begin COMPU_METHOD CU_DTC_B_BARO_PRESSLVOLTAGE "Conversion method for DTC_b_BARO_PressLVoltage" RAT_FUNC "%10.0" "b" COEFFS 0.000000 1.000000 0.000000 0.000000 0.000000 1.000000 /end COMPU_METHOD
/* Scalar measurable for DDE 'DTC_b_BAT_VoltageOutofRange'. */
/begin MEASUREMENT DTC_b_BAT_VoltageOutofRange "DTC176" UBYTE CU_DTC_B_BAT_VOLTAGEOUTOFRANGE 1 100 0.0 1.0 ECU_ADDRESS 0x40002f8b BYTE_ORDER MSB_FIRST /end MEASUREMENT
/begin COMPU_METHOD CU_DTC_B_BAT_VOLTAGEOUTOFRANGE "Conversion method for DTC_b_BAT_VoltageOutofRange" RAT_FUNC "%10.0" "b" COEFFS 0.000000 1.000000 0.000000 0.000000 0.000000 1.000000 /end COMPU_METHOD
/* Scalar measurable for DDE 'DTC_b_CataCounting'. */
/begin MEASUREMENT DTC_b_CataCounting "DTC" UBYTE CU_DTC_B_CATACOUNTING 1 100 0.0 1.0 ECU_ADDRESS 0x40002fb7 BYTE_ORDER MSB_FIRST /end MEASUREMENT
/begin COMPU_METHOD CU_DTC_B_CATACOUNTING "Conversion method for DTC_b_CataCounting" RAT_FUNC "%10.0" "b" COEFFS 0.000000 1.000000 0.000000 0.000000 0.000000 1.000000 /end COMPU_METHOD
/* Scalar measurable for DDE 'DTC_b_Catalyst_A'. */
/begin MEASUREMENT DTC_b_Catalyst_A "DTC40" UBYTE CU_DTC_B_CATALYST_A 1 100 0.0 1.0 ECU_ADDRESS 0x40002fb6 BYTE_ORDER MSB_FIRST /end MEASUREMENT
/begin COMPU_METHOD CU_DTC_B_CATALYST_A "Conversion method for DTC_b_Catalyst_A" RAT_FUNC "%10.0" "b" COEFFS 0.000000 1.000000 0.000000 0.000000 0.000000 1.000000 /end COMPU_METHOD
/* Scalar measurable for DDE 'DTC_b_CompIAT_HTemp'. */
/begin MEASUREMENT DTC_b_CompIAT_HTemp "DTC172" UBYTE CU_DTC_B_COMPIAT_HTEMP 1 100 0.0 1.0 ECU_ADDRESS 0x40002f9c BYTE_ORDER MSB_FIRST /end MEASUREMENT
/begin COMPU_METHOD CU_DTC_B_COMPIAT_HTEMP "Conversion method for DTC_b_CompIAT_HTemp" RAT_FUNC "%10.0" "b" COEFFS 0.000000 1.000000 0.000000 0.000000 0.000000 1.000000 /end COMPU_METHOD
/* Scalar measurable for DDE 'DTC_b_CompIAT_TempHV'. */
/begin MEASUREMENT DTC_b_CompIAT_TempHV "DTC171" UBYTE CU_DTC_B_COMPIAT_TEMPHV 1 100 0.0 1.0 ECU_ADDRESS 0x40002f9d BYTE_ORDER MSB_FIRST /end MEASUREMENT
/begin COMPU_METHOD CU_DTC_B_COMPIAT_TEMPHV "Conversion method for DTC_b_CompIAT_TempHV" RAT_FUNC "%10.0" "b" COEFFS 0.000000 1.000000 0.000000 0.000000 0.000000 1.000000 /end COMPU_METHOD
/* Scalar measurable for DDE 'DTC_b_CompIAT_TempLV'. */
/begin MEASUREMENT DTC_b_CompIAT_TempLV "DTC170" UBYTE CU_DTC_B_COMPIAT_TEMPLV 1 100 0.0 1.0 ECU_ADDRESS 0x40002f9e BYTE_ORDER MSB_FIRST /end MEASUREMENT
/begin COMPU_METHOD CU_DTC_B_COMPIAT_TEMPLV "Conversion method for DTC_b_CompIAT_TempLV" RAT_FUNC "%10.0" "b" COEFFS 0.000000 1.000000 0.000000 0.000000 0.000000 1.000000 /end COMPU_METHOD
/* Scalar measurable for DDE 'DTC_b_DM11Force'. */
/begin MEASUREMENT DTC_b_DM11Force "DTC168" UBYTE CU_DTC_B_DM11FORCE 1 100 0.0 1.0 ECU_ADDRESS 0x40002f2e BYTE_ORDER MSB_FIRST /end MEASUREMENT
/begin COMPU_METHOD CU_DTC_B_DM11FORCE "Conversion method for DTC_b_DM11Force" RAT_FUNC "%10.0" "b" COEFFS 0.000000 1.000000 0.000000 0.000000 0.000000 1.000000 /end COMPU_METHOD
/* Scalar measurable for DDE 'DTC_b_DM37request'. */
/begin MEASUREMENT DTC_b_DM37request "DTC168" UBYTE CU_DTC_B_DM37REQUEST 1 100 0.0 1.0 ECU_ADDRESS 0x40002efb BYTE_ORDER MSB_FIRST /end MEASUREMENT
/begin COMPU_METHOD CU_DTC_B_DM37REQUEST "Conversion method for DTC_b_DM37request" RAT_FUNC "%10.0" "b" COEFFS 0.000000 1.000000 0.000000 0.000000 0.000000 1.000000 /end COMPU_METHOD
/* Scalar measurable for DDE 'DTC_b_DiagCataTemp_ena'. */
/begin MEASUREMENT DTC_b_DiagCataTemp_ena "DiagCataTemp_ena" UBYTE CU_DTC_B_DIAGCATATEMP_ENA 1 100 0.0 1.0 ECU_ADDRESS 0x40002fba BYTE_ORDER MSB_FIRST /end MEASUREMENT
/begin COMPU_METHOD CU_DTC_B_DIAGCATATEMP_ENA "Conversion method for DTC_b_DiagCataTemp_ena" RAT_FUNC "%10.0" "b" COEFFS 0.000000 1.000000 0.000000 0.000000 0.000000 1.000000 /end COMPU_METHOD
/* Scalar measurable for DDE 'DTC_b_DiagCata_Condition'. */
/begin MEASUREMENT DTC_b_DiagCata_Condition "DiagCata_Condition" UBYTE CU_DTC_B_DIAGCATA_CONDITION 1 100 0.0 1.0 ECU_ADDRESS 0x40002fb9 BYTE_ORDER MSB_FIRST /end MEASUREMENT
/begin COMPU_METHOD CU_DTC_B_DIAGCATA_CONDITION "Conversion method for DTC_b_DiagCata_Condition" RAT_FUNC "%10.0" "b" COEFFS 0.000000 1.000000 0.000000 0.000000 0.000000 1.000000 /end COMPU_METHOD
/* Scalar measurable for DDE 'DTC_b_DiagCata_Reset'. */
/begin MEASUREMENT DTC_b_DiagCata_Reset "DiagCata_Reset" UBYTE CU_DTC_B_DIAGCATA_RESET 1 100 0.0 1.0 ECU_ADDRESS 0x40002fb8 BYTE_ORDER MSB_FIRST /end MEASUREMENT
/begin COMPU_METHOD CU_DTC_B_DIAGCATA_RESET "Conversion method for DTC_b_DiagCata_Reset" RAT_FUNC "%10.0" "b" COEFFS 0.000000 1.000000 0.000000 0.000000 0.000000 1.000000 /end COMPU_METHOD
/* Scalar measurable for DDE 'DTC_b_DiagCata_Set'. */
/begin MEASUREMENT DTC_b_DiagCata_Set "DiagCata_Set" UBYTE CU_DTC_B_DIAGCATA_SET 1 100 0.0 1.0 ECU_ADDRESS 0x40002fc0 BYTE_ORDER MSB_FIRST /end MEASUREMENT
/begin COMPU_METHOD CU_DTC_B_DIAGCATA_SET "Conversion method for DTC_b_DiagCata_Set" RAT_FUNC "%10.0" "b" COEFFS 0.000000 1.000000 0.000000 0.000000 0.000000 1.000000 /end COMPU_METHOD
/* Scalar measurable for DDE 'DTC_b_DiagCata_TestEnd'. */
/begin MEASUREMENT DTC_b_DiagCata_TestEnd "DiagCata_TestEnd" UBYTE CU_DTC_B_DIAGCATA_TESTEND 1 100 0.0 1.0 ECU_ADDRESS 0x40002f81 BYTE_ORDER MSB_FIRST /end MEASUREMENT
/begin COMPU_METHOD CU_DTC_B_DIAGCATA_TESTEND "Conversion method for DTC_b_DiagCata_TestEnd" RAT_FUNC "%10.0" "b" COEFFS 0.000000 1.000000 0.000000 0.000000 0.000000 1.000000 /end COMPU_METHOD
/* Scalar measurable for DDE 'DTC_b_ECT_HTemp'. */
/begin MEASUREMENT DTC_b_ECT_HTemp "DTC91" UBYTE CU_DTC_B_ECT_HTEMP 1 100 0.0 1.0 ECU_ADDRESS 0x40002fb3 BYTE_ORDER MSB_FIRST /end MEASUREMENT
/begin COMPU_METHOD CU_DTC_B_ECT_HTEMP "Conversion method for DTC_b_ECT_HTemp" RAT_FUNC "%10.0" "b" COEFFS 0.000000 1.000000 0.000000 0.000000 0.000000 1.000000 /end COMPU_METHOD
/* Scalar measurable for DDE 'DTC_b_ECT_LTemp'. */
/begin MEASUREMENT DTC_b_ECT_LTemp "DTC92" UBYTE CU_DTC_B_ECT_LTEMP 1 100 0.0 1.0 ECU_ADDRESS 0x40002fb2 BYTE_ORDER MSB_FIRST /end MEASUREMENT
/begin COMPU_METHOD CU_DTC_B_ECT_LTEMP "Conversion method for DTC_b_ECT_LTemp" RAT_FUNC "%10.0" "b" COEFFS 0.000000 1.000000 0.000000 0.000000 0.000000 1.000000 /end COMPU_METHOD
/* Scalar measurable for DDE 'DTC_b_ECT_TempHVoltage'. */
/begin MEASUREMENT DTC_b_ECT_TempHVoltage "DTC89" UBYTE CU_DTC_B_ECT_TEMPHVOLTAGE 1 100 0.0 1.0 ECU_ADDRESS 0x40002fb5 BYTE_ORDER MSB_FIRST /end MEASUREMENT
/begin COMPU_METHOD CU_DTC_B_ECT_TEMPHVOLTAGE "Conversion method for DTC_b_ECT_TempHVoltage" RAT_FUNC "%10.0" "b" COEFFS 0.000000 1.000000 0.000000 0.000000 0.000000 1.000000 /end COMPU_METHOD
/* Scalar measurable for DDE 'DTC_b_ECT_TempLVoltage'. */
/begin MEASUREMENT DTC_b_ECT_TempLVoltage "DTC90" UBYTE CU_DTC_B_ECT_TEMPLVOLTAGE 1 100 0.0 1.0 ECU_ADDRESS 0x40002fb4 BYTE_ORDER MSB_FIRST /end MEASUREMENT
/begin COMPU_METHOD CU_DTC_B_ECT_TEMPLVOLTAGE "Conversion method for DTC_b_ECT_TempLVoltage" RAT_FUNC "%10.0" "b" COEFFS 0.000000 1.000000 0.000000 0.000000 0.000000 1.000000 /end COMPU_METHOD
/* Scalar measurable for DDE 'DTC_b_EGT_TempHV'. */
/begin MEASUREMENT DTC_b_EGT_TempHV "DTC171" UBYTE CU_DTC_B_EGT_TEMPHV 1 100 0.0 1.0 ECU_ADDRESS 0x40002fb0 BYTE_ORDER MSB_FIRST /end MEASUREMENT
/begin COMPU_METHOD CU_DTC_B_EGT_TEMPHV "Conversion method for DTC_b_EGT_TempHV" RAT_FUNC "%10.0" "b" COEFFS 0.000000 1.000000 0.000000 0.000000 0.000000 1.000000 /end COMPU_METHOD
/* Scalar measurable for DDE 'DTC_b_EGT_TempLV'. */
/begin MEASUREMENT DTC_b_EGT_TempLV "DTC171" UBYTE CU_DTC_B_EGT_TEMPLV 1 100 0.0 1.0 ECU_ADDRESS 0x40002faf BYTE_ORDER MSB_FIRST /end MEASUREMENT
/begin COMPU_METHOD CU_DTC_B_EGT_TEMPLV "Conversion method for DTC_b_EGT_TempLV" RAT_FUNC "%10.0" "b" COEFFS 0.000000 1.000000 0.000000 0.000000 0.000000 1.000000 /end COMPU_METHOD
/* Scalar measurable for DDE 'DTC_b_ETC_MotorFLT'. */
/begin MEASUREMENT DTC_b_ETC_MotorFLT "DTC134" UBYTE CU_DTC_B_ETC_MOTORFLT 1 100 0.0 1.0 ECU_ADDRESS 0x40002ea4 BYTE_ORDER MSB_FIRST /end MEASUREMENT
/begin COMPU_METHOD CU_DTC_B_ETC_MOTORFLT "Conversion method for DTC_b_ETC_MotorFLT" RAT_FUNC "%10.0" "b" COEFFS 0.000000 1.000000 0.000000 0.000000 0.000000 1.000000 /end COMPU_METHOD
/* Scalar measurable for DDE 'DTC_b_EcuMemFault'. */
/begin MEASUREMENT DTC_b_EcuMemFault "DTC141" UBYTE CU_DTC_B_ECUMEMFAULT 1 100 0.0 1.0 ECU_ADDRESS 0x40002fd7 BYTE_ORDER MSB_FIRST /end MEASUREMENT
/begin COMPU_METHOD CU_DTC_B_ECUMEMFAULT "Conversion method for DTC_b_EcuMemFault" RAT_FUNC "%10.0" "b" COEFFS 0.000000 1.000000 0.000000 0.000000 0.000000 1.000000 /end COMPU_METHOD
/* Scalar measurable for DDE 'DTC_b_EnableMIsfire'. */
/begin MEASUREMENT DTC_b_EnableMIsfire "DTC" UBYTE CU_DTC_B_ENABLEMISFIRE 1 100 0.0 1.0 ECU_ADDRESS 0x40002f80 BYTE_ORDER MSB_FIRST /end MEASUREMENT
/begin COMPU_METHOD CU_DTC_B_ENABLEMISFIRE "Conversion method for DTC_b_EnableMIsfire" RAT_FUNC "%10.0" "b" COEFFS 0.000000 1.000000 0.000000 0.000000 0.000000 1.000000 /end COMPU_METHOD
/* Scalar measurable for DDE 'DTC_b_Exhaust_HTemp'. */
/begin MEASUREMENT DTC_b_Exhaust_HTemp "Turbo_HTemp" UBYTE CU_DTC_B_EXHAUST_HTEMP 1 100 0.0 1.0 ECU_ADDRESS 0x40002fae BYTE_ORDER MSB_FIRST /end MEASUREMENT
/begin COMPU_METHOD CU_DTC_B_EXHAUST_HTEMP "Conversion method for DTC_b_Exhaust_HTemp" RAT_FUNC "%10.0" "b" COEFFS 0.000000 1.000000 0.000000 0.000000 0.000000 1.000000 /end COMPU_METHOD
/* Scalar measurable for DDE 'DTC_b_FAP_Disconected'. */
/begin MEASUREMENT DTC_b_FAP_Disconected "Displayable" UBYTE CU_DTC_B_FAP_DISCONECTED 1 100 0.0 1.0 ECU_ADDRESS 0x40002fab BYTE_ORDER MSB_FIRST /end MEASUREMENT
/begin COMPU_METHOD CU_DTC_B_FAP_DISCONECTED "Conversion method for DTC_b_FAP_Disconected" RAT_FUNC "%10.0" "b" COEFFS 0.000000 1.000000 0.000000 0.000000 0.000000 1.000000 /end COMPU_METHOD
/* Scalar measurable for DDE 'DTC_b_FAP_HPress'. */
/begin MEASUREMENT DTC_b_FAP_HPress "Displayable" UBYTE CU_DTC_B_FAP_HPRESS 1 100 0.0 1.0 ECU_ADDRESS 0x40002fac BYTE_ORDER MSB_FIRST /end MEASUREMENT
/begin COMPU_METHOD CU_DTC_B_FAP_HPRESS "Conversion method for DTC_b_FAP_HPress" RAT_FUNC "%10.0" "b" COEFFS 0.000000 1.000000 0.000000 0.000000 0.000000 1.000000 /end COMPU_METHOD
/* Scalar measurable for DDE 'DTC_b_FalloCamShaft'. */
/begin MEASUREMENT DTC_b_FalloCamShaft "DTC141" UBYTE CU_DTC_B_FALLOCAMSHAFT 1 100 0.0 1.0 ECU_ADDRESS 0x40002f76 BYTE_ORDER MSB_FIRST /end MEASUREMENT
/begin COMPU_METHOD CU_DTC_B_FALLOCAMSHAFT "Conversion method for DTC_b_FalloCamShaft" RAT_FUNC "%10.0" "b" COEFFS 0.000000 1.000000 0.000000 0.000000 0.000000 1.000000 /end COMPU_METHOD
/* Scalar measurable for DDE 'DTC_b_FalloCramShaft'. */
/begin MEASUREMENT DTC_b_FalloCramShaft "DTC141" UBYTE CU_DTC_B_FALLOCRAMSHAFT 1 100 0.0 1.0 ECU_ADDRESS 0x40002f7a BYTE_ORDER MSB_FIRST /end MEASUREMENT
/begin COMPU_METHOD CU_DTC_B_FALLOCRAMSHAFT "Conversion method for DTC_b_FalloCramShaft" RAT_FUNC "%10.0" "b" COEFFS 0.000000 1.000000 0.000000 0.000000 0.000000 1.000000 /end COMPU_METHOD
/* Scalar measurable for DDE 'DTC_b_GLP1_HVoltage'. */
/begin MEASUREMENT DTC_b_GLP1_HVoltage "DTC147" UBYTE CU_DTC_B_GLP1_HVOLTAGE 1 100 0.0 1.0 ECU_ADDRESS 0x40002fa0 BYTE_ORDER MSB_FIRST /end MEASUREMENT
/begin COMPU_METHOD CU_DTC_B_GLP1_HVOLTAGE "Conversion method for DTC_b_GLP1_HVoltage" RAT_FUNC "%10.0" "b" COEFFS 0.000000 1.000000 0.000000 0.000000 0.000000 1.000000 /end COMPU_METHOD
/* Scalar measurable for DDE 'DTC_b_GLP2_HVoltage'. */
/begin MEASUREMENT DTC_b_GLP2_HVoltage "DTC147" UBYTE CU_DTC_B_GLP2_HVOLTAGE 1 100 0.0 1.0 ECU_ADDRESS 0x40002f9f BYTE_ORDER MSB_FIRST /end MEASUREMENT
/begin COMPU_METHOD CU_DTC_B_GLP2_HVOLTAGE "Conversion method for DTC_b_GLP2_HVoltage" RAT_FUNC "%10.0" "b" COEFFS 0.000000 1.000000 0.000000 0.000000 0.000000 1.000000 /end COMPU_METHOD
/* Scalar measurable for DDE 'DTC_b_GLP_HPress'. */
/begin MEASUREMENT DTC_b_GLP_HPress "DTC144" UBYTE CU_DTC_B_GLP_HPRESS 1 100 0.0 1.0 ECU_ADDRESS 0x40002fa9 BYTE_ORDER MSB_FIRST /end MEASUREMENT
/begin COMPU_METHOD CU_DTC_B_GLP_HPRESS "Conversion method for DTC_b_GLP_HPress" RAT_FUNC "%10.0" "b" COEFFS 0.000000 1.000000 0.000000 0.000000 0.000000 1.000000 /end COMPU_METHOD
/* Scalar measurable for DDE 'DTC_b_GLP_HTemp'. */
/begin MEASUREMENT DTC_b_GLP_HTemp "DTC178" UBYTE CU_DTC_B_GLP_HTEMP 1 100 0.0 1.0 ECU_ADDRESS 0x40002fa3 BYTE_ORDER MSB_FIRST /end MEASUREMENT
/begin COMPU_METHOD CU_DTC_B_GLP_HTEMP "Conversion method for DTC_b_GLP_HTemp" RAT_FUNC "%10.0" "b" COEFFS 0.000000 1.000000 0.000000 0.000000 0.000000 1.000000 /end COMPU_METHOD
/* Scalar measurable for DDE 'DTC_b_GLP_LPress'. */
/begin MEASUREMENT DTC_b_GLP_LPress "DTC145" UBYTE CU_DTC_B_GLP_LPRESS 1 100 0.0 1.0 ECU_ADDRESS 0x40002fa7 BYTE_ORDER MSB_FIRST /end MEASUREMENT
/begin COMPU_METHOD CU_DTC_B_GLP_LPRESS "Conversion method for DTC_b_GLP_LPress" RAT_FUNC "%10.0" "b" COEFFS 0.000000 1.000000 0.000000 0.000000 0.000000 1.000000 /end COMPU_METHOD
/* Scalar measurable for DDE 'DTC_b_GLP_LTemp'. */
/begin MEASUREMENT DTC_b_GLP_LTemp "DTC179" UBYTE CU_DTC_B_GLP_LTEMP 1 100 0.0 1.0 ECU_ADDRESS 0x40002fa2 BYTE_ORDER MSB_FIRST /end MEASUREMENT
/begin COMPU_METHOD CU_DTC_B_GLP_LTEMP "Conversion method for DTC_b_GLP_LTemp" RAT_FUNC "%10.0" "b" COEFFS 0.000000 1.000000 0.000000 0.000000 0.000000 1.000000 /end COMPU_METHOD
/* Scalar measurable for DDE 'DTC_b_GLP_OL'. */
/begin MEASUREMENT DTC_b_GLP_OL "DTCxxx" UBYTE CU_DTC_B_GLP_OL 1 100 0.0 1.0 ECU_ADDRESS 0x40002fa8 BYTE_ORDER MSB_FIRST /end MEASUREMENT
/begin COMPU_METHOD CU_DTC_B_GLP_OL "Conversion method for DTC_b_GLP_OL" RAT_FUNC "%10.0" "b" COEFFS 0.000000 1.000000 0.000000 0.000000 0.000000 1.000000 /end COMPU_METHOD
/* Scalar measurable for DDE 'DTC_b_GLP_TempHVoltage'. */
/begin MEASUREMENT DTC_b_GLP_TempHVoltage "DTC177" UBYTE CU_DTC_B_GLP_TEMPHVOLTAGE 1 100 0.0 1.0 ECU_ADDRESS 0x40002fa5 BYTE_ORDER MSB_FIRST /end MEASUREMENT
/begin COMPU_METHOD CU_DTC_B_GLP_TEMPHVOLTAGE "Conversion method for DTC_b_GLP_TempHVoltage" RAT_FUNC "%10.0" "b" COEFFS 0.000000 1.000000 0.000000 0.000000 0.000000 1.000000 /end COMPU_METHOD
/* Scalar measurable for DDE 'DTC_b_GLP_TempLVoltage'. */
/begin MEASUREMENT DTC_b_GLP_TempLVoltage "DTCxxx" UBYTE CU_DTC_B_GLP_TEMPLVOLTAGE 1 100 0.0 1.0 ECU_ADDRESS 0x40002fa4 BYTE_ORDER MSB_FIRST /end MEASUREMENT
/begin COMPU_METHOD CU_DTC_B_GLP_TEMPLVOLTAGE "Conversion method for DTC_b_GLP_TempLVoltage" RAT_FUNC "%10.0" "b" COEFFS 0.000000 1.000000 0.000000 0.000000 0.000000 1.000000 /end COMPU_METHOD
/* Scalar measurable for DDE 'DTC_b_HeatersA_OL'. */
/begin MEASUREMENT DTC_b_HeatersA_OL "DTC13" UBYTE CU_DTC_B_HEATERSA_OL 1 100 0.0 1.0 ECU_ADDRESS 0x40002f98 BYTE_ORDER MSB_FIRST /end MEASUREMENT
/begin COMPU_METHOD CU_DTC_B_HEATERSA_OL "Conversion method for DTC_b_HeatersA_OL" RAT_FUNC "%10.0" "b" COEFFS 0.000000 1.000000 0.000000 0.000000 0.000000 1.000000 /end COMPU_METHOD
/* Scalar measurable for DDE 'DTC_b_HeatersA_SB'. */
/begin MEASUREMENT DTC_b_HeatersA_SB "DTC19" UBYTE CU_DTC_B_HEATERSA_SB 1 100 0.0 1.0 ECU_ADDRESS 0x40002f95 BYTE_ORDER MSB_FIRST /end MEASUREMENT
/begin COMPU_METHOD CU_DTC_B_HEATERSA_SB "Conversion method for DTC_b_HeatersA_SB" RAT_FUNC "%10.0" "b" COEFFS 0.000000 1.000000 0.000000 0.000000 0.000000 1.000000 /end COMPU_METHOD
/* Scalar measurable for DDE 'DTC_b_HeatersA_SG'. */
/begin MEASUREMENT DTC_b_HeatersA_SG "DTC17" UBYTE CU_DTC_B_HEATERSA_SG 1 100 0.0 1.0 ECU_ADDRESS 0x40002f96 BYTE_ORDER MSB_FIRST /end MEASUREMENT
/begin COMPU_METHOD CU_DTC_B_HEATERSA_SG "Conversion method for DTC_b_HeatersA_SG" RAT_FUNC "%10.0" "b" COEFFS 0.000000 1.000000 0.000000 0.000000 0.000000 1.000000 /end COMPU_METHOD
/* Scalar measurable for DDE 'DTC_b_KNOCK_Cyl1'. */
/begin MEASUREMENT DTC_b_KNOCK_Cyl1 "DTC152" UBYTE CU_DTC_B_KNOCK_CYL1 1 100 0.0 1.0 ECU_ADDRESS 0x40002e97 BYTE_ORDER MSB_FIRST /end MEASUREMENT
/begin COMPU_METHOD CU_DTC_B_KNOCK_CYL1 "Conversion method for DTC_b_KNOCK_Cyl1" RAT_FUNC "%10.0" "b" COEFFS 0.000000 1.000000 0.000000 0.000000 0.000000 1.000000 /end COMPU_METHOD
/* Scalar measurable for DDE 'DTC_b_KNOCK_Cyl2'. */
/begin MEASUREMENT DTC_b_KNOCK_Cyl2 "DTC153" UBYTE CU_DTC_B_KNOCK_CYL2 1 100 0.0 1.0 ECU_ADDRESS 0x40002e96 BYTE_ORDER MSB_FIRST /end MEASUREMENT
/begin COMPU_METHOD CU_DTC_B_KNOCK_CYL2 "Conversion method for DTC_b_KNOCK_Cyl2" RAT_FUNC "%10.0" "b" COEFFS 0.000000 1.000000 0.000000 0.000000 0.000000 1.000000 /end COMPU_METHOD
/* Scalar measurable for DDE 'DTC_b_KNOCK_Cyl3'. */
/begin MEASUREMENT DTC_b_KNOCK_Cyl3 "DTC154" UBYTE CU_DTC_B_KNOCK_CYL3 1 100 0.0 1.0 ECU_ADDRESS 0x40002e95 BYTE_ORDER MSB_FIRST /end MEASUREMENT
/begin COMPU_METHOD CU_DTC_B_KNOCK_CYL3 "Conversion method for DTC_b_KNOCK_Cyl3" RAT_FUNC "%10.0" "b" COEFFS 0.000000 1.000000 0.000000 0.000000 0.000000 1.000000 /end COMPU_METHOD
/* Scalar measurable for DDE 'DTC_b_KNOCK_Cyl4'. */
/begin MEASUREMENT DTC_b_KNOCK_Cyl4 "DTC155" UBYTE CU_DTC_B_KNOCK_CYL4 1 100 0.0 1.0 ECU_ADDRESS 0x40002e94 BYTE_ORDER MSB_FIRST /end MEASUREMENT
/begin COMPU_METHOD CU_DTC_B_KNOCK_CYL4 "Conversion method for DTC_b_KNOCK_Cyl4" RAT_FUNC "%10.0" "b" COEFFS 0.000000 1.000000 0.000000 0.000000 0.000000 1.000000 /end COMPU_METHOD
/* Scalar measurable for DDE 'DTC_b_LB11CTFail'. */
/begin MEASUREMENT DTC_b_LB11CTFail "DTC15" UBYTE CU_DTC_B_LB11CTFAIL 1 100 0.0 1.0 ECU_ADDRESS 0x40002f97 BYTE_ORDER MSB_FIRST /end MEASUREMENT
/begin COMPU_METHOD CU_DTC_B_LB11CTFAIL "Conversion method for DTC_b_LB11CTFail" RAT_FUNC "%10.0" "b" COEFFS 0.000000 1.000000 0.000000 0.000000 0.000000 1.000000 /end COMPU_METHOD
/* Scalar measurable for DDE 'DTC_b_LB12OL'. */
/begin MEASUREMENT DTC_b_LB12OL "DTC31" UBYTE CU_DTC_B_LB12OL 1 100 0.0 1.0 ECU_ADDRESS 0x40002fbe BYTE_ORDER MSB_FIRST /end MEASUREMENT
/begin COMPU_METHOD CU_DTC_B_LB12OL "Conversion method for DTC_b_LB12OL" RAT_FUNC "%10.0" "b" COEFFS 0.000000 1.000000 0.000000 0.000000 0.000000 1.000000 /end COMPU_METHOD
/* Scalar measurable for DDE 'DTC_b_LB12SB'. */
/begin MEASUREMENT DTC_b_LB12SB "DTC33" UBYTE CU_DTC_B_LB12SB 1 100 0.0 1.0 ECU_ADDRESS 0x40002fbc BYTE_ORDER MSB_FIRST /end MEASUREMENT
/begin COMPU_METHOD CU_DTC_B_LB12SB "Conversion method for DTC_b_LB12SB" RAT_FUNC "%10.0" "b" COEFFS 0.000000 1.000000 0.000000 0.000000 0.000000 1.000000 /end COMPU_METHOD
/* Scalar measurable for DDE 'DTC_b_LambdaA_SB'. */
/begin MEASUREMENT DTC_b_LambdaA_SB "DTC11" UBYTE CU_DTC_B_LAMBDAA_SB 1 100 0.0 1.0 ECU_ADDRESS 0x40002f99 BYTE_ORDER MSB_FIRST /end MEASUREMENT
/begin COMPU_METHOD CU_DTC_B_LAMBDAA_SB "Conversion method for DTC_b_LambdaA_SB" RAT_FUNC "%10.0" "b" COEFFS 0.000000 1.000000 0.000000 0.000000 0.000000 1.000000 /end COMPU_METHOD
/* Scalar measurable for DDE 'DTC_b_LambdaA_SG'. */
/begin MEASUREMENT DTC_b_LambdaA_SG "DTC9" UBYTE CU_DTC_B_LAMBDAA_SG 1 100 0.0 1.0 ECU_ADDRESS 0x40002f94 BYTE_ORDER MSB_FIRST /end MEASUREMENT
/begin COMPU_METHOD CU_DTC_B_LAMBDAA_SG "Conversion method for DTC_b_LambdaA_SG" RAT_FUNC "%10.0" "b" COEFFS 0.000000 1.000000 0.000000 0.000000 0.000000 1.000000 /end COMPU_METHOD
/* Scalar measurable for DDE 'DTC_b_LambdaB11NOTValid'. */
/begin MEASUREMENT DTC_b_LambdaB11NOTValid "DTC160" UBYTE CU_DTC_B_LAMBDAB11NOTVALID 1 100 0.0 1.0 ECU_ADDRESS 0x40002f93 BYTE_ORDER MSB_FIRST /end MEASUREMENT
/begin COMPU_METHOD CU_DTC_B_LAMBDAB11NOTVALID "Conversion method for DTC_b_LambdaB11NOTValid" RAT_FUNC "%10.0" "b" COEFFS 0.000000 1.000000 0.000000 0.000000 0.000000 1.000000 /end COMPU_METHOD
/* Scalar measurable for DDE 'DTC_b_MAPAfterThInfraPress'. */
/begin MEASUREMENT DTC_b_MAPAfterThInfraPress "DTC166" UBYTE CU_DTC_B_MAPAFTERTHINFRAPRESS 1 100 0.0 1.0 ECU_ADDRESS 0x40002fc5 BYTE_ORDER MSB_FIRST /end MEASUREMENT
/begin COMPU_METHOD CU_DTC_B_MAPAFTERTHINFRAPRESS "Conversion method for DTC_b_MAPAfterThInfraPress" RAT_FUNC "%10.0" "b" COEFFS 0.000000 1.000000 0.000000 0.000000 0.000000 1.000000 /end COMPU_METHOD
/* Scalar measurable for DDE 'DTC_b_MAPAfterThOverPress'. */
/begin MEASUREMENT DTC_b_MAPAfterThOverPress "DTC16" UBYTE CU_DTC_B_MAPAFTERTHOVERPRESS 1 100 0.0 1.0 ECU_ADDRESS 0x40002fc6 BYTE_ORDER MSB_FIRST /end MEASUREMENT
/begin COMPU_METHOD CU_DTC_B_MAPAFTERTHOVERPRESS "Conversion method for DTC_b_MAPAfterThOverPress" RAT_FUNC "%10.0" "b" COEFFS 0.000000 1.000000 0.000000 0.000000 0.000000 1.000000 /end COMPU_METHOD
/* Scalar measurable for DDE 'DTC_b_MAPAfterThr_LV'. */
/begin MEASUREMENT DTC_b_MAPAfterThr_LV "DTC168" UBYTE CU_DTC_B_MAPAFTERTHR_LV 1 100 0.0 1.0 ECU_ADDRESS 0x40002fc8 BYTE_ORDER MSB_FIRST /end MEASUREMENT
/begin COMPU_METHOD CU_DTC_B_MAPAFTERTHR_LV "Conversion method for DTC_b_MAPAfterThr_LV" RAT_FUNC "%10.0" "b" COEFFS 0.000000 1.000000 0.000000 0.000000 0.000000 1.000000 /end COMPU_METHOD
/* Scalar measurable for DDE 'DTC_b_MAPAftrThr_HV'. */
/begin MEASUREMENT DTC_b_MAPAftrThr_HV "DTC167" UBYTE CU_DTC_B_MAPAFTRTHR_HV 1 100 0.0 1.0 ECU_ADDRESS 0x40002fc9 BYTE_ORDER MSB_FIRST /end MEASUREMENT
/begin COMPU_METHOD CU_DTC_B_MAPAFTRTHR_HV "Conversion method for DTC_b_MAPAftrThr_HV" RAT_FUNC "%10.0" "b" COEFFS 0.000000 1.000000 0.000000 0.000000 0.000000 1.000000 /end COMPU_METHOD
/* Scalar measurable for DDE 'DTC_b_MAPBefThroHV'. */
/begin MEASUREMENT DTC_b_MAPBefThroHV "DTC167" UBYTE CU_DTC_B_MAPBEFTHROHV 1 100 0.0 1.0 ECU_ADDRESS 0x40002f89 BYTE_ORDER MSB_FIRST /end MEASUREMENT
/begin COMPU_METHOD CU_DTC_B_MAPBEFTHROHV "Conversion method for DTC_b_MAPBefThroHV" RAT_FUNC "%10.0" "b" COEFFS 0.000000 1.000000 0.000000 0.000000 0.000000 1.000000 /end COMPU_METHOD
/* Scalar measurable for DDE 'DTC_b_MAPBefThroOL'. */
/begin MEASUREMENT DTC_b_MAPBefThroOL "DTC168" UBYTE CU_DTC_B_MAPBEFTHROOL 1 100 0.0 1.0 ECU_ADDRESS 0x40002f8a BYTE_ORDER MSB_FIRST /end MEASUREMENT
/begin COMPU_METHOD CU_DTC_B_MAPBEFTHROOL "Conversion method for DTC_b_MAPBefThroOL" RAT_FUNC "%10.0" "b" COEFFS 0.000000 1.000000 0.000000 0.000000 0.000000 1.000000 /end COMPU_METHOD
/* Scalar measurable for DDE 'DTC_b_MAPBeforeThroHPress'. */
/begin MEASUREMENT DTC_b_MAPBeforeThroHPress "DTC16" UBYTE CU_DTC_B_MAPBEFORETHROHPRESS 1 100 0.0 1.0 ECU_ADDRESS 0x40002f87 BYTE_ORDER MSB_FIRST /end MEASUREMENT
/begin COMPU_METHOD CU_DTC_B_MAPBEFORETHROHPRESS "Conversion method for DTC_b_MAPBeforeThroHPress" RAT_FUNC "%10.0" "b" COEFFS 0.000000 1.000000 0.000000 0.000000 0.000000 1.000000 /end COMPU_METHOD
/* Scalar measurable for DDE 'DTC_b_MAPBeforeThroLPress'. */
/begin MEASUREMENT DTC_b_MAPBeforeThroLPress "DTC166" UBYTE CU_DTC_B_MAPBEFORETHROLPRESS 1 100 0.0 1.0 ECU_ADDRESS 0x40002f88 BYTE_ORDER MSB_FIRST /end MEASUREMENT
/begin COMPU_METHOD CU_DTC_B_MAPBEFORETHROLPRESS "Conversion method for DTC_b_MAPBeforeThroLPress" RAT_FUNC "%10.0" "b" COEFFS 0.000000 1.000000 0.000000 0.000000 0.000000 1.000000 /end COMPU_METHOD
/* Scalar measurable for DDE 'DTC_b_Misfire_Bancada'. */
/begin MEASUREMENT DTC_b_Misfire_Bancada "DTC" UBYTE CU_DTC_B_MISFIRE_BANCADA 1 100 0.0 1.0 ECU_ADDRESS 0x40002f7b BYTE_ORDER MSB_FIRST /end MEASUREMENT
/begin COMPU_METHOD CU_DTC_B_MISFIRE_BANCADA "Conversion method for DTC_b_Misfire_Bancada" RAT_FUNC "%10.0" "b" COEFFS 0.000000 1.000000 0.000000 0.000000 0.000000 1.000000 /end COMPU_METHOD
/* Scalar measurable for DDE 'DTC_b_Misfire_Cylinder_1'. */
/begin MEASUREMENT DTC_b_Misfire_Cylinder_1 "DTC" UBYTE CU_DTC_B_MISFIRE_CYLINDER_1 1 100 0.0 1.0 ECU_ADDRESS 0x40002f7f BYTE_ORDER MSB_FIRST /end MEASUREMENT
/begin COMPU_METHOD CU_DTC_B_MISFIRE_CYLINDER_1 "Conversion method for DTC_b_Misfire_Cylinder_1" RAT_FUNC "%10.0" "b" COEFFS 0.000000 1.000000 0.000000 0.000000 0.000000 1.000000 /end COMPU_METHOD
/* Scalar measurable for DDE 'DTC_b_Misfire_Cylinder_2'. */
/begin MEASUREMENT DTC_b_Misfire_Cylinder_2 "DTC" UBYTE CU_DTC_B_MISFIRE_CYLINDER_2 1 100 0.0 1.0 ECU_ADDRESS 0x40002f7e BYTE_ORDER MSB_FIRST /end MEASUREMENT
/begin COMPU_METHOD CU_DTC_B_MISFIRE_CYLINDER_2 "Conversion method for DTC_b_Misfire_Cylinder_2" RAT_FUNC "%10.0" "b" COEFFS 0.000000 1.000000 0.000000 0.000000 0.000000 1.000000 /end COMPU_METHOD
/* Scalar measurable for DDE 'DTC_b_Misfire_Cylinder_3'. */
/begin MEASUREMENT DTC_b_Misfire_Cylinder_3 "DTC" UBYTE CU_DTC_B_MISFIRE_CYLINDER_3 1 100 0.0 1.0 ECU_ADDRESS 0x40002f7d BYTE_ORDER MSB_FIRST /end MEASUREMENT
/begin COMPU_METHOD CU_DTC_B_MISFIRE_CYLINDER_3 "Conversion method for DTC_b_Misfire_Cylinder_3" RAT_FUNC "%10.0" "b" COEFFS 0.000000 1.000000 0.000000 0.000000 0.000000 1.000000 /end COMPU_METHOD
/* Scalar measurable for DDE 'DTC_b_Misfire_Cylinder_4'. */
/begin MEASUREMENT DTC_b_Misfire_Cylinder_4 "DTC" UBYTE CU_DTC_B_MISFIRE_CYLINDER_4 1 100 0.0 1.0 ECU_ADDRESS 0x40002f7c BYTE_ORDER MSB_FIRST /end MEASUREMENT
/begin COMPU_METHOD CU_DTC_B_MISFIRE_CYLINDER_4 "Conversion method for DTC_b_Misfire_Cylinder_4" RAT_FUNC "%10.0" "b" COEFFS 0.000000 1.000000 0.000000 0.000000 0.000000 1.000000 /end COMPU_METHOD
/* Scalar measurable for DDE 'DTC_b_NBValid'. */
/begin MEASUREMENT DTC_b_NBValid "NBValid" UBYTE CU_DTC_B_NBVALID 1 100 0.0 1.0 ECU_ADDRESS 0x40002fbb BYTE_ORDER MSB_FIRST /end MEASUREMENT
/begin COMPU_METHOD CU_DTC_B_NBVALID "Conversion method for DTC_b_NBValid" RAT_FUNC "%10.0" "b" COEFFS 0.000000 1.000000 0.000000 0.000000 0.000000 1.000000 /end COMPU_METHOD
/* Scalar measurable for DDE 'DTC_b_OIL_LPress'. */
/begin MEASUREMENT DTC_b_OIL_LPress "DTC108" UBYTE CU_DTC_B_OIL_LPRESS 1 100 0.0 1.0 ECU_ADDRESS 0x40002f6e BYTE_ORDER MSB_FIRST /end MEASUREMENT
/begin COMPU_METHOD CU_DTC_B_OIL_LPRESS "Conversion method for DTC_b_OIL_LPress" RAT_FUNC "%10.0" "b" COEFFS 0.000000 1.000000 0.000000 0.000000 0.000000 1.000000 /end COMPU_METHOD
/* Scalar measurable for DDE 'DTC_b_OIL_Sensor'. */
/begin MEASUREMENT DTC_b_OIL_Sensor "DTC107" UBYTE CU_DTC_B_OIL_SENSOR 1 100 0.0 1.0 ECU_ADDRESS 0x40002f70 BYTE_ORDER MSB_FIRST /end MEASUREMENT
/begin COMPU_METHOD CU_DTC_B_OIL_SENSOR "Conversion method for DTC_b_OIL_Sensor" RAT_FUNC "%10.0" "b" COEFFS 0.000000 1.000000 0.000000 0.000000 0.000000 1.000000 /end COMPU_METHOD
/* Scalar measurable for DDE 'DTC_b_OIL_SensorOL'. */
/begin MEASUREMENT DTC_b_OIL_SensorOL "DTC111" UBYTE CU_DTC_B_OIL_SENSOROL 1 100 0.0 1.0 ECU_ADDRESS 0x40002f6f BYTE_ORDER MSB_FIRST /end MEASUREMENT
/begin COMPU_METHOD CU_DTC_B_OIL_SENSOROL "Conversion method for DTC_b_OIL_SensorOL" RAT_FUNC "%10.0" "b" COEFFS 0.000000 1.000000 0.000000 0.000000 0.000000 1.000000 /end COMPU_METHOD
/* Scalar measurable for DDE 'DTC_b_Readiness'. */
/begin MEASUREMENT DTC_b_Readiness "(not defined)" UBYTE CU_DTC_B_READINESS 1 100 0.0 1.0 ECU_ADDRESS 0x40002f2f BYTE_ORDER MSB_FIRST /end MEASUREMENT
/begin COMPU_METHOD CU_DTC_B_READINESS "Conversion method for DTC_b_Readiness" RAT_FUNC "%10.0" "b" COEFFS 0.000000 1.000000 0.000000 0.000000 0.000000 1.000000 /end COMPU_METHOD
/* Scalar measurable for DDE 'DTC_b_ShutOffValveEngine_OL'. */
/begin MEASUREMENT DTC_b_ShutOffValveEngine_OL "DTC119" UBYTE CU_DTC_B_SHUTOFFVALVEENGINE_OL 1 100 0.0 1.0 ECU_ADDRESS 0x40002f1e BYTE_ORDER MSB_FIRST /end MEASUREMENT
/begin COMPU_METHOD CU_DTC_B_SHUTOFFVALVEENGINE_OL "Conversion method for DTC_b_ShutOffValveEngine_OL" RAT_FUNC "%10.0" "b" COEFFS 0.000000 1.000000 0.000000 0.000000 0.000000 1.000000 /end COMPU_METHOD
/* Scalar measurable for DDE 'DTC_b_ShutOffValveEngine_SG'. */
/begin MEASUREMENT DTC_b_ShutOffValveEngine_SG "SG" UBYTE CU_DTC_B_SHUTOFFVALVEENGINE_SG 1 100 0.0 1.0 ECU_ADDRESS 0x40002fbf BYTE_ORDER MSB_FIRST /end MEASUREMENT
/begin COMPU_METHOD CU_DTC_B_SHUTOFFVALVEENGINE_SG "Conversion method for DTC_b_ShutOffValveEngine_SG" RAT_FUNC "%10.0" "b" COEFFS 0.000000 1.000000 0.000000 0.000000 0.000000 1.000000 /end COMPU_METHOD
/* Scalar measurable for DDE 'DTC_b_Supply_VRefA'. */
/begin MEASUREMENT DTC_b_Supply_VRefA "DTC162" UBYTE CU_DTC_B_SUPPLY_VREFA 1 100 0.0 1.0 ECU_ADDRESS 0x40002f64 BYTE_ORDER MSB_FIRST /end MEASUREMENT
/begin COMPU_METHOD CU_DTC_B_SUPPLY_VREFA "Conversion method for DTC_b_Supply_VRefA" RAT_FUNC "%10.0" "b" COEFFS 0.000000 1.000000 0.000000 0.000000 0.000000 1.000000 /end COMPU_METHOD
/* Scalar measurable for DDE 'DTC_b_Supply_VRefB'. */
/begin MEASUREMENT DTC_b_Supply_VRefB "DTC161" UBYTE CU_DTC_B_SUPPLY_VREFB 1 100 0.0 1.0 ECU_ADDRESS 0x40002f65 BYTE_ORDER MSB_FIRST /end MEASUREMENT
/begin COMPU_METHOD CU_DTC_B_SUPPLY_VREFB "Conversion method for DTC_b_Supply_VRefB" RAT_FUNC "%10.0" "b" COEFFS 0.000000 1.000000 0.000000 0.000000 0.000000 1.000000 /end COMPU_METHOD
/* Scalar measurable for DDE 'DTC_b_Supply_VRefC'. */
/begin MEASUREMENT DTC_b_Supply_VRefC "DTC163" UBYTE CU_DTC_B_SUPPLY_VREFC 1 100 0.0 1.0 ECU_ADDRESS 0x40002f63 BYTE_ORDER MSB_FIRST /end MEASUREMENT
/begin COMPU_METHOD CU_DTC_B_SUPPLY_VREFC "Conversion method for DTC_b_Supply_VRefC" RAT_FUNC "%10.0" "b" COEFFS 0.000000 1.000000 0.000000 0.000000 0.000000 1.000000 /end COMPU_METHOD
/* Scalar measurable for DDE 'DTC_b_Supply_VRefD'. */
/begin MEASUREMENT DTC_b_Supply_VRefD "DTC175" UBYTE CU_DTC_B_SUPPLY_VREFD 1 100 0.0 1.0 ECU_ADDRESS 0x40002f62 BYTE_ORDER MSB_FIRST /end MEASUREMENT
/begin COMPU_METHOD CU_DTC_B_SUPPLY_VREFD "Conversion method for DTC_b_Supply_VRefD" RAT_FUNC "%10.0" "b" COEFFS 0.000000 1.000000 0.000000 0.000000 0.000000 1.000000 /end COMPU_METHOD
/* Scalar measurable for DDE 'DTC_b_THR_Motor_Fail'. */
/begin MEASUREMENT DTC_b_THR_Motor_Fail "DTC136" UBYTE CU_DTC_B_THR_MOTOR_FAIL 1 100 0.0 1.0 ECU_ADDRESS 0x40002f90 BYTE_ORDER MSB_FIRST /end MEASUREMENT
/begin COMPU_METHOD CU_DTC_B_THR_MOTOR_FAIL "Conversion method for DTC_b_THR_Motor_Fail" RAT_FUNC "%10.0" "b" COEFFS 0.000000 1.000000 0.000000 0.000000 0.000000 1.000000 /end COMPU_METHOD
/* Scalar measurable for DDE 'DTC_b_TP1_SensorHV'. */
/begin MEASUREMENT DTC_b_TP1_SensorHV "DTC126" UBYTE CU_DTC_B_TP1_SENSORHV 1 100 0.0 1.0 ECU_ADDRESS 0x40002f91 BYTE_ORDER MSB_FIRST /end MEASUREMENT
/begin COMPU_METHOD CU_DTC_B_TP1_SENSORHV "Conversion method for DTC_b_TP1_SensorHV" RAT_FUNC "%10.0" "b" COEFFS 0.000000 1.000000 0.000000 0.000000 0.000000 1.000000 /end COMPU_METHOD
/* Scalar measurable for DDE 'DTC_b_TP1_SensorLV'. */
/begin MEASUREMENT DTC_b_TP1_SensorLV "DTC124" UBYTE CU_DTC_B_TP1_SENSORLV 1 100 0.0 1.0 ECU_ADDRESS 0x40002f92 BYTE_ORDER MSB_FIRST /end MEASUREMENT
/begin COMPU_METHOD CU_DTC_B_TP1_SENSORLV "Conversion method for DTC_b_TP1_SensorLV" RAT_FUNC "%10.0" "b" COEFFS 0.000000 1.000000 0.000000 0.000000 0.000000 1.000000 /end COMPU_METHOD
/* Scalar measurable for DDE 'DTC_b_TP2_SensorHV'. */
/begin MEASUREMENT DTC_b_TP2_SensorHV "DTC127" UBYTE CU_DTC_B_TP2_SENSORHV 1 100 0.0 1.0 ECU_ADDRESS 0x40002f8d BYTE_ORDER MSB_FIRST /end MEASUREMENT
/begin COMPU_METHOD CU_DTC_B_TP2_SENSORHV "Conversion method for DTC_b_TP2_SensorHV" RAT_FUNC "%10.0" "b" COEFFS 0.000000 1.000000 0.000000 0.000000 0.000000 1.000000 /end COMPU_METHOD
/* Scalar measurable for DDE 'DTC_b_TP2_SensorLV'. */
/begin MEASUREMENT DTC_b_TP2_SensorLV "DTC125" UBYTE CU_DTC_B_TP2_SENSORLV 1 100 0.0 1.0 ECU_ADDRESS 0x40002f8e BYTE_ORDER MSB_FIRST /end MEASUREMENT
/begin COMPU_METHOD CU_DTC_B_TP2_SENSORLV "Conversion method for DTC_b_TP2_SensorLV" RAT_FUNC "%10.0" "b" COEFFS 0.000000 1.000000 0.000000 0.000000 0.000000 1.000000 /end COMPU_METHOD
/* Scalar measurable for DDE 'DTC_b_TP_CorrFLT'. */
/begin MEASUREMENT DTC_b_TP_CorrFLT "DTC128" UBYTE CU_DTC_B_TP_CORRFLT 1 100 0.0 1.0 ECU_ADDRESS 0x40002ea1 BYTE_ORDER MSB_FIRST /end MEASUREMENT
/begin COMPU_METHOD CU_DTC_B_TP_CORRFLT "Conversion method for DTC_b_TP_CorrFLT" RAT_FUNC "%10.0" "b" COEFFS 0.000000 1.000000 0.000000 0.000000 0.000000 1.000000 /end COMPU_METHOD
/* Scalar measurable for DDE 'DTC_b_TurboError'. */
/begin MEASUREMENT DTC_b_TurboError "DTC" UBYTE CU_DTC_B_TURBOERROR 1 100 0.0 1.0 ECU_ADDRESS 0x40002e8f BYTE_ORDER MSB_FIRST /end MEASUREMENT
/begin COMPU_METHOD CU_DTC_B_TURBOERROR "Conversion method for DTC_b_TurboError" RAT_FUNC "%10.0" "b" COEFFS 0.000000 1.000000 0.000000 0.000000 0.000000 1.000000 /end COMPU_METHOD
/* Scalar measurable for DDE 'DTC_s_BegasTime'. */
/begin MEASUREMENT DTC_s_BegasTime "(not defined)" FLOAT32_IEEE CU_DTC_S_BEGASTIME 1 100 0.0 100000.0 ECU_ADDRESS 0x4000396c BYTE_ORDER MSB_FIRST /end MEASUREMENT
/begin COMPU_METHOD CU_DTC_S_BEGASTIME "Conversion method for DTC_s_BegasTime" RAT_FUNC "%10.0" "s" COEFFS 0.000000 1.000000 0.000000 0.000000 0.000000 1.000000 /end COMPU_METHOD
/* Scalar measurable for DDE 'DTC_s_TimerOut_1'. */
/begin MEASUREMENT DTC_s_TimerOut_1 "timer salida" FLOAT32_IEEE CU_DTC_S_TIMEROUT_1 1 100 0.0 10000000.0 ECU_ADDRESS 0x40003918 BYTE_ORDER MSB_FIRST /end MEASUREMENT
/begin COMPU_METHOD CU_DTC_S_TIMEROUT_1 "Conversion method for DTC_s_TimerOut_1" RAT_FUNC "%10.2" "s" COEFFS 0.000000 1.000000 0.000000 0.000000 0.000000 1.000000 /end COMPU_METHOD
/* Scalar measurable for DDE 'DTC_s_TimerOut_2'. */
/begin MEASUREMENT DTC_s_TimerOut_2 "timer salida" FLOAT32_IEEE CU_DTC_S_TIMEROUT_2 1 100 0.0 10000000.0 ECU_ADDRESS 0x4000391c BYTE_ORDER MSB_FIRST /end MEASUREMENT
/begin COMPU_METHOD CU_DTC_S_TIMEROUT_2 "Conversion method for DTC_s_TimerOut_2" RAT_FUNC "%10.2" "s" COEFFS 0.000000 1.000000 0.000000 0.000000 0.000000 1.000000 /end COMPU_METHOD
/* Scalar measurable for DDE 'EFP_NU_FuelPumpErrROC'. */
/begin MEASUREMENT EFP_NU_FuelPumpErrROC "(bar/s) Time derivative of position error" FLOAT32_IEEE CU_EFP_NU_FUELPUMPERRROC 1 100 -100.0 100.0 ECU_ADDRESS 0x400036d8 BYTE_ORDER MSB_FIRST /end MEASUREMENT
/begin COMPU_METHOD CU_EFP_NU_FUELPUMPERRROC "Conversion method for EFP_NU_FuelPumpErrROC" RAT_FUNC "%10.3" "NU" COEFFS 0.000000 1.000000 0.000000 0.000000 0.000000 1.000000 /end COMPU_METHOD
/* Scalar measurable for DDE 'EFP_b_FuelPumpDC'. */
/begin MEASUREMENT EFP_b_FuelPumpDC "PWM Signal percentage for Monitoring" FLOAT32_IEEE CU_EFP_B_FUELPUMPDC 1 100 0.0 1.0 ECU_ADDRESS 0x400036c8 BYTE_ORDER MSB_FIRST /end MEASUREMENT
/begin COMPU_METHOD CU_EFP_B_FUELPUMPDC "Conversion method for EFP_b_FuelPumpDC" RAT_FUNC "%10.2" "pct" COEFFS 0.000000 1.000000 0.000000 0.000000 0.000000 1.000000 /end COMPU_METHOD
/* Scalar measurable for DDE 'EFP_b_NotStalled'. */
/begin MEASUREMENT EFP_b_NotStalled "Displayable" UBYTE CU_EFP_B_NOTSTALLED 1 100 0.0 1.0 ECU_ADDRESS 0x40002f28 BYTE_ORDER MSB_FIRST /end MEASUREMENT
/begin COMPU_METHOD CU_EFP_B_NOTSTALLED "Conversion method for EFP_b_NotStalled" RAT_FUNC "%10.0" "b" COEFFS 0.000000 1.000000 0.000000 0.000000 0.000000 1.000000 /end COMPU_METHOD
/* Scalar measurable for DDE 'EFP_b_RunFuelPump'. */
/begin MEASUREMENT EFP_b_RunFuelPump "Displayable" UBYTE CU_EFP_B_RUNFUELPUMP 1 100 0.0 1.0 ECU_ADDRESS 0x40002f27 BYTE_ORDER MSB_FIRST /end MEASUREMENT
/begin COMPU_METHOD CU_EFP_B_RUNFUELPUMP "Conversion method for EFP_b_RunFuelPump" RAT_FUNC "%10.0" "b" COEFFS 0.000000 1.000000 0.000000 0.000000 0.000000 1.000000 /end COMPU_METHOD
/* Scalar measurable for DDE 'EFP_bar_PressErr'. */
/begin MEASUREMENT EFP_bar_PressErr "Fuel pressure error" FLOAT32_IEEE CU_EFP_BAR_PRESSERR 1 100 -100.0 100.0 ECU_ADDRESS 0x400036e4 BYTE_ORDER MSB_FIRST /end MEASUREMENT
/begin COMPU_METHOD CU_EFP_BAR_PRESSERR "Conversion method for EFP_bar_PressErr" RAT_FUNC "%10.3" "NU" COEFFS 0.000000 1.000000 0.000000 0.000000 0.000000 1.000000 /end COMPU_METHOD
/* Scalar measurable for DDE 'EFP_pct_FuelPumpDC_PID'. */
/begin MEASUREMENT EFP_pct_FuelPumpDC_PID "Feedback control effort for  FuelPump" FLOAT32_IEEE CU_EFP_PCT_FUELPUMPDC_PID 1 100 0.0 1.0 ECU_ADDRESS 0x400036cc BYTE_ORDER MSB_FIRST /end MEASUREMENT
/begin COMPU_METHOD CU_EFP_PCT_FUELPUMPDC_PID "Conversion method for EFP_pct_FuelPumpDC_PID" RAT_FUNC "%10.3" "NU" COEFFS 0.000000 1.000000 0.000000 0.000000 0.000000 1.000000 /end COMPU_METHOD
/* Scalar measurable for DDE 'EFP_pct_FuelPumpDTerm'. */
/begin MEASUREMENT EFP_pct_FuelPumpDTerm "Derivative effort for  FuelPump" FLOAT32_IEEE CU_EFP_PCT_FUELPUMPDTERM 1 100 -1.0 1.0 ECU_ADDRESS 0x400036d4 BYTE_ORDER MSB_FIRST /end MEASUREMENT
/begin COMPU_METHOD CU_EFP_PCT_FUELPUMPDTERM "Conversion method for EFP_pct_FuelPumpDTerm" RAT_FUNC "%10.3" "NU" COEFFS 0.000000 1.000000 0.000000 0.000000 0.000000 1.000000 /end COMPU_METHOD
/* Scalar measurable for DDE 'EFP_pct_FuelPumpITerm'. */
/begin MEASUREMENT EFP_pct_FuelPumpITerm "Integral effort for  FuelPump" FLOAT32_IEEE CU_EFP_PCT_FUELPUMPITERM 1 100 -1.0 1.0 ECU_ADDRESS 0x400036dc BYTE_ORDER MSB_FIRST /end MEASUREMENT
/begin COMPU_METHOD CU_EFP_PCT_FUELPUMPITERM "Conversion method for EFP_pct_FuelPumpITerm" RAT_FUNC "%10.3" "NU" COEFFS 0.000000 1.000000 0.000000 0.000000 0.000000 1.000000 /end COMPU_METHOD
/* Scalar measurable for DDE 'EFP_pct_FuelPumpPIDRaw'. */
/begin MEASUREMENT EFP_pct_FuelPumpPIDRaw "FuelPump PID effort raw" FLOAT32_IEEE CU_EFP_PCT_FUELPUMPPIDRAW 1 100 -1.0 1.0 ECU_ADDRESS 0x400036d0 BYTE_ORDER MSB_FIRST /end MEASUREMENT
/begin COMPU_METHOD CU_EFP_PCT_FUELPUMPPIDRAW "Conversion method for EFP_pct_FuelPumpPIDRaw" RAT_FUNC "%10.3" "NU" COEFFS 0.000000 1.000000 0.000000 0.000000 0.000000 1.000000 /end COMPU_METHOD
/* Scalar measurable for DDE 'EFP_pct_FuelPumpPTerm'. */
/begin MEASUREMENT EFP_pct_FuelPumpPTerm "Proportional effort" FLOAT32_IEEE CU_EFP_PCT_FUELPUMPPTERM 1 100 0.0 1.0 ECU_ADDRESS 0x400036e0 BYTE_ORDER MSB_FIRST /end MEASUREMENT
/begin COMPU_METHOD CU_EFP_PCT_FUELPUMPPTERM "Conversion method for EFP_pct_FuelPumpPTerm" RAT_FUNC "%10.3" "NU" COEFFS 0.000000 1.000000 0.000000 0.000000 0.000000 1.000000 /end COMPU_METHOD
/* Scalar measurable for DDE 'ELM_Nm_AlternatorTq'. */
/begin MEASUREMENT ELM_Nm_AlternatorTq "Alternator load torque value" FLOAT32_IEEE CU_ELM_NM_ALTERNATORTQ 1 100 0.0 0.0 ECU_ADDRESS 0x400035b4 BYTE_ORDER MSB_FIRST /end MEASUREMENT
/begin COMPU_METHOD CU_ELM_NM_ALTERNATORTQ "Conversion method for ELM_Nm_AlternatorTq" RAT_FUNC "%10.2" "Nm" COEFFS 0.000000 1.000000 0.000000 0.000000 0.000000 1.000000 /end COMPU_METHOD
/* Scalar measurable for DDE 'ELM_Nm_FrictionTq'. */
/begin MEASUREMENT ELM_Nm_FrictionTq "Friction torque value" FLOAT32_IEEE CU_ELM_NM_FRICTIONTQ 1 100 0.0 0.0 ECU_ADDRESS 0x40003580 BYTE_ORDER MSB_FIRST /end MEASUREMENT
/begin COMPU_METHOD CU_ELM_NM_FRICTIONTQ "Conversion method for ELM_Nm_FrictionTq" RAT_FUNC "%10.2" "Nm" COEFFS 0.000000 1.000000 0.000000 0.000000 0.000000 1.000000 /end COMPU_METHOD
/* Scalar measurable for DDE 'ELM_Nm_HVAC_Tq'. */
/begin MEASUREMENT ELM_Nm_HVAC_Tq "HVAC load torque value" FLOAT32_IEEE CU_ELM_NM_HVAC_TQ 1 100 0.0 0.0 ECU_ADDRESS 0x40003588 BYTE_ORDER MSB_FIRST /end MEASUREMENT
/begin COMPU_METHOD CU_ELM_NM_HVAC_TQ "Conversion method for ELM_Nm_HVAC_Tq" RAT_FUNC "%10.2" "Nm" COEFFS 0.000000 1.000000 0.000000 0.000000 0.000000 1.000000 /end COMPU_METHOD
/* Scalar measurable for DDE 'ELM_Nm_PwrStrTq'. */
/begin MEASUREMENT ELM_Nm_PwrStrTq "Power steering load torque value" FLOAT32_IEEE CU_ELM_NM_PWRSTRTQ 1 100 0.0 0.0 ECU_ADDRESS 0x40003584 BYTE_ORDER MSB_FIRST /end MEASUREMENT
/begin COMPU_METHOD CU_ELM_NM_PWRSTRTQ "Conversion method for ELM_Nm_PwrStrTq" RAT_FUNC "%10.2" "Nm" COEFFS 0.000000 1.000000 0.000000 0.000000 0.000000 1.000000 /end COMPU_METHOD
/* Scalar measurable for DDE 'ELM_Nm_Tq'. */
/begin MEASUREMENT ELM_Nm_Tq "Total engine load torque" FLOAT32_IEEE CU_ELM_NM_TQ 1 100 0.0 0.0 ECU_ADDRESS 0x40003574 BYTE_ORDER MSB_FIRST /end MEASUREMENT
/begin COMPU_METHOD CU_ELM_NM_TQ "Conversion method for ELM_Nm_Tq" RAT_FUNC "%10.2" "Nm" COEFFS 0.000000 1.000000 0.000000 0.000000 0.000000 1.000000 /end COMPU_METHOD
/* Scalar measurable for DDE 'ELM_Nm_ZFFAN_Tq'. */
/begin MEASUREMENT ELM_Nm_ZFFAN_Tq "Fuel pump load torque value" FLOAT32_IEEE CU_ELM_NM_ZFFAN_TQ 1 100 0.0 0.0 ECU_ADDRESS 0x4000357c BYTE_ORDER MSB_FIRST /end MEASUREMENT
/begin COMPU_METHOD CU_ELM_NM_ZFFAN_TQ "Conversion method for ELM_Nm_ZFFAN_Tq" RAT_FUNC "%10.2" "Nm" COEFFS 0.000000 1.000000 0.000000 0.000000 0.000000 1.000000 /end COMPU_METHOD
/* Scalar measurable for DDE 'ERL_RPM_HardLim'. */
/begin MEASUREMENT ERL_RPM_HardLim "Hard engine speed limit" FLOAT32_IEEE CU_ERL_RPM_HARDLIM 1 100 0.0 0.0 ECU_ADDRESS 0x4000356c BYTE_ORDER MSB_FIRST /end MEASUREMENT
/begin COMPU_METHOD CU_ERL_RPM_HARDLIM "Conversion method for ERL_RPM_HardLim" RAT_FUNC "%10.0" "RPM" COEFFS 0.000000 1.000000 0.000000 0.000000 0.000000 1.000000 /end COMPU_METHOD
/* Scalar measurable for DDE 'ERL_RPM_Overspd'. */
/begin MEASUREMENT ERL_RPM_Overspd "Engine over speed" FLOAT32_IEEE CU_ERL_RPM_OVERSPD 1 100 0.0 0.0 ECU_ADDRESS 0x40003568 BYTE_ORDER MSB_FIRST /end MEASUREMENT
/begin COMPU_METHOD CU_ERL_RPM_OVERSPD "Conversion method for ERL_RPM_Overspd" RAT_FUNC "%10.0" "RPM" COEFFS 0.000000 1.000000 0.000000 0.000000 0.000000 1.000000 /end COMPU_METHOD
/* Scalar measurable for DDE 'ERL_b_Active'. */
/begin MEASUREMENT ERL_b_Active "Engine speed limiting active flag" UBYTE CU_ERL_B_ACTIVE 1 100 0.0 1.0 ECU_ADDRESS 0x40002ecc BYTE_ORDER MSB_FIRST /end MEASUREMENT
/begin COMPU_METHOD CU_ERL_B_ACTIVE "Conversion method for ERL_b_Active" RAT_FUNC "%10.0" "b" COEFFS 0.000000 1.000000 0.000000 0.000000 0.000000 1.000000 /end COMPU_METHOD
/* Scalar measurable for DDE 'ERL_b_CutFuel'. */
/begin MEASUREMENT ERL_b_CutFuel "Engine speed limited fuel cut command" UBYTE CU_ERL_B_CUTFUEL 1 100 0.0 1.0 ECU_ADDRESS 0x40002ece BYTE_ORDER MSB_FIRST /end MEASUREMENT
/begin COMPU_METHOD CU_ERL_B_CUTFUEL "Conversion method for ERL_b_CutFuel" RAT_FUNC "%10.0" "b" COEFFS 0.000000 1.000000 0.000000 0.000000 0.000000 1.000000 /end COMPU_METHOD
/* Scalar measurable for DDE 'ERL_b_CutSpark'. */
/begin MEASUREMENT ERL_b_CutSpark "Engine speed limited spark cut command" UBYTE CU_ERL_B_CUTSPARK 1 100 0.0 1.0 ECU_ADDRESS 0x40002e92 BYTE_ORDER MSB_FIRST /end MEASUREMENT
/begin COMPU_METHOD CU_ERL_B_CUTSPARK "Conversion method for ERL_b_CutSpark" RAT_FUNC "%10.0" "b" COEFFS 0.000000 1.000000 0.000000 0.000000 0.000000 1.000000 /end COMPU_METHOD
/* Scalar measurable for DDE 'ERL_b_HardLimReached'. */
/begin MEASUREMENT ERL_b_HardLimReached "Hard engine speed limit reached" UBYTE CU_ERL_B_HARDLIMREACHED 1 100 0.0 1.0 ECU_ADDRESS 0x40002ed2 BYTE_ORDER MSB_FIRST /end MEASUREMENT
/begin COMPU_METHOD CU_ERL_B_HARDLIMREACHED "Conversion method for ERL_b_HardLimReached" RAT_FUNC "%10.0" "b" COEFFS 0.000000 1.000000 0.000000 0.000000 0.000000 1.000000 /end COMPU_METHOD
/* Scalar measurable for DDE 'ERL_pct_PTerm'. */
/begin MEASUREMENT ERL_pct_PTerm "Torque demand multiplier for proportional speed limiting" FLOAT32_IEEE CU_ERL_PCT_PTERM 1 100 0.0 0.0 ECU_ADDRESS 0x40003564 BYTE_ORDER MSB_FIRST /end MEASUREMENT
/begin COMPU_METHOD CU_ERL_PCT_PTERM "Conversion method for ERL_pct_PTerm" RAT_FUNC "%10.2" "pct" COEFFS 0.000000 1.000000 0.000000 0.000000 0.000000 1.000000 /end COMPU_METHOD
/* Scalar measurable for DDE 'ERL_pct_TqMult'. */
/begin MEASUREMENT ERL_pct_TqMult "Final torque demand multiplier" FLOAT32_IEEE CU_ERL_PCT_TQMULT 1 100 0.0 0.0 ECU_ADDRESS 0x40003560 BYTE_ORDER MSB_FIRST /end MEASUREMENT
/begin COMPU_METHOD CU_ERL_PCT_TQMULT "Conversion method for ERL_pct_TqMult" RAT_FUNC "%10.2" "pct" COEFFS 0.000000 1.000000 0.000000 0.000000 0.000000 1.000000 /end COMPU_METHOD
/* Scalar measurable for DDE 'ERL_ret_SparkRetard'. */
/begin MEASUREMENT ERL_ret_SparkRetard "Engine speed limiting spark retard angle" FLOAT32_IEEE CU_ERL_RET_SPARKRETARD 1 100 0.0 0.0 ECU_ADDRESS 0x40003454 BYTE_ORDER MSB_FIRST /end MEASUREMENT
/begin COMPU_METHOD CU_ERL_RET_SPARKRETARD "Conversion method for ERL_ret_SparkRetard" RAT_FUNC "%10.0" "ret" COEFFS 0.000000 1.000000 0.000000 0.000000 0.000000 1.000000 /end COMPU_METHOD
/* Scalar measurable for DDE 'ERM_e_RunningMode'. */
/begin MEASUREMENT ERM_e_RunningMode "Displayable" UBYTE CU_ERM_E_RUNNINGMODE 1 100 0.0 0.0 ECU_ADDRESS 0x40002fe8 BYTE_ORDER MSB_FIRST /end MEASUREMENT
/begin COMPU_METHOD CU_ERM_E_RUNNINGMODE "Conversion method for ERM_e_RunningMode" TAB_VERB "%12.0" "e" COMPU_TAB_REF CT_ERM_E_RUNNINGMODE /end COMPU_METHOD
/begin COMPU_VTAB CT_ERM_E_RUNNINGMODE "Conversion method for ERM_e_RunningMode" TAB_VERB 5 0 "ERMk_e_Stopped" 1 "ERMk_e_Stalled" 2 "ERMk_e_Cranking" 3 "ERMk_e_360_Mode" 4 "ERMk_e_Running" /end COMPU_VTAB
/* Scalar measurable for DDE 'ERM_s_TimeSinceStart'. */
/begin MEASUREMENT ERM_s_TimeSinceStart "Displayable" FLOAT32_IEEE CU_ERM_S_TIMESINCESTART 1 100 0.0 0.0 ECU_ADDRESS 0x400035bc BYTE_ORDER MSB_FIRST /end MEASUREMENT
/begin COMPU_METHOD CU_ERM_S_TIMESINCESTART "Conversion method for ERM_s_TimeSinceStart" RAT_FUNC "%10.0" "s" COEFFS 0.000000 1.000000 0.000000 0.000000 0.000000 1.000000 /end COMPU_METHOD
/* Scalar measurable for DDE 'ETC_NU_DTerm'. */
/begin MEASUREMENT ETC_NU_DTerm "Displayable" FLOAT32_IEEE CU_ETC_NU_DTERM 1 100 0.0 0.0 ECU_ADDRESS 0x40003188 BYTE_ORDER MSB_FIRST /end MEASUREMENT
/begin COMPU_METHOD CU_ETC_NU_DTERM "Conversion method for ETC_NU_DTerm" RAT_FUNC "%10.3" "NU" COEFFS 0.000000 1.000000 0.000000 0.000000 0.000000 1.000000 /end COMPU_METHOD
/* Scalar measurable for DDE 'ETC_NU_Error_Int'. */
/begin MEASUREMENT ETC_NU_Error_Int "(not defined)" FLOAT32_IEEE CU_ETC_NU_ERROR_INT 1 100 -1000.0 1000.0 ECU_ADDRESS 0x40003170 BYTE_ORDER MSB_FIRST /end MEASUREMENT
/begin COMPU_METHOD CU_ETC_NU_ERROR_INT "Conversion method for ETC_NU_Error_Int" RAT_FUNC "%10.2" "NU" COEFFS 0.000000 1.000000 0.000000 0.000000 0.000000 1.000000 /end COMPU_METHOD
/* Scalar measurable for DDE 'ETC_NU_ITerm'. */
/begin MEASUREMENT ETC_NU_ITerm "Displayable" FLOAT32_IEEE CU_ETC_NU_ITERM 1 100 0.0 0.0 ECU_ADDRESS 0x40003178 BYTE_ORDER MSB_FIRST /end MEASUREMENT
/begin COMPU_METHOD CU_ETC_NU_ITERM "Conversion method for ETC_NU_ITerm" RAT_FUNC "%10.3" "NU" COEFFS 0.000000 1.000000 0.000000 0.000000 0.000000 1.000000 /end COMPU_METHOD
/* Scalar measurable for DDE 'ETC_NU_PTerm'. */
/begin MEASUREMENT ETC_NU_PTerm "Displayable" FLOAT32_IEEE CU_ETC_NU_PTERM 1 100 0.0 0.0 ECU_ADDRESS 0x40003194 BYTE_ORDER MSB_FIRST /end MEASUREMENT
/begin COMPU_METHOD CU_ETC_NU_PTERM "Conversion method for ETC_NU_PTerm" RAT_FUNC "%10.3" "NU" COEFFS 0.000000 1.000000 0.000000 0.000000 0.000000 1.000000 /end COMPU_METHOD
/* Scalar measurable for DDE 'ETC_NU_TP1_FullPos'. */
/begin MEASUREMENT ETC_NU_TP1_FullPos "Displayable" FLOAT32_IEEE CU_ETC_NU_TP1_FULLPOS 1 100 0.0 0.0 ECU_ADDRESS 0x40003360 BYTE_ORDER MSB_FIRST /end MEASUREMENT
/begin COMPU_METHOD CU_ETC_NU_TP1_FULLPOS "Conversion method for ETC_NU_TP1_FullPos" RAT_FUNC "%10.3" "NU" COEFFS 0.000000 1.000000 0.000000 0.000000 0.000000 1.000000 /end COMPU_METHOD
/* Scalar measurable for DDE 'ETC_NU_TP1_Slow'. */
/begin MEASUREMENT ETC_NU_TP1_Slow "Result of lowspeed filter for TP endstop learning" FLOAT32_IEEE CU_ETC_NU_TP1_SLOW 1 100 0.0 0.0 ECU_ADDRESS 0x40003368 BYTE_ORDER MSB_FIRST /end MEASUREMENT
/begin COMPU_METHOD CU_ETC_NU_TP1_SLOW "Conversion method for ETC_NU_TP1_Slow" RAT_FUNC "%10.3" "NU" COEFFS 0.000000 1.000000 0.000000 0.000000 0.000000 1.000000 /end COMPU_METHOD
/* Scalar measurable for DDE 'ETC_NU_TP1_ZeroPos'. */
/begin MEASUREMENT ETC_NU_TP1_ZeroPos "Displayable" FLOAT32_IEEE CU_ETC_NU_TP1_ZEROPOS 1 100 0.0 0.0 ECU_ADDRESS 0x40003364 BYTE_ORDER MSB_FIRST /end MEASUREMENT
/begin COMPU_METHOD CU_ETC_NU_TP1_ZEROPOS "Conversion method for ETC_NU_TP1_ZeroPos" RAT_FUNC "%10.3" "NU" COEFFS 0.000000 1.000000 0.000000 0.000000 0.000000 1.000000 /end COMPU_METHOD
/* Scalar measurable for DDE 'ETC_NU_TP2_FullPos'. */
/begin MEASUREMENT ETC_NU_TP2_FullPos "Displayable" FLOAT32_IEEE CU_ETC_NU_TP2_FULLPOS 1 100 0.0 0.0 ECU_ADDRESS 0x40003354 BYTE_ORDER MSB_FIRST /end MEASUREMENT
/begin COMPU_METHOD CU_ETC_NU_TP2_FULLPOS "Conversion method for ETC_NU_TP2_FullPos" RAT_FUNC "%10.3" "NU" COEFFS 0.000000 1.000000 0.000000 0.000000 0.000000 1.000000 /end COMPU_METHOD
/* Scalar measurable for DDE 'ETC_NU_TP2_Slow'. */
/begin MEASUREMENT ETC_NU_TP2_Slow "Result of lowspeed filter for TP endstop learning" FLOAT32_IEEE CU_ETC_NU_TP2_SLOW 1 100 0.0 0.0 ECU_ADDRESS 0x40003374 BYTE_ORDER MSB_FIRST /end MEASUREMENT
/begin COMPU_METHOD CU_ETC_NU_TP2_SLOW "Conversion method for ETC_NU_TP2_Slow" RAT_FUNC "%10.3" "NU" COEFFS 0.000000 1.000000 0.000000 0.000000 0.000000 1.000000 /end COMPU_METHOD
/* Scalar measurable for DDE 'ETC_NU_TP2_ZeroPos'. */
/begin MEASUREMENT ETC_NU_TP2_ZeroPos "Displayable" FLOAT32_IEEE CU_ETC_NU_TP2_ZEROPOS 1 100 0.0 0.0 ECU_ADDRESS 0x40003358 BYTE_ORDER MSB_FIRST /end MEASUREMENT
/begin COMPU_METHOD CU_ETC_NU_TP2_ZEROPOS "Conversion method for ETC_NU_TP2_ZeroPos" RAT_FUNC "%10.3" "NU" COEFFS 0.000000 1.000000 0.000000 0.000000 0.000000 1.000000 /end COMPU_METHOD
/* Scalar measurable for DDE 'ETC_NU_TPRate'. */
/begin MEASUREMENT ETC_NU_TPRate "Displayable" FLOAT32_IEEE CU_ETC_NU_TPRATE 1 100 0.0 0.0 ECU_ADDRESS 0x4000336c BYTE_ORDER MSB_FIRST /end MEASUREMENT
/begin COMPU_METHOD CU_ETC_NU_TPRATE "Conversion method for ETC_NU_TPRate" RAT_FUNC "%10.3" "NU" COEFFS 0.000000 1.000000 0.000000 0.000000 0.000000 1.000000 /end COMPU_METHOD
/* Scalar measurable for DDE 'ETC_NU_TP_Dot'. */
/begin MEASUREMENT ETC_NU_TP_Dot "(V/s) Raw TPS rate of change" FLOAT32_IEEE CU_ETC_NU_TP_DOT 1 100 0.0 0.0 ECU_ADDRESS 0x40003038 BYTE_ORDER MSB_FIRST /end MEASUREMENT
/begin COMPU_METHOD CU_ETC_NU_TP_DOT "Conversion method for ETC_NU_TP_Dot" RAT_FUNC "%10.2" "NU" COEFFS 0.000000 1.000000 0.000000 0.000000 0.000000 1.000000 /end COMPU_METHOD
/* Scalar measurable for DDE 'ETC_b_AuthorityReduced'. */
/begin MEASUREMENT ETC_b_AuthorityReduced "Flag to indicate to other features that ETC cannot currently provide high-precision position control" UBYTE CU_ETC_B_AUTHORITYREDUCED 1 100 0.0 1.0 ECU_ADDRESS 0x40002e81 BYTE_ORDER MSB_FIRST /end MEASUREMENT
/begin COMPU_METHOD CU_ETC_B_AUTHORITYREDUCED "Conversion method for ETC_b_AuthorityReduced" RAT_FUNC "%10.0" "b" COEFFS 0.000000 1.000000 0.000000 0.000000 0.000000 1.000000 /end COMPU_METHOD
/* Scalar measurable for DDE 'ETC_b_CloseComplete'. */
/begin MEASUREMENT ETC_b_CloseComplete "Displayable" UBYTE CU_ETC_B_CLOSECOMPLETE 1 100 0.0 1.0 ECU_ADDRESS 0x40002fe1 BYTE_ORDER MSB_FIRST /end MEASUREMENT
/begin COMPU_METHOD CU_ETC_B_CLOSECOMPLETE "Conversion method for ETC_b_CloseComplete" RAT_FUNC "%10.0" "b" COEFFS 0.000000 1.000000 0.000000 0.000000 0.000000 1.000000 /end COMPU_METHOD
/* Scalar measurable for DDE 'ETC_b_Expired'. */
/begin MEASUREMENT ETC_b_Expired "Displayable" UBYTE CU_ETC_B_EXPIRED 1 100 0.0 1.0 ECU_ADDRESS 0x40002ea6 BYTE_ORDER MSB_FIRST /end MEASUREMENT
/begin COMPU_METHOD CU_ETC_B_EXPIRED "Conversion method for ETC_b_Expired" RAT_FUNC "%10.0" "b" COEFFS 0.000000 1.000000 0.000000 0.000000 0.000000 1.000000 /end COMPU_METHOD
/* Scalar measurable for DDE 'ETC_b_ForceClosed'. */
/begin MEASUREMENT ETC_b_ForceClosed "Displayable" UBYTE CU_ETC_B_FORCECLOSED 1 100 0.0 1.0 ECU_ADDRESS 0x40002e71 BYTE_ORDER MSB_FIRST /end MEASUREMENT
/begin COMPU_METHOD CU_ETC_B_FORCECLOSED "Conversion method for ETC_b_ForceClosed" RAT_FUNC "%10.0" "b" COEFFS 0.000000 1.000000 0.000000 0.000000 0.000000 1.000000 /end COMPU_METHOD
/* Scalar measurable for DDE 'ETC_b_ForceOpen'. */
/begin MEASUREMENT ETC_b_ForceOpen "Displayable" UBYTE CU_ETC_B_FORCEOPEN 1 100 0.0 1.0 ECU_ADDRESS 0x40002e72 BYTE_ORDER MSB_FIRST /end MEASUREMENT
/begin COMPU_METHOD CU_ETC_B_FORCEOPEN "Conversion method for ETC_b_ForceOpen" RAT_FUNC "%10.0" "b" COEFFS 0.000000 1.000000 0.000000 0.000000 0.000000 1.000000 /end COMPU_METHOD
/* Scalar measurable for DDE 'ETC_b_LearnReady'. */
/begin MEASUREMENT ETC_b_LearnReady "Displayable" UBYTE CU_ETC_B_LEARNREADY 1 100 0.0 1.0 ECU_ADDRESS 0x40002eaa BYTE_ORDER MSB_FIRST /end MEASUREMENT
/begin COMPU_METHOD CU_ETC_B_LEARNREADY "Conversion method for ETC_b_LearnReady" RAT_FUNC "%10.0" "b" COEFFS 0.000000 1.000000 0.000000 0.000000 0.000000 1.000000 /end COMPU_METHOD
/* Scalar measurable for DDE 'ETC_b_LearnRest'. */
/begin MEASUREMENT ETC_b_LearnRest "Displayable" UBYTE CU_ETC_B_LEARNREST 1 100 0.0 1.0 ECU_ADDRESS 0x40002ea7 BYTE_ORDER MSB_FIRST /end MEASUREMENT
/begin COMPU_METHOD CU_ETC_B_LEARNREST "Conversion method for ETC_b_LearnRest" RAT_FUNC "%10.0" "b" COEFFS 0.000000 1.000000 0.000000 0.000000 0.000000 1.000000 /end COMPU_METHOD
/* Scalar measurable for DDE 'ETC_b_LearnSequenceFailed'. */
/begin MEASUREMENT ETC_b_LearnSequenceFailed "Displayable" UBYTE CU_ETC_B_LEARNSEQUENCEFAILED 1 100 0.0 1.0 ECU_ADDRESS 0x40002e6f BYTE_ORDER MSB_FIRST /end MEASUREMENT
/begin COMPU_METHOD CU_ETC_B_LEARNSEQUENCEFAILED "Conversion method for ETC_b_LearnSequenceFailed" RAT_FUNC "%10.0" "b" COEFFS 0.000000 1.000000 0.000000 0.000000 0.000000 1.000000 /end COMPU_METHOD
/* Scalar measurable for DDE 'ETC_b_LearnSequenceSuccess'. */
/begin MEASUREMENT ETC_b_LearnSequenceSuccess "Displayable" UBYTE CU_ETC_B_LEARNSEQUENCESUCCESS 1 100 0.0 1.0 ECU_ADDRESS 0x40002e70 BYTE_ORDER MSB_FIRST /end MEASUREMENT
/begin COMPU_METHOD CU_ETC_B_LEARNSEQUENCESUCCESS "Conversion method for ETC_b_LearnSequenceSuccess" RAT_FUNC "%10.0" "b" COEFFS 0.000000 1.000000 0.000000 0.000000 0.000000 1.000000 /end COMPU_METHOD
/* Scalar measurable for DDE 'ETC_b_OpenComplete'. */
/begin MEASUREMENT ETC_b_OpenComplete "Displayable" UBYTE CU_ETC_B_OPENCOMPLETE 1 100 0.0 1.0 ECU_ADDRESS 0x40002fe0 BYTE_ORDER MSB_FIRST /end MEASUREMENT
/begin COMPU_METHOD CU_ETC_B_OPENCOMPLETE "Conversion method for ETC_b_OpenComplete" RAT_FUNC "%10.0" "b" COEFFS 0.000000 1.000000 0.000000 0.000000 0.000000 1.000000 /end COMPU_METHOD
/* Scalar measurable for DDE 'ETC_b_RangeCheckFailed'. */
/begin MEASUREMENT ETC_b_RangeCheckFailed "Displayable" UBYTE CU_ETC_B_RANGECHECKFAILED 1 100 0.0 1.0 ECU_ADDRESS 0x40002ea5 BYTE_ORDER MSB_FIRST /end MEASUREMENT
/begin COMPU_METHOD CU_ETC_B_RANGECHECKFAILED "Conversion method for ETC_b_RangeCheckFailed" RAT_FUNC "%10.0" "b" COEFFS 0.000000 1.000000 0.000000 0.000000 0.000000 1.000000 /end COMPU_METHOD
/* Scalar measurable for DDE 'ETC_b_RestPosOOR'. */
/begin MEASUREMENT ETC_b_RestPosOOR "Displayable" UBYTE CU_ETC_B_RESTPOSOOR 1 100 0.0 1.0 ECU_ADDRESS 0x40002ea2 BYTE_ORDER MSB_FIRST /end MEASUREMENT
/begin COMPU_METHOD CU_ETC_B_RESTPOSOOR "Conversion method for ETC_b_RestPosOOR" RAT_FUNC "%10.0" "b" COEFFS 0.000000 1.000000 0.000000 0.000000 0.000000 1.000000 /end COMPU_METHOD
/* Scalar measurable for DDE 'ETC_b_Stable'. */
/begin MEASUREMENT ETC_b_Stable "Displayable" UBYTE CU_ETC_B_STABLE 1 100 0.0 1.0 ECU_ADDRESS 0x40002eb3 BYTE_ORDER MSB_FIRST /end MEASUREMENT
/begin COMPU_METHOD CU_ETC_B_STABLE "Conversion method for ETC_b_Stable" RAT_FUNC "%10.0" "b" COEFFS 0.000000 1.000000 0.000000 0.000000 0.000000 1.000000 /end COMPU_METHOD
/* Scalar measurable for DDE 'ETC_b_StoppedClosing'. */
/begin MEASUREMENT ETC_b_StoppedClosing "Displayable" UBYTE CU_ETC_B_STOPPEDCLOSING 1 100 0.0 1.0 ECU_ADDRESS 0x40002ea8 BYTE_ORDER MSB_FIRST /end MEASUREMENT
/begin COMPU_METHOD CU_ETC_B_STOPPEDCLOSING "Conversion method for ETC_b_StoppedClosing" RAT_FUNC "%10.0" "b" COEFFS 0.000000 1.000000 0.000000 0.000000 0.000000 1.000000 /end COMPU_METHOD
/* Scalar measurable for DDE 'ETC_b_StoppedOpening'. */
/begin MEASUREMENT ETC_b_StoppedOpening "Displayable" UBYTE CU_ETC_B_STOPPEDOPENING 1 100 0.0 1.0 ECU_ADDRESS 0x40002ea9 BYTE_ORDER MSB_FIRST /end MEASUREMENT
/begin COMPU_METHOD CU_ETC_B_STOPPEDOPENING "Conversion method for ETC_b_StoppedOpening" RAT_FUNC "%10.0" "b" COEFFS 0.000000 1.000000 0.000000 0.000000 0.000000 1.000000 /end COMPU_METHOD
/* Scalar measurable for DDE 'ETC_b_TP1_FullPosOOR'. */
/begin MEASUREMENT ETC_b_TP1_FullPosOOR "Displayable" UBYTE CU_ETC_B_TP1_FULLPOSOOR 1 100 0.0 1.0 ECU_ADDRESS 0x40002eab BYTE_ORDER MSB_FIRST /end MEASUREMENT
/begin COMPU_METHOD CU_ETC_B_TP1_FULLPOSOOR "Conversion method for ETC_b_TP1_FullPosOOR" RAT_FUNC "%10.0" "b" COEFFS 0.000000 1.000000 0.000000 0.000000 0.000000 1.000000 /end COMPU_METHOD
/* Scalar measurable for DDE 'ETC_b_TP1_LearnFull'. */
/begin MEASUREMENT ETC_b_TP1_LearnFull "Displayable" UBYTE CU_ETC_B_TP1_LEARNFULL 1 100 0.0 1.0 ECU_ADDRESS 0x40002eac BYTE_ORDER MSB_FIRST /end MEASUREMENT
/begin COMPU_METHOD CU_ETC_B_TP1_LEARNFULL "Conversion method for ETC_b_TP1_LearnFull" RAT_FUNC "%10.0" "b" COEFFS 0.000000 1.000000 0.000000 0.000000 0.000000 1.000000 /end COMPU_METHOD
/* Scalar measurable for DDE 'ETC_b_TP1_LearnZero'. */
/begin MEASUREMENT ETC_b_TP1_LearnZero "Displayable" UBYTE CU_ETC_B_TP1_LEARNZERO 1 100 0.0 1.0 ECU_ADDRESS 0x40002eb0 BYTE_ORDER MSB_FIRST /end MEASUREMENT
/begin COMPU_METHOD CU_ETC_B_TP1_LEARNZERO "Conversion method for ETC_b_TP1_LearnZero" RAT_FUNC "%10.0" "b" COEFFS 0.000000 1.000000 0.000000 0.000000 0.000000 1.000000 /end COMPU_METHOD
/* Scalar measurable for DDE 'ETC_b_TP1_ZeroPosOOR'. */
/begin MEASUREMENT ETC_b_TP1_ZeroPosOOR "Displayable" UBYTE CU_ETC_B_TP1_ZEROPOSOOR 1 100 0.0 1.0 ECU_ADDRESS 0x40002eaf BYTE_ORDER MSB_FIRST /end MEASUREMENT
/begin COMPU_METHOD CU_ETC_B_TP1_ZEROPOSOOR "Conversion method for ETC_b_TP1_ZeroPosOOR" RAT_FUNC "%10.0" "b" COEFFS 0.000000 1.000000 0.000000 0.000000 0.000000 1.000000 /end COMPU_METHOD
/* Scalar measurable for DDE 'ETC_b_TP2_FullPosOOR'. */
/begin MEASUREMENT ETC_b_TP2_FullPosOOR "Displayable" UBYTE CU_ETC_B_TP2_FULLPOSOOR 1 100 0.0 1.0 ECU_ADDRESS 0x40002ead BYTE_ORDER MSB_FIRST /end MEASUREMENT
/begin COMPU_METHOD CU_ETC_B_TP2_FULLPOSOOR "Conversion method for ETC_b_TP2_FullPosOOR" RAT_FUNC "%10.0" "b" COEFFS 0.000000 1.000000 0.000000 0.000000 0.000000 1.000000 /end COMPU_METHOD
/* Scalar measurable for DDE 'ETC_b_TP2_LearnFull'. */
/begin MEASUREMENT ETC_b_TP2_LearnFull "Displayable" UBYTE CU_ETC_B_TP2_LEARNFULL 1 100 0.0 1.0 ECU_ADDRESS 0x40002eae BYTE_ORDER MSB_FIRST /end MEASUREMENT
/begin COMPU_METHOD CU_ETC_B_TP2_LEARNFULL "Conversion method for ETC_b_TP2_LearnFull" RAT_FUNC "%10.0" "b" COEFFS 0.000000 1.000000 0.000000 0.000000 0.000000 1.000000 /end COMPU_METHOD
/* Scalar measurable for DDE 'ETC_b_TP2_LearnZero'. */
/begin MEASUREMENT ETC_b_TP2_LearnZero "Displayable" UBYTE CU_ETC_B_TP2_LEARNZERO 1 100 0.0 1.0 ECU_ADDRESS 0x40002eb2 BYTE_ORDER MSB_FIRST /end MEASUREMENT
/begin COMPU_METHOD CU_ETC_B_TP2_LEARNZERO "Conversion method for ETC_b_TP2_LearnZero" RAT_FUNC "%10.0" "b" COEFFS 0.000000 1.000000 0.000000 0.000000 0.000000 1.000000 /end COMPU_METHOD
/* Scalar measurable for DDE 'ETC_b_TP2_ZeroPosOOR'. */
/begin MEASUREMENT ETC_b_TP2_ZeroPosOOR "Displayable" UBYTE CU_ETC_B_TP2_ZEROPOSOOR 1 100 0.0 1.0 ECU_ADDRESS 0x40002eb1 BYTE_ORDER MSB_FIRST /end MEASUREMENT
/begin COMPU_METHOD CU_ETC_B_TP2_ZEROPOSOOR "Conversion method for ETC_b_TP2_ZeroPosOOR" RAT_FUNC "%10.0" "b" COEFFS 0.000000 1.000000 0.000000 0.000000 0.000000 1.000000 /end COMPU_METHOD
/* Scalar measurable for DDE 'ETC_b_TP_CorrFlt'. */
/begin MEASUREMENT ETC_b_TP_CorrFlt "DiagFail flag" UBYTE CU_ETC_B_TP_CORRFLT 1 100 0.0 1.0 ECU_ADDRESS 0x40002ea3 BYTE_ORDER MSB_FIRST /end MEASUREMENT
/begin COMPU_METHOD CU_ETC_B_TP_CORRFLT "Conversion method for ETC_b_TP_CorrFlt" RAT_FUNC "%10.0" "b" COEFFS 0.000000 1.000000 0.000000 0.000000 0.000000 1.000000 /end COMPU_METHOD
/* Scalar measurable for DDE 'ETC_deg_Error'. */
/begin MEASUREMENT ETC_deg_Error "Displayable" FLOAT32_IEEE CU_ETC_DEG_ERROR 1 100 0.0 0.0 ECU_ADDRESS 0x400031a4 BYTE_ORDER MSB_FIRST /end MEASUREMENT
/begin COMPU_METHOD CU_ETC_DEG_ERROR "Conversion method for ETC_deg_Error" RAT_FUNC "%10.1" "deg" COEFFS 0.000000 1.000000 0.000000 0.000000 0.000000 1.000000 /end COMPU_METHOD
/* Scalar measurable for DDE 'ETC_deg_RelativeThRqst'. */
/begin MEASUREMENT ETC_deg_RelativeThRqst "Difference between rqst and rest position (used for FF lookup)" FLOAT32_IEEE CU_ETC_DEG_RELATIVETHRQST 1 100 0.0 0.0 ECU_ADDRESS 0x4000319c BYTE_ORDER MSB_FIRST /end MEASUREMENT
/begin COMPU_METHOD CU_ETC_DEG_RELATIVETHRQST "Conversion method for ETC_deg_RelativeThRqst" RAT_FUNC "%10.1" "deg" COEFFS 0.000000 1.000000 0.000000 0.000000 0.000000 1.000000 /end COMPU_METHOD
/* Scalar measurable for DDE 'ETC_deg_RestPos'. */
/begin MEASUREMENT ETC_deg_RestPos "Displayable" FLOAT32_IEEE CU_ETC_DEG_RESTPOS 1 100 0.0 90.0 ECU_ADDRESS 0x40003344 BYTE_ORDER MSB_FIRST /end MEASUREMENT
/begin COMPU_METHOD CU_ETC_DEG_RESTPOS "Conversion method for ETC_deg_RestPos" RAT_FUNC "%10.2" "deg" COEFFS 0.000000 1.000000 0.000000 0.000000 0.000000 1.000000 /end COMPU_METHOD
/* Scalar measurable for DDE 'ETC_deg_ThRqstFiltd'. */
/begin MEASUREMENT ETC_deg_ThRqstFiltd "Monitoring Corrected Throttle Angle" FLOAT32_IEEE CU_ETC_DEG_THRQSTFILTD 1 100 0.0 0.0 ECU_ADDRESS 0x40003338 BYTE_ORDER MSB_FIRST /end MEASUREMENT
/begin COMPU_METHOD CU_ETC_DEG_THRQSTFILTD "Conversion method for ETC_deg_ThRqstFiltd" RAT_FUNC "%10.3" "deg" COEFFS 0.000000 1.000000 0.000000 0.000000 0.000000 1.000000 /end COMPU_METHOD
/* Scalar measurable for DDE 'ETC_deg_ThRqstHPF'. */
/begin MEASUREMENT ETC_deg_ThRqstHPF "Throttle request HPF result" FLOAT32_IEEE CU_ETC_DEG_THRQSTHPF 1 100 0.0 0.0 ECU_ADDRESS 0x400031a8 BYTE_ORDER MSB_FIRST /end MEASUREMENT
/begin COMPU_METHOD CU_ETC_DEG_THRQSTHPF "Conversion method for ETC_deg_ThRqstHPF" RAT_FUNC "%10.2" "deg" COEFFS 0.000000 1.000000 0.000000 0.000000 0.000000 1.000000 /end COMPU_METHOD
/* Scalar measurable for DDE 'ETC_deg_VlvPos'. */
/begin MEASUREMENT ETC_deg_VlvPos "Arbitrated throttle blade position" FLOAT32_IEEE CU_ETC_DEG_VLVPOS 1 100 0.0 0.0 ECU_ADDRESS 0x40003348 BYTE_ORDER MSB_FIRST /end MEASUREMENT
/begin COMPU_METHOD CU_ETC_DEG_VLVPOS "Conversion method for ETC_deg_VlvPos" RAT_FUNC "%10.1" "deg" COEFFS 0.000000 1.000000 0.000000 0.000000 0.000000 1.000000 /end COMPU_METHOD
/* Scalar measurable for DDE 'ETC_pct_AvgTP'. */
/begin MEASUREMENT ETC_pct_AvgTP "Average throttle position (taken after xfr)" FLOAT32_IEEE CU_ETC_PCT_AVGTP 1 100 0.0 0.0 ECU_ADDRESS 0x40003230 BYTE_ORDER MSB_FIRST /end MEASUREMENT
/begin COMPU_METHOD CU_ETC_PCT_AVGTP "Conversion method for ETC_pct_AvgTP" RAT_FUNC "%10.2" "pct" COEFFS 0.000000 1.000000 0.000000 0.000000 0.000000 1.000000 /end COMPU_METHOD
/* Scalar measurable for DDE 'ETC_pct_Effort'. */
/begin MEASUREMENT ETC_pct_Effort "Displayable" FLOAT32_IEEE CU_ETC_PCT_EFFORT 1 100 0.0 0.0 ECU_ADDRESS 0x4000317c BYTE_ORDER MSB_FIRST /end MEASUREMENT
/begin COMPU_METHOD CU_ETC_PCT_EFFORT "Conversion method for ETC_pct_Effort" RAT_FUNC "%10.2" "pct" COEFFS 0.000000 1.000000 0.000000 0.000000 0.000000 1.000000 /end COMPU_METHOD
/* Scalar measurable for DDE 'ETC_pct_FB'. */
/begin MEASUREMENT ETC_pct_FB "Displayable" FLOAT32_IEEE CU_ETC_PCT_FB 1 100 0.0 0.0 ECU_ADDRESS 0x40003180 BYTE_ORDER MSB_FIRST /end MEASUREMENT
/begin COMPU_METHOD CU_ETC_PCT_FB "Conversion method for ETC_pct_FB" RAT_FUNC "%10.2" "pct" COEFFS 0.000000 1.000000 0.000000 0.000000 0.000000 1.000000 /end COMPU_METHOD
/* Scalar measurable for DDE 'ETC_pct_FF'. */
/begin MEASUREMENT ETC_pct_FF "Feedforward effort" FLOAT32_IEEE CU_ETC_PCT_FF 1 100 0.0 0.0 ECU_ADDRESS 0x40003198 BYTE_ORDER MSB_FIRST /end MEASUREMENT
/begin COMPU_METHOD CU_ETC_PCT_FF "Conversion method for ETC_pct_FF" RAT_FUNC "%10.2" "pct" COEFFS 0.000000 1.000000 0.000000 0.000000 0.000000 1.000000 /end COMPU_METHOD
/* Scalar measurable for DDE 'ETC_pct_Hyst'. */
/begin MEASUREMENT ETC_pct_Hyst "Feedforward effort" FLOAT32_IEEE CU_ETC_PCT_HYST 1 100 0.0 0.0 ECU_ADDRESS 0x400031a0 BYTE_ORDER MSB_FIRST /end MEASUREMENT
/begin COMPU_METHOD CU_ETC_PCT_HYST "Conversion method for ETC_pct_Hyst" RAT_FUNC "%10.3" "pct" COEFFS 0.000000 1.000000 0.000000 0.000000 0.000000 1.000000 /end COMPU_METHOD
/* Scalar measurable for DDE 'ETC_pct_Kick'. */
/begin MEASUREMENT ETC_pct_Kick "Kick term output" FLOAT32_IEEE CU_ETC_PCT_KICK 1 100 0.0 0.0 ECU_ADDRESS 0x40003174 BYTE_ORDER MSB_FIRST /end MEASUREMENT
/begin COMPU_METHOD CU_ETC_PCT_KICK "Conversion method for ETC_pct_Kick" RAT_FUNC "%10.3" "pct" COEFFS 0.000000 1.000000 0.000000 0.000000 0.000000 1.000000 /end COMPU_METHOD
/* Scalar measurable for DDE 'ETC_pct_Kick_error'. */
/begin MEASUREMENT ETC_pct_Kick_error "(not defined)" FLOAT32_IEEE CU_ETC_PCT_KICK_ERROR 1 100 -1000.0 1000.0 ECU_ADDRESS 0x4000316c BYTE_ORDER MSB_FIRST /end MEASUREMENT
/begin COMPU_METHOD CU_ETC_PCT_KICK_ERROR "Conversion method for ETC_pct_Kick_error" RAT_FUNC "%10.2" "pct" COEFFS 0.000000 1.000000 0.000000 0.000000 0.000000 1.000000 /end COMPU_METHOD
/* Scalar measurable for DDE 'ETC_pct_MotorCmd'. */
/begin MEASUREMENT ETC_pct_MotorCmd "Final actuator command" FLOAT32_IEEE CU_ETC_PCT_MOTORCMD 1 100 0.0 0.0 ECU_ADDRESS 0x400031fc BYTE_ORDER MSB_FIRST /end MEASUREMENT
/begin COMPU_METHOD CU_ETC_PCT_MOTORCMD "Conversion method for ETC_pct_MotorCmd" RAT_FUNC "%10.2" "pct" COEFFS 0.000000 1.000000 0.000000 0.000000 0.000000 1.000000 /end COMPU_METHOD
/* Scalar measurable for DDE 'ETC_pct_MotorCmdVb'. */
/begin MEASUREMENT ETC_pct_MotorCmdVb "Final actuator command" FLOAT32_IEEE CU_ETC_PCT_MOTORCMDVB 1 100 0.0 0.0 ECU_ADDRESS 0x40003334 BYTE_ORDER MSB_FIRST /end MEASUREMENT
/begin COMPU_METHOD CU_ETC_PCT_MOTORCMDVB "Conversion method for ETC_pct_MotorCmdVb" RAT_FUNC "%10.2" "pct" COEFFS 0.000000 1.000000 0.000000 0.000000 0.000000 1.000000 /end COMPU_METHOD
/* Scalar measurable for DDE 'ETC_pct_TP1'. */
/begin MEASUREMENT ETC_pct_TP1 "throttle position 1 percent" FLOAT32_IEEE CU_ETC_PCT_TP1 1 100 0.0 0.0 ECU_ADDRESS 0x4000335c BYTE_ORDER MSB_FIRST /end MEASUREMENT
/begin COMPU_METHOD CU_ETC_PCT_TP1 "Conversion method for ETC_pct_TP1" RAT_FUNC "%10.3" "pct" COEFFS 0.000000 1.000000 0.000000 0.000000 0.000000 1.000000 /end COMPU_METHOD
/* Scalar measurable for DDE 'ETC_pct_TP2'. */
/begin MEASUREMENT ETC_pct_TP2 "throttle position 2 percent" FLOAT32_IEEE CU_ETC_PCT_TP2 1 100 0.0 0.0 ECU_ADDRESS 0x40003350 BYTE_ORDER MSB_FIRST /end MEASUREMENT
/begin COMPU_METHOD CU_ETC_PCT_TP2 "Conversion method for ETC_pct_TP2" RAT_FUNC "%10.3" "pct" COEFFS 0.000000 1.000000 0.000000 0.000000 0.000000 1.000000 /end COMPU_METHOD
/* Scalar measurable for DDE 'ETC_pct_TP_Delta'. */
/begin MEASUREMENT ETC_pct_TP_Delta "TP1-TP2 difference" FLOAT32_IEEE CU_ETC_PCT_TP_DELTA 1 100 0.0 0.0 ECU_ADDRESS 0x4000334c BYTE_ORDER MSB_FIRST /end MEASUREMENT
/begin COMPU_METHOD CU_ETC_PCT_TP_DELTA "Conversion method for ETC_pct_TP_Delta" RAT_FUNC "%10.2" "pct" COEFFS 0.000000 1.000000 0.000000 0.000000 0.000000 1.000000 /end COMPU_METHOD
/* Scalar measurable for DDE 'FCA_Km_AcumDistance'. */
/begin MEASUREMENT FCA_Km_AcumDistance "Distance learn default value" FLOAT32_IEEE CU_FCA_KM_ACUMDISTANCE 1 100 0.0 0.0 ECU_ADDRESS 0x400031d8 BYTE_ORDER MSB_FIRST /end MEASUREMENT
/begin COMPU_METHOD CU_FCA_KM_ACUMDISTANCE "Conversion method for FCA_Km_AcumDistance" RAT_FUNC "%10.0" "km" COEFFS 0.000000 1.000000 0.000000 0.000000 0.000000 1.000000 /end COMPU_METHOD
/* Scalar measurable for DDE 'FCA_L_AcumFuelComsuption'. */
/begin MEASUREMENT FCA_L_AcumFuelComsuption "Fuel consumption learn default value" FLOAT32_IEEE CU_FCA_L_ACUMFUELCOMSUPTION 1 100 0.0 0.0 ECU_ADDRESS 0x400031d0 BYTE_ORDER MSB_FIRST /end MEASUREMENT
/begin COMPU_METHOD CU_FCA_L_ACUMFUELCOMSUPTION "Conversion method for FCA_L_AcumFuelComsuption" RAT_FUNC "%10.1" "L" COEFFS 0.000000 1.000000 0.000000 0.000000 0.000000 1.000000 /end COMPU_METHOD
/* Scalar measurable for DDE 'FCA_L_TotalFuelFlow'. */
/begin MEASUREMENT FCA_L_TotalFuelFlow "Fuel consumption" FLOAT32_IEEE CU_FCA_L_TOTALFUELFLOW 1 100 0.0 0.0 ECU_ADDRESS 0x400031d4 BYTE_ORDER MSB_FIRST /end MEASUREMENT
/begin COMPU_METHOD CU_FCA_L_TOTALFUELFLOW "Conversion method for FCA_L_TotalFuelFlow" RAT_FUNC "%10.1" "L" COEFFS 0.000000 1.000000 0.000000 0.000000 0.000000 1.000000 /end COMPU_METHOD
/* Scalar measurable for DDE 'FCA_kps_VhSpd'. */
/begin MEASUREMENT FCA_kps_VhSpd "vehicle speed (kilometers per seconds)" FLOAT32_IEEE CU_FCA_KPS_VHSPD 1 100 0.0 0.0 ECU_ADDRESS 0x400031dc BYTE_ORDER MSB_FIRST /end MEASUREMENT
/begin COMPU_METHOD CU_FCA_KPS_VHSPD "Conversion method for FCA_kps_VhSpd" RAT_FUNC "%10.5" "kps" COEFFS 0.000000 1.000000 0.000000 0.000000 0.000000 1.000000 /end COMPU_METHOD
/* Scalar measurable for DDE 'FCA_lpk_AverageFuelConsumption'. */
/begin MEASUREMENT FCA_lpk_AverageFuelConsumption "Fuel consumption in Liters per 100km" FLOAT32_IEEE CU_FCA_LPK_AVERAGEFUELCONSUMPT0 1 100 0.0 0.0 ECU_ADDRESS 0x400031f8 BYTE_ORDER MSB_FIRST /end MEASUREMENT
/begin COMPU_METHOD CU_FCA_LPK_AVERAGEFUELCONSUMPT0 "Conversion method for FCA_lpk_AverageFuelConsumption" RAT_FUNC "%10.1" "lpk" COEFFS 0.000000 1.000000 0.000000 0.000000 0.000000 1.000000 /end COMPU_METHOD
/* Scalar measurable for DDE 'FLT_NU_APP1'. */
/begin MEASUREMENT FLT_NU_APP1 "Exported Global for sensor fault status" UBYTE CU_FLT_NU_APP1 1 100 0.0 0.0 ECU_ADDRESS 0x40003000 BYTE_ORDER MSB_FIRST /end MEASUREMENT
/begin COMPU_METHOD CU_FLT_NU_APP1 "Conversion method for FLT_NU_APP1" RAT_FUNC "%10.0" "NU" COEFFS 0.000000 1.000000 0.000000 0.000000 0.000000 1.000000 /end COMPU_METHOD
/* Scalar measurable for DDE 'FLT_NU_APP2'. */
/begin MEASUREMENT FLT_NU_APP2 "Exported Global for sensor fault status" UBYTE CU_FLT_NU_APP2 1 100 0.0 0.0 ECU_ADDRESS 0x40002fff BYTE_ORDER MSB_FIRST /end MEASUREMENT
/begin COMPU_METHOD CU_FLT_NU_APP2 "Conversion method for FLT_NU_APP2" RAT_FUNC "%10.0" "NU" COEFFS 0.000000 1.000000 0.000000 0.000000 0.000000 1.000000 /end COMPU_METHOD
/* Scalar measurable for DDE 'FLT_NU_BrkSw'. */
/begin MEASUREMENT FLT_NU_BrkSw "Exported Global for sensor fault status" UBYTE CU_FLT_NU_BRKSW 1 100 0.0 0.0 ECU_ADDRESS 0x40003001 BYTE_ORDER MSB_FIRST /end MEASUREMENT
/begin COMPU_METHOD CU_FLT_NU_BRKSW "Conversion method for FLT_NU_BrkSw" RAT_FUNC "%10.0" "NU" COEFFS 0.000000 1.000000 0.000000 0.000000 0.000000 1.000000 /end COMPU_METHOD
/* Scalar measurable for DDE 'FLT_NU_CAN_CCVS'. */
/begin MEASUREMENT FLT_NU_CAN_CCVS "Exported Global for sensor fault status" UBYTE CU_FLT_NU_CAN_CCVS 1 100 0.0 0.0 ECU_ADDRESS 0x40002ffe BYTE_ORDER MSB_FIRST /end MEASUREMENT
/begin COMPU_METHOD CU_FLT_NU_CAN_CCVS "Conversion method for FLT_NU_CAN_CCVS" RAT_FUNC "%10.0" "NU" COEFFS 0.000000 1.000000 0.000000 0.000000 0.000000 1.000000 /end COMPU_METHOD
/* Scalar measurable for DDE 'FLT_NU_CamPhaser'. */
/begin MEASUREMENT FLT_NU_CamPhaser "Exported Global for sensor fault status" UBYTE CU_FLT_NU_CAMPHASER 1 100 0.0 0.0 ECU_ADDRESS 0x40002ffc BYTE_ORDER MSB_FIRST /end MEASUREMENT
/begin COMPU_METHOD CU_FLT_NU_CAMPHASER "Conversion method for FLT_NU_CamPhaser" RAT_FUNC "%10.0" "NU" COEFFS 0.000000 1.000000 0.000000 0.000000 0.000000 1.000000 /end COMPU_METHOD
/* Scalar measurable for DDE 'FLT_NU_CoolantTemp'. */
/begin MEASUREMENT FLT_NU_CoolantTemp "Exported Global for sensor fault status" UBYTE CU_FLT_NU_COOLANTTEMP 1 100 0.0 0.0 ECU_ADDRESS 0x40003006 BYTE_ORDER MSB_FIRST /end MEASUREMENT
/begin COMPU_METHOD CU_FLT_NU_COOLANTTEMP "Conversion method for FLT_NU_CoolantTemp" RAT_FUNC "%10.0" "NU" COEFFS 0.000000 1.000000 0.000000 0.000000 0.000000 1.000000 /end COMPU_METHOD
/* Scalar measurable for DDE 'FLT_NU_ECU'. */
/begin MEASUREMENT FLT_NU_ECU "Exported Global for sensor fault status" UBYTE CU_FLT_NU_ECU 1 100 0.0 0.0 ECU_ADDRESS 0x40003002 BYTE_ORDER MSB_FIRST /end MEASUREMENT
/begin COMPU_METHOD CU_FLT_NU_ECU "Conversion method for FLT_NU_ECU" RAT_FUNC "%10.0" "NU" COEFFS 0.000000 1.000000 0.000000 0.000000 0.000000 1.000000 /end COMPU_METHOD
/* Scalar measurable for DDE 'FLT_NU_EGO11'. */
/begin MEASUREMENT FLT_NU_EGO11 "Exported Global for sensor fault status" UBYTE CU_FLT_NU_EGO11 1 100 0.0 0.0 ECU_ADDRESS 0x4000300c BYTE_ORDER MSB_FIRST /end MEASUREMENT
/begin COMPU_METHOD CU_FLT_NU_EGO11 "Conversion method for FLT_NU_EGO11" RAT_FUNC "%10.0" "NU" COEFFS 0.000000 1.000000 0.000000 0.000000 0.000000 1.000000 /end COMPU_METHOD
/* Scalar measurable for DDE 'FLT_NU_EGO12'. */
/begin MEASUREMENT FLT_NU_EGO12 "Exported Global for sensor fault status" UBYTE CU_FLT_NU_EGO12 1 100 0.0 0.0 ECU_ADDRESS 0x4000300a BYTE_ORDER MSB_FIRST /end MEASUREMENT
/begin COMPU_METHOD CU_FLT_NU_EGO12 "Conversion method for FLT_NU_EGO12" RAT_FUNC "%10.0" "NU" COEFFS 0.000000 1.000000 0.000000 0.000000 0.000000 1.000000 /end COMPU_METHOD
/* Scalar measurable for DDE 'FLT_NU_EGO21'. */
/begin MEASUREMENT FLT_NU_EGO21 "Exported Global for sensor fault status" UBYTE CU_FLT_NU_EGO21 1 100 0.0 0.0 ECU_ADDRESS 0x4000300b BYTE_ORDER MSB_FIRST /end MEASUREMENT
/begin COMPU_METHOD CU_FLT_NU_EGO21 "Conversion method for FLT_NU_EGO21" RAT_FUNC "%10.0" "NU" COEFFS 0.000000 1.000000 0.000000 0.000000 0.000000 1.000000 /end COMPU_METHOD
/* Scalar measurable for DDE 'FLT_NU_EGO22'. */
/begin MEASUREMENT FLT_NU_EGO22 "Exported Global for sensor fault status" UBYTE CU_FLT_NU_EGO22 1 100 0.0 0.0 ECU_ADDRESS 0x40003009 BYTE_ORDER MSB_FIRST /end MEASUREMENT
/begin COMPU_METHOD CU_FLT_NU_EGO22 "Conversion method for FLT_NU_EGO22" RAT_FUNC "%10.0" "NU" COEFFS 0.000000 1.000000 0.000000 0.000000 0.000000 1.000000 /end COMPU_METHOD
/* Scalar measurable for DDE 'FLT_NU_ETC'. */
/begin MEASUREMENT FLT_NU_ETC "Exported Global for sensor fault status" UBYTE CU_FLT_NU_ETC 1 100 0.0 0.0 ECU_ADDRESS 0x40002ffd BYTE_ORDER MSB_FIRST /end MEASUREMENT
/begin COMPU_METHOD CU_FLT_NU_ETC "Conversion method for FLT_NU_ETC" RAT_FUNC "%10.0" "NU" COEFFS 0.000000 1.000000 0.000000 0.000000 0.000000 1.000000 /end COMPU_METHOD
/* Scalar measurable for DDE 'FLT_NU_FCV'. */
/begin MEASUREMENT FLT_NU_FCV "Exported Global for sensor fault status" UBYTE CU_FLT_NU_FCV 1 100 0.0 0.0 ECU_ADDRESS 0x40002ffb BYTE_ORDER MSB_FIRST /end MEASUREMENT
/begin COMPU_METHOD CU_FLT_NU_FCV "Conversion method for FLT_NU_FCV" RAT_FUNC "%10.0" "NU" COEFFS 0.000000 1.000000 0.000000 0.000000 0.000000 1.000000 /end COMPU_METHOD
/* Scalar measurable for DDE 'FLT_NU_HighLevel1'. */
/begin MEASUREMENT FLT_NU_HighLevel1 "High level Exported Global for sensor fault status" ULONG CU_FLT_NU_HIGHLEVEL1 1 100 0.0 0.0 ECU_ADDRESS 0x40003044 BYTE_ORDER MSB_FIRST /end MEASUREMENT
/begin COMPU_METHOD CU_FLT_NU_HIGHLEVEL1 "Conversion method for FLT_NU_HighLevel1" RAT_FUNC "%10.0" "NU" COEFFS 0.000000 1.000000 0.000000 0.000000 0.000000 1.000000 /end COMPU_METHOD
/* Scalar measurable for DDE 'FLT_NU_HighLevel2'. */
/begin MEASUREMENT FLT_NU_HighLevel2 "High level Exported Global for sensor fault status" ULONG CU_FLT_NU_HIGHLEVEL2 1 100 0.0 0.0 ECU_ADDRESS 0x40003040 BYTE_ORDER MSB_FIRST /end MEASUREMENT
/begin COMPU_METHOD CU_FLT_NU_HIGHLEVEL2 "Conversion method for FLT_NU_HighLevel2" RAT_FUNC "%10.0" "NU" COEFFS 0.000000 1.000000 0.000000 0.000000 0.000000 1.000000 /end COMPU_METHOD
/* Scalar measurable for DDE 'FLT_NU_Inj1'. */
/begin MEASUREMENT FLT_NU_Inj1 "Exported Global for sensor fault status" UBYTE CU_FLT_NU_INJ1 1 100 0.0 0.0 ECU_ADDRESS 0x40002ff8 BYTE_ORDER MSB_FIRST /end MEASUREMENT
/begin COMPU_METHOD CU_FLT_NU_INJ1 "Conversion method for FLT_NU_Inj1" RAT_FUNC "%10.0" "NU" COEFFS 0.000000 1.000000 0.000000 0.000000 0.000000 1.000000 /end COMPU_METHOD
/* Scalar measurable for DDE 'FLT_NU_Inj2'. */
/begin MEASUREMENT FLT_NU_Inj2 "Exported Global for sensor fault status" UBYTE CU_FLT_NU_INJ2 1 100 0.0 0.0 ECU_ADDRESS 0x40002ff7 BYTE_ORDER MSB_FIRST /end MEASUREMENT
/begin COMPU_METHOD CU_FLT_NU_INJ2 "Conversion method for FLT_NU_Inj2" RAT_FUNC "%10.0" "NU" COEFFS 0.000000 1.000000 0.000000 0.000000 0.000000 1.000000 /end COMPU_METHOD
/* Scalar measurable for DDE 'FLT_NU_Inj3'. */
/begin MEASUREMENT FLT_NU_Inj3 "Exported Global for sensor fault status" UBYTE CU_FLT_NU_INJ3 1 100 0.0 0.0 ECU_ADDRESS 0x40002ff6 BYTE_ORDER MSB_FIRST /end MEASUREMENT
/begin COMPU_METHOD CU_FLT_NU_INJ3 "Conversion method for FLT_NU_Inj3" RAT_FUNC "%10.0" "NU" COEFFS 0.000000 1.000000 0.000000 0.000000 0.000000 1.000000 /end COMPU_METHOD
/* Scalar measurable for DDE 'FLT_NU_Inj4'. */
/begin MEASUREMENT FLT_NU_Inj4 "Exported Global for sensor fault status" UBYTE CU_FLT_NU_INJ4 1 100 0.0 0.0 ECU_ADDRESS 0x40002ff5 BYTE_ORDER MSB_FIRST /end MEASUREMENT
/begin COMPU_METHOD CU_FLT_NU_INJ4 "Conversion method for FLT_NU_Inj4" RAT_FUNC "%10.0" "NU" COEFFS 0.000000 1.000000 0.000000 0.000000 0.000000 1.000000 /end COMPU_METHOD
/* Scalar measurable for DDE 'FLT_NU_Inj5'. */
/begin MEASUREMENT FLT_NU_Inj5 "Exported Global for sensor fault status" UBYTE CU_FLT_NU_INJ5 1 100 0.0 0.0 ECU_ADDRESS 0x40002ff4 BYTE_ORDER MSB_FIRST /end MEASUREMENT
/begin COMPU_METHOD CU_FLT_NU_INJ5 "Conversion method for FLT_NU_Inj5" RAT_FUNC "%10.0" "NU" COEFFS 0.000000 1.000000 0.000000 0.000000 0.000000 1.000000 /end COMPU_METHOD
/* Scalar measurable for DDE 'FLT_NU_Inj6'. */
/begin MEASUREMENT FLT_NU_Inj6 "Exported Global for sensor fault status" UBYTE CU_FLT_NU_INJ6 1 100 0.0 0.0 ECU_ADDRESS 0x40002ff3 BYTE_ORDER MSB_FIRST /end MEASUREMENT
/begin COMPU_METHOD CU_FLT_NU_INJ6 "Conversion method for FLT_NU_Inj6" RAT_FUNC "%10.0" "NU" COEFFS 0.000000 1.000000 0.000000 0.000000 0.000000 1.000000 /end COMPU_METHOD
/* Scalar measurable for DDE 'FLT_NU_Inj7'. */
/begin MEASUREMENT FLT_NU_Inj7 "Exported Global for sensor fault status" UBYTE CU_FLT_NU_INJ7 1 100 0.0 0.0 ECU_ADDRESS 0x40002ff2 BYTE_ORDER MSB_FIRST /end MEASUREMENT
/begin COMPU_METHOD CU_FLT_NU_INJ7 "Conversion method for FLT_NU_Inj7" RAT_FUNC "%10.0" "NU" COEFFS 0.000000 1.000000 0.000000 0.000000 0.000000 1.000000 /end COMPU_METHOD
/* Scalar measurable for DDE 'FLT_NU_Inj8'. */
/begin MEASUREMENT FLT_NU_Inj8 "Exported Global for sensor fault status" UBYTE CU_FLT_NU_INJ8 1 100 0.0 0.0 ECU_ADDRESS 0x40002ff1 BYTE_ORDER MSB_FIRST /end MEASUREMENT
/begin COMPU_METHOD CU_FLT_NU_INJ8 "Conversion method for FLT_NU_Inj8" RAT_FUNC "%10.0" "NU" COEFFS 0.000000 1.000000 0.000000 0.000000 0.000000 1.000000 /end COMPU_METHOD
/* Scalar measurable for DDE 'FLT_NU_MAF'. */
/begin MEASUREMENT FLT_NU_MAF "Exported Global for sensor fault status" UBYTE CU_FLT_NU_MAF 1 100 0.0 0.0 ECU_ADDRESS 0x4000300d BYTE_ORDER MSB_FIRST /end MEASUREMENT
/begin COMPU_METHOD CU_FLT_NU_MAF "Conversion method for FLT_NU_MAF" RAT_FUNC "%10.0" "NU" COEFFS 0.000000 1.000000 0.000000 0.000000 0.000000 1.000000 /end COMPU_METHOD
/* Scalar measurable for DDE 'FLT_NU_OilTemp'. */
/begin MEASUREMENT FLT_NU_OilTemp "Exported Global for sensor fault status" UBYTE CU_FLT_NU_OILTEMP 1 100 0.0 0.0 ECU_ADDRESS 0x40003005 BYTE_ORDER MSB_FIRST /end MEASUREMENT
/begin COMPU_METHOD CU_FLT_NU_OILTEMP "Conversion method for FLT_NU_OilTemp" RAT_FUNC "%10.0" "NU" COEFFS 0.000000 1.000000 0.000000 0.000000 0.000000 1.000000 /end COMPU_METHOD
/* Scalar measurable for DDE 'FLT_NU_PSU'. */
/begin MEASUREMENT FLT_NU_PSU "Exported Global for sensor fault status" UBYTE CU_FLT_NU_PSU 1 100 0.0 0.0 ECU_ADDRESS 0x40003003 BYTE_ORDER MSB_FIRST /end MEASUREMENT
/begin COMPU_METHOD CU_FLT_NU_PSU "Conversion method for FLT_NU_PSU" RAT_FUNC "%10.0" "NU" COEFFS 0.000000 1.000000 0.000000 0.000000 0.000000 1.000000 /end COMPU_METHOD
/* Scalar measurable for DDE 'FLT_NU_PurgeVlv'. */
/begin MEASUREMENT FLT_NU_PurgeVlv "Exported Global for sensor fault status" UBYTE CU_FLT_NU_PURGEVLV 1 100 0.0 0.0 ECU_ADDRESS 0x40002ff9 BYTE_ORDER MSB_FIRST /end MEASUREMENT
/begin COMPU_METHOD CU_FLT_NU_PURGEVLV "Conversion method for FLT_NU_PurgeVlv" RAT_FUNC "%10.0" "NU" COEFFS 0.000000 1.000000 0.000000 0.000000 0.000000 1.000000 /end COMPU_METHOD
/* Scalar measurable for DDE 'FLT_NU_Spk1'. */
/begin MEASUREMENT FLT_NU_Spk1 "Exported Global for sensor fault status" UBYTE CU_FLT_NU_SPK1 1 100 0.0 0.0 ECU_ADDRESS 0x40002ff0 BYTE_ORDER MSB_FIRST /end MEASUREMENT
/begin COMPU_METHOD CU_FLT_NU_SPK1 "Conversion method for FLT_NU_Spk1" RAT_FUNC "%10.0" "NU" COEFFS 0.000000 1.000000 0.000000 0.000000 0.000000 1.000000 /end COMPU_METHOD
/* Scalar measurable for DDE 'FLT_NU_Spk2'. */
/begin MEASUREMENT FLT_NU_Spk2 "Exported Global for sensor fault status" UBYTE CU_FLT_NU_SPK2 1 100 0.0 0.0 ECU_ADDRESS 0x40002fef BYTE_ORDER MSB_FIRST /end MEASUREMENT
/begin COMPU_METHOD CU_FLT_NU_SPK2 "Conversion method for FLT_NU_Spk2" RAT_FUNC "%10.0" "NU" COEFFS 0.000000 1.000000 0.000000 0.000000 0.000000 1.000000 /end COMPU_METHOD
/* Scalar measurable for DDE 'FLT_NU_Spk3'. */
/begin MEASUREMENT FLT_NU_Spk3 "Exported Global for sensor fault status" UBYTE CU_FLT_NU_SPK3 1 100 0.0 0.0 ECU_ADDRESS 0x40002fee BYTE_ORDER MSB_FIRST /end MEASUREMENT
/begin COMPU_METHOD CU_FLT_NU_SPK3 "Conversion method for FLT_NU_Spk3" RAT_FUNC "%10.0" "NU" COEFFS 0.000000 1.000000 0.000000 0.000000 0.000000 1.000000 /end COMPU_METHOD
/* Scalar measurable for DDE 'FLT_NU_Spk4'. */
/begin MEASUREMENT FLT_NU_Spk4 "Exported Global for sensor fault status" UBYTE CU_FLT_NU_SPK4 1 100 0.0 0.0 ECU_ADDRESS 0x40002fed BYTE_ORDER MSB_FIRST /end MEASUREMENT
/begin COMPU_METHOD CU_FLT_NU_SPK4 "Conversion method for FLT_NU_Spk4" RAT_FUNC "%10.0" "NU" COEFFS 0.000000 1.000000 0.000000 0.000000 0.000000 1.000000 /end COMPU_METHOD
/* Scalar measurable for DDE 'FLT_NU_Spk5'. */
/begin MEASUREMENT FLT_NU_Spk5 "Exported Global for sensor fault status" UBYTE CU_FLT_NU_SPK5 1 100 0.0 0.0 ECU_ADDRESS 0x40002fec BYTE_ORDER MSB_FIRST /end MEASUREMENT
/begin COMPU_METHOD CU_FLT_NU_SPK5 "Conversion method for FLT_NU_Spk5" RAT_FUNC "%10.0" "NU" COEFFS 0.000000 1.000000 0.000000 0.000000 0.000000 1.000000 /end COMPU_METHOD
/* Scalar measurable for DDE 'FLT_NU_Spk6'. */
/begin MEASUREMENT FLT_NU_Spk6 "Exported Global for sensor fault status" UBYTE CU_FLT_NU_SPK6 1 100 0.0 0.0 ECU_ADDRESS 0x40002feb BYTE_ORDER MSB_FIRST /end MEASUREMENT
/begin COMPU_METHOD CU_FLT_NU_SPK6 "Conversion method for FLT_NU_Spk6" RAT_FUNC "%10.0" "NU" COEFFS 0.000000 1.000000 0.000000 0.000000 0.000000 1.000000 /end COMPU_METHOD
/* Scalar measurable for DDE 'FLT_NU_Spk7'. */
/begin MEASUREMENT FLT_NU_Spk7 "Exported Global for sensor fault status" UBYTE CU_FLT_NU_SPK7 1 100 0.0 0.0 ECU_ADDRESS 0x40002fea BYTE_ORDER MSB_FIRST /end MEASUREMENT
/begin COMPU_METHOD CU_FLT_NU_SPK7 "Conversion method for FLT_NU_Spk7" RAT_FUNC "%10.0" "NU" COEFFS 0.000000 1.000000 0.000000 0.000000 0.000000 1.000000 /end COMPU_METHOD
/* Scalar measurable for DDE 'FLT_NU_Spk8'. */
/begin MEASUREMENT FLT_NU_Spk8 "Exported Global for sensor fault status" UBYTE CU_FLT_NU_SPK8 1 100 0.0 0.0 ECU_ADDRESS 0x40002fe9 BYTE_ORDER MSB_FIRST /end MEASUREMENT
/begin COMPU_METHOD CU_FLT_NU_SPK8 "Conversion method for FLT_NU_Spk8" RAT_FUNC "%10.0" "NU" COEFFS 0.000000 1.000000 0.000000 0.000000 0.000000 1.000000 /end COMPU_METHOD
/* Scalar measurable for DDE 'FLT_NU_TP1'. */
/begin MEASUREMENT FLT_NU_TP1 "Exported Global for sensor fault status" UBYTE CU_FLT_NU_TP1 1 100 0.0 0.0 ECU_ADDRESS 0x40003010 BYTE_ORDER MSB_FIRST /end MEASUREMENT
/begin COMPU_METHOD CU_FLT_NU_TP1 "Conversion method for FLT_NU_TP1" RAT_FUNC "%10.0" "NU" COEFFS 0.000000 1.000000 0.000000 0.000000 0.000000 1.000000 /end COMPU_METHOD
/* Scalar measurable for DDE 'FLT_NU_TP2'. */
/begin MEASUREMENT FLT_NU_TP2 "Exported Global for sensor fault status" UBYTE CU_FLT_NU_TP2 1 100 0.0 0.0 ECU_ADDRESS 0x4000300f BYTE_ORDER MSB_FIRST /end MEASUREMENT
/begin COMPU_METHOD CU_FLT_NU_TP2 "Conversion method for FLT_NU_TP2" RAT_FUNC "%10.0" "NU" COEFFS 0.000000 1.000000 0.000000 0.000000 0.000000 1.000000 /end COMPU_METHOD
/* Scalar measurable for DDE 'FLT_NU_TurCtrl'. */
/begin MEASUREMENT FLT_NU_TurCtrl "Exported Global for sensor fault status" UBYTE CU_FLT_NU_TURCTRL 1 100 0.0 0.0 ECU_ADDRESS 0x40002ffa BYTE_ORDER MSB_FIRST /end MEASUREMENT
/begin COMPU_METHOD CU_FLT_NU_TURCTRL "Conversion method for FLT_NU_TurCtrl" RAT_FUNC "%10.0" "NU" COEFFS 0.000000 1.000000 0.000000 0.000000 0.000000 1.000000 /end COMPU_METHOD
/* Scalar measurable for DDE 'FLT_NU_UEGO1'. */
/begin MEASUREMENT FLT_NU_UEGO1 "Exported Global for sensor fault status" UBYTE CU_FLT_NU_UEGO1 1 100 0.0 0.0 ECU_ADDRESS 0x40003008 BYTE_ORDER MSB_FIRST /end MEASUREMENT
/begin COMPU_METHOD CU_FLT_NU_UEGO1 "Conversion method for FLT_NU_UEGO1" RAT_FUNC "%10.0" "NU" COEFFS 0.000000 1.000000 0.000000 0.000000 0.000000 1.000000 /end COMPU_METHOD
/* Scalar measurable for DDE 'FLT_NU_UEGO2'. */
/begin MEASUREMENT FLT_NU_UEGO2 "Exported Global for sensor fault status" UBYTE CU_FLT_NU_UEGO2 1 100 0.0 0.0 ECU_ADDRESS 0x40003007 BYTE_ORDER MSB_FIRST /end MEASUREMENT
/begin COMPU_METHOD CU_FLT_NU_UEGO2 "Conversion method for FLT_NU_UEGO2" RAT_FUNC "%10.0" "NU" COEFFS 0.000000 1.000000 0.000000 0.000000 0.000000 1.000000 /end COMPU_METHOD
/* Scalar measurable for DDE 'FLT_NU_VCP'. */
/begin MEASUREMENT FLT_NU_VCP "Exported Global for sensor fault status" UBYTE CU_FLT_NU_VCP 1 100 0.0 0.0 ECU_ADDRESS 0x4000300e BYTE_ORDER MSB_FIRST /end MEASUREMENT
/begin COMPU_METHOD CU_FLT_NU_VCP "Conversion method for FLT_NU_VCP" RAT_FUNC "%10.0" "NU" COEFFS 0.000000 1.000000 0.000000 0.000000 0.000000 1.000000 /end COMPU_METHOD
/* Scalar measurable for DDE 'FLT_NU_VRef'. */
/begin MEASUREMENT FLT_NU_VRef "Exported Global for sensor fault status" UBYTE CU_FLT_NU_VREF 1 100 0.0 0.0 ECU_ADDRESS 0x40003004 BYTE_ORDER MSB_FIRST /end MEASUREMENT
/begin COMPU_METHOD CU_FLT_NU_VREF "Conversion method for FLT_NU_VRef" RAT_FUNC "%10.0" "NU" COEFFS 0.000000 1.000000 0.000000 0.000000 0.000000 1.000000 /end COMPU_METHOD
/* Scalar measurable for DDE 'FLT_b_EH_Open_A'. */
/begin MEASUREMENT FLT_b_EH_Open_A "DIN fault flag from OE block for external heater open" UBYTE CU_FLT_B_EH_OPEN_A 1 100 0.0 1.0 ECU_ADDRESS 0x40002e33 BYTE_ORDER MSB_FIRST /end MEASUREMENT
/begin COMPU_METHOD CU_FLT_B_EH_OPEN_A "Conversion method for FLT_b_EH_Open_A" RAT_FUNC "%10.0" "b" COEFFS 0.000000 1.000000 0.000000 0.000000 0.000000 1.000000 /end COMPU_METHOD
/* Scalar measurable for DDE 'FLT_b_EH_Open_B'. */
/begin MEASUREMENT FLT_b_EH_Open_B "DIN fault flag from OE block for external heater open" UBYTE CU_FLT_B_EH_OPEN_B 1 100 0.0 1.0 ECU_ADDRESS 0x40002e3e BYTE_ORDER MSB_FIRST /end MEASUREMENT
/begin COMPU_METHOD CU_FLT_B_EH_OPEN_B "Conversion method for FLT_b_EH_Open_B" RAT_FUNC "%10.0" "b" COEFFS 0.000000 1.000000 0.000000 0.000000 0.000000 1.000000 /end COMPU_METHOD
/* Scalar measurable for DDE 'FLT_b_EH_ShrtGrnd_A'. */
/begin MEASUREMENT FLT_b_EH_ShrtGrnd_A "DIN fault flag from OE block for external heater short to ground" UBYTE CU_FLT_B_EH_SHRTGRND_A 1 100 0.0 1.0 ECU_ADDRESS 0x40002e36 BYTE_ORDER MSB_FIRST /end MEASUREMENT
/begin COMPU_METHOD CU_FLT_B_EH_SHRTGRND_A "Conversion method for FLT_b_EH_ShrtGrnd_A" RAT_FUNC "%10.0" "b" COEFFS 0.000000 1.000000 0.000000 0.000000 0.000000 1.000000 /end COMPU_METHOD
/* Scalar measurable for DDE 'FLT_b_EH_ShrtGrnd_B'. */
/begin MEASUREMENT FLT_b_EH_ShrtGrnd_B "DIN fault flag from OE block for external heater short to ground" UBYTE CU_FLT_B_EH_SHRTGRND_B 1 100 0.0 1.0 ECU_ADDRESS 0x40002e41 BYTE_ORDER MSB_FIRST /end MEASUREMENT
/begin COMPU_METHOD CU_FLT_B_EH_SHRTGRND_B "Conversion method for FLT_b_EH_ShrtGrnd_B" RAT_FUNC "%10.0" "b" COEFFS 0.000000 1.000000 0.000000 0.000000 0.000000 1.000000 /end COMPU_METHOD
/* Scalar measurable for DDE 'FLT_b_EH_ShrtVBatt_A'. */
/begin MEASUREMENT FLT_b_EH_ShrtVBatt_A "DIN fault flag from OE block for external heater short to Vbatt" UBYTE CU_FLT_B_EH_SHRTVBATT_A 1 100 0.0 1.0 ECU_ADDRESS 0x40002e35 BYTE_ORDER MSB_FIRST /end MEASUREMENT
/begin COMPU_METHOD CU_FLT_B_EH_SHRTVBATT_A "Conversion method for FLT_b_EH_ShrtVBatt_A" RAT_FUNC "%10.0" "b" COEFFS 0.000000 1.000000 0.000000 0.000000 0.000000 1.000000 /end COMPU_METHOD
/* Scalar measurable for DDE 'FLT_b_EH_ShrtVBatt_B'. */
/begin MEASUREMENT FLT_b_EH_ShrtVBatt_B "DIN fault flag from OE block for external heater short to Vbatt" UBYTE CU_FLT_B_EH_SHRTVBATT_B 1 100 0.0 1.0 ECU_ADDRESS 0x40002e40 BYTE_ORDER MSB_FIRST /end MEASUREMENT
/begin COMPU_METHOD CU_FLT_B_EH_SHRTVBATT_B "Conversion method for FLT_b_EH_ShrtVBatt_B" RAT_FUNC "%10.0" "b" COEFFS 0.000000 1.000000 0.000000 0.000000 0.000000 1.000000 /end COMPU_METHOD
/* Scalar measurable for DDE 'FLT_b_HtrPWM_NoResponse_A'. */
/begin MEASUREMENT FLT_b_HtrPWM_NoResponse_A "Fault flag to indicate heater PWM was on too long without response from UR" UBYTE CU_FLT_B_HTRPWM_NORESPONSE_A 1 100 0.0 1.0 ECU_ADDRESS 0x40002e4d BYTE_ORDER MSB_FIRST /end MEASUREMENT
/begin COMPU_METHOD CU_FLT_B_HTRPWM_NORESPONSE_A "Conversion method for FLT_b_HtrPWM_NoResponse_A" RAT_FUNC "%10.0" "b" COEFFS 0.000000 1.000000 0.000000 0.000000 0.000000 1.000000 /end COMPU_METHOD
/* Scalar measurable for DDE 'FLT_b_HtrPWM_NoResponse_B'. */
/begin MEASUREMENT FLT_b_HtrPWM_NoResponse_B "Fault flag to indicate heater PWM was on too long without response from UR" UBYTE CU_FLT_B_HTRPWM_NORESPONSE_B 1 100 0.0 1.0 ECU_ADDRESS 0x40002e5e BYTE_ORDER MSB_FIRST /end MEASUREMENT
/begin COMPU_METHOD CU_FLT_B_HTRPWM_NORESPONSE_B "Conversion method for FLT_b_HtrPWM_NoResponse_B" RAT_FUNC "%10.0" "b" COEFFS 0.000000 1.000000 0.000000 0.000000 0.000000 1.000000 /end COMPU_METHOD
/* Scalar measurable for DDE 'FLT_b_IaIp_ShrtGrnd_A'. */
/begin MEASUREMENT FLT_b_IaIp_ShrtGrnd_A "DIN fault flag from OE block for setup current/pump current short to ground" UBYTE CU_FLT_B_IAIP_SHRTGRND_A 1 100 0.0 1.0 ECU_ADDRESS 0x40002e32 BYTE_ORDER MSB_FIRST /end MEASUREMENT
/begin COMPU_METHOD CU_FLT_B_IAIP_SHRTGRND_A "Conversion method for FLT_b_IaIp_ShrtGrnd_A" RAT_FUNC "%10.0" "b" COEFFS 0.000000 1.000000 0.000000 0.000000 0.000000 1.000000 /end COMPU_METHOD
/* Scalar measurable for DDE 'FLT_b_IaIp_ShrtGrnd_B'. */
/begin MEASUREMENT FLT_b_IaIp_ShrtGrnd_B "DIN fault flag from OE block for setup current/pump current short to ground" UBYTE CU_FLT_B_IAIP_SHRTGRND_B 1 100 0.0 1.0 ECU_ADDRESS 0x40002e3d BYTE_ORDER MSB_FIRST /end MEASUREMENT
/begin COMPU_METHOD CU_FLT_B_IAIP_SHRTGRND_B "Conversion method for FLT_b_IaIp_ShrtGrnd_B" RAT_FUNC "%10.0" "b" COEFFS 0.000000 1.000000 0.000000 0.000000 0.000000 1.000000 /end COMPU_METHOD
/* Scalar measurable for DDE 'FLT_b_IaIp_ShrtVBatt_A'. */
/begin MEASUREMENT FLT_b_IaIp_ShrtVBatt_A "DIN fault flag from OE block for setup current/pump current short to Vbatt" UBYTE CU_FLT_B_IAIP_SHRTVBATT_A 1 100 0.0 1.0 ECU_ADDRESS 0x40002e31 BYTE_ORDER MSB_FIRST /end MEASUREMENT
/begin COMPU_METHOD CU_FLT_B_IAIP_SHRTVBATT_A "Conversion method for FLT_b_IaIp_ShrtVBatt_A" RAT_FUNC "%10.0" "b" COEFFS 0.000000 1.000000 0.000000 0.000000 0.000000 1.000000 /end COMPU_METHOD
/* Scalar measurable for DDE 'FLT_b_IaIp_ShrtVBatt_B'. */
/begin MEASUREMENT FLT_b_IaIp_ShrtVBatt_B "DIN fault flag from OE block for setup current/pump current short to Vbatt" UBYTE CU_FLT_B_IAIP_SHRTVBATT_B 1 100 0.0 1.0 ECU_ADDRESS 0x40002e3c BYTE_ORDER MSB_FIRST /end MEASUREMENT
/begin COMPU_METHOD CU_FLT_B_IAIP_SHRTVBATT_B "Conversion method for FLT_b_IaIp_ShrtVBatt_B" RAT_FUNC "%10.0" "b" COEFFS 0.000000 1.000000 0.000000 0.000000 0.000000 1.000000 /end COMPU_METHOD
/* Scalar measurable for DDE 'FLT_b_SpiCtrl_A'. */
/begin MEASUREMENT FLT_b_SpiCtrl_A "Fault flag from Spi counter indication" UBYTE CU_FLT_B_SPICTRL_A 1 100 0.0 1.0 ECU_ADDRESS 0x40002e52 BYTE_ORDER MSB_FIRST /end MEASUREMENT
/begin COMPU_METHOD CU_FLT_B_SPICTRL_A "Conversion method for FLT_b_SpiCtrl_A" RAT_FUNC "%10.0" "b" COEFFS 0.000000 1.000000 0.000000 0.000000 0.000000 1.000000 /end COMPU_METHOD
/* Scalar measurable for DDE 'FLT_b_SpiCtrl_B'. */
/begin MEASUREMENT FLT_b_SpiCtrl_B "Fault flag from leaky bucket counter for Spi control diagnostic" UBYTE CU_FLT_B_SPICTRL_B 1 100 0.0 1.0 ECU_ADDRESS 0x40002e63 BYTE_ORDER MSB_FIRST /end MEASUREMENT
/begin COMPU_METHOD CU_FLT_B_SPICTRL_B "Conversion method for FLT_b_SpiCtrl_B" RAT_FUNC "%10.0" "b" COEFFS 0.000000 1.000000 0.000000 0.000000 0.000000 1.000000 /end COMPU_METHOD
/* Scalar measurable for DDE 'FLT_b_UA_OORHi_A'. */
/begin MEASUREMENT FLT_b_UA_OORHi_A "Fault flag for OOR" UBYTE CU_FLT_B_UA_OORHI_A 1 100 0.0 1.0 ECU_ADDRESS 0x40002e51 BYTE_ORDER MSB_FIRST /end MEASUREMENT
/begin COMPU_METHOD CU_FLT_B_UA_OORHI_A "Conversion method for FLT_b_UA_OORHi_A" RAT_FUNC "%10.0" "b" COEFFS 0.000000 1.000000 0.000000 0.000000 0.000000 1.000000 /end COMPU_METHOD
/* Scalar measurable for DDE 'FLT_b_UA_OORHi_B'. */
/begin MEASUREMENT FLT_b_UA_OORHi_B "Fault flag for OOR" UBYTE CU_FLT_B_UA_OORHI_B 1 100 0.0 1.0 ECU_ADDRESS 0x40002e62 BYTE_ORDER MSB_FIRST /end MEASUREMENT
/begin COMPU_METHOD CU_FLT_B_UA_OORHI_B "Conversion method for FLT_b_UA_OORHi_B" RAT_FUNC "%10.0" "b" COEFFS 0.000000 1.000000 0.000000 0.000000 0.000000 1.000000 /end COMPU_METHOD
/* Scalar measurable for DDE 'FLT_b_UA_OORLo_A'. */
/begin MEASUREMENT FLT_b_UA_OORLo_A "Fault flag for OOR" UBYTE CU_FLT_B_UA_OORLO_A 1 100 0.0 1.0 ECU_ADDRESS 0x40002e4f BYTE_ORDER MSB_FIRST /end MEASUREMENT
/begin COMPU_METHOD CU_FLT_B_UA_OORLO_A "Conversion method for FLT_b_UA_OORLo_A" RAT_FUNC "%10.0" "b" COEFFS 0.000000 1.000000 0.000000 0.000000 0.000000 1.000000 /end COMPU_METHOD
/* Scalar measurable for DDE 'FLT_b_UA_OORLo_B'. */
/begin MEASUREMENT FLT_b_UA_OORLo_B "Fault flag for OOR" UBYTE CU_FLT_B_UA_OORLO_B 1 100 0.0 1.0 ECU_ADDRESS 0x40002e60 BYTE_ORDER MSB_FIRST /end MEASUREMENT
/begin COMPU_METHOD CU_FLT_B_UA_OORLO_B "Conversion method for FLT_b_UA_OORLo_B" RAT_FUNC "%10.0" "b" COEFFS 0.000000 1.000000 0.000000 0.000000 0.000000 1.000000 /end COMPU_METHOD
/* Scalar measurable for DDE 'FLT_b_UR_OORHi_A'. */
/begin MEASUREMENT FLT_b_UR_OORHi_A "Fault flag for OOR" UBYTE CU_FLT_B_UR_OORHI_A 1 100 0.0 1.0 ECU_ADDRESS 0x40002e50 BYTE_ORDER MSB_FIRST /end MEASUREMENT
/begin COMPU_METHOD CU_FLT_B_UR_OORHI_A "Conversion method for FLT_b_UR_OORHi_A" RAT_FUNC "%10.0" "b" COEFFS 0.000000 1.000000 0.000000 0.000000 0.000000 1.000000 /end COMPU_METHOD
/* Scalar measurable for DDE 'FLT_b_UR_OORHi_B'. */
/begin MEASUREMENT FLT_b_UR_OORHi_B "Fault flag for OOR" UBYTE CU_FLT_B_UR_OORHI_B 1 100 0.0 1.0 ECU_ADDRESS 0x40002e61 BYTE_ORDER MSB_FIRST /end MEASUREMENT
/begin COMPU_METHOD CU_FLT_B_UR_OORHI_B "Conversion method for FLT_b_UR_OORHi_B" RAT_FUNC "%10.0" "b" COEFFS 0.000000 1.000000 0.000000 0.000000 0.000000 1.000000 /end COMPU_METHOD
/* Scalar measurable for DDE 'FLT_b_UR_OORLo_A'. */
/begin MEASUREMENT FLT_b_UR_OORLo_A "Fault flag for OOR" UBYTE CU_FLT_B_UR_OORLO_A 1 100 0.0 1.0 ECU_ADDRESS 0x40002e4e BYTE_ORDER MSB_FIRST /end MEASUREMENT
/begin COMPU_METHOD CU_FLT_B_UR_OORLO_A "Conversion method for FLT_b_UR_OORLo_A" RAT_FUNC "%10.0" "b" COEFFS 0.000000 1.000000 0.000000 0.000000 0.000000 1.000000 /end COMPU_METHOD
/* Scalar measurable for DDE 'FLT_b_UR_OORLo_B'. */
/begin MEASUREMENT FLT_b_UR_OORLo_B "Fault flag for OOR" UBYTE CU_FLT_B_UR_OORLO_B 1 100 0.0 1.0 ECU_ADDRESS 0x40002e5f BYTE_ORDER MSB_FIRST /end MEASUREMENT
/begin COMPU_METHOD CU_FLT_B_UR_OORLO_B "Conversion method for FLT_b_UR_OORLo_B" RAT_FUNC "%10.0" "b" COEFFS 0.000000 1.000000 0.000000 0.000000 0.000000 1.000000 /end COMPU_METHOD
/* Scalar measurable for DDE 'FLT_b_Un_Open_A'. */
/begin MEASUREMENT FLT_b_Un_Open_A "DIN fault flag from OE block for Nernst cell open" UBYTE CU_FLT_B_UN_OPEN_A 1 100 0.0 1.0 ECU_ADDRESS 0x40002e2d BYTE_ORDER MSB_FIRST /end MEASUREMENT
/begin COMPU_METHOD CU_FLT_B_UN_OPEN_A "Conversion method for FLT_b_Un_Open_A" RAT_FUNC "%10.0" "b" COEFFS 0.000000 1.000000 0.000000 0.000000 0.000000 1.000000 /end COMPU_METHOD
/* Scalar measurable for DDE 'FLT_b_Un_Open_B'. */
/begin MEASUREMENT FLT_b_Un_Open_B "DIN fault flag from OE block for Nernst cell open" UBYTE CU_FLT_B_UN_OPEN_B 1 100 0.0 1.0 ECU_ADDRESS 0x40002e38 BYTE_ORDER MSB_FIRST /end MEASUREMENT
/begin COMPU_METHOD CU_FLT_B_UN_OPEN_B "Conversion method for FLT_b_Un_Open_B" RAT_FUNC "%10.0" "b" COEFFS 0.000000 1.000000 0.000000 0.000000 0.000000 1.000000 /end COMPU_METHOD
/* Scalar measurable for DDE 'FLT_b_Un_ShrtGrnd_A'. */
/begin MEASUREMENT FLT_b_Un_ShrtGrnd_A "DIN fault flag from OE block for Nernst cell short to ground" UBYTE CU_FLT_B_UN_SHRTGRND_A 1 100 0.0 1.0 ECU_ADDRESS 0x40002e30 BYTE_ORDER MSB_FIRST /end MEASUREMENT
/begin COMPU_METHOD CU_FLT_B_UN_SHRTGRND_A "Conversion method for FLT_b_Un_ShrtGrnd_A" RAT_FUNC "%10.0" "b" COEFFS 0.000000 1.000000 0.000000 0.000000 0.000000 1.000000 /end COMPU_METHOD
/* Scalar measurable for DDE 'FLT_b_Un_ShrtGrnd_B'. */
/begin MEASUREMENT FLT_b_Un_ShrtGrnd_B "DIN fault flag from OE block for Nernst cell short to ground" UBYTE CU_FLT_B_UN_SHRTGRND_B 1 100 0.0 1.0 ECU_ADDRESS 0x40002e3b BYTE_ORDER MSB_FIRST /end MEASUREMENT
/begin COMPU_METHOD CU_FLT_B_UN_SHRTGRND_B "Conversion method for FLT_b_Un_ShrtGrnd_B" RAT_FUNC "%10.0" "b" COEFFS 0.000000 1.000000 0.000000 0.000000 0.000000 1.000000 /end COMPU_METHOD
/* Scalar measurable for DDE 'FLT_b_Un_ShrtVBatt_A'. */
/begin MEASUREMENT FLT_b_Un_ShrtVBatt_A "DIN fault flag from OE block for Nernst cell short to Vbatt" UBYTE CU_FLT_B_UN_SHRTVBATT_A 1 100 0.0 1.0 ECU_ADDRESS 0x40002e2f BYTE_ORDER MSB_FIRST /end MEASUREMENT
/begin COMPU_METHOD CU_FLT_B_UN_SHRTVBATT_A "Conversion method for FLT_b_Un_ShrtVBatt_A" RAT_FUNC "%10.0" "b" COEFFS 0.000000 1.000000 0.000000 0.000000 0.000000 1.000000 /end COMPU_METHOD
/* Scalar measurable for DDE 'FLT_b_Un_ShrtVBatt_B'. */
/begin MEASUREMENT FLT_b_Un_ShrtVBatt_B "DIN fault flag from OE block for Nernst cell short to Vbatt" UBYTE CU_FLT_B_UN_SHRTVBATT_B 1 100 0.0 1.0 ECU_ADDRESS 0x40002e3a BYTE_ORDER MSB_FIRST /end MEASUREMENT
/begin COMPU_METHOD CU_FLT_B_UN_SHRTVBATT_B "Conversion method for FLT_b_Un_ShrtVBatt_B" RAT_FUNC "%10.0" "b" COEFFS 0.000000 1.000000 0.000000 0.000000 0.000000 1.000000 /end COMPU_METHOD
/* Scalar measurable for DDE 'FLT_b_Vm_Open_B'. */
/begin MEASUREMENT FLT_b_Vm_Open_B "DIN fault flag from OE block for virtual ground open" UBYTE CU_FLT_B_VM_OPEN_B 1 100 0.0 1.0 ECU_ADDRESS 0x40002e37 BYTE_ORDER MSB_FIRST /end MEASUREMENT
/begin COMPU_METHOD CU_FLT_B_VM_OPEN_B "Conversion method for FLT_b_Vm_Open_B" RAT_FUNC "%10.0" "b" COEFFS 0.000000 1.000000 0.000000 0.000000 0.000000 1.000000 /end COMPU_METHOD
/* Scalar measurable for DDE 'FLT_b_Vm_ShrtGrnd_A'. */
/begin MEASUREMENT FLT_b_Vm_ShrtGrnd_A "DIN fault flag from OE block for virtual ground short to ground" UBYTE CU_FLT_B_VM_SHRTGRND_A 1 100 0.0 1.0 ECU_ADDRESS 0x40002e2e BYTE_ORDER MSB_FIRST /end MEASUREMENT
/begin COMPU_METHOD CU_FLT_B_VM_SHRTGRND_A "Conversion method for FLT_b_Vm_ShrtGrnd_A" RAT_FUNC "%10.0" "b" COEFFS 0.000000 1.000000 0.000000 0.000000 0.000000 1.000000 /end COMPU_METHOD
/* Scalar measurable for DDE 'FLT_b_Vm_ShrtGrnd_B'. */
/begin MEASUREMENT FLT_b_Vm_ShrtGrnd_B "DIN fault flag from OE block for virtual ground short to ground" UBYTE CU_FLT_B_VM_SHRTGRND_B 1 100 0.0 1.0 ECU_ADDRESS 0x40002e39 BYTE_ORDER MSB_FIRST /end MEASUREMENT
/begin COMPU_METHOD CU_FLT_B_VM_SHRTGRND_B "Conversion method for FLT_b_Vm_ShrtGrnd_B" RAT_FUNC "%10.0" "b" COEFFS 0.000000 1.000000 0.000000 0.000000 0.000000 1.000000 /end COMPU_METHOD
/* Scalar measurable for DDE 'FLT_b_Vm_ShrtVBatt_A'. */
/begin MEASUREMENT FLT_b_Vm_ShrtVBatt_A "DIN fault flag from OE block for virtual ground short to Vbatt" UBYTE CU_FLT_B_VM_SHRTVBATT_A 1 100 0.0 1.0 ECU_ADDRESS 0x40002e34 BYTE_ORDER MSB_FIRST /end MEASUREMENT
/begin COMPU_METHOD CU_FLT_B_VM_SHRTVBATT_A "Conversion method for FLT_b_Vm_ShrtVBatt_A" RAT_FUNC "%10.0" "b" COEFFS 0.000000 1.000000 0.000000 0.000000 0.000000 1.000000 /end COMPU_METHOD
/* Scalar measurable for DDE 'FLT_b_Vm_ShrtVBatt_B'. */
/begin MEASUREMENT FLT_b_Vm_ShrtVBatt_B "DIN fault flag from OE block for virtual ground short to Vbatt" UBYTE CU_FLT_B_VM_SHRTVBATT_B 1 100 0.0 1.0 ECU_ADDRESS 0x40002e3f BYTE_ORDER MSB_FIRST /end MEASUREMENT
/begin COMPU_METHOD CU_FLT_B_VM_SHRTVBATT_B "Conversion method for FLT_b_Vm_ShrtVBatt_B" RAT_FUNC "%10.0" "b" COEFFS 0.000000 1.000000 0.000000 0.000000 0.000000 1.000000 /end COMPU_METHOD
/* Scalar measurable for DDE 'FMG_e_FltReset'. */
/begin MEASUREMENT FMG_e_FltReset "Displayable- global fault management control signal, sent to each FBM" UBYTE CU_FMG_E_FLTRESET 1 100 0.0 0.0 ECU_ADDRESS 0x40003013 BYTE_ORDER MSB_FIRST /end MEASUREMENT
/begin COMPU_METHOD CU_FMG_E_FLTRESET "Conversion method for FMG_e_FltReset" RAT_FUNC "%10.0" "e" COEFFS 0.000000 1.000000 0.000000 0.000000 0.000000 1.000000 /end COMPU_METHOD
/* Scalar measurable for DDE 'HHT_pct_EGO11_HeaterDuty'. */
/begin MEASUREMENT HHT_pct_EGO11_HeaterDuty "Displayable" FLOAT32_IEEE CU_HHT_PCT_EGO11_HEATERDUTY 1 100 0.0 0.0 ECU_ADDRESS 0x400036c4 BYTE_ORDER MSB_FIRST /end MEASUREMENT
/begin COMPU_METHOD CU_HHT_PCT_EGO11_HEATERDUTY "Conversion method for HHT_pct_EGO11_HeaterDuty" RAT_FUNC "%10.2" "pct" COEFFS 0.000000 1.000000 0.000000 0.000000 0.000000 1.000000 /end COMPU_METHOD
/* Scalar measurable for DDE 'HHT_pct_EGO12_HeaterDuty'. */
/begin MEASUREMENT HHT_pct_EGO12_HeaterDuty "Displayable" FLOAT32_IEEE CU_HHT_PCT_EGO12_HEATERDUTY 1 100 0.0 0.0 ECU_ADDRESS 0x400036bc BYTE_ORDER MSB_FIRST /end MEASUREMENT
/begin COMPU_METHOD CU_HHT_PCT_EGO12_HEATERDUTY "Conversion method for HHT_pct_EGO12_HeaterDuty" RAT_FUNC "%10.2" "pct" COEFFS 0.000000 1.000000 0.000000 0.000000 0.000000 1.000000 /end COMPU_METHOD
/* Scalar measurable for DDE 'HHT_pct_EGO21_HeaterDuty'. */
/begin MEASUREMENT HHT_pct_EGO21_HeaterDuty "Displayable" FLOAT32_IEEE CU_HHT_PCT_EGO21_HEATERDUTY 1 100 0.0 0.0 ECU_ADDRESS 0x400036c0 BYTE_ORDER MSB_FIRST /end MEASUREMENT
/begin COMPU_METHOD CU_HHT_PCT_EGO21_HEATERDUTY "Conversion method for HHT_pct_EGO21_HeaterDuty" RAT_FUNC "%10.2" "pct" COEFFS 0.000000 1.000000 0.000000 0.000000 0.000000 1.000000 /end COMPU_METHOD
/* Scalar measurable for DDE 'HHT_pct_EGO22_HeaterDuty'. */
/begin MEASUREMENT HHT_pct_EGO22_HeaterDuty "Displayable" FLOAT32_IEEE CU_HHT_PCT_EGO22_HEATERDUTY 1 100 0.0 0.0 ECU_ADDRESS 0x400036b8 BYTE_ORDER MSB_FIRST /end MEASUREMENT
/begin COMPU_METHOD CU_HHT_PCT_EGO22_HEATERDUTY "Conversion method for HHT_pct_EGO22_HeaterDuty" RAT_FUNC "%10.2" "pct" COEFFS 0.000000 1.000000 0.000000 0.000000 0.000000 1.000000 /end COMPU_METHOD
/* Scalar measurable for DDE 'HTR_C_SensorTemperature_A'. */
/begin MEASUREMENT HTR_C_SensorTemperature_A "Sensor temperature in deg Celsius" FLOAT32_IEEE CU_HTR_C_SENSORTEMPERATURE_A 1 100 0.0 0.0 ECU_ADDRESS 0x400030f0 BYTE_ORDER MSB_FIRST /end MEASUREMENT
/begin COMPU_METHOD CU_HTR_C_SENSORTEMPERATURE_A "Conversion method for HTR_C_SensorTemperature_A" RAT_FUNC "%10.3" "C" COEFFS 0.000000 1.000000 0.000000 0.000000 0.000000 1.000000 /end COMPU_METHOD
/* Scalar measurable for DDE 'HTR_C_SensorTemperature_B'. */
/begin MEASUREMENT HTR_C_SensorTemperature_B "Sensor temperature in deg Celsius" FLOAT32_IEEE CU_HTR_C_SENSORTEMPERATURE_B 1 100 0.0 0.0 ECU_ADDRESS 0x40003120 BYTE_ORDER MSB_FIRST /end MEASUREMENT
/begin COMPU_METHOD CU_HTR_C_SENSORTEMPERATURE_B "Conversion method for HTR_C_SensorTemperature_B" RAT_FUNC "%10.3" "C" COEFFS 0.000000 1.000000 0.000000 0.000000 0.000000 1.000000 /end COMPU_METHOD
/* Scalar measurable for DDE 'HTR_NU_SysVoltCompCL'. */
/begin MEASUREMENT HTR_NU_SysVoltCompCL "System voltage compensation gain to the Closed Loop PWM command" FLOAT32_IEEE CU_HTR_NU_SYSVOLTCOMPCL 1 100 0.0 0.0 ECU_ADDRESS 0x400030e0 BYTE_ORDER MSB_FIRST /end MEASUREMENT
/begin COMPU_METHOD CU_HTR_NU_SYSVOLTCOMPCL "Conversion method for HTR_NU_SysVoltCompCL" RAT_FUNC "%10.3" "NU" COEFFS 0.000000 1.000000 0.000000 0.000000 0.000000 1.000000 /end COMPU_METHOD
/* Scalar measurable for DDE 'HTR_NU_SysVoltCompCL_B'. */
/begin MEASUREMENT HTR_NU_SysVoltCompCL_B "System voltage compensation gain to the Closed Loop PWM command" FLOAT32_IEEE CU_HTR_NU_SYSVOLTCOMPCL_B 1 100 0.0 0.0 ECU_ADDRESS 0x40003110 BYTE_ORDER MSB_FIRST /end MEASUREMENT
/begin COMPU_METHOD CU_HTR_NU_SYSVOLTCOMPCL_B "Conversion method for HTR_NU_SysVoltCompCL_B" RAT_FUNC "%10.3" "NU" COEFFS 0.000000 1.000000 0.000000 0.000000 0.000000 1.000000 /end COMPU_METHOD
/* Scalar measurable for DDE 'HTR_NU_SysVoltCompOL'. */
/begin MEASUREMENT HTR_NU_SysVoltCompOL "System voltage compensation gain to the Open Loop PWM command" FLOAT32_IEEE CU_HTR_NU_SYSVOLTCOMPOL 1 100 0.0 0.0 ECU_ADDRESS 0x400030e8 BYTE_ORDER MSB_FIRST /end MEASUREMENT
/begin COMPU_METHOD CU_HTR_NU_SYSVOLTCOMPOL "Conversion method for HTR_NU_SysVoltCompOL" RAT_FUNC "%10.3" "NU" COEFFS 0.000000 1.000000 0.000000 0.000000 0.000000 1.000000 /end COMPU_METHOD
/* Scalar measurable for DDE 'HTR_NU_SysVoltCompOL_B'. */
/begin MEASUREMENT HTR_NU_SysVoltCompOL_B "System voltage compensation gain to the Open Loop PWM command" FLOAT32_IEEE CU_HTR_NU_SYSVOLTCOMPOL_B 1 100 0.0 0.0 ECU_ADDRESS 0x40003118 BYTE_ORDER MSB_FIRST /end MEASUREMENT
/begin COMPU_METHOD CU_HTR_NU_SYSVOLTCOMPOL_B "Conversion method for HTR_NU_SysVoltCompOL_B" RAT_FUNC "%10.3" "NU" COEFFS 0.000000 1.000000 0.000000 0.000000 0.000000 1.000000 /end COMPU_METHOD
/* Scalar measurable for DDE 'HTR_b_ClosedLoopActv_A'. */
/begin MEASUREMENT HTR_b_ClosedLoopActv_A "Closed Loop heater control active flag" UBYTE CU_HTR_B_CLOSEDLOOPACTV_A 1 100 0.0 1.0 ECU_ADDRESS 0x40002e43 BYTE_ORDER MSB_FIRST /end MEASUREMENT
/begin COMPU_METHOD CU_HTR_B_CLOSEDLOOPACTV_A "Conversion method for HTR_b_ClosedLoopActv_A" RAT_FUNC "%10.0" "b" COEFFS 0.000000 1.000000 0.000000 0.000000 0.000000 1.000000 /end COMPU_METHOD
/* Scalar measurable for DDE 'HTR_b_ClosedLoopActv_B'. */
/begin MEASUREMENT HTR_b_ClosedLoopActv_B "Closed Loop heater control active flag" UBYTE CU_HTR_B_CLOSEDLOOPACTV_B 1 100 0.0 1.0 ECU_ADDRESS 0x40002e54 BYTE_ORDER MSB_FIRST /end MEASUREMENT
/begin COMPU_METHOD CU_HTR_B_CLOSEDLOOPACTV_B "Conversion method for HTR_b_ClosedLoopActv_B" RAT_FUNC "%10.0" "b" COEFFS 0.000000 1.000000 0.000000 0.000000 0.000000 1.000000 /end COMPU_METHOD
/* Scalar measurable for DDE 'HTR_b_FaultBasedHeaterLimit_A'. */
/begin MEASUREMENT HTR_b_FaultBasedHeaterLimit_A "Flag to indicate heater is disabled due to a cj125 fault" UBYTE CU_HTR_B_FAULTBASEDHEATERLIMIT0 1 100 0.0 1.0 ECU_ADDRESS 0x40002e47 BYTE_ORDER MSB_FIRST /end MEASUREMENT
/begin COMPU_METHOD CU_HTR_B_FAULTBASEDHEATERLIMIT0 "Conversion method for HTR_b_FaultBasedHeaterLimit_A" RAT_FUNC "%10.0" "b" COEFFS 0.000000 1.000000 0.000000 0.000000 0.000000 1.000000 /end COMPU_METHOD
/* Scalar measurable for DDE 'HTR_b_FaultBasedHeaterLimit_B'. */
/begin MEASUREMENT HTR_b_FaultBasedHeaterLimit_B "Flag to indicate heater is disabled due to a cj125 fault" UBYTE CU_HTR_B_FAULTBASEDHEATERLIMIT1 1 100 0.0 1.0 ECU_ADDRESS 0x40002e58 BYTE_ORDER MSB_FIRST /end MEASUREMENT
/begin COMPU_METHOD CU_HTR_B_FAULTBASEDHEATERLIMIT1 "Conversion method for HTR_b_FaultBasedHeaterLimit_B" RAT_FUNC "%10.0" "b" COEFFS 0.000000 1.000000 0.000000 0.000000 0.000000 1.000000 /end COMPU_METHOD
/* Scalar measurable for DDE 'HTR_b_HeaterEnabled_A'. */
/begin MEASUREMENT HTR_b_HeaterEnabled_A "Flag to indicate heater is enabled" UBYTE CU_HTR_B_HEATERENABLED_A 1 100 0.0 1.0 ECU_ADDRESS 0x40002e48 BYTE_ORDER MSB_FIRST /end MEASUREMENT
/begin COMPU_METHOD CU_HTR_B_HEATERENABLED_A "Conversion method for HTR_b_HeaterEnabled_A" RAT_FUNC "%10.0" "b" COEFFS 0.000000 1.000000 0.000000 0.000000 0.000000 1.000000 /end COMPU_METHOD
/* Scalar measurable for DDE 'HTR_b_HeaterEnabled_B'. */
/begin MEASUREMENT HTR_b_HeaterEnabled_B "Flag to indicate heater is enabled" UBYTE CU_HTR_B_HEATERENABLED_B 1 100 0.0 1.0 ECU_ADDRESS 0x40002e59 BYTE_ORDER MSB_FIRST /end MEASUREMENT
/begin COMPU_METHOD CU_HTR_B_HEATERENABLED_B "Conversion method for HTR_b_HeaterEnabled_B" RAT_FUNC "%10.0" "b" COEFFS 0.000000 1.000000 0.000000 0.000000 0.000000 1.000000 /end COMPU_METHOD
/* Scalar measurable for DDE 'HTR_b_OpenLoopActv_A'. */
/begin MEASUREMENT HTR_b_OpenLoopActv_A "Open Loop heater control active flag" UBYTE CU_HTR_B_OPENLOOPACTV_A 1 100 0.0 1.0 ECU_ADDRESS 0x40002e44 BYTE_ORDER MSB_FIRST /end MEASUREMENT
/begin COMPU_METHOD CU_HTR_B_OPENLOOPACTV_A "Conversion method for HTR_b_OpenLoopActv_A" RAT_FUNC "%10.0" "b" COEFFS 0.000000 1.000000 0.000000 0.000000 0.000000 1.000000 /end COMPU_METHOD
/* Scalar measurable for DDE 'HTR_b_OpenLoopActv_B'. */
/begin MEASUREMENT HTR_b_OpenLoopActv_B "Open Loop heater control active flag" UBYTE CU_HTR_B_OPENLOOPACTV_B 1 100 0.0 1.0 ECU_ADDRESS 0x40002e55 BYTE_ORDER MSB_FIRST /end MEASUREMENT
/begin COMPU_METHOD CU_HTR_B_OPENLOOPACTV_B "Conversion method for HTR_b_OpenLoopActv_B" RAT_FUNC "%10.0" "b" COEFFS 0.000000 1.000000 0.000000 0.000000 0.000000 1.000000 /end COMPU_METHOD
/* Scalar measurable for DDE 'HTR_b_OpenLoopReset_A'. */
/begin MEASUREMENT HTR_b_OpenLoopReset_A "Open Loop heater control reset flag" UBYTE CU_HTR_B_OPENLOOPRESET_A 1 100 0.0 1.0 ECU_ADDRESS 0x40002e45 BYTE_ORDER MSB_FIRST /end MEASUREMENT
/begin COMPU_METHOD CU_HTR_B_OPENLOOPRESET_A "Conversion method for HTR_b_OpenLoopReset_A" RAT_FUNC "%10.0" "b" COEFFS 0.000000 1.000000 0.000000 0.000000 0.000000 1.000000 /end COMPU_METHOD
/* Scalar measurable for DDE 'HTR_b_OpenLoopReset_B'. */
/begin MEASUREMENT HTR_b_OpenLoopReset_B "Open Loop heater control reset flag" UBYTE CU_HTR_B_OPENLOOPRESET_B 1 100 0.0 1.0 ECU_ADDRESS 0x40002e56 BYTE_ORDER MSB_FIRST /end MEASUREMENT
/begin COMPU_METHOD CU_HTR_B_OPENLOOPRESET_B "Conversion method for HTR_b_OpenLoopReset_B" RAT_FUNC "%10.0" "b" COEFFS 0.000000 1.000000 0.000000 0.000000 0.000000 1.000000 /end COMPU_METHOD
/* Scalar measurable for DDE 'HTR_b_OpenLoopSet_A'. */
/begin MEASUREMENT HTR_b_OpenLoopSet_A "Open Loop heater control set flag" UBYTE CU_HTR_B_OPENLOOPSET_A 1 100 0.0 1.0 ECU_ADDRESS 0x40002e46 BYTE_ORDER MSB_FIRST /end MEASUREMENT
/begin COMPU_METHOD CU_HTR_B_OPENLOOPSET_A "Conversion method for HTR_b_OpenLoopSet_A" RAT_FUNC "%10.0" "b" COEFFS 0.000000 1.000000 0.000000 0.000000 0.000000 1.000000 /end COMPU_METHOD
/* Scalar measurable for DDE 'HTR_b_OpenLoopSet_B'. */
/begin MEASUREMENT HTR_b_OpenLoopSet_B "Open Loop heater control set flag" UBYTE CU_HTR_B_OPENLOOPSET_B 1 100 0.0 1.0 ECU_ADDRESS 0x40002e57 BYTE_ORDER MSB_FIRST /end MEASUREMENT
/begin COMPU_METHOD CU_HTR_B_OPENLOOPSET_B "Conversion method for HTR_b_OpenLoopSet_B" RAT_FUNC "%10.0" "b" COEFFS 0.000000 1.000000 0.000000 0.000000 0.000000 1.000000 /end COMPU_METHOD
/* Scalar measurable for DDE 'HTR_b_WaterCondensActv_A'. */
/begin MEASUREMENT HTR_b_WaterCondensActv_A "Open Loop heater control Water Condensation period is active flag" UBYTE CU_HTR_B_WATERCONDENSACTV_A 1 100 0.0 1.0 ECU_ADDRESS 0x40002e42 BYTE_ORDER MSB_FIRST /end MEASUREMENT
/begin COMPU_METHOD CU_HTR_B_WATERCONDENSACTV_A "Conversion method for HTR_b_WaterCondensActv_A" RAT_FUNC "%10.0" "b" COEFFS 0.000000 1.000000 0.000000 0.000000 0.000000 1.000000 /end COMPU_METHOD
/* Scalar measurable for DDE 'HTR_b_WaterCondensActv_B'. */
/begin MEASUREMENT HTR_b_WaterCondensActv_B "Open Loop heater control Water Condensation period is active flag" UBYTE CU_HTR_B_WATERCONDENSACTV_B 1 100 0.0 1.0 ECU_ADDRESS 0x40002e53 BYTE_ORDER MSB_FIRST /end MEASUREMENT
/begin COMPU_METHOD CU_HTR_B_WATERCONDENSACTV_B "Conversion method for HTR_b_WaterCondensActv_B" RAT_FUNC "%10.0" "b" COEFFS 0.000000 1.000000 0.000000 0.000000 0.000000 1.000000 /end COMPU_METHOD
/* Scalar measurable for DDE 'HTR_e_RefCurrEnum_A'. */
/begin MEASUREMENT HTR_e_RefCurrEnum_A "Temporary applied reference current enumeration" UBYTE CU_HTR_E_REFCURRENUM_A 1 100 0.0 0.0 ECU_ADDRESS 0x40002fda BYTE_ORDER MSB_FIRST /end MEASUREMENT
/begin COMPU_METHOD CU_HTR_E_REFCURRENUM_A "Conversion method for HTR_e_RefCurrEnum_A" RAT_FUNC "%10.0" "e" COEFFS 0.000000 1.000000 0.000000 0.000000 0.000000 1.000000 /end COMPU_METHOD
/* Scalar measurable for DDE 'HTR_e_RefCurrEnum_B'. */
/begin MEASUREMENT HTR_e_RefCurrEnum_B "Temporary applied reference current enumeration" UBYTE CU_HTR_E_REFCURRENUM_B 1 100 0.0 0.0 ECU_ADDRESS 0x40002fdb BYTE_ORDER MSB_FIRST /end MEASUREMENT
/begin COMPU_METHOD CU_HTR_E_REFCURRENUM_B "Conversion method for HTR_e_RefCurrEnum_B" RAT_FUNC "%10.0" "e" COEFFS 0.000000 1.000000 0.000000 0.000000 0.000000 1.000000 /end COMPU_METHOD
/* Scalar measurable for DDE 'HTR_pct_ClosedLoopPWMCmd_A'. */
/begin MEASUREMENT HTR_pct_ClosedLoopPWMCmd_A "Closed Loop control heater PWM command" FLOAT32_IEEE CU_HTR_PCT_CLOSEDLOOPPWMCMD_A 1 100 0.0 0.0 ECU_ADDRESS 0x400030dc BYTE_ORDER MSB_FIRST /end MEASUREMENT
/begin COMPU_METHOD CU_HTR_PCT_CLOSEDLOOPPWMCMD_A "Conversion method for HTR_pct_ClosedLoopPWMCmd_A" RAT_FUNC "%10.3" "pct" COEFFS 0.000000 1.000000 0.000000 0.000000 0.000000 1.000000 /end COMPU_METHOD
/* Scalar measurable for DDE 'HTR_pct_ClosedLoopPWMCmd_B'. */
/begin MEASUREMENT HTR_pct_ClosedLoopPWMCmd_B "Closed Loop control heater PWM command" FLOAT32_IEEE CU_HTR_PCT_CLOSEDLOOPPWMCMD_B 1 100 0.0 0.0 ECU_ADDRESS 0x4000310c BYTE_ORDER MSB_FIRST /end MEASUREMENT
/begin COMPU_METHOD CU_HTR_PCT_CLOSEDLOOPPWMCMD_B "Conversion method for HTR_pct_ClosedLoopPWMCmd_B" RAT_FUNC "%10.3" "pct" COEFFS 0.000000 1.000000 0.000000 0.000000 0.000000 1.000000 /end COMPU_METHOD
/* Scalar measurable for DDE 'HTR_pct_FinalPWMCmd_A'. */
/begin MEASUREMENT HTR_pct_FinalPWMCmd_A "Final heater PWM command" FLOAT32_IEEE CU_HTR_PCT_FINALPWMCMD_A 1 100 0.0 0.0 ECU_ADDRESS 0x400030ec BYTE_ORDER MSB_FIRST /end MEASUREMENT
/begin COMPU_METHOD CU_HTR_PCT_FINALPWMCMD_A "Conversion method for HTR_pct_FinalPWMCmd_A" RAT_FUNC "%10.3" "pct" COEFFS 0.000000 1.000000 0.000000 0.000000 0.000000 1.000000 /end COMPU_METHOD
/* Scalar measurable for DDE 'HTR_pct_FinalPWMCmd_B'. */
/begin MEASUREMENT HTR_pct_FinalPWMCmd_B "Final heater PWM command" FLOAT32_IEEE CU_HTR_PCT_FINALPWMCMD_B 1 100 0.0 0.0 ECU_ADDRESS 0x4000311c BYTE_ORDER MSB_FIRST /end MEASUREMENT
/begin COMPU_METHOD CU_HTR_PCT_FINALPWMCMD_B "Conversion method for HTR_pct_FinalPWMCmd_B" RAT_FUNC "%10.3" "pct" COEFFS 0.000000 1.000000 0.000000 0.000000 0.000000 1.000000 /end COMPU_METHOD
/* Scalar measurable for DDE 'HTR_pct_OpenLoopPWMCmd_A'. */
/begin MEASUREMENT HTR_pct_OpenLoopPWMCmd_A "Open Loop control heater PWM command" FLOAT32_IEEE CU_HTR_PCT_OPENLOOPPWMCMD_A 1 100 0.0 0.0 ECU_ADDRESS 0x400030e4 BYTE_ORDER MSB_FIRST /end MEASUREMENT
/begin COMPU_METHOD CU_HTR_PCT_OPENLOOPPWMCMD_A "Conversion method for HTR_pct_OpenLoopPWMCmd_A" RAT_FUNC "%10.3" "pct" COEFFS 0.000000 1.000000 0.000000 0.000000 0.000000 1.000000 /end COMPU_METHOD
/* Scalar measurable for DDE 'HTR_pct_OpenLoopPWMCmd_B'. */
/begin MEASUREMENT HTR_pct_OpenLoopPWMCmd_B "Open Loop control heater PWM command" FLOAT32_IEEE CU_HTR_PCT_OPENLOOPPWMCMD_B 1 100 0.0 0.0 ECU_ADDRESS 0x40003114 BYTE_ORDER MSB_FIRST /end MEASUREMENT
/begin COMPU_METHOD CU_HTR_PCT_OPENLOOPPWMCMD_B "Conversion method for HTR_pct_OpenLoopPWMCmd_B" RAT_FUNC "%10.3" "pct" COEFFS 0.000000 1.000000 0.000000 0.000000 0.000000 1.000000 /end COMPU_METHOD
/* Scalar measurable for DDE 'IDL_NU_AirDTerm'. */
/begin MEASUREMENT IDL_NU_AirDTerm "Displayable" FLOAT32_IEEE CU_IDL_NU_AIRDTERM 1 100 0.0 0.0 ECU_ADDRESS 0x40003400 BYTE_ORDER MSB_FIRST /end MEASUREMENT
/begin COMPU_METHOD CU_IDL_NU_AIRDTERM "Conversion method for IDL_NU_AirDTerm" RAT_FUNC "%10.3" "NU" COEFFS 0.000000 1.000000 0.000000 0.000000 0.000000 1.000000 /end COMPU_METHOD
/* Scalar measurable for DDE 'IDL_NU_AirITerm'. */
/begin MEASUREMENT IDL_NU_AirITerm "Displayable" FLOAT32_IEEE CU_IDL_NU_AIRITERM 1 100 0.0 0.0 ECU_ADDRESS 0x40003404 BYTE_ORDER MSB_FIRST /end MEASUREMENT
/begin COMPU_METHOD CU_IDL_NU_AIRITERM "Conversion method for IDL_NU_AirITerm" RAT_FUNC "%10.3" "NU" COEFFS 0.000000 1.000000 0.000000 0.000000 0.000000 1.000000 /end COMPU_METHOD
/* Scalar measurable for DDE 'IDL_NU_AirPIDEffort'. */
/begin MEASUREMENT IDL_NU_AirPIDEffort "Effort displayable" FLOAT32_IEEE CU_IDL_NU_AIRPIDEFFORT 1 100 0.0 0.0 ECU_ADDRESS 0x400033fc BYTE_ORDER MSB_FIRST /end MEASUREMENT
/begin COMPU_METHOD CU_IDL_NU_AIRPIDEFFORT "Conversion method for IDL_NU_AirPIDEffort" RAT_FUNC "%10.3" "NU" COEFFS 0.000000 1.000000 0.000000 0.000000 0.000000 1.000000 /end COMPU_METHOD
/* Scalar measurable for DDE 'IDL_NU_AirPTerm'. */
/begin MEASUREMENT IDL_NU_AirPTerm "Displayable" FLOAT32_IEEE CU_IDL_NU_AIRPTERM 1 100 0.0 0.0 ECU_ADDRESS 0x40003408 BYTE_ORDER MSB_FIRST /end MEASUREMENT
/begin COMPU_METHOD CU_IDL_NU_AIRPTERM "Conversion method for IDL_NU_AirPTerm" RAT_FUNC "%10.3" "NU" COEFFS 0.000000 1.000000 0.000000 0.000000 0.000000 1.000000 /end COMPU_METHOD
/* Scalar measurable for DDE 'IDL_NU_ErrorROC'. */
/begin MEASUREMENT IDL_NU_ErrorROC "(RPM/s) rate of change of air flow rate error" FLOAT32_IEEE CU_IDL_NU_ERRORROC 1 100 0.0 0.0 ECU_ADDRESS 0x4000346c BYTE_ORDER MSB_FIRST /end MEASUREMENT
/begin COMPU_METHOD CU_IDL_NU_ERRORROC "Conversion method for IDL_NU_ErrorROC" RAT_FUNC "%10.0" "NU" COEFFS 0.000000 1.000000 0.000000 0.000000 0.000000 1.000000 /end COMPU_METHOD
/* Scalar measurable for DDE 'IDL_NU_IdlAirGEAR_FF'. */
/begin MEASUREMENT IDL_NU_IdlAirGEAR_FF "Feedforward idle Air" FLOAT32_IEEE CU_IDL_NU_IDLAIRGEAR_FF 1 100 0.0 0.0 ECU_ADDRESS 0x400033f0 BYTE_ORDER MSB_FIRST /end MEASUREMENT
/begin COMPU_METHOD CU_IDL_NU_IDLAIRGEAR_FF "Conversion method for IDL_NU_IdlAirGEAR_FF" RAT_FUNC "%10.3" "NU" COEFFS 0.000000 1.000000 0.000000 0.000000 0.000000 1.000000 /end COMPU_METHOD
/* Scalar measurable for DDE 'IDL_NU_SparkDTerm'. */
/begin MEASUREMENT IDL_NU_SparkDTerm "Displayable" FLOAT32_IEEE CU_IDL_NU_SPARKDTERM 1 100 0.0 0.0 ECU_ADDRESS 0x40003468 BYTE_ORDER MSB_FIRST /end MEASUREMENT
/begin COMPU_METHOD CU_IDL_NU_SPARKDTERM "Conversion method for IDL_NU_SparkDTerm" RAT_FUNC "%10.3" "NU" COEFFS 0.000000 1.000000 0.000000 0.000000 0.000000 1.000000 /end COMPU_METHOD
/* Scalar measurable for DDE 'IDL_NU_SparkITerm'. */
/begin MEASUREMENT IDL_NU_SparkITerm "Displayable" FLOAT32_IEEE CU_IDL_NU_SPARKITERM 1 100 0.0 0.0 ECU_ADDRESS 0x40003474 BYTE_ORDER MSB_FIRST /end MEASUREMENT
/begin COMPU_METHOD CU_IDL_NU_SPARKITERM "Conversion method for IDL_NU_SparkITerm" RAT_FUNC "%10.3" "NU" COEFFS 0.000000 1.000000 0.000000 0.000000 0.000000 1.000000 /end COMPU_METHOD
/* Scalar measurable for DDE 'IDL_NU_SparkPID_Effort'. */
/begin MEASUREMENT IDL_NU_SparkPID_Effort "Effort displayable" FLOAT32_IEEE CU_IDL_NU_SPARKPID_EFFORT 1 100 0.0 0.0 ECU_ADDRESS 0x40003464 BYTE_ORDER MSB_FIRST /end MEASUREMENT
/begin COMPU_METHOD CU_IDL_NU_SPARKPID_EFFORT "Conversion method for IDL_NU_SparkPID_Effort" RAT_FUNC "%10.3" "NU" COEFFS 0.000000 1.000000 0.000000 0.000000 0.000000 1.000000 /end COMPU_METHOD
/* Scalar measurable for DDE 'IDL_NU_SparkPTerm'. */
/begin MEASUREMENT IDL_NU_SparkPTerm "Displayable" FLOAT32_IEEE CU_IDL_NU_SPARKPTERM 1 100 0.0 0.0 ECU_ADDRESS 0x40003478 BYTE_ORDER MSB_FIRST /end MEASUREMENT
/begin COMPU_METHOD CU_IDL_NU_SPARKPTERM "Conversion method for IDL_NU_SparkPTerm" RAT_FUNC "%10.3" "NU" COEFFS 0.000000 1.000000 0.000000 0.000000 0.000000 1.000000 /end COMPU_METHOD
/* Scalar measurable for DDE 'IDL_RPM_AC_Term'. */
/begin MEASUREMENT IDL_RPM_AC_Term "Idle speed adder based on AC compressor" FLOAT32_IEEE CU_IDL_RPM_AC_TERM 1 100 0.0 0.0 ECU_ADDRESS 0x400035a8 BYTE_ORDER MSB_FIRST /end MEASUREMENT
/begin COMPU_METHOD CU_IDL_RPM_AC_TERM "Conversion method for IDL_RPM_AC_Term" RAT_FUNC "%10.0" "RPM" COEFFS 0.000000 1.000000 0.000000 0.000000 0.000000 1.000000 /end COMPU_METHOD
/* Scalar measurable for DDE 'IDL_RPM_Added'. */
/begin MEASUREMENT IDL_RPM_Added "Displayable" FLOAT32_IEEE CU_IDL_RPM_ADDED 1 100 0.0 0.0 ECU_ADDRESS 0x4000359c BYTE_ORDER MSB_FIRST /end MEASUREMENT
/begin COMPU_METHOD CU_IDL_RPM_ADDED "Conversion method for IDL_RPM_Added" RAT_FUNC "%10.0" "RPM" COEFFS 0.000000 1.000000 0.000000 0.000000 0.000000 1.000000 /end COMPU_METHOD
/* Scalar measurable for DDE 'IDL_RPM_AlternatorTerm'. */
/begin MEASUREMENT IDL_RPM_AlternatorTerm "Idle speed adder based on alternator current" FLOAT32_IEEE CU_IDL_RPM_ALTERNATORTERM 1 100 0.0 0.0 ECU_ADDRESS 0x400035ac BYTE_ORDER MSB_FIRST /end MEASUREMENT
/begin COMPU_METHOD CU_IDL_RPM_ALTERNATORTERM "Conversion method for IDL_RPM_AlternatorTerm" RAT_FUNC "%10.0" "RPM" COEFFS 0.000000 1.000000 0.000000 0.000000 0.000000 1.000000 /end COMPU_METHOD
/* Scalar measurable for DDE 'IDL_RPM_AlternatorTermRaw'. */
/begin MEASUREMENT IDL_RPM_AlternatorTermRaw "Map output value" FLOAT32_IEEE CU_IDL_RPM_ALTERNATORTERMRAW 1 100 0.0 0.0 ECU_ADDRESS 0x400035b0 BYTE_ORDER MSB_FIRST /end MEASUREMENT
/begin COMPU_METHOD CU_IDL_RPM_ALTERNATORTERMRAW "Conversion method for IDL_RPM_AlternatorTermRaw" RAT_FUNC "%10.0" "RPM" COEFFS 0.000000 1.000000 0.000000 0.000000 0.000000 1.000000 /end COMPU_METHOD
/* Scalar measurable for DDE 'IDL_RPM_Base'. */
/begin MEASUREMENT IDL_RPM_Base "Temp and StartTime idle speed target result" FLOAT32_IEEE CU_IDL_RPM_BASE 1 100 0.0 0.0 ECU_ADDRESS 0x400035b8 BYTE_ORDER MSB_FIRST /end MEASUREMENT
/begin COMPU_METHOD CU_IDL_RPM_BASE "Conversion method for IDL_RPM_Base" RAT_FUNC "%10.0" "RPM" COEFFS 0.000000 1.000000 0.000000 0.000000 0.000000 1.000000 /end COMPU_METHOD
/* Scalar measurable for DDE 'IDL_RPM_DrivingTerm'. */
/begin MEASUREMENT IDL_RPM_DrivingTerm "Displayable" FLOAT32_IEEE CU_IDL_RPM_DRIVINGTERM 1 100 0.0 0.0 ECU_ADDRESS 0x400035a4 BYTE_ORDER MSB_FIRST /end MEASUREMENT
/begin COMPU_METHOD CU_IDL_RPM_DRIVINGTERM "Conversion method for IDL_RPM_DrivingTerm" RAT_FUNC "%10.0" "RPM" COEFFS 0.000000 1.000000 0.000000 0.000000 0.000000 1.000000 /end COMPU_METHOD
/* Scalar measurable for DDE 'IDL_RPM_Error'. */
/begin MEASUREMENT IDL_RPM_Error "Speed error used for FB control" FLOAT32_IEEE CU_IDL_RPM_ERROR 1 100 0.0 0.0 ECU_ADDRESS 0x40003594 BYTE_ORDER MSB_FIRST /end MEASUREMENT
/begin COMPU_METHOD CU_IDL_RPM_ERROR "Conversion method for IDL_RPM_Error" RAT_FUNC "%10.0" "RPM" COEFFS 0.000000 1.000000 0.000000 0.000000 0.000000 1.000000 /end COMPU_METHOD
/* Scalar measurable for DDE 'IDL_RPM_ErrorLPF'. */
/begin MEASUREMENT IDL_RPM_ErrorLPF "Displayable" FLOAT32_IEEE CU_IDL_RPM_ERRORLPF 1 100 0.0 0.0 ECU_ADDRESS 0x40003470 BYTE_ORDER MSB_FIRST /end MEASUREMENT
/begin COMPU_METHOD CU_IDL_RPM_ERRORLPF "Conversion method for IDL_RPM_ErrorLPF" RAT_FUNC "%10.0" "RPM" COEFFS 0.000000 1.000000 0.000000 0.000000 0.000000 1.000000 /end COMPU_METHOD
/* Scalar measurable for DDE 'IDL_RPM_Trgt'. */
/begin MEASUREMENT IDL_RPM_Trgt "Displayable" FLOAT32_IEEE CU_IDL_RPM_TRGT 1 100 0.0 0.0 ECU_ADDRESS 0x400035a0 BYTE_ORDER MSB_FIRST /end MEASUREMENT
/begin COMPU_METHOD CU_IDL_RPM_TRGT "Conversion method for IDL_RPM_Trgt" RAT_FUNC "%10.0" "RPM" COEFFS 0.000000 1.000000 0.000000 0.000000 0.000000 1.000000 /end COMPU_METHOD
/* Scalar measurable for DDE 'IDL_RPM_Trgt_trt'. */
/begin MEASUREMENT IDL_RPM_Trgt_trt "Displayable" FLOAT32_IEEE CU_IDL_RPM_TRGT_TRT 1 100 0.0 0.0 ECU_ADDRESS 0x40003598 BYTE_ORDER MSB_FIRST /end MEASUREMENT
/begin COMPU_METHOD CU_IDL_RPM_TRGT_TRT "Conversion method for IDL_RPM_Trgt_trt" RAT_FUNC "%10.0" "RPM" COEFFS 0.000000 1.000000 0.000000 0.000000 0.000000 1.000000 /end COMPU_METHOD
/* Scalar measurable for DDE 'IDL_b_Actv'. */
/begin MEASUREMENT IDL_b_Actv "Displayable" UBYTE CU_IDL_B_ACTV 1 100 0.0 1.0 ECU_ADDRESS 0x40002ed4 BYTE_ORDER MSB_FIRST /end MEASUREMENT
/begin COMPU_METHOD CU_IDL_B_ACTV "Conversion method for IDL_b_Actv" RAT_FUNC "%10.0" "b" COEFFS 0.000000 1.000000 0.000000 0.000000 0.000000 1.000000 /end COMPU_METHOD
/* Scalar measurable for DDE 'IDL_gps_Air'. */
/begin MEASUREMENT IDL_gps_Air "Final Idle Air request" FLOAT32_IEEE CU_IDL_GPS_AIR 1 100 0.0 0.0 ECU_ADDRESS 0x400033e8 BYTE_ORDER MSB_FIRST /end MEASUREMENT
/begin COMPU_METHOD CU_IDL_GPS_AIR "Conversion method for IDL_gps_Air" RAT_FUNC "%10.3" "gps" COEFFS 0.000000 1.000000 0.000000 0.000000 0.000000 1.000000 /end COMPU_METHOD
/* Scalar measurable for DDE 'IDL_gps_IdlAC_FF'. */
/begin MEASUREMENT IDL_gps_IdlAC_FF "Feedforward idle Air" FLOAT32_IEEE CU_IDL_GPS_IDLAC_FF 1 100 0.0 0.0 ECU_ADDRESS 0x400033ec BYTE_ORDER MSB_FIRST /end MEASUREMENT
/begin COMPU_METHOD CU_IDL_GPS_IDLAC_FF "Conversion method for IDL_gps_IdlAC_FF" RAT_FUNC "%10.3" "NU" COEFFS 0.000000 1.000000 0.000000 0.000000 0.000000 1.000000 /end COMPU_METHOD
/* Scalar measurable for DDE 'IDL_gps_IdlAir_FF'. */
/begin MEASUREMENT IDL_gps_IdlAir_FF "Feedforward idle Air" FLOAT32_IEEE CU_IDL_GPS_IDLAIR_FF 1 100 0.0 100.0 ECU_ADDRESS 0x400033f4 BYTE_ORDER MSB_FIRST /end MEASUREMENT
/begin COMPU_METHOD CU_IDL_GPS_IDLAIR_FF "Conversion method for IDL_gps_IdlAir_FF" RAT_FUNC "%10.3" "gps" COEFFS 0.000000 1.000000 0.000000 0.000000 0.000000 1.000000 /end COMPU_METHOD
/* Scalar measurable for DDE 'IDL_gps_IdlAir_PID'. */
/begin MEASUREMENT IDL_gps_IdlAir_PID "Idle Air feedback term" FLOAT32_IEEE CU_IDL_GPS_IDLAIR_PID 1 100 -1000.0 1000.0 ECU_ADDRESS 0x400033f8 BYTE_ORDER MSB_FIRST /end MEASUREMENT
/begin COMPU_METHOD CU_IDL_GPS_IDLAIR_PID "Conversion method for IDL_gps_IdlAir_PID" RAT_FUNC "%10.3" "gps" COEFFS 0.000000 1.000000 0.000000 0.000000 0.000000 1.000000 /end COMPU_METHOD
/* Scalar measurable for DDE 'IDL_ret_Spark'. */
/begin MEASUREMENT IDL_ret_Spark "Final Idle spark request" FLOAT32_IEEE CU_IDL_RET_SPARK 1 100 0.0 0.0 ECU_ADDRESS 0x40003460 BYTE_ORDER MSB_FIRST /end MEASUREMENT
/begin COMPU_METHOD CU_IDL_RET_SPARK "Conversion method for IDL_ret_Spark" RAT_FUNC "%10.1" "(not defined)" COEFFS 0.000000 1.000000 0.000000 0.000000 0.000000 1.000000 /end COMPU_METHOD
/* Scalar measurable for DDE 'IJT_NU_TotalFuelFlowKgPerHr'. */
/begin MEASUREMENT IJT_NU_TotalFuelFlowKgPerHr "(kg/hr) Commanded engine-total fuel flow rate" FLOAT32_IEEE CU_IJT_NU_TOTALFUELFLOWKGPERHR 1 100 0.0 0.0 ECU_ADDRESS 0x400032fc BYTE_ORDER MSB_FIRST /end MEASUREMENT
/begin COMPU_METHOD CU_IJT_NU_TOTALFUELFLOWKGPERHR "Conversion method for IJT_NU_TotalFuelFlowKgPerHr" RAT_FUNC "%10.1" "NU" COEFFS 0.000000 1.000000 0.000000 0.000000 0.000000 1.000000 /end COMPU_METHOD
/* Scalar measurable for DDE 'IJT_adv_CrankingSOI'. */
/begin MEASUREMENT IJT_adv_CrankingSOI "Displayable" FLOAT32_IEEE CU_IJT_ADV_CRANKINGSOI 1 100 0.0 0.0 ECU_ADDRESS 0x40003330 BYTE_ORDER MSB_FIRST /end MEASUREMENT
/begin COMPU_METHOD CU_IJT_ADV_CRANKINGSOI "Conversion method for IJT_adv_CrankingSOI" RAT_FUNC "%10.2" "adv" COEFFS 0.000000 1.000000 0.000000 0.000000 0.000000 1.000000 /end COMPU_METHOD
/* Scalar measurable for DDE 'IJT_adv_RunningSOI'. */
/begin MEASUREMENT IJT_adv_RunningSOI "Displayable" FLOAT32_IEEE CU_IJT_ADV_RUNNINGSOI 1 100 0.0 0.0 ECU_ADDRESS 0x4000332c BYTE_ORDER MSB_FIRST /end MEASUREMENT
/begin COMPU_METHOD CU_IJT_ADV_RUNNINGSOI "Conversion method for IJT_adv_RunningSOI" RAT_FUNC "%10.2" "adv" COEFFS 0.000000 1.000000 0.000000 0.000000 0.000000 1.000000 /end COMPU_METHOD
/* Scalar measurable for DDE 'IJT_adv_SOC_Inj1'. */
/begin MEASUREMENT IJT_adv_SOC_Inj1 "Displayable" FLOAT32_IEEE CU_IJT_ADV_SOC_INJ1 1 100 0.0 0.0 ECU_ADDRESS 0x40003324 BYTE_ORDER MSB_FIRST /end MEASUREMENT
/begin COMPU_METHOD CU_IJT_ADV_SOC_INJ1 "Conversion method for IJT_adv_SOC_Inj1" RAT_FUNC "%10.2" "adv" COEFFS 0.000000 1.000000 0.000000 0.000000 0.000000 1.000000 /end COMPU_METHOD
/* Scalar measurable for DDE 'IJT_adv_SOC_Inj2'. */
/begin MEASUREMENT IJT_adv_SOC_Inj2 "Displayable" FLOAT32_IEEE CU_IJT_ADV_SOC_INJ2 1 100 0.0 0.0 ECU_ADDRESS 0x40003320 BYTE_ORDER MSB_FIRST /end MEASUREMENT
/begin COMPU_METHOD CU_IJT_ADV_SOC_INJ2 "Conversion method for IJT_adv_SOC_Inj2" RAT_FUNC "%10.2" "adv" COEFFS 0.000000 1.000000 0.000000 0.000000 0.000000 1.000000 /end COMPU_METHOD
/* Scalar measurable for DDE 'IJT_adv_SOC_Inj3'. */
/begin MEASUREMENT IJT_adv_SOC_Inj3 "Displayable" FLOAT32_IEEE CU_IJT_ADV_SOC_INJ3 1 100 0.0 0.0 ECU_ADDRESS 0x4000331c BYTE_ORDER MSB_FIRST /end MEASUREMENT
/begin COMPU_METHOD CU_IJT_ADV_SOC_INJ3 "Conversion method for IJT_adv_SOC_Inj3" RAT_FUNC "%10.2" "adv" COEFFS 0.000000 1.000000 0.000000 0.000000 0.000000 1.000000 /end COMPU_METHOD
/* Scalar measurable for DDE 'IJT_adv_SOC_Inj4'. */
/begin MEASUREMENT IJT_adv_SOC_Inj4 "Displayable" FLOAT32_IEEE CU_IJT_ADV_SOC_INJ4 1 100 0.0 0.0 ECU_ADDRESS 0x40003318 BYTE_ORDER MSB_FIRST /end MEASUREMENT
/begin COMPU_METHOD CU_IJT_ADV_SOC_INJ4 "Conversion method for IJT_adv_SOC_Inj4" RAT_FUNC "%10.2" "adv" COEFFS 0.000000 1.000000 0.000000 0.000000 0.000000 1.000000 /end COMPU_METHOD
/* Scalar measurable for DDE 'IJT_b_Inj1_InjectionSent'. */
/begin MEASUREMENT IJT_b_Inj1_InjectionSent "Displayable" UBYTE CU_IJT_B_INJ1_INJECTIONSENT 1 100 0.0 1.0 ECU_ADDRESS 0x40002ea0 BYTE_ORDER MSB_FIRST /end MEASUREMENT
/begin COMPU_METHOD CU_IJT_B_INJ1_INJECTIONSENT "Conversion method for IJT_b_Inj1_InjectionSent" RAT_FUNC "%10.0" "b" COEFFS 0.000000 1.000000 0.000000 0.000000 0.000000 1.000000 /end COMPU_METHOD
/* Scalar measurable for DDE 'IJT_b_Inj2_InjectionSent'. */
/begin MEASUREMENT IJT_b_Inj2_InjectionSent "Displayable" UBYTE CU_IJT_B_INJ2_INJECTIONSENT 1 100 0.0 1.0 ECU_ADDRESS 0x40002e9f BYTE_ORDER MSB_FIRST /end MEASUREMENT
/begin COMPU_METHOD CU_IJT_B_INJ2_INJECTIONSENT "Conversion method for IJT_b_Inj2_InjectionSent" RAT_FUNC "%10.0" "b" COEFFS 0.000000 1.000000 0.000000 0.000000 0.000000 1.000000 /end COMPU_METHOD
/* Scalar measurable for DDE 'IJT_b_Inj3_InjectionSent'. */
/begin MEASUREMENT IJT_b_Inj3_InjectionSent "Displayable" UBYTE CU_IJT_B_INJ3_INJECTIONSENT 1 100 0.0 1.0 ECU_ADDRESS 0x40002e9e BYTE_ORDER MSB_FIRST /end MEASUREMENT
/begin COMPU_METHOD CU_IJT_B_INJ3_INJECTIONSENT "Conversion method for IJT_b_Inj3_InjectionSent" RAT_FUNC "%10.0" "b" COEFFS 0.000000 1.000000 0.000000 0.000000 0.000000 1.000000 /end COMPU_METHOD
/* Scalar measurable for DDE 'IJT_b_Inj4_InjectionSent'. */
/begin MEASUREMENT IJT_b_Inj4_InjectionSent "Displayable" UBYTE CU_IJT_B_INJ4_INJECTIONSENT 1 100 0.0 1.0 ECU_ADDRESS 0x40002e9d BYTE_ORDER MSB_FIRST /end MEASUREMENT
/begin COMPU_METHOD CU_IJT_B_INJ4_INJECTIONSENT "Conversion method for IJT_b_Inj4_InjectionSent" RAT_FUNC "%10.0" "b" COEFFS 0.000000 1.000000 0.000000 0.000000 0.000000 1.000000 /end COMPU_METHOD
/* Scalar measurable for DDE 'IJT_b_InjectorOverlap'. */
/begin MEASUREMENT IJT_b_InjectorOverlap "Displayable" UBYTE CU_IJT_B_INJECTOROVERLAP 1 100 0.0 1.0 ECU_ADDRESS 0x40002e98 BYTE_ORDER MSB_FIRST /end MEASUREMENT
/begin COMPU_METHOD CU_IJT_B_INJECTOROVERLAP "Conversion method for IJT_b_InjectorOverlap" RAT_FUNC "%10.0" "b" COEFFS 0.000000 1.000000 0.000000 0.000000 0.000000 1.000000 /end COMPU_METHOD
/* Scalar measurable for DDE 'IJT_b_PrimingPulseActiveCyl1'. */
/begin MEASUREMENT IJT_b_PrimingPulseActiveCyl1 "Displayable" UBYTE CU_IJT_B_PRIMINGPULSEACTIVECYL1 1 100 0.0 1.0 ECU_ADDRESS 0x40002e9c BYTE_ORDER MSB_FIRST /end MEASUREMENT
/begin COMPU_METHOD CU_IJT_B_PRIMINGPULSEACTIVECYL1 "Conversion method for IJT_b_PrimingPulseActiveCyl1" RAT_FUNC "%10.0" "b" COEFFS 0.000000 1.000000 0.000000 0.000000 0.000000 1.000000 /end COMPU_METHOD
/* Scalar measurable for DDE 'IJT_b_PrimingPulseActiveCyl2'. */
/begin MEASUREMENT IJT_b_PrimingPulseActiveCyl2 "Displayable" UBYTE CU_IJT_B_PRIMINGPULSEACTIVECYL2 1 100 0.0 1.0 ECU_ADDRESS 0x40002e9b BYTE_ORDER MSB_FIRST /end MEASUREMENT
/begin COMPU_METHOD CU_IJT_B_PRIMINGPULSEACTIVECYL2 "Conversion method for IJT_b_PrimingPulseActiveCyl2" RAT_FUNC "%10.0" "b" COEFFS 0.000000 1.000000 0.000000 0.000000 0.000000 1.000000 /end COMPU_METHOD
/* Scalar measurable for DDE 'IJT_b_PrimingPulseActiveCyl3'. */
/begin MEASUREMENT IJT_b_PrimingPulseActiveCyl3 "Displayable" UBYTE CU_IJT_B_PRIMINGPULSEACTIVECYL3 1 100 0.0 1.0 ECU_ADDRESS 0x40002e9a BYTE_ORDER MSB_FIRST /end MEASUREMENT
/begin COMPU_METHOD CU_IJT_B_PRIMINGPULSEACTIVECYL3 "Conversion method for IJT_b_PrimingPulseActiveCyl3" RAT_FUNC "%10.0" "b" COEFFS 0.000000 1.000000 0.000000 0.000000 0.000000 1.000000 /end COMPU_METHOD
/* Scalar measurable for DDE 'IJT_b_PrimingPulseActiveCyl4'. */
/begin MEASUREMENT IJT_b_PrimingPulseActiveCyl4 "Displayable" UBYTE CU_IJT_B_PRIMINGPULSEACTIVECYL4 1 100 0.0 1.0 ECU_ADDRESS 0x40002e99 BYTE_ORDER MSB_FIRST /end MEASUREMENT
/begin COMPU_METHOD CU_IJT_B_PRIMINGPULSEACTIVECYL4 "Conversion method for IJT_b_PrimingPulseActiveCyl4" RAT_FUNC "%10.0" "b" COEFFS 0.000000 1.000000 0.000000 0.000000 0.000000 1.000000 /end COMPU_METHOD
/* Scalar measurable for DDE 'IJT_bar_EffectivePress'. */
/begin MEASUREMENT IJT_bar_EffectivePress "Effective pressure (DeltaP) at injector" FLOAT32_IEEE CU_IJT_BAR_EFFECTIVEPRESS 1 100 0.0 200.0 ECU_ADDRESS 0x400032f4 BYTE_ORDER MSB_FIRST /end MEASUREMENT
/begin COMPU_METHOD CU_IJT_BAR_EFFECTIVEPRESS "Conversion method for IJT_bar_EffectivePress" RAT_FUNC "%10.2" "bar" COEFFS 0.000000 1.000000 0.000000 0.000000 0.000000 1.000000 /end COMPU_METHOD
/* Scalar measurable for DDE 'IJT_cnt_PrimingPulsesCyl1'. */
/begin MEASUREMENT IJT_cnt_PrimingPulsesCyl1 "Displayable" UBYTE CU_IJT_CNT_PRIMINGPULSESCYL1 1 100 0.0 0.0 ECU_ADDRESS 0x40002fdf BYTE_ORDER MSB_FIRST /end MEASUREMENT
/begin COMPU_METHOD CU_IJT_CNT_PRIMINGPULSESCYL1 "Conversion method for IJT_cnt_PrimingPulsesCyl1" RAT_FUNC "%10.0" "cnt" COEFFS 0.000000 1.000000 0.000000 0.000000 0.000000 1.000000 /end COMPU_METHOD
/* Scalar measurable for DDE 'IJT_cnt_PrimingPulsesCyl2'. */
/begin MEASUREMENT IJT_cnt_PrimingPulsesCyl2 "Displayable" UBYTE CU_IJT_CNT_PRIMINGPULSESCYL2 1 100 0.0 0.0 ECU_ADDRESS 0x40002fde BYTE_ORDER MSB_FIRST /end MEASUREMENT
/begin COMPU_METHOD CU_IJT_CNT_PRIMINGPULSESCYL2 "Conversion method for IJT_cnt_PrimingPulsesCyl2" RAT_FUNC "%10.0" "cnt" COEFFS 0.000000 1.000000 0.000000 0.000000 0.000000 1.000000 /end COMPU_METHOD
/* Scalar measurable for DDE 'IJT_cnt_PrimingPulsesCyl3'. */
/begin MEASUREMENT IJT_cnt_PrimingPulsesCyl3 "Displayable" UBYTE CU_IJT_CNT_PRIMINGPULSESCYL3 1 100 0.0 0.0 ECU_ADDRESS 0x40002fdd BYTE_ORDER MSB_FIRST /end MEASUREMENT
/begin COMPU_METHOD CU_IJT_CNT_PRIMINGPULSESCYL3 "Conversion method for IJT_cnt_PrimingPulsesCyl3" RAT_FUNC "%10.0" "cnt" COEFFS 0.000000 1.000000 0.000000 0.000000 0.000000 1.000000 /end COMPU_METHOD
/* Scalar measurable for DDE 'IJT_cnt_PrimingPulsesCyl4'. */
/begin MEASUREMENT IJT_cnt_PrimingPulsesCyl4 "Displayable" UBYTE CU_IJT_CNT_PRIMINGPULSESCYL4 1 100 0.0 0.0 ECU_ADDRESS 0x40002fdc BYTE_ORDER MSB_FIRST /end MEASUREMENT
/begin COMPU_METHOD CU_IJT_CNT_PRIMINGPULSESCYL4 "Conversion method for IJT_cnt_PrimingPulsesCyl4" RAT_FUNC "%10.0" "cnt" COEFFS 0.000000 1.000000 0.000000 0.000000 0.000000 1.000000 /end COMPU_METHOD
/* Scalar measurable for DDE 'IJT_deg_Inj1'. */
/begin MEASUREMENT IJT_deg_Inj1 "Displayable" FLOAT32_IEEE CU_IJT_DEG_INJ1 1 100 0.0 0.0 ECU_ADDRESS 0x400032e8 BYTE_ORDER MSB_FIRST /end MEASUREMENT
/begin COMPU_METHOD CU_IJT_DEG_INJ1 "Conversion method for IJT_deg_Inj1" RAT_FUNC "%10.2" "deg" COEFFS 0.000000 1.000000 0.000000 0.000000 0.000000 1.000000 /end COMPU_METHOD
/* Scalar measurable for DDE 'IJT_deg_Inj2'. */
/begin MEASUREMENT IJT_deg_Inj2 "Displayable" FLOAT32_IEEE CU_IJT_DEG_INJ2 1 100 0.0 0.0 ECU_ADDRESS 0x400032e4 BYTE_ORDER MSB_FIRST /end MEASUREMENT
/begin COMPU_METHOD CU_IJT_DEG_INJ2 "Conversion method for IJT_deg_Inj2" RAT_FUNC "%10.2" "deg" COEFFS 0.000000 1.000000 0.000000 0.000000 0.000000 1.000000 /end COMPU_METHOD
/* Scalar measurable for DDE 'IJT_deg_Inj3'. */
/begin MEASUREMENT IJT_deg_Inj3 "Displayable" FLOAT32_IEEE CU_IJT_DEG_INJ3 1 100 0.0 0.0 ECU_ADDRESS 0x400032e0 BYTE_ORDER MSB_FIRST /end MEASUREMENT
/begin COMPU_METHOD CU_IJT_DEG_INJ3 "Conversion method for IJT_deg_Inj3" RAT_FUNC "%10.2" "deg" COEFFS 0.000000 1.000000 0.000000 0.000000 0.000000 1.000000 /end COMPU_METHOD
/* Scalar measurable for DDE 'IJT_deg_Inj4'. */
/begin MEASUREMENT IJT_deg_Inj4 "Displayable" FLOAT32_IEEE CU_IJT_DEG_INJ4 1 100 0.0 0.0 ECU_ADDRESS 0x400032dc BYTE_ORDER MSB_FIRST /end MEASUREMENT
/begin COMPU_METHOD CU_IJT_DEG_INJ4 "Conversion method for IJT_deg_Inj4" RAT_FUNC "%10.2" "deg" COEFFS 0.000000 1.000000 0.000000 0.000000 0.000000 1.000000 /end COMPU_METHOD
/* Scalar measurable for DDE 'IJT_gps_InjectorFlowRatePFI'. */
/begin MEASUREMENT IJT_gps_InjectorFlowRatePFI "(not defined)" FLOAT32_IEEE CU_IJT_GPS_INJECTORFLOWRATEPFI 1 100 0.0 0.0 ECU_ADDRESS 0x400032f0 BYTE_ORDER MSB_FIRST /end MEASUREMENT
/begin COMPU_METHOD CU_IJT_GPS_INJECTORFLOWRATEPFI "Conversion method for IJT_gps_InjectorFlowRatePFI" RAT_FUNC "%10.4" "gps" COEFFS 0.000000 1.000000 0.000000 0.000000 0.000000 1.000000 /end COMPU_METHOD
/* Scalar measurable for DDE 'IJT_gps_TotalFuelFlow'. */
/begin MEASUREMENT IJT_gps_TotalFuelFlow "(g/s) Commanded engine-total fuel flow rate" FLOAT32_IEEE CU_IJT_GPS_TOTALFUELFLOW 1 100 0.0 0.0 ECU_ADDRESS 0x40003300 BYTE_ORDER MSB_FIRST /end MEASUREMENT
/begin COMPU_METHOD CU_IJT_GPS_TOTALFUELFLOW "Conversion method for IJT_gps_TotalFuelFlow" RAT_FUNC "%10.1" "gps" COEFFS 0.000000 1.000000 0.000000 0.000000 0.000000 1.000000 /end COMPU_METHOD
/* Scalar measurable for DDE 'IJT_mg_Inj1'. */
/begin MEASUREMENT IJT_mg_Inj1 "Displayable" FLOAT32_IEEE CU_IJT_MG_INJ1 1 100 0.0 0.0 ECU_ADDRESS 0x400032d8 BYTE_ORDER MSB_FIRST /end MEASUREMENT
/begin COMPU_METHOD CU_IJT_MG_INJ1 "Conversion method for IJT_mg_Inj1" RAT_FUNC "%10.2" "mg" COEFFS 0.000000 1.000000 0.000000 0.000000 0.000000 1.000000 /end COMPU_METHOD
/* Scalar measurable for DDE 'IJT_mg_Inj2'. */
/begin MEASUREMENT IJT_mg_Inj2 "Displayable" FLOAT32_IEEE CU_IJT_MG_INJ2 1 100 0.0 0.0 ECU_ADDRESS 0x400032d4 BYTE_ORDER MSB_FIRST /end MEASUREMENT
/begin COMPU_METHOD CU_IJT_MG_INJ2 "Conversion method for IJT_mg_Inj2" RAT_FUNC "%10.2" "mg" COEFFS 0.000000 1.000000 0.000000 0.000000 0.000000 1.000000 /end COMPU_METHOD
/* Scalar measurable for DDE 'IJT_mg_Inj3'. */
/begin MEASUREMENT IJT_mg_Inj3 "Displayable" FLOAT32_IEEE CU_IJT_MG_INJ3 1 100 0.0 0.0 ECU_ADDRESS 0x400032d0 BYTE_ORDER MSB_FIRST /end MEASUREMENT
/begin COMPU_METHOD CU_IJT_MG_INJ3 "Conversion method for IJT_mg_Inj3" RAT_FUNC "%10.2" "mg" COEFFS 0.000000 1.000000 0.000000 0.000000 0.000000 1.000000 /end COMPU_METHOD
/* Scalar measurable for DDE 'IJT_mg_Inj4'. */
/begin MEASUREMENT IJT_mg_Inj4 "Displayable" FLOAT32_IEEE CU_IJT_MG_INJ4 1 100 0.0 0.0 ECU_ADDRESS 0x400032cc BYTE_ORDER MSB_FIRST /end MEASUREMENT
/begin COMPU_METHOD CU_IJT_MG_INJ4 "Conversion method for IJT_mg_Inj4" RAT_FUNC "%10.2" "mg" COEFFS 0.000000 1.000000 0.000000 0.000000 0.000000 1.000000 /end COMPU_METHOD
/* Scalar measurable for DDE 'IJT_ms_Inj1'. */
/begin MEASUREMENT IJT_ms_Inj1 "Displayable" FLOAT32_IEEE CU_IJT_MS_INJ1 1 100 0.0 0.0 ECU_ADDRESS 0x40003220 BYTE_ORDER MSB_FIRST /end MEASUREMENT
/begin COMPU_METHOD CU_IJT_MS_INJ1 "Conversion method for IJT_ms_Inj1" RAT_FUNC "%10.3" "ms" COEFFS 0.000000 1.000000 0.000000 0.000000 0.000000 1.000000 /end COMPU_METHOD
/* Scalar measurable for DDE 'IJT_ms_Inj2'. */
/begin MEASUREMENT IJT_ms_Inj2 "Displayable" FLOAT32_IEEE CU_IJT_MS_INJ2 1 100 0.0 0.0 ECU_ADDRESS 0x40003224 BYTE_ORDER MSB_FIRST /end MEASUREMENT
/begin COMPU_METHOD CU_IJT_MS_INJ2 "Conversion method for IJT_ms_Inj2" RAT_FUNC "%10.3" "ms" COEFFS 0.000000 1.000000 0.000000 0.000000 0.000000 1.000000 /end COMPU_METHOD
/* Scalar measurable for DDE 'IJT_ms_Inj3'. */
/begin MEASUREMENT IJT_ms_Inj3 "Displayable" FLOAT32_IEEE CU_IJT_MS_INJ3 1 100 0.0 0.0 ECU_ADDRESS 0x4000322c BYTE_ORDER MSB_FIRST /end MEASUREMENT
/begin COMPU_METHOD CU_IJT_MS_INJ3 "Conversion method for IJT_ms_Inj3" RAT_FUNC "%10.3" "ms" COEFFS 0.000000 1.000000 0.000000 0.000000 0.000000 1.000000 /end COMPU_METHOD
/* Scalar measurable for DDE 'IJT_ms_Inj4'. */
/begin MEASUREMENT IJT_ms_Inj4 "Displayable" FLOAT32_IEEE CU_IJT_MS_INJ4 1 100 0.0 0.0 ECU_ADDRESS 0x40003228 BYTE_ORDER MSB_FIRST /end MEASUREMENT
/begin COMPU_METHOD CU_IJT_MS_INJ4 "Conversion method for IJT_ms_Inj4" RAT_FUNC "%10.3" "ms" COEFFS 0.000000 1.000000 0.000000 0.000000 0.000000 1.000000 /end COMPU_METHOD
/* Scalar measurable for DDE 'IJT_ms_OpeningDelay'. */
/begin MEASUREMENT IJT_ms_OpeningDelay "Calculated Opening delay" FLOAT32_IEEE CU_IJT_MS_OPENINGDELAY 1 100 0.0 2.0 ECU_ADDRESS 0x40003328 BYTE_ORDER MSB_FIRST /end MEASUREMENT
/begin COMPU_METHOD CU_IJT_MS_OPENINGDELAY "Conversion method for IJT_ms_OpeningDelay" RAT_FUNC "%10.3" "ms" COEFFS 0.000000 1.000000 0.000000 0.000000 0.000000 1.000000 /end COMPU_METHOD
/* Scalar measurable for DDE 'IJT_ms_OpeningDelayInj1'. */
/begin MEASUREMENT IJT_ms_OpeningDelayInj1 "Displayable" FLOAT32_IEEE CU_IJT_MS_OPENINGDELAYINJ1 1 100 0.0 0.0 ECU_ADDRESS 0x4000321c BYTE_ORDER MSB_FIRST /end MEASUREMENT
/begin COMPU_METHOD CU_IJT_MS_OPENINGDELAYINJ1 "Conversion method for IJT_ms_OpeningDelayInj1" RAT_FUNC "%10.3" "ms" COEFFS 0.000000 1.000000 0.000000 0.000000 0.000000 1.000000 /end COMPU_METHOD
/* Scalar measurable for DDE 'IJT_ms_OpeningDelayInj2'. */
/begin MEASUREMENT IJT_ms_OpeningDelayInj2 "Displayable" FLOAT32_IEEE CU_IJT_MS_OPENINGDELAYINJ2 1 100 0.0 0.0 ECU_ADDRESS 0x40003218 BYTE_ORDER MSB_FIRST /end MEASUREMENT
/begin COMPU_METHOD CU_IJT_MS_OPENINGDELAYINJ2 "Conversion method for IJT_ms_OpeningDelayInj2" RAT_FUNC "%10.3" "ms" COEFFS 0.000000 1.000000 0.000000 0.000000 0.000000 1.000000 /end COMPU_METHOD
/* Scalar measurable for DDE 'IJT_ms_OpeningDelayInj3'. */
/begin MEASUREMENT IJT_ms_OpeningDelayInj3 "Displayable" FLOAT32_IEEE CU_IJT_MS_OPENINGDELAYINJ3 1 100 0.0 0.0 ECU_ADDRESS 0x40003214 BYTE_ORDER MSB_FIRST /end MEASUREMENT
/begin COMPU_METHOD CU_IJT_MS_OPENINGDELAYINJ3 "Conversion method for IJT_ms_OpeningDelayInj3" RAT_FUNC "%10.3" "ms" COEFFS 0.000000 1.000000 0.000000 0.000000 0.000000 1.000000 /end COMPU_METHOD
/* Scalar measurable for DDE 'IJT_ms_OpeningDelayInj4'. */
/begin MEASUREMENT IJT_ms_OpeningDelayInj4 "Displayable" FLOAT32_IEEE CU_IJT_MS_OPENINGDELAYINJ4 1 100 0.0 0.0 ECU_ADDRESS 0x40003210 BYTE_ORDER MSB_FIRST /end MEASUREMENT
/begin COMPU_METHOD CU_IJT_MS_OPENINGDELAYINJ4 "Conversion method for IJT_ms_OpeningDelayInj4" RAT_FUNC "%10.3" "ms" COEFFS 0.000000 1.000000 0.000000 0.000000 0.000000 1.000000 /end COMPU_METHOD
/* Scalar measurable for DDE 'IJT_ms_OverlapThrsh'. */
/begin MEASUREMENT IJT_ms_OverlapThrsh "If injector flow time exceeds this value consider it overlap" FLOAT32_IEEE CU_IJT_MS_OVERLAPTHRSH 1 100 0.0 0.0 ECU_ADDRESS 0x400032ec BYTE_ORDER MSB_FIRST /end MEASUREMENT
/begin COMPU_METHOD CU_IJT_MS_OVERLAPTHRSH "Conversion method for IJT_ms_OverlapThrsh" RAT_FUNC "%10.1" "ms" COEFFS 0.000000 1.000000 0.000000 0.000000 0.000000 1.000000 /end COMPU_METHOD
/* Scalar measurable for DDE 'IJT_pct_FuelTempCF'. */
/begin MEASUREMENT IJT_pct_FuelTempCF "Injection quantity fuel rail temperature compensation factor" FLOAT32_IEEE CU_IJT_PCT_FUELTEMPCF 1 100 0.0 0.0 ECU_ADDRESS 0x400032f8 BYTE_ORDER MSB_FIRST /end MEASUREMENT
/begin COMPU_METHOD CU_IJT_PCT_FUELTEMPCF "Conversion method for IJT_pct_FuelTempCF" RAT_FUNC "%10.2" "pct" COEFFS 0.000000 1.000000 0.000000 0.000000 0.000000 1.000000 /end COMPU_METHOD
/* Scalar measurable for DDE 'IJT_s_Slack'. */
/begin MEASUREMENT IJT_s_Slack "Displayable" FLOAT32_IEEE CU_IJT_S_SLACK 1 100 0.0 0.0 ECU_ADDRESS 0x40003314 BYTE_ORDER MSB_FIRST /end MEASUREMENT
/begin COMPU_METHOD CU_IJT_S_SLACK "Conversion method for IJT_s_Slack" RAT_FUNC "%10.3" "s" COEFFS 0.000000 1.000000 0.000000 0.000000 0.000000 1.000000 /end COMPU_METHOD
/* Scalar measurable for DDE 'exd_NU_awlstatus'. */
/begin MEASUREMENT exd_NU_awlstatus "(not defined)" FLOAT32_IEEE CU_EXD_NU_AWLSTATUS 1 100 0.0 3.0 ECU_ADDRESS 0x40003680 BYTE_ORDER MSB_FIRST /end MEASUREMENT
/begin COMPU_METHOD CU_EXD_NU_AWLSTATUS "Conversion method for exd_NU_awlstatus" RAT_FUNC "%10.0" "NU" COEFFS 0.000000 1.000000 0.000000 0.000000 0.000000 1.000000 /end COMPU_METHOD
/* Scalar measurable for DDE 'exd_NU_milstatus'. */
/begin MEASUREMENT exd_NU_milstatus "(not defined)" FLOAT32_IEEE CU_EXD_NU_MILSTATUS 1 100 0.0 3.0 ECU_ADDRESS 0x40003688 BYTE_ORDER MSB_FIRST /end MEASUREMENT
/begin COMPU_METHOD CU_EXD_NU_MILSTATUS "Conversion method for exd_NU_milstatus" RAT_FUNC "%10.0" "NU" COEFFS 0.000000 1.000000 0.000000 0.000000 0.000000 1.000000 /end COMPU_METHOD
/* Scalar measurable for DDE 'exd_NU_prlstatus'. */
/begin MEASUREMENT exd_NU_prlstatus "(not defined)" FLOAT32_IEEE CU_EXD_NU_PRLSTATUS 1 100 0.0 3.0 ECU_ADDRESS 0x4000367c BYTE_ORDER MSB_FIRST /end MEASUREMENT
/begin COMPU_METHOD CU_EXD_NU_PRLSTATUS "Conversion method for exd_NU_prlstatus" RAT_FUNC "%10.0" "NU" COEFFS 0.000000 1.000000 0.000000 0.000000 0.000000 1.000000 /end COMPU_METHOD
/* Scalar measurable for DDE 'exd_NU_rslstatus'. */
/begin MEASUREMENT exd_NU_rslstatus "(not defined)" FLOAT32_IEEE CU_EXD_NU_RSLSTATUS 1 100 0.0 3.0 ECU_ADDRESS 0x40003684 BYTE_ORDER MSB_FIRST /end MEASUREMENT
/begin COMPU_METHOD CU_EXD_NU_RSLSTATUS "Conversion method for exd_NU_rslstatus" RAT_FUNC "%10.0" "NU" COEFFS 0.000000 1.000000 0.000000 0.000000 0.000000 1.000000 /end COMPU_METHOD
/* Scalar measurable for DDE 'exd_b_DM11cleared'. */
/begin MEASUREMENT exd_b_DM11cleared "Override flag" UBYTE CU_EXD_B_DM11CLEARED 1 100 0.0 1.0 ECU_ADDRESS 0x40002f2d BYTE_ORDER MSB_FIRST /end MEASUREMENT
/begin COMPU_METHOD CU_EXD_B_DM11CLEARED "Conversion method for exd_b_DM11cleared" RAT_FUNC "%10.0" "b" COEFFS 0.000000 1.000000 0.000000 0.000000 0.000000 1.000000 /end COMPU_METHOD
/* Scalar measurable for DDE 'exd_b_DTCscleared'. */
/begin MEASUREMENT exd_b_DTCscleared "Override flag" UBYTE CU_EXD_B_DTCSCLEARED 1 100 0.0 1.0 ECU_ADDRESS 0x4000368c BYTE_ORDER MSB_FIRST /end MEASUREMENT
/begin COMPU_METHOD CU_EXD_B_DTCSCLEARED "Conversion method for exd_b_DTCscleared" RAT_FUNC "%10.0" "b" COEFFS 0.000000 1.000000 0.000000 0.000000 0.000000 1.000000 /end COMPU_METHOD
/* Scalar measurable for DDE 'ext_NU_activmode'. */
/begin MEASUREMENT ext_NU_activmode "(not defined)" FLOAT32_IEEE CU_EXT_NU_ACTIVMODE 1 100 0.0 3.0 ECU_ADDRESS 0x40003012 BYTE_ORDER MSB_FIRST /end MEASUREMENT
/begin COMPU_METHOD CU_EXT_NU_ACTIVMODE "Conversion method for ext_NU_activmode" RAT_FUNC "%10.0" "NU" COEFFS 0.000000 1.000000 0.000000 0.000000 0.000000 1.000000 /end COMPU_METHOD
/* Scalar measurable for DDE 'ext_NU_b1constinuous'. */
/begin MEASUREMENT ext_NU_b1constinuous "(not defined)" FLOAT32_IEEE CU_EXT_NU_B1CONSTINUOUS 1 100 0.0 4294967295.0 ECU_ADDRESS 0x40003048 BYTE_ORDER MSB_FIRST /end MEASUREMENT
/begin COMPU_METHOD CU_EXT_NU_B1CONSTINUOUS "Conversion method for ext_NU_b1constinuous" RAT_FUNC "%10.1" "NU" COEFFS 0.000000 1.000000 0.000000 0.000000 0.000000 1.000000 /end COMPU_METHOD
/* Scalar measurable for DDE 'ext_NU_b1cumulative'. */
/begin MEASUREMENT ext_NU_b1cumulative "(not defined)" FLOAT32_IEEE CU_EXT_NU_B1CUMULATIVE 1 100 0.0 4294967295.0 ECU_ADDRESS 0x4000304c BYTE_ORDER MSB_FIRST /end MEASUREMENT
/begin COMPU_METHOD CU_EXT_NU_B1CUMULATIVE "Conversion method for ext_NU_b1cumulative" RAT_FUNC "%10.1" "NU" COEFFS 0.000000 1.000000 0.000000 0.000000 0.000000 1.000000 /end COMPU_METHOD
/* Scalar measurable for DDE 'ext_NU_milcumulative'. */
/begin MEASUREMENT ext_NU_milcumulative "(not defined)" FLOAT32_IEEE CU_EXT_NU_MILCUMULATIVE 1 100 0.0 4294967295.0 ECU_ADDRESS 0x40003050 BYTE_ORDER MSB_FIRST /end MEASUREMENT
/begin COMPU_METHOD CU_EXT_NU_MILCUMULATIVE "Conversion method for ext_NU_milcumulative" RAT_FUNC "%10.1" "NU" COEFFS 0.000000 1.000000 0.000000 0.000000 0.000000 1.000000 /end COMPU_METHOD
/begin FUNCTION dtc "Group /ByDataDictionaryPrefix/dtc"
 /begin LOC_MEASUREMENT DTC_NU_KNKButaneThr DTC_NU_TestTime DTC_b_1_boostOC DTC_b_1_lsol DTC_b_1_sb DTC_b_1_sg DTC_b_2_boostOC DTC_b_2_lsol DTC_b_2_sb DTC_b_2_sg DTC_b_3_boostOC DTC_b_3_lsol DTC_b_3_sb DTC_b_3_sg DTC_b_4_boostOC DTC_b_4_lsol DTC_b_4_sb DTC_b_4_sg DTC_b_APP1_NonValidVoltage DTC_b_APP2_NonValidVoltage DTC_b_APP_CorrFLT DTC_b_Air_HTemp DTC_b_Air_TempHV DTC_b_Air_TempLV DTC_b_BARO_ErraticValue DTC_b_BARO_PressHVoltage DTC_b_BARO_PressLVoltage DTC_b_BAT_VoltageOutofRange DTC_b_CataCounting DTC_b_Catalyst_A DTC_b_CompIAT_HTemp DTC_b_CompIAT_TempHV DTC_b_CompIAT_TempLV DTC_b_DM11Force DTC_b_DM37request DTC_b_DiagCataTemp_ena DTC_b_DiagCata_Condition DTC_b_DiagCata_Reset DTC_b_DiagCata_Set DTC_b_DiagCata_TestEnd DTC_b_ECT_HTemp DTC_b_ECT_LTemp DTC_b_ECT_TempHVoltage DTC_b_ECT_TempLVoltage DTC_b_EGT_TempHV DTC_b_EGT_TempLV DTC_b_ETC_MotorFLT DTC_b_EcuMemFault DTC_b_EnableMIsfire DTC_b_Exhaust_HTemp DTC_b_FAP_Disconected DTC_b_FAP_HPress DTC_b_FalloCamShaft DTC_b_FalloCramShaft DTC_b_GLP1_HVoltage DTC_b_GLP2_HVoltage DTC_b_GLP_HPress DTC_b_GLP_HTemp DTC_b_GLP_LPress DTC_b_GLP_LTemp DTC_b_GLP_OL DTC_b_GLP_TempHVoltage DTC_b_GLP_TempLVoltage DTC_b_HeatersA_OL DTC_b_HeatersA_SB DTC_b_HeatersA_SG DTC_b_KNOCK_Cyl1 DTC_b_KNOCK_Cyl2 DTC_b_KNOCK_Cyl3 DTC_b_KNOCK_Cyl4 DTC_b_LB11CTFail DTC_b_LB12OL DTC_b_LB12SB DTC_b_LambdaA_SB DTC_b_LambdaA_SG DTC_b_LambdaB11NOTValid DTC_b_MAPAfterThInfraPress DTC_b_MAPAfterThOverPress DTC_b_MAPAfterThr_LV DTC_b_MAPAftrThr_HV DTC_b_MAPBefThroHV DTC_b_MAPBefThroOL DTC_b_MAPBeforeThroHPress DTC_b_MAPBeforeThroLPress DTC_b_Misfire_Bancada DTC_b_Misfire_Cylinder_1 DTC_b_Misfire_Cylinder_2 DTC_b_Misfire_Cylinder_3 DTC_b_Misfire_Cylinder_4 DTC_b_NBValid DTC_b_OIL_LPress DTC_b_OIL_Sensor DTC_b_OIL_SensorOL DTC_b_Readiness DTC_b_ShutOffValveEngine_OL DTC_b_ShutOffValveEngine_SG DTC_b_Supply_VRefA DTC_b_Supply_VRefB DTC_b_Supply_VRefC DTC_b_Supply_VRefD DTC_b_THR_Motor_Fail DTC_b_TP1_SensorHV DTC_b_TP1_SensorLV DTC_b_TP2_SensorHV DTC_b_TP2_SensorLV DTC_b_TP_CorrFLT DTC_b_TurboError DTC_s_BegasTime DTC_s_TimerOut_1 DTC_s_TimerOut_2 /end LOC_MEASUREMENT
 /begin REF_CHARACTERISTIC DTCc_C_DiagCata_MaxEGT DTCc_C_DiagCata_MinEGT DTCc_NU_CatalystTimeThreshold DTCc_NU_DC DTCc_NU_KNKButaneAlarm DTCc_NU_KNKButaneThr DTCc_NU_Seconds DTCc_NU_TestTime DTCc_NU_TimeRichLean DTCc_RPM_EntryThrshMisf DTCc_b_1_boostOC DTCc_b_1_lsol DTCc_b_1_sb DTCc_b_1_sg DTCc_b_2_boostOC DTCc_b_2_lsol DTCc_b_2_sb DTCc_b_2_sg DTCc_b_3_boostOC DTCc_b_3_lsol DTCc_b_3_sb DTCc_b_3_sg DTCc_b_4_boostOC DTCc_b_4_lsol DTCc_b_4_sb DTCc_b_4_sg DTCc_b_APP1_NonValidVoltage DTCc_b_APP2_NonValidVoltage DTCc_b_APP_CorrFLT DTCc_b_Air_HTemp DTCc_b_Air_TempHV DTCc_b_Air_TempLV DTCc_b_BARO_ErraticValue DTCc_b_BARO_PressHVoltage DTCc_b_BARO_PressLVoltage DTCc_b_BAT_VoltageOutofRange DTCc_b_CataCounting DTCc_b_Catalyst_A DTCc_b_CompIAT_HTemp DTCc_b_CompIAT_TempHV DTCc_b_CompIAT_TempLV DTCc_b_DM11Force DTCc_b_DiagCata_TestEnd DTCc_b_ECT_HTemp DTCc_b_ECT_LTemp DTCc_b_ECT_TempHVoltage DTCc_b_ECT_TempLVoltage DTCc_b_EGT_TempHV DTCc_b_EGT_TempLV DTCc_b_ETC_MotorFLT DTCc_b_EcuMemFault DTCc_b_EnableMIsfire DTCc_b_Exhaust_HTemp DTCc_b_FAP_Disconected DTCc_b_FAP_HPress DTCc_b_FalloCamShaft DTCc_b_FalloCramShaft DTCc_b_GLP1_HVoltage DTCc_b_GLP2_HVoltage DTCc_b_GLP_HPress DTCc_b_GLP_HTemp DTCc_b_GLP_LPress DTCc_b_GLP_LTemp DTCc_b_GLP_OL DTCc_b_GLP_TempHVoltage DTCc_b_GLP_TempLVoltage DTCc_b_HeatersA_OL DTCc_b_HeatersA_SB DTCc_b_HeatersA_SG DTCc_b_KNOCK_Cyl1 DTCc_b_KNOCK_Cyl2 DTCc_b_KNOCK_Cyl3 DTCc_b_KNOCK_Cyl4 DTCc_b_LB11CTFail DTCc_b_LB12OL DTCc_b_LB12SB DTCc_b_LambdaA_SB DTCc_b_LambdaA_SG DTCc_b_LambdaB11NOTValid DTCc_b_MAPAfterThInfraPress DTCc_b_MAPAfterThOverPress DTCc_b_MAPAfterThr_LV DTCc_b_MAPAftrThr_HV DTCc_b_MAPBefThroHV DTCc_b_MAPBefThroOL DTCc_b_MAPBeforeThroHPress DTCc_b_MAPBeforeThroLPress DTCc_b_Misfire_Bancada DTCc_b_Misfire_Cylinder_1 DTCc_b_Misfire_Cylinder_2 DTCc_b_Misfire_Cylinder_3 DTCc_b_Misfire_Cylinder_4 DTCc_b_NBValid DTCc_b_OIL_LPress DTCc_b_OIL_Sensor DTCc_b_OIL_SensorOL DTCc_b_Readiness DTCc_b_ResetKnockCounters DTCc_b_ResetNVM DTCc_b_ShutOffValveEngine_OL DTCc_b_ShutOffValveEngine_SG DTCc_b_Supply_VRefA DTCc_b_Supply_VRefB DTCc_b_Supply_VRefC DTCc_b_Supply_VRefD DTCc_b_THR_Motor_Fail DTCc_b_TP1_SensorHV DTCc_b_TP1_SensorLV DTCc_b_TP2_SensorHV DTCc_b_TP2_SensorLV DTCc_b_TP_CorrFLT DTCc_b_TurboError DTCc_cnt_KnockHIT DTCc_o_1_boostOC DTCc_o_1_lsol DTCc_o_1_sb DTCc_o_1_sg DTCc_o_2_boostOC DTCc_o_2_lsol DTCc_o_2_sb DTCc_o_2_sg DTCc_o_3_boostOC DTCc_o_3_lsol DTCc_o_3_sb DTCc_o_3_sg DTCc_o_4_boostOC DTCc_o_4_lsol DTCc_o_4_sb DTCc_o_4_sg DTCc_o_APP1_NonValidVoltage DTCc_o_APP2_NonValidVoltage DTCc_o_APP_CorrFLT DTCc_o_Air_HTemp DTCc_o_Air_TempHV DTCc_o_Air_TempLV DTCc_o_BARO_ErraticValue DTCc_o_BARO_PressHVoltage DTCc_o_BARO_PressLVoltage DTCc_o_BAT_VoltageOutofRange DTCc_o_BegasTime DTCc_o_CataCounting DTCc_o_Catalyst_A DTCc_o_CompIAT_HTemp DTCc_o_CompIAT_TempHV DTCc_o_CompIAT_TempLV DTCc_o_DM11Force DTCc_o_DiagCata_TestEnd DTCc_o_ECT_HTemp DTCc_o_ECT_LTemp DTCc_o_ECT_TempHVoltage DTCc_o_ECT_TempLVoltage DTCc_o_EGT_TempHV DTCc_o_EGT_TempLV DTCc_o_ETC_MotorFLT DTCc_o_EcuMemFault DTCc_o_EnableMIsfire DTCc_o_Exhaust_HTemp DTCc_o_FAP_Disconected DTCc_o_FAP_HPress DTCc_o_FalloCamShaft DTCc_o_FalloCramShaft DTCc_o_GLP1_HVoltage DTCc_o_GLP2_HVoltage DTCc_o_GLP_HPress DTCc_o_GLP_HTemp DTCc_o_GLP_LPress DTCc_o_GLP_LTemp DTCc_o_GLP_OL DTCc_o_GLP_TempHVoltage DTCc_o_GLP_TempLVoltage DTCc_o_HeatersA_OL DTCc_o_HeatersA_SB DTCc_o_HeatersA_SG DTCc_o_KNKButaneThr DTCc_o_KNOCK_Cyl1 DTCc_o_KNOCK_Cyl2 DTCc_o_KNOCK_Cyl3 DTCc_o_KNOCK_Cyl4 DTCc_o_LB11CTFail DTCc_o_LB12OL DTCc_o_LB12SB DTCc_o_LambdaA_SB DTCc_o_LambdaA_SG DTCc_o_LambdaB11NOTValid DTCc_o_MAPAfterThInfraPress DTCc_o_MAPAfterThOverPress DTCc_o_MAPAfterThr_LV DTCc_o_MAPAftrThr_HV DTCc_o_MAPBefThroHV DTCc_o_MAPBefThroOL DTCc_o_MAPBeforeThroHPress DTCc_o_MAPBeforeThroLPress DTCc_o_Misfire_Bancada DTCc_o_Misfire_Cylinder_1 DTCc_o_Misfire_Cylinder_2 DTCc_o_Misfire_Cylinder_3 DTCc_o_Misfire_Cylinder_4 DTCc_o_NBValid DTCc_o_OIL_LPress DTCc_o_OIL_Sensor DTCc_o_OIL_SensorOL DTCc_o_Readiness DTCc_o_ShutOffValveEngine_OL DTCc_o_ShutOffValveEngine_SG DTCc_o_Supply_VRefA DTCc_o_Supply_VRefB DTCc_o_Supply_VRefC DTCc_o_Supply_VRefD DTCc_o_THR_Motor_Fail DTCc_o_TP1_SensorHV DTCc_o_TP1_SensorLV DTCc_o_TP2_SensorHV DTCc_o_TP2_SensorLV DTCc_o_TP_CorrFLT DTCc_o_TestTime DTCc_o_TurboError DTCc_s_BegasTime DTCc_s_DiagCataActv_IdlDelay DTCc_s_DiagCata_RstDelay DTCc_s_ResetKnockPeriodic DTCm_NU_TherMisfire_x DTCm_NU_TherMisfire_y DTCm_NU_TherMisfire_z DTCv_NU_CALID DTCv_NU_ESN DTCv_NU_VIN /end REF_CHARACTERISTIC
/end FUNCTION
/begin FUNCTION efp "Group /ByDataDictionaryPrefix/efp"
 /begin LOC_MEASUREMENT EFP_NU_FuelPumpErrROC EFP_b_FuelPumpDC EFP_b_NotStalled EFP_b_RunFuelPump EFP_bar_PressErr EFP_pct_FuelPumpDC_PID EFP_pct_FuelPumpDTerm EFP_pct_FuelPumpITerm EFP_pct_FuelPumpPIDRaw EFP_pct_FuelPumpPTerm /end LOC_MEASUREMENT
 /begin REF_CHARACTERISTIC EFPc_NU_FuelPumpDGain EFPc_NU_FuelPumpErrROCThrsh EFPc_NU_FuelPumpIGain EFPc_NU_FuelPumpPGain EFPc_b_FuelPumpDC EFPc_b_FuelPumpResetITerm EFPc_b_NotStalled EFPc_b_RunFuelPump EFPc_bar_FRP_Trgt EFPc_bar_FuelPressMax EFPc_bar_FuelPressMin EFPc_bar_FuelPumpDbndLatchI EFPc_o_FuelPumpDC EFPc_o_NotStalled EFPc_o_RunFuelPump EFPc_pct_FuelPumpITermMax EFPc_pct_FuelPumpITermMin EFPc_pct_FuelPumpPID_Dbnd EFPc_pct_FuelPumpPID_Max EFPc_pct_FuelPumpPID_Min EFPm_NU_FuelPumpDC_FF_x EFPm_NU_FuelPumpDC_FF_y EFPm_NU_FuelPumpDC_FF_z /end REF_CHARACTERISTIC
/end FUNCTION
/begin FUNCTION elm "Group /ByDataDictionaryPrefix/elm"
 /begin LOC_MEASUREMENT ELM_Nm_AlternatorTq ELM_Nm_FrictionTq ELM_Nm_HVAC_Tq ELM_Nm_PwrStrTq ELM_Nm_Tq ELM_Nm_ZFFAN_Tq /end LOC_MEASUREMENT
 /begin REF_CHARACTERISTIC ELMc_Nm_AlternatorTq ELMc_Nm_Tq ELMc_o_AlternatorTq ELMc_o_Tq ELMm_NU_Alternator_Tq_x ELMm_NU_Alternator_Tq_z ELMm_NU_FrictionTq_x ELMm_NU_FrictionTq_y ELMm_NU_FrictionTq_z ELMm_NU_HVAC_Tq_x ELMm_NU_HVAC_Tq_z ELMm_NU_PwrStrTq_x ELMm_NU_PwrStrTq_z ELMm_NU_ZFFAN_Tq_x ELMm_NU_ZFFAN_Tq_z /end REF_CHARACTERISTIC
/end FUNCTION
/begin FUNCTION erl "Group /ByDataDictionaryPrefix/erl"
 /begin LOC_MEASUREMENT ERL_RPM_HardLim ERL_RPM_Overspd ERL_b_Active ERL_b_CutFuel ERL_b_CutSpark ERL_b_HardLimReached ERL_pct_PTerm ERL_pct_TqMult ERL_ret_SparkRetard /end LOC_MEASUREMENT
 /begin REF_CHARACTERISTIC ERLc_NU_PGain ERLc_RPM_HardLimOfst ERLc_RPM_SoftLim ERLc_b_Active ERLc_b_CutFuel ERLc_b_CutSpark ERLc_o_Active ERLc_o_CutFuel ERLc_o_CutSpark ERLc_o_SparkRetard ERLc_o_TqMult ERLc_pct_HardLim ERLc_pct_TqMult ERLc_ret_SparkRetard ERLm_NU_SparkRetard_x ERLm_NU_SparkRetard_z /end REF_CHARACTERISTIC
/end FUNCTION
/begin FUNCTION erm "Group /ByDataDictionaryPrefix/erm" /begin LOC_MEASUREMENT ERM_e_RunningMode ERM_s_TimeSinceStart /end LOC_MEASUREMENT
 /begin REF_CHARACTERISTIC ERMc_RPM_EnterCranking ERMc_RPM_EnterRunning ERMc_RPM_ExitCranking ERMc_RPM_ExitRunning ERMc_e_RunningMode ERMc_o_RunningMode ERMc_o_TimeSinceStart ERMc_s_TimeSinceStart /end REF_CHARACTERISTIC
/end FUNCTION
/begin FUNCTION etc "Group /ByDataDictionaryPrefix/etc"
 /begin LOC_MEASUREMENT ETC_NU_DTerm ETC_NU_Error_Int ETC_NU_ITerm ETC_NU_PTerm ETC_NU_TP1_FullPos ETC_NU_TP1_Slow ETC_NU_TP1_ZeroPos ETC_NU_TP2_FullPos ETC_NU_TP2_Slow ETC_NU_TP2_ZeroPos ETC_NU_TPRate ETC_NU_TP_Dot ETC_b_AuthorityReduced ETC_b_CloseComplete ETC_b_Expired ETC_b_ForceClosed ETC_b_ForceOpen ETC_b_LearnReady ETC_b_LearnRest ETC_b_LearnSequenceFailed ETC_b_LearnSequenceSuccess ETC_b_OpenComplete ETC_b_RangeCheckFailed ETC_b_RestPosOOR ETC_b_Stable ETC_b_StoppedClosing ETC_b_StoppedOpening ETC_b_TP1_FullPosOOR ETC_b_TP1_LearnFull ETC_b_TP1_LearnZero ETC_b_TP1_ZeroPosOOR ETC_b_TP2_FullPosOOR ETC_b_TP2_LearnFull ETC_b_TP2_LearnZero ETC_b_TP2_ZeroPosOOR ETC_b_TP_CorrFlt ETC_deg_Error ETC_deg_RelativeThRqst ETC_deg_RestPos ETC_deg_ThRqstFiltd ETC_deg_ThRqstHPF ETC_deg_VlvPos ETC_pct_AvgTP ETC_pct_Effort ETC_pct_FB ETC_pct_FF ETC_pct_Hyst ETC_pct_Kick ETC_pct_Kick_error ETC_pct_MotorCmd ETC_pct_MotorCmdVb ETC_pct_TP1 ETC_pct_TP2 ETC_pct_TP_Delta /end LOC_MEASUREMENT
 /begin REF_CHARACTERISTIC ETCc_Hz_TP1_LPF ETCc_Hz_TP2_LPF ETCc_NU_FallRate ETCc_NU_FullLearnDfltTP1 ETCc_NU_FullLearnDfltTP2 ETCc_NU_FullLearnHiLimTP1 ETCc_NU_FullLearnHiLimTP2 ETCc_NU_FullLearnLoLimTP1 ETCc_NU_FullLearnLoLimTP2 ETCc_NU_Int_thd ETCc_NU_KickHPF_Tc ETCc_NU_KickHPF_Thrsh ETCc_NU_LFallRate ETCc_NU_LRiseRate ETCc_NU_RiseRate ETCc_NU_TP1_FullPos ETCc_NU_TP1_ZeroPos ETCc_NU_TP2_FullPos ETCc_NU_TP2_ZeroPos ETCc_NU_TP_DotThrsh ETCc_NU_TP_FallRateThrsh ETCc_NU_TP_RiseRateThrsh ETCc_NU_ZeroLearnDfltTP1 ETCc_NU_ZeroLearnDfltTP2 ETCc_NU_ZeroLearnHiLimTP1 ETCc_NU_ZeroLearnHiLimTP2 ETCc_NU_ZeroLearnLoLimTP1 ETCc_NU_ZeroLearnLoLimTP2 ETCc_b_AW_Enbl ETCc_b_AuthorityReduced ETCc_b_HystAxisStrategy ETCc_b_HystStrategy ETCc_b_ManualRangeRetry ETCc_b_RangeLearnEnbl ETCc_b_ResetNVM ETCc_b_RestDuringCranking ETCc_b_RestWhenStopped ETCc_b_TP1_Inverted ETCc_b_TP2_Inverted ETCc_b_UseCrankingPos ETCc_b_UsePedalDirectly ETCc_deg_AW_Thrsh ETCc_deg_ControlClosedCmd ETCc_deg_ControlOpenCmd ETCc_deg_FreezeITermDbnd ETCc_deg_FullClosed ETCc_deg_FullClosedErrorThrsh ETCc_deg_FullOpen ETCc_deg_FullOpenErrorThrsh ETCc_deg_Reset_thd ETCc_deg_RestLearnDflt ETCc_deg_RestMax ETCc_deg_RestMin ETCc_deg_RestPos ETCc_deg_RestPosITermDbnd ETCc_deg_RestPosThrsh ETCc_deg_ThRqstFiltd ETCc_o_AuthorityReduced ETCc_o_AvgTP ETCc_o_FB ETCc_o_MotorCmd ETCc_o_MotorCmdVb ETCc_o_RestPos ETCc_o_TP1_FullPos ETCc_o_TP1_ZeroPos ETCc_o_TP2_FullPos ETCc_o_TP2_ZeroPos ETCc_o_ThRqstFiltd ETCc_pct_AvgTP ETCc_pct_ContinuousDutyMax ETCc_pct_ContinuousDutyMin ETCc_pct_DMax ETCc_pct_DMin ETCc_pct_EMax ETCc_pct_EMin ETCc_pct_FB ETCc_pct_FB_Dbnd ETCc_pct_FB_Max ETCc_pct_FB_Min ETCc_pct_ForceClosedCmd ETCc_pct_ForceOpenCmd ETCc_pct_IMax ETCc_pct_IMin ETCc_pct_KickDuty ETCc_pct_Kick_Error ETCc_pct_MotorCmd ETCc_pct_MotorCmdVb ETCc_pct_TP_DeltaMax ETCc_s_ContinuousDutyDbnc ETCc_s_KickSignDbnc ETCc_s_Kick_hold ETCc_s_PowerupDelay ETCc_s_RangeCheckExpire ETCc_s_RestCrankingExpiration ETCc_s_TP_FallDelay ETCc_s_TP_FltDbnc ETCc_s_TP_RiseDelay ETCc_s_TP_StableDelay ETCca_NU_FullLearnDfltTP1 ETCca_NU_FullLearnDfltTP2 ETCca_NU_ZeroLearnDfltTP1 ETCca_NU_ZeroLearnDfltTP2 ETCca_deg_RestLearnDflt ETCm_NU_DGain_x ETCm_NU_DGain_y ETCm_NU_DGain_z ETCm_NU_DutyCycle_x ETCm_NU_DutyCycle_z ETCm_NU_FF_x ETCm_NU_FF_y ETCm_NU_FF_z ETCm_NU_Hyst_x ETCm_NU_Hyst_y ETCm_NU_Hyst_z ETCm_NU_IGain_x ETCm_NU_IGain_y ETCm_NU_IGain_z ETCm_NU_IRest_x ETCm_NU_IRest_y ETCm_NU_IRest_z ETCm_NU_PGain_x ETCm_NU_PGain_y ETCm_NU_PGain_z ETCm_NU_PRest_x ETCm_NU_PRest_y ETCm_NU_PRest_z ETCm_NU_VbCorr_x ETCm_NU_VbCorr_z ETCm_deg_CrankAmbTemp_x ETCm_deg_CrankAmbTemp_z /end REF_CHARACTERISTIC
/end FUNCTION
/begin FUNCTION exd "Group /ByDataDictionaryPrefix/exd"
 /begin LOC_MEASUREMENT exd_NU_awlstatus exd_NU_milstatus exd_NU_prlstatus exd_NU_rslstatus exd_b_DM11cleared exd_b_DTCscleared /end LOC_MEASUREMENT
 /begin REF_CHARACTERISTIC exdc_clear_unconditionally exdc_dm5c_obd_compliance exdv_ff_spn_set_d /end REF_CHARACTERISTIC
/end FUNCTION
/begin FUNCTION ext "Group /ByDataDictionaryPrefix/ext"
 /begin LOC_MEASUREMENT ext_NU_activmode ext_NU_b1constinuous ext_NU_b1cumulative ext_NU_milcumulative /end LOC_MEASUREMENT
/end FUNCTION
/begin FUNCTION fca "Group /ByDataDictionaryPrefix/fca"
 /begin LOC_MEASUREMENT FCA_Km_AcumDistance FCA_L_AcumFuelComsuption FCA_L_TotalFuelFlow FCA_kps_VhSpd FCA_lpk_AverageFuelConsumption /end LOC_MEASUREMENT
 /begin REF_CHARACTERISTIC FCAc_L_AcumFuelConsumption FCAc_b_ResetFuelAcum FCAc_b_ResetKmAcum FCAc_km_AcumDistance FCAc_lpk_AverageFuelConsumption FCAc_o_AverageFuelConsumption FCAca_L_AcumFuelConsumption FCAca_km_AcumDistance /end REF_CHARACTERISTIC
/end FUNCTION
/begin FUNCTION flt "Group /ByDataDictionaryPrefix/flt"
 /begin LOC_MEASUREMENT FLT_NU_APP1 FLT_NU_APP2 FLT_NU_BrkSw FLT_NU_CAN_CCVS FLT_NU_CamPhaser FLT_NU_CoolantTemp FLT_NU_ECU FLT_NU_EGO11 FLT_NU_EGO12 FLT_NU_EGO21 FLT_NU_EGO22 FLT_NU_ETC FLT_NU_FCV FLT_NU_HighLevel1 FLT_NU_HighLevel2 FLT_NU_Inj1 FLT_NU_Inj2 FLT_NU_Inj3 FLT_NU_Inj4 FLT_NU_Inj5 FLT_NU_Inj6 FLT_NU_Inj7 FLT_NU_Inj8 FLT_NU_MAF FLT_NU_OilTemp FLT_NU_PSU FLT_NU_PurgeVlv FLT_NU_Spk1 FLT_NU_Spk2 FLT_NU_Spk3 FLT_NU_Spk4 FLT_NU_Spk5 FLT_NU_Spk6 FLT_NU_Spk7 FLT_NU_Spk8 FLT_NU_TP1 FLT_NU_TP2 FLT_NU_TurCtrl FLT_NU_UEGO1 FLT_NU_UEGO2 FLT_NU_VCP FLT_NU_VRef FLT_b_EH_Open_A FLT_b_EH_Open_B FLT_b_EH_ShrtGrnd_A FLT_b_EH_ShrtGrnd_B FLT_b_EH_ShrtVBatt_A FLT_b_EH_ShrtVBatt_B FLT_b_HtrPWM_NoResponse_A FLT_b_HtrPWM_NoResponse_B FLT_b_IaIp_ShrtGrnd_A FLT_b_IaIp_ShrtGrnd_B FLT_b_IaIp_ShrtVBatt_A FLT_b_IaIp_ShrtVBatt_B FLT_b_SpiCtrl_A FLT_b_SpiCtrl_B FLT_b_UA_OORHi_A FLT_b_UA_OORHi_B FLT_b_UA_OORLo_A FLT_b_UA_OORLo_B FLT_b_UR_OORHi_A FLT_b_UR_OORHi_B FLT_b_UR_OORLo_A FLT_b_UR_OORLo_B FLT_b_Un_Open_A FLT_b_Un_Open_B FLT_b_Un_ShrtGrnd_A FLT_b_Un_ShrtGrnd_B FLT_b_Un_ShrtVBatt_A FLT_b_Un_ShrtVBatt_B FLT_b_Vm_Open_B FLT_b_Vm_ShrtGrnd_A FLT_b_Vm_ShrtGrnd_B FLT_b_Vm_ShrtVBatt_A FLT_b_Vm_ShrtVBatt_B /end LOC_MEASUREMENT
/end FUNCTION
/begin FUNCTION fmg "Group /ByDataDictionaryPrefix/fmg" /begin LOC_MEASUREMENT FMG_e_FltReset /end LOC_MEASUREMENT /begin REF_CHARACTERISTIC FMGc_b_ForceFltReset FMGc_e_FltReset FMGc_o_FltReset /end REF_CHARACTERISTIC /end FUNCTION
/begin FUNCTION frp "Group /ByDataDictionaryPrefix/frp" /begin REF_CHARACTERISTIC FRPm_NU_DutyCycle_x FRPm_NU_DutyCycle_z /end REF_CHARACTERISTIC /end FUNCTION
/begin FUNCTION hht "Group /ByDataDictionaryPrefix/hht"
 /begin LOC_MEASUREMENT HHT_pct_EGO11_HeaterDuty HHT_pct_EGO12_HeaterDuty HHT_pct_EGO21_HeaterDuty HHT_pct_EGO22_HeaterDuty /end LOC_MEASUREMENT
 /begin REF_CHARACTERISTIC HHTc_o_EGO11_HeaterDuty HHTc_o_EGO12_HeaterDuty HHTc_o_EGO21_HeaterDuty HHTc_o_EGO22_HeaterDuty HHTc_pct_EGO11_HeaterDuty HHTc_pct_EGO12_HeaterDuty HHTc_pct_EGO21_HeaterDuty HHTc_pct_EGO22_HeaterDuty HHTc_pct_RunningDuty HHTc_pct_WarmupDuty HHTc_s_Warmup /end REF_CHARACTERISTIC
/end FUNCTION
/begin FUNCTION hrw "Group /ByDataDictionaryPrefix/hrw" /begin REF_CHARACTERISTIC HRWc_NU_VehSpeed_Gain HRWc_NU_VehSpeed_Ofst /end REF_CHARACTERISTIC /end FUNCTION
/begin FUNCTION htr "Group /ByDataDictionaryPrefix/htr"
 /begin LOC_MEASUREMENT HTR_C_SensorTemperature_A HTR_C_SensorTemperature_B HTR_NU_SysVoltCompCL HTR_NU_SysVoltCompCL_B HTR_NU_SysVoltCompOL HTR_NU_SysVoltCompOL_B HTR_b_ClosedLoopActv_A HTR_b_ClosedLoopActv_B HTR_b_FaultBasedHeaterLimit_A HTR_b_FaultBasedHeaterLimit_B HTR_b_HeaterEnabled_A HTR_b_HeaterEnabled_B HTR_b_OpenLoopActv_A HTR_b_OpenLoopActv_B HTR_b_OpenLoopReset_A HTR_b_OpenLoopReset_B HTR_b_OpenLoopSet_A HTR_b_OpenLoopSet_B HTR_b_WaterCondensActv_A HTR_b_WaterCondensActv_B HTR_e_RefCurrEnum_A HTR_e_RefCurrEnum_B HTR_pct_ClosedLoopPWMCmd_A HTR_pct_ClosedLoopPWMCmd_B HTR_pct_FinalPWMCmd_A HTR_pct_FinalPWMCmd_B HTR_pct_OpenLoopPWMCmd_A HTR_pct_OpenLoopPWMCmd_B /end LOC_MEASUREMENT
 /begin REF_CHARACTERISTIC HTRc_C_OptimalSensorTemp_A HTRc_C_OptimalSensorTemp_B HTRc_C_WaterCondensTemp_A HTRc_C_WaterCondensTemp_B HTRc_NU_IGain_A HTRc_NU_IGain_B HTRc_NU_PGain_A HTRc_NU_PGain_B HTRc_NU_RefCurrEnum_A HTRc_NU_RefCurrEnum_B HTRc_b_EnblHeater_A HTRc_b_EnblHeater_B HTRc_b_EnblTempSensor_A HTRc_b_EnblTempSensor_B HTRc_pct_HeaterLimitCLPWMCmd_A HTRc_pct_HeaterLimitCLPWMCmd_B HTRc_pct_HeaterLimitOLPWMCmd_A HTRc_pct_HeaterLimitOLPWMCmd_B HTRc_pct_LinRampPWMCmd_A HTRc_pct_LinRampPWMCmd_B HTRc_pct_MaxDutyCyc HTRc_pct_OpenLoopLinRamp_A HTRc_pct_OpenLoopLinRamp_B HTRc_pct_PID_OutputMax_A HTRc_pct_PID_OutputMax_B HTRc_pct_WaterCondensPWMCmd_A HTRc_pct_WaterCondensPWMCmd_B HTRc_s_EngineStopTimeout HTRc_s_FaultFlagDbnc HTRc_s_OpenLoopWatrCondnsDbnc_A HTRc_s_OpenLoopWatrCondnsDbnc_B HTRm_C_SensorTempA_x HTRm_C_SensorTempA_z HTRm_C_SensorTempB_x HTRm_C_SensorTempB_z HTRm_NU_SysVoltageCompA_x HTRm_NU_SysVoltageCompA_z HTRm_NU_SysVoltageCompB_x HTRm_NU_SysVoltageCompB_z /end REF_CHARACTERISTIC
/end FUNCTION
/begin FUNCTION idl "Group /ByDataDictionaryPrefix/idl"
 /begin LOC_MEASUREMENT IDL_NU_AirDTerm IDL_NU_AirITerm IDL_NU_AirPIDEffort IDL_NU_AirPTerm IDL_NU_ErrorROC IDL_NU_IdlAirGEAR_FF IDL_NU_SparkDTerm IDL_NU_SparkITerm IDL_NU_SparkPID_Effort IDL_NU_SparkPTerm IDL_RPM_AC_Term IDL_RPM_Added IDL_RPM_AlternatorTerm IDL_RPM_AlternatorTermRaw IDL_RPM_Base IDL_RPM_DrivingTerm IDL_RPM_Error IDL_RPM_ErrorLPF IDL_RPM_Trgt IDL_RPM_Trgt_trt IDL_b_Actv IDL_gps_Air IDL_gps_IdlAC_FF IDL_gps_IdlAir_FF IDL_gps_IdlAir_PID IDL_ret_Spark /end LOC_MEASUREMENT
 /begin REF_CHARACTERISTIC IDLc_C_AmbTemp IDLc_Hz_AlternatorTermLPF IDLc_Hz_ErrorLPF IDLc_NU_AirErrorROCThrsh IDLc_NU_AirIMax IDLc_NU_AirIMin IDLc_NU_AirPID_Dbnd IDLc_NU_AirPID_Max IDLc_NU_AirPID_Min IDLc_NU_AlternatorFallRate IDLc_NU_AlternatorRiseRate IDLc_NU_SparkErrorROCThrsh IDLc_NU_SparkIMax IDLc_NU_SparkIMin IDLc_NU_SparkPID_Dbnd IDLc_NU_SparkPID_Max IDLc_NU_SparkPID_Min IDLc_RPM_AC_Adder IDLc_RPM_AirErrorDbnd IDLc_RPM_DrivingAdder IDLc_RPM_ErrorActivationThrsh IDLc_RPM_ExitRPMAdder IDLc_RPM_ITermMaxError IDLc_RPM_ITermMinError IDLc_RPM_LimitErrorActThrsh IDLc_RPM_MaxIdlSpd IDLc_RPM_SparkErrorDbnd IDLc_RPM_SparkITermMaxError IDLc_RPM_SparkITermMinError IDLc_RPM_Trgt IDLc_b_Actv IDLc_b_ITermAutoReset IDLc_b_IgnoreTransGear IDLc_gps_Air IDLc_kph_DrivingThrsh IDLc_o_Actv IDLc_o_Air IDLc_o_Spark IDLc_o_Trgt IDLc_pct_AirGainScale IDLc_pct_SparkGainScale IDLc_ret_Spark IDLc_s_AC_Dbnc IDLc_s_Hold IDLc_s_HoldRPMAdder IDLc_s_StartupDelay IDLm_NU_AirDGainNeg_x IDLm_NU_AirDGainNeg_z IDLm_NU_AirDGainPos_x IDLm_NU_AirDGainPos_z IDLm_NU_AirIGainNeg_x IDLm_NU_AirIGainNeg_z IDLm_NU_AirIGainPos_x IDLm_NU_AirIGainPos_z IDLm_NU_AirPGainNeg_x IDLm_NU_AirPGainNeg_z IDLm_NU_AirPGainPos_x IDLm_NU_AirPGainPos_z IDLm_NU_Alternator_x IDLm_NU_Alternator_z IDLm_NU_EffortToAir_x IDLm_NU_EffortToAir_z IDLm_NU_EffortToSpark_x IDLm_NU_EffortToSpark_z IDLm_NU_EngineTemp_x IDLm_NU_EngineTemp_z IDLm_NU_IdlAC_FF_x IDLm_NU_IdlAC_FF_z IDLm_NU_IdlAir_FF_x IDLm_NU_IdlAir_FF_y IDLm_NU_IdlAir_FF_z IDLm_NU_SparkDGainNeg_x IDLm_NU_SparkDGainNeg_z IDLm_NU_SparkDGainPos_x IDLm_NU_SparkDGainPos_z IDLm_NU_SparkIGainNeg_x IDLm_NU_SparkIGainNeg_z IDLm_NU_SparkIGainPos_x IDLm_NU_SparkIGainPos_z IDLm_NU_SparkPGainNeg_x IDLm_NU_SparkPGainNeg_z IDLm_NU_SparkPGainPos_x IDLm_NU_SparkPGainPos_z IDLm_NU_TimeSinceStart_x IDLm_NU_TimeSinceStart_z IDLm_gps_IdlAirGEAR_FF_x IDLm_gps_IdlAirGEAR_FF_y IDLm_gps_IdlAirGEAR_FF_z /end REF_CHARACTERISTIC
/end FUNCTION
/begin FUNCTION ijt "Group /ByDataDictionaryPrefix/ijt"
 /begin LOC_MEASUREMENT IJT_NU_TotalFuelFlowKgPerHr IJT_adv_CrankingSOI IJT_adv_RunningSOI IJT_adv_SOC_Inj1 IJT_adv_SOC_Inj2 IJT_adv_SOC_Inj3 IJT_adv_SOC_Inj4 IJT_b_Inj1_InjectionSent IJT_b_Inj2_InjectionSent IJT_b_Inj3_InjectionSent IJT_b_Inj4_InjectionSent IJT_b_InjectorOverlap IJT_b_PrimingPulseActiveCyl1 IJT_b_PrimingPulseActiveCyl2 IJT_b_PrimingPulseActiveCyl3 IJT_b_PrimingPulseActiveCyl4 IJT_bar_EffectivePress IJT_cnt_PrimingPulsesCyl1 IJT_cnt_PrimingPulsesCyl2 IJT_cnt_PrimingPulsesCyl3 IJT_cnt_PrimingPulsesCyl4 IJT_deg_Inj1 IJT_deg_Inj2 IJT_deg_Inj3 IJT_deg_Inj4 IJT_gps_InjectorFlowRatePFI IJT_gps_TotalFuelFlow IJT_mg_Inj1 IJT_mg_Inj2 IJT_mg_Inj3 IJT_mg_Inj4 IJT_ms_Inj1 IJT_ms_Inj2 IJT_ms_Inj3 IJT_ms_Inj4 IJT_ms_OpeningDelay IJT_ms_OpeningDelayInj1 IJT_ms_OpeningDelayInj2 IJT_ms_OpeningDelayInj3 IJT_ms_OpeningDelayInj4 IJT_ms_OverlapThrsh IJT_pct_FuelTempCF IJT_s_Slack /end LOC_MEASUREMENT
 /begin REF_CHARACTERISTIC IJTc_NU_FlowRateConstant IJTc_adv_SOC_Inj1 IJTc_adv_SOC_Inj2 IJTc_adv_SOC_Inj3 IJTc_adv_SOC_Inj4 IJTc_adv_SOC_Max IJTc_adv_SOC_Min IJTc_b_Inj1_InjectionSent IJTc_b_Inj2_InjectionSent IJTc_b_Inj3_InjectionSent IJTc_b_Inj4_InjectionSent IJTc_b_PrimingPulseEnable IJTc_b_UseFlowRateTable IJTc_cnt_PrimingPulses IJTc_mg_MaxInj IJTc_mg_MinInj IJTc_ms_ClosingDelayNoOverlap IJTc_ms_ClosingDelayWithOverlap IJTc_ms_Inj1 IJTc_ms_Inj2 IJTc_ms_Inj3 IJTc_ms_Inj4 IJTc_ms_OpeningDelayInj1 IJTc_ms_OpeningDelayInj2 IJTc_ms_OpeningDelayInj3 IJTc_ms_OpeningDelayInj4 IJTc_ms_OverlapOfst IJTc_ms_PrimingPulseFlowTime IJTc_o_Inj1_InjectionSent IJTc_o_Inj1_PulseDur IJTc_o_Inj2_InjectionSent IJTc_o_Inj2_PulseDur IJTc_o_Inj3_InjectionSent IJTc_o_Inj3_PulseDur IJTc_o_Inj4_InjectionSent IJTc_o_Inj4_PulseDur IJTc_o_OpeningDelayInj1 IJTc_o_OpeningDelayInj2 IJTc_o_OpeningDelayInj3 IJTc_o_OpeningDelayInj4 IJTc_o_SOC_Inj1 IJTc_o_SOC_Inj2 IJTc_o_SOC_Inj3 IJTc_o_SOC_Inj4 IJTc_pct_Inj1_Balancing IJTc_pct_Inj2_Balancing IJTc_pct_Inj3_Balancing IJTc_pct_Inj4_Balancing IJTc_s_MinCalculationSlack IJTc_s_PrimingPulseTimeout IJTm_NU_CrankingSOI_Pulse1_x IJTm_NU_CrankingSOI_Pulse1_y IJTm_NU_CrankingSOI_Pulse1_z IJTm_NU_FuelFlowOffset_x IJTm_NU_FuelFlowOffset_y IJTm_NU_FuelFlowOffset_z IJTm_NU_FuelTempCF_x IJTm_NU_FuelTempCF_z IJTm_NU_InjectorFlowMapCmp_x IJTm_NU_InjectorFlowMapCmp_y IJTm_NU_InjectorFlowMapCmp_z IJTm_NU_InjectorFlowMapPFI_x IJTm_NU_InjectorFlowMapPFI_y IJTm_NU_InjectorFlowMapPFI_z IJTm_NU_OpeningDelayPFI_x IJTm_NU_OpeningDelayPFI_z IJTm_NU_RunningSOI_Pulse1_x IJTm_NU_RunningSOI_Pulse1_y IJTm_NU_RunningSOI_Pulse1_z /end REF_CHARACTERISTIC
/end FUNCTION
/end MODULE
/end PROJECT
