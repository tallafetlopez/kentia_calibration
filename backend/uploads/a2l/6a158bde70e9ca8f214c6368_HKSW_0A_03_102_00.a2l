ASAP2_VERSION 1 31
/begin PROJECT M670_Engine_Control_1.2.0_M670_000 "BeGas B430LG Turbocharged engine"
/begin HEADER "Begas Motor 2017-2022 (c)" VERSION "1_2_0" /end HEADER
/begin MODULE OpenECU_M670_000 ""
/* Scalar calibration for DDE 'AINc_V_VBatt'. */
/begin CHARACTERISTIC AINc_V_VBatt "Override value" VALUE 0x8c08c RL_AINC_V_VBATT 30.000000 CU_AINC_V_VBATT 0.000000 30.000000 BYTE_ORDER MSB_FIRST /end CHARACTERISTIC
/begin RECORD_LAYOUT RL_AINC_V_VBATT FNC_VALUES 1 FLOAT32_IEEE COLUMN_DIR DIRECT /end RECORD_LAYOUT
/begin COMPU_METHOD CU_AINC_V_VBATT "Conversion method for AINc_V_VBatt" RAT_FUNC "%10.1" "V" COEFFS 0.000000 1.000000 0.000000 0.000000 0.000000 1.000000 /end COMPU_METHOD
/* Scalar calibration for DDE 'AINc_V_VBattLow'. */
/begin CHARACTERISTIC AINc_V_VBattLow "Battery power monitor circuit gain: M670 uses 111/11" VALUE 0x8c380 RL_AINC_V_VBATTLOW 0.000000 CU_AINC_V_VBATTLOW 11.000000 11.000000 BYTE_ORDER MSB_FIRST /end CHARACTERISTIC
/begin RECORD_LAYOUT RL_AINC_V_VBATTLOW FNC_VALUES 1 FLOAT32_IEEE COLUMN_DIR DIRECT /end RECORD_LAYOUT
/begin COMPU_METHOD CU_AINC_V_VBATTLOW "Conversion method for AINc_V_VBattLow" RAT_FUNC "%10.3" "V" COEFFS 0.000000 1.000000 0.000000 0.000000 0.000000 1.000000 /end COMPU_METHOD
/* Scalar calibration for DDE 'AINc_V_VBattTop'. */
/begin CHARACTERISTIC AINc_V_VBattTop "Battery power monitor circuit gain: M670 uses 111/11" VALUE 0x8c384 RL_AINC_V_VBATTTOP 0.000000 CU_AINC_V_VBATTTOP 16.000000 16.000000 BYTE_ORDER MSB_FIRST /end CHARACTERISTIC
/begin RECORD_LAYOUT RL_AINC_V_VBATTTOP FNC_VALUES 1 FLOAT32_IEEE COLUMN_DIR DIRECT /end RECORD_LAYOUT
/begin COMPU_METHOD CU_AINC_V_VBATTTOP "Conversion method for AINc_V_VBattTop" RAT_FUNC "%10.3" "V" COEFFS 0.000000 1.000000 0.000000 0.000000 0.000000 1.000000 /end COMPU_METHOD
/* Scalar calibration for DDE 'AINc_adv_KnockRegionStartAng'. */
/begin CHARACTERISTIC AINc_adv_KnockRegionStartAng "Start angle (BTDC) of knock region" VALUE 0x8d4fc RL_AINC_ADV_KNOCKREGIONSTARTANG 720.000000 CU_AINC_ADV_KNOCKREGIONSTARTANG -360.000000 360.000000 BYTE_ORDER MSB_FIRST /end CHARACTERISTIC
/begin RECORD_LAYOUT RL_AINC_ADV_KNOCKREGIONSTARTANG FNC_VALUES 1 FLOAT32_IEEE COLUMN_DIR DIRECT /end RECORD_LAYOUT
/begin COMPU_METHOD CU_AINC_ADV_KNOCKREGIONSTARTANG "Conversion method for AINc_adv_KnockRegionStartAng" RAT_FUNC "%10.1" "adv" COEFFS 0.000000 1.000000 0.000000 0.000000 0.000000 1.000000 /end COMPU_METHOD
/* Scalar calibration for DDE 'AINc_b_APP1_Valid'. */
/begin CHARACTERISTIC AINc_b_APP1_Valid "Override value" VALUE 0x8c411 RL_AINC_B_APP1_VALID 1.000000 CU_AINC_B_APP1_VALID 0.000000 1.000000 BYTE_ORDER MSB_FIRST /end CHARACTERISTIC
/begin RECORD_LAYOUT RL_AINC_B_APP1_VALID FNC_VALUES 1 UBYTE COLUMN_DIR DIRECT /end RECORD_LAYOUT
/begin COMPU_METHOD CU_AINC_B_APP1_VALID "Conversion method for AINc_b_APP1_Valid" RAT_FUNC "%10.0" "b" COEFFS 0.000000 1.000000 0.000000 0.000000 0.000000 1.000000 /end COMPU_METHOD
/* Scalar calibration for DDE 'AINc_b_APP2_Valid'. */
/begin CHARACTERISTIC AINc_b_APP2_Valid "Override value" VALUE 0x8c409 RL_AINC_B_APP2_VALID 1.000000 CU_AINC_B_APP2_VALID 0.000000 1.000000 BYTE_ORDER MSB_FIRST /end CHARACTERISTIC
/begin RECORD_LAYOUT RL_AINC_B_APP2_VALID FNC_VALUES 1 UBYTE COLUMN_DIR DIRECT /end RECORD_LAYOUT
/begin COMPU_METHOD CU_AINC_B_APP2_VALID "Conversion method for AINc_b_APP2_Valid" RAT_FUNC "%10.0" "b" COEFFS 0.000000 1.000000 0.000000 0.000000 0.000000 1.000000 /end COMPU_METHOD
/* Scalar calibration for DDE 'AINc_b_DC_start'. */
/begin CHARACTERISTIC AINc_b_DC_start "Override value" VALUE 0x8ce65 RL_AINC_B_DC_START 1.000000 CU_AINC_B_DC_START 0.000000 1.000000 BYTE_ORDER MSB_FIRST /end CHARACTERISTIC
/begin RECORD_LAYOUT RL_AINC_B_DC_START FNC_VALUES 1 UBYTE COLUMN_DIR DIRECT /end RECORD_LAYOUT
/begin COMPU_METHOD CU_AINC_B_DC_START "Conversion method for AINc_b_DC_start" RAT_FUNC "%10.0" "b" COEFFS 0.000000 1.000000 0.000000 0.000000 0.000000 1.000000 /end COMPU_METHOD
/* Scalar calibration for DDE 'AINc_b_Eng_running'. */
/begin CHARACTERISTIC AINc_b_Eng_running "Override value" VALUE 0x8ce6b RL_AINC_B_ENG_RUNNING 1.000000 CU_AINC_B_ENG_RUNNING 0.000000 1.000000 BYTE_ORDER MSB_FIRST /end CHARACTERISTIC
/begin RECORD_LAYOUT RL_AINC_B_ENG_RUNNING FNC_VALUES 1 UBYTE COLUMN_DIR DIRECT /end RECORD_LAYOUT
/begin COMPU_METHOD CU_AINC_B_ENG_RUNNING "Conversion method for AINc_b_Eng_running" RAT_FUNC "%10.0" "b" COEFFS 0.000000 1.000000 0.000000 0.000000 0.000000 1.000000 /end COMPU_METHOD
/* Scalar calibration for DDE 'AINc_b_IC_start'. */
/begin CHARACTERISTIC AINc_b_IC_start "Override value" VALUE 0x8ce69 RL_AINC_B_IC_START 1.000000 CU_AINC_B_IC_START 0.000000 1.000000 BYTE_ORDER MSB_FIRST /end CHARACTERISTIC
/begin RECORD_LAYOUT RL_AINC_B_IC_START FNC_VALUES 1 UBYTE COLUMN_DIR DIRECT /end RECORD_LAYOUT
/begin COMPU_METHOD CU_AINC_B_IC_START "Conversion method for AINc_b_IC_start" RAT_FUNC "%10.0" "b" COEFFS 0.000000 1.000000 0.000000 0.000000 0.000000 1.000000 /end COMPU_METHOD
/* Scalar calibration for DDE 'AINc_b_KnockWinSPT_Ofst'. */
/begin CHARACTERISTIC AINc_b_KnockWinSPT_Ofst "Use knock windows relative to the commanded spark timing" VALUE 0x8c21a RL_AINC_B_KNOCKWINSPT_OFST 1.000000 CU_AINC_B_KNOCKWINSPT_OFST 0.000000 1.000000 BYTE_ORDER MSB_FIRST /end CHARACTERISTIC
/begin RECORD_LAYOUT RL_AINC_B_KNOCKWINSPT_OFST FNC_VALUES 1 UBYTE COLUMN_DIR DIRECT /end RECORD_LAYOUT
/begin COMPU_METHOD CU_AINC_B_KNOCKWINSPT_OFST "Conversion method for AINc_b_KnockWinSPT_Ofst" RAT_FUNC "%10.0" "b" COEFFS 0.000000 1.000000 0.000000 0.000000 0.000000 1.000000 /end COMPU_METHOD
/* Scalar calibration for DDE 'AINc_b_RealGear'. */
/begin CHARACTERISTIC AINc_b_RealGear "Marcha real CAN?" VALUE 0x8cdee RL_AINC_B_REALGEAR 1.000000 CU_AINC_B_REALGEAR 0.000000 1.000000 BYTE_ORDER MSB_FIRST /end CHARACTERISTIC
/begin RECORD_LAYOUT RL_AINC_B_REALGEAR FNC_VALUES 1 UBYTE COLUMN_DIR DIRECT /end RECORD_LAYOUT
/begin COMPU_METHOD CU_AINC_B_REALGEAR "Conversion method for AINc_b_RealGear" RAT_FUNC "%10.0" "b" COEFFS 0.000000 1.000000 0.000000 0.000000 0.000000 1.000000 /end COMPU_METHOD
/* Scalar calibration for DDE 'AINc_b_Tank2_Available'. */
/begin CHARACTERISTIC AINc_b_Tank2_Available "Set 1 for 2 tanks Setup, set 0 for 1 tank Setup" VALUE 0x8bda5 RL_AINC_B_TANK2_AVAILABLE 1.000000 CU_AINC_B_TANK2_AVAILABLE 0.000000 1.000000 BYTE_ORDER MSB_FIRST /end CHARACTERISTIC
/begin RECORD_LAYOUT RL_AINC_B_TANK2_AVAILABLE FNC_VALUES 1 UBYTE COLUMN_DIR DIRECT /end RECORD_LAYOUT
/begin COMPU_METHOD CU_AINC_B_TANK2_AVAILABLE "Conversion method for AINc_b_Tank2_Available" RAT_FUNC "%10.0" "b" COEFFS 0.000000 1.000000 0.000000 0.000000 0.000000 1.000000 /end COMPU_METHOD
/* Scalar calibration for DDE 'AINc_b_UEGO1_Valid'. */
/begin CHARACTERISTIC AINc_b_UEGO1_Valid "Override value" VALUE 0x8c429 RL_AINC_B_UEGO1_VALID 1.000000 CU_AINC_B_UEGO1_VALID 0.000000 1.000000 BYTE_ORDER MSB_FIRST /end CHARACTERISTIC
/begin RECORD_LAYOUT RL_AINC_B_UEGO1_VALID FNC_VALUES 1 UBYTE COLUMN_DIR DIRECT /end RECORD_LAYOUT
/begin COMPU_METHOD CU_AINC_B_UEGO1_VALID "Conversion method for AINc_b_UEGO1_Valid" RAT_FUNC "%10.0" "b" COEFFS 0.000000 1.000000 0.000000 0.000000 0.000000 1.000000 /end COMPU_METHOD
/* Scalar calibration for DDE 'AINc_b_UEGO2_Valid'. */
/begin CHARACTERISTIC AINc_b_UEGO2_Valid "Override value" VALUE 0x8c431 RL_AINC_B_UEGO2_VALID 1.000000 CU_AINC_B_UEGO2_VALID 0.000000 1.000000 BYTE_ORDER MSB_FIRST /end CHARACTERISTIC
/begin RECORD_LAYOUT RL_AINC_B_UEGO2_VALID FNC_VALUES 1 UBYTE COLUMN_DIR DIRECT /end RECORD_LAYOUT
/begin COMPU_METHOD CU_AINC_B_UEGO2_VALID "Conversion method for AINc_b_UEGO2_Valid" RAT_FUNC "%10.0" "b" COEFFS 0.000000 1.000000 0.000000 0.000000 0.000000 1.000000 /end COMPU_METHOD
/* Scalar calibration for DDE 'AINc_b_UseHalfVBatt'. */
/begin CHARACTERISTIC AINc_b_UseHalfVBatt "Flag to allow switching between half of battery voltage/ full voltage (24V system)" VALUE 0x8c090 RL_AINC_B_USEHALFVBATT 1.000000 CU_AINC_B_USEHALFVBATT 0.000000 1.000000 BYTE_ORDER MSB_FIRST /end CHARACTERISTIC
/begin RECORD_LAYOUT RL_AINC_B_USEHALFVBATT FNC_VALUES 1 UBYTE COLUMN_DIR DIRECT /end RECORD_LAYOUT
/begin COMPU_METHOD CU_AINC_B_USEHALFVBATT "Conversion method for AINc_b_UseHalfVBatt" RAT_FUNC "%10.0" "b" COEFFS 0.000000 1.000000 0.000000 0.000000 0.000000 1.000000 /end COMPU_METHOD
/* Scalar calibration for DDE 'AINc_b_WU_start'. */
/begin CHARACTERISTIC AINc_b_WU_start "Override value" VALUE 0x8ce67 RL_AINC_B_WU_START 1.000000 CU_AINC_B_WU_START 0.000000 1.000000 BYTE_ORDER MSB_FIRST /end CHARACTERISTIC
/begin RECORD_LAYOUT RL_AINC_B_WU_START FNC_VALUES 1 UBYTE COLUMN_DIR DIRECT /end RECORD_LAYOUT
/begin COMPU_METHOD CU_AINC_B_WU_START "Conversion method for AINc_b_WU_start" RAT_FUNC "%10.0" "b" COEFFS 0.000000 1.000000 0.000000 0.000000 0.000000 1.000000 /end COMPU_METHOD
/* Scalar calibration for DDE 'AINc_bar_FuelPress'. */
/begin CHARACTERISTIC AINc_bar_FuelPress "Override value" VALUE 0x8c470 RL_AINC_BAR_FUELPRESS 1000.000000 CU_AINC_BAR_FUELPRESS 0.000000 1000.000000 BYTE_ORDER MSB_FIRST /end CHARACTERISTIC
/begin RECORD_LAYOUT RL_AINC_BAR_FUELPRESS FNC_VALUES 1 FLOAT32_IEEE COLUMN_DIR DIRECT /end RECORD_LAYOUT
/begin COMPU_METHOD CU_AINC_BAR_FUELPRESS "Conversion method for AINc_bar_FuelPress" RAT_FUNC "%10.2" "bar" COEFFS 0.000000 1.000000 0.000000 0.000000 0.000000 1.000000 /end COMPU_METHOD
/* Scalar calibration for DDE 'AINc_bar_FuelPressOvrd'. */
/begin CHARACTERISTIC AINc_bar_FuelPressOvrd "Override value for DI volume-mode" VALUE 0x8bf80 RL_AINC_BAR_FUELPRESSOVRD 1000.000000 CU_AINC_BAR_FUELPRESSOVRD 0.000000 1000.000000 BYTE_ORDER MSB_FIRST /end CHARACTERISTIC
/begin RECORD_LAYOUT RL_AINC_BAR_FUELPRESSOVRD FNC_VALUES 1 FLOAT32_IEEE COLUMN_DIR DIRECT /end RECORD_LAYOUT
/begin COMPU_METHOD CU_AINC_BAR_FUELPRESSOVRD "Conversion method for AINc_bar_FuelPressOvrd" RAT_FUNC "%10.2" "bar" COEFFS 0.000000 1.000000 0.000000 0.000000 0.000000 1.000000 /end COMPU_METHOD
/* Scalar calibration for DDE 'AINc_bar_FuelPress_Dflt'. */
/begin CHARACTERISTIC AINc_bar_FuelPress_Dflt "This default is only applied once the leaky bucket is full" VALUE 0x8dcb0 RL_AINC_BAR_FUELPRESS_DFLT 500.100000 CU_AINC_BAR_FUELPRESS_DFLT -0.100000 500.000000 BYTE_ORDER MSB_FIRST /end CHARACTERISTIC
/begin RECORD_LAYOUT RL_AINC_BAR_FUELPRESS_DFLT FNC_VALUES 1 FLOAT32_IEEE COLUMN_DIR DIRECT /end RECORD_LAYOUT
/begin COMPU_METHOD CU_AINC_BAR_FUELPRESS_DFLT "Conversion method for AINc_bar_FuelPress_Dflt" RAT_FUNC "%10.1" "bar" COEFFS 0.000000 1.000000 0.000000 0.000000 0.000000 1.000000 /end COMPU_METHOD
/* Scalar calibration for DDE 'AINc_bar_FuelPress_Max'. */
/begin CHARACTERISTIC AINc_bar_FuelPress_Max "AIN output will be bounded by this range" VALUE 0x8dcac RL_AINC_BAR_FUELPRESS_MAX 1000.000000 CU_AINC_BAR_FUELPRESS_MAX 0.000000 1000.000000 BYTE_ORDER MSB_FIRST /end CHARACTERISTIC
/begin RECORD_LAYOUT RL_AINC_BAR_FUELPRESS_MAX FNC_VALUES 1 FLOAT32_IEEE COLUMN_DIR DIRECT /end RECORD_LAYOUT
/begin COMPU_METHOD CU_AINC_BAR_FUELPRESS_MAX "Conversion method for AINc_bar_FuelPress_Max" RAT_FUNC "%10.1" "bar" COEFFS 0.000000 1.000000 0.000000 0.000000 0.000000 1.000000 /end COMPU_METHOD
/* Scalar calibration for DDE 'AINc_bar_FuelPress_Min'. */
/begin CHARACTERISTIC AINc_bar_FuelPress_Min "AIN output will be bounded by this range" VALUE 0x8dca8 RL_AINC_BAR_FUELPRESS_MIN 1000.000000 CU_AINC_BAR_FUELPRESS_MIN 0.000000 1000.000000 BYTE_ORDER MSB_FIRST /end CHARACTERISTIC
/begin RECORD_LAYOUT RL_AINC_BAR_FUELPRESS_MIN FNC_VALUES 1 FLOAT32_IEEE COLUMN_DIR DIRECT /end RECORD_LAYOUT
/begin COMPU_METHOD CU_AINC_BAR_FUELPRESS_MIN "Conversion method for AINc_bar_FuelPress_Min" RAT_FUNC "%10.1" "bar" COEFFS 0.000000 1.000000 0.000000 0.000000 0.000000 1.000000 /end COMPU_METHOD
/* Scalar calibration for DDE 'AINc_cnt_CylIdxA'. */
/begin CHARACTERISTIC AINc_cnt_CylIdxA "Override value" VALUE 0x8c219 RL_AINC_CNT_CYLIDXA 8.000000 CU_AINC_CNT_CYLIDXA 0.000000 8.000000 BYTE_ORDER MSB_FIRST /end CHARACTERISTIC
/begin RECORD_LAYOUT RL_AINC_CNT_CYLIDXA FNC_VALUES 1 UBYTE COLUMN_DIR DIRECT /end RECORD_LAYOUT
/begin COMPU_METHOD CU_AINC_CNT_CYLIDXA "Conversion method for AINc_cnt_CylIdxA" RAT_FUNC "%10.0" "cnt" COEFFS 0.000000 1.000000 0.000000 0.000000 0.000000 1.000000 /end COMPU_METHOD
/* Scalar calibration for DDE 'AINc_cnt_CylIdxB'. */
/begin CHARACTERISTIC AINc_cnt_CylIdxB "Override value" VALUE 0x8c27d RL_AINC_CNT_CYLIDXB 8.000000 CU_AINC_CNT_CYLIDXB 0.000000 8.000000 BYTE_ORDER MSB_FIRST /end CHARACTERISTIC
/begin RECORD_LAYOUT RL_AINC_CNT_CYLIDXB FNC_VALUES 1 UBYTE COLUMN_DIR DIRECT /end RECORD_LAYOUT
/begin COMPU_METHOD CU_AINC_CNT_CYLIDXB "Conversion method for AINc_cnt_CylIdxB" RAT_FUNC "%10.0" "cnt" COEFFS 0.000000 1.000000 0.000000 0.000000 0.000000 1.000000 /end COMPU_METHOD
/* Scalar calibration for DDE 'AINc_e_MAP_SampleCylinder'. */
/begin CHARACTERISTIC AINc_e_MAP_SampleCylinder "Choose which cylinder the MAP sampling will be relative to. If set to 0  the most recent cylinder will be used." VALUE 0x8bfdc RL_AINC_E_MAP_SAMPLECYLINDER 2.000000 CU_AINC_E_MAP_SAMPLECYLINDER 0.000000 2.000000 BYTE_ORDER MSB_FIRST /end CHARACTERISTIC
/begin RECORD_LAYOUT RL_AINC_E_MAP_SAMPLECYLINDER FNC_VALUES 1 UBYTE COLUMN_DIR DIRECT /end RECORD_LAYOUT
/begin COMPU_METHOD CU_AINC_E_MAP_SAMPLECYLINDER "Conversion method for AINc_e_MAP_SampleCylinder" TAB_VERB "%12.0" "e" COMPU_TAB_REF CT_AINC_E_MAP_SAMPLECYLINDER /end COMPU_METHOD
/begin COMPU_VTAB CT_AINC_E_MAP_SAMPLECYLINDER "Conversion method for AINc_e_MAP_SampleCylinder" TAB_VERB 9 0 "SYSk_e_CylinderNotSpecified" 1 "SYSk_e_Cylinder1" 2 "SYSk_e_Cylinder2" 3 "SYSk_e_Cylinder3" 4 "SYSk_e_Cylinder4" 5 "SYSk_e_Cylinder5" 6 "SYSk_e_Cylinder6" 7 "SYSk_e_Cylinder7" 8 "SYSk_e_Cylinder8" /end COMPU_VTAB
/* Scalar calibration for DDE 'AINc_kPa_Baro'. */
/begin CHARACTERISTIC AINc_kPa_Baro "Override value" VALUE 0x8c3fc RL_AINC_KPA_BARO 0.000000 CU_AINC_KPA_BARO 0.000000 0.000000 BYTE_ORDER MSB_FIRST /end CHARACTERISTIC
/begin RECORD_LAYOUT RL_AINC_KPA_BARO FNC_VALUES 1 FLOAT32_IEEE COLUMN_DIR DIRECT /end RECORD_LAYOUT
/begin COMPU_METHOD CU_AINC_KPA_BARO "Conversion method for AINc_kPa_Baro" RAT_FUNC "%10.2" "kPa" COEFFS 0.000000 1.000000 0.000000 0.000000 0.000000 1.000000 /end COMPU_METHOD
/* Scalar calibration for DDE 'AINc_kPa_Baro_Dflt'. */
/begin CHARACTERISTIC AINc_kPa_Baro_Dflt "This default is only applied once the leaky bucket is full" VALUE 0x8dca4 RL_AINC_KPA_BARO_DFLT 1.100000 CU_AINC_KPA_BARO_DFLT -0.100000 1.000000 BYTE_ORDER MSB_FIRST /end CHARACTERISTIC
/begin RECORD_LAYOUT RL_AINC_KPA_BARO_DFLT FNC_VALUES 1 FLOAT32_IEEE COLUMN_DIR DIRECT /end RECORD_LAYOUT
/begin COMPU_METHOD CU_AINC_KPA_BARO_DFLT "Conversion method for AINc_kPa_Baro_Dflt" RAT_FUNC "%10.1" "kPa" COEFFS 0.000000 1.000000 0.000000 0.000000 0.000000 1.000000 /end COMPU_METHOD
/* Scalar calibration for DDE 'AINc_kPa_Baro_Max'. */
/begin CHARACTERISTIC AINc_kPa_Baro_Max "AIN output will be bounded by this range" VALUE 0x8dca0 RL_AINC_KPA_BARO_MAX 0.000000 CU_AINC_KPA_BARO_MAX 120.000000 120.000000 BYTE_ORDER MSB_FIRST /end CHARACTERISTIC
/begin RECORD_LAYOUT RL_AINC_KPA_BARO_MAX FNC_VALUES 1 FLOAT32_IEEE COLUMN_DIR DIRECT /end RECORD_LAYOUT
/begin COMPU_METHOD CU_AINC_KPA_BARO_MAX "Conversion method for AINc_kPa_Baro_Max" RAT_FUNC "%10.1" "kPa" COEFFS 0.000000 1.000000 0.000000 0.000000 0.000000 1.000000 /end COMPU_METHOD
/* Scalar calibration for DDE 'AINc_kPa_Baro_Min'. */
/begin CHARACTERISTIC AINc_kPa_Baro_Min "AIN output will be bounded by this range" VALUE 0x8dc9c RL_AINC_KPA_BARO_MIN 0.000000 CU_AINC_KPA_BARO_MIN 60.000000 60.000000 BYTE_ORDER MSB_FIRST /end CHARACTERISTIC
/begin RECORD_LAYOUT RL_AINC_KPA_BARO_MIN FNC_VALUES 1 FLOAT32_IEEE COLUMN_DIR DIRECT /end RECORD_LAYOUT
/begin COMPU_METHOD CU_AINC_KPA_BARO_MIN "Conversion method for AINc_kPa_Baro_Min" RAT_FUNC "%10.1" "kPa" COEFFS 0.000000 1.000000 0.000000 0.000000 0.000000 1.000000 /end COMPU_METHOD
/* Scalar calibration for DDE 'AINc_kPa_Baro_Ofst'. */
/begin CHARACTERISTIC AINc_kPa_Baro_Ofst "Sensor transfer function" VALUE 0x8c078 RL_AINC_KPA_BARO_OFST 200.000000 CU_AINC_KPA_BARO_OFST -100.000000 100.000000 BYTE_ORDER MSB_FIRST /end CHARACTERISTIC
/begin RECORD_LAYOUT RL_AINC_KPA_BARO_OFST FNC_VALUES 1 FLOAT32_IEEE COLUMN_DIR DIRECT /end RECORD_LAYOUT
/begin COMPU_METHOD CU_AINC_KPA_BARO_OFST "Conversion method for AINc_kPa_Baro_Ofst" RAT_FUNC "%10.2" "kPa" COEFFS 0.000000 1.000000 0.000000 0.000000 0.000000 1.000000 /end COMPU_METHOD
/* Scalar calibration for DDE 'AINc_kPa_CompOutPress'. */
/begin CHARACTERISTIC AINc_kPa_CompOutPress "Override value" VALUE 0x8c454 RL_AINC_KPA_COMPOUTPRESS 0.000000 CU_AINC_KPA_COMPOUTPRESS 0.000000 0.000000 BYTE_ORDER MSB_FIRST /end CHARACTERISTIC
/begin RECORD_LAYOUT RL_AINC_KPA_COMPOUTPRESS FNC_VALUES 1 FLOAT32_IEEE COLUMN_DIR DIRECT /end RECORD_LAYOUT
/begin COMPU_METHOD CU_AINC_KPA_COMPOUTPRESS "Conversion method for AINc_kPa_CompOutPress" RAT_FUNC "%10.2" "kPa" COEFFS 0.000000 1.000000 0.000000 0.000000 0.000000 1.000000 /end COMPU_METHOD
/* Scalar calibration for DDE 'AINc_kPa_CompOutPress_Dflt'. */
/begin CHARACTERISTIC AINc_kPa_CompOutPress_Dflt "This default is only applied once the leaky bucket is full" VALUE 0x8dc98 RL_AINC_KPA_COMPOUTPRESS_DFLT 1.100000 CU_AINC_KPA_COMPOUTPRESS_DFLT -0.100000 1.000000 BYTE_ORDER MSB_FIRST /end CHARACTERISTIC
/begin RECORD_LAYOUT RL_AINC_KPA_COMPOUTPRESS_DFLT FNC_VALUES 1 FLOAT32_IEEE COLUMN_DIR DIRECT /end RECORD_LAYOUT
/begin COMPU_METHOD CU_AINC_KPA_COMPOUTPRESS_DFLT "Conversion method for AINc_kPa_CompOutPress_Dflt" RAT_FUNC "%10.1" "kPa" COEFFS 0.000000 1.000000 0.000000 0.000000 0.000000 1.000000 /end COMPU_METHOD
/* Scalar calibration for DDE 'AINc_kPa_CompOutPress_Max'. */
/begin CHARACTERISTIC AINc_kPa_CompOutPress_Max "AIN output will be bounded by this range" VALUE 0x8dc94 RL_AINC_KPA_COMPOUTPRESS_MAX 300.000000 CU_AINC_KPA_COMPOUTPRESS_MAX 0.000000 300.000000 BYTE_ORDER MSB_FIRST /end CHARACTERISTIC
/begin RECORD_LAYOUT RL_AINC_KPA_COMPOUTPRESS_MAX FNC_VALUES 1 FLOAT32_IEEE COLUMN_DIR DIRECT /end RECORD_LAYOUT
/begin COMPU_METHOD CU_AINC_KPA_COMPOUTPRESS_MAX "Conversion method for AINc_kPa_CompOutPress_Max" RAT_FUNC "%10.1" "kPa" COEFFS 0.000000 1.000000 0.000000 0.000000 0.000000 1.000000 /end COMPU_METHOD
/* Scalar calibration for DDE 'AINc_kPa_CompOutPress_Min'. */
/begin CHARACTERISTIC AINc_kPa_CompOutPress_Min "AIN output will be bounded by this range" VALUE 0x8dc90 RL_AINC_KPA_COMPOUTPRESS_MIN 300.000000 CU_AINC_KPA_COMPOUTPRESS_MIN 0.000000 300.000000 BYTE_ORDER MSB_FIRST /end CHARACTERISTIC
/begin RECORD_LAYOUT RL_AINC_KPA_COMPOUTPRESS_MIN FNC_VALUES 1 FLOAT32_IEEE COLUMN_DIR DIRECT /end RECORD_LAYOUT
/begin COMPU_METHOD CU_AINC_KPA_COMPOUTPRESS_MIN "Conversion method for AINc_kPa_CompOutPress_Min" RAT_FUNC "%10.1" "kPa" COEFFS 0.000000 1.000000 0.000000 0.000000 0.000000 1.000000 /end COMPU_METHOD
/* Scalar calibration for DDE 'AINc_kPa_CompOutPress_Ofst'. */
/begin CHARACTERISTIC AINc_kPa_CompOutPress_Ofst "Sensor transfer function" VALUE 0x8c398 RL_AINC_KPA_COMPOUTPRESS_OFST 200.000000 CU_AINC_KPA_COMPOUTPRESS_OFST -100.000000 100.000000 BYTE_ORDER MSB_FIRST /end CHARACTERISTIC
/begin RECORD_LAYOUT RL_AINC_KPA_COMPOUTPRESS_OFST FNC_VALUES 1 FLOAT32_IEEE COLUMN_DIR DIRECT /end RECORD_LAYOUT
/begin COMPU_METHOD CU_AINC_KPA_COMPOUTPRESS_OFST "Conversion method for AINc_kPa_CompOutPress_Ofst" RAT_FUNC "%10.2" "kPa" COEFFS 0.000000 1.000000 0.000000 0.000000 0.000000 1.000000 /end COMPU_METHOD
/* Scalar calibration for DDE 'AINc_kPa_FAP'. */
/begin CHARACTERISTIC AINc_kPa_FAP "Override value" VALUE 0x8c3a4 RL_AINC_KPA_FAP 6425.500000 CU_AINC_KPA_FAP 0.000000 6425.500000 BYTE_ORDER MSB_FIRST /end CHARACTERISTIC
/begin RECORD_LAYOUT RL_AINC_KPA_FAP FNC_VALUES 1 FLOAT32_IEEE COLUMN_DIR DIRECT /end RECORD_LAYOUT
/begin COMPU_METHOD CU_AINC_KPA_FAP "Conversion method for AINc_kPa_FAP" RAT_FUNC "%10.1" "kPa" COEFFS 0.000000 1.000000 0.000000 0.000000 0.000000 1.000000 /end COMPU_METHOD
/* Scalar calibration for DDE 'AINc_kPa_FAPPress_Dflt'. */
/begin CHARACTERISTIC AINc_kPa_FAPPress_Dflt "This default is only applied once the leaky bucket is full" VALUE 0x8c3a8 RL_AINC_KPA_FAPPRESS_DFLT 500.100000 CU_AINC_KPA_FAPPRESS_DFLT -0.100000 500.000000 BYTE_ORDER MSB_FIRST /end CHARACTERISTIC
/begin RECORD_LAYOUT RL_AINC_KPA_FAPPRESS_DFLT FNC_VALUES 1 FLOAT32_IEEE COLUMN_DIR DIRECT /end RECORD_LAYOUT
/begin COMPU_METHOD CU_AINC_KPA_FAPPRESS_DFLT "Conversion method for AINc_kPa_FAPPress_Dflt" RAT_FUNC "%10.1" "bar" COEFFS 0.000000 1.000000 0.000000 0.000000 0.000000 1.000000 /end COMPU_METHOD
/* Scalar calibration for DDE 'AINc_kPa_FAPPress_Max'. */
/begin CHARACTERISTIC AINc_kPa_FAPPress_Max "AIN output will be bounded by this range" VALUE 0x8dc8c RL_AINC_KPA_FAPPRESS_MAX 10000.000000 CU_AINC_KPA_FAPPRESS_MAX 0.000000 10000.000000 BYTE_ORDER MSB_FIRST /end CHARACTERISTIC
/begin RECORD_LAYOUT RL_AINC_KPA_FAPPRESS_MAX FNC_VALUES 1 FLOAT32_IEEE COLUMN_DIR DIRECT /end RECORD_LAYOUT
/begin COMPU_METHOD CU_AINC_KPA_FAPPRESS_MAX "Conversion method for AINc_kPa_FAPPress_Max" RAT_FUNC "%10.2" "kPa" COEFFS 0.000000 1.000000 0.000000 0.000000 0.000000 1.000000 /end COMPU_METHOD
/* Scalar calibration for DDE 'AINc_kPa_FAPPress_Min'. */
/begin CHARACTERISTIC AINc_kPa_FAPPress_Min "AIN output will be bounded by this range" VALUE 0x8dc88 RL_AINC_KPA_FAPPRESS_MIN 11000.000000 CU_AINC_KPA_FAPPRESS_MIN -1000.000000 10000.000000 BYTE_ORDER MSB_FIRST /end CHARACTERISTIC
/begin RECORD_LAYOUT RL_AINC_KPA_FAPPRESS_MIN FNC_VALUES 1 FLOAT32_IEEE COLUMN_DIR DIRECT /end RECORD_LAYOUT
/begin COMPU_METHOD CU_AINC_KPA_FAPPRESS_MIN "Conversion method for AINc_kPa_FAPPress_Min" RAT_FUNC "%10.2" "kPa" COEFFS 0.000000 1.000000 0.000000 0.000000 0.000000 1.000000 /end COMPU_METHOD
/* Scalar calibration for DDE 'AINc_kPa_FuelPressDefault'. */
/begin CHARACTERISTIC AINc_kPa_FuelPressDefault "AIN output will be bounded by this range" VALUE 0x8c474 RL_AINC_KPA_FUELPRESSDEFAULT 1000.000000 CU_AINC_KPA_FUELPRESSDEFAULT 0.000000 1000.000000 BYTE_ORDER MSB_FIRST /end CHARACTERISTIC
/begin RECORD_LAYOUT RL_AINC_KPA_FUELPRESSDEFAULT FNC_VALUES 1 FLOAT32_IEEE COLUMN_DIR DIRECT /end RECORD_LAYOUT
/begin COMPU_METHOD CU_AINC_KPA_FUELPRESSDEFAULT "Conversion method for AINc_kPa_FuelPressDefault" RAT_FUNC "%10.2" "kPa" COEFFS 0.000000 1.000000 0.000000 0.000000 0.000000 1.000000 /end COMPU_METHOD
/* Scalar calibration for DDE 'AINc_kPa_MAP'. */
/begin CHARACTERISTIC AINc_kPa_MAP "Override value" VALUE 0x8c468 RL_AINC_KPA_MAP 10000.000000 CU_AINC_KPA_MAP 0.000000 10000.000000 BYTE_ORDER MSB_FIRST /end CHARACTERISTIC
/begin RECORD_LAYOUT RL_AINC_KPA_MAP FNC_VALUES 1 FLOAT32_IEEE COLUMN_DIR DIRECT /end RECORD_LAYOUT
/begin COMPU_METHOD CU_AINC_KPA_MAP "Conversion method for AINc_kPa_MAP" RAT_FUNC "%10.0" "kPa" COEFFS 0.000000 1.000000 0.000000 0.000000 0.000000 1.000000 /end COMPU_METHOD
/* Scalar calibration for DDE 'AINc_kPa_MAPsThershold'. */
/begin CHARACTERISTIC AINc_kPa_MAPsThershold "MAP Threshold" VALUE 0x8c064 RL_AINC_KPA_MAPSTHERSHOLD 20000.000000 CU_AINC_KPA_MAPSTHERSHOLD -10000.000000 10000.000000 BYTE_ORDER MSB_FIRST /end CHARACTERISTIC
/begin RECORD_LAYOUT RL_AINC_KPA_MAPSTHERSHOLD FNC_VALUES 1 FLOAT32_IEEE COLUMN_DIR DIRECT /end RECORD_LAYOUT
/begin COMPU_METHOD CU_AINC_KPA_MAPSTHERSHOLD "Conversion method for AINc_kPa_MAPsThershold" RAT_FUNC "%10.1" "kPa" COEFFS 0.000000 1.000000 0.000000 0.000000 0.000000 1.000000 /end COMPU_METHOD
/* Scalar calibration for DDE 'AINc_kPa_MAPuThershold'. */
/begin CHARACTERISTIC AINc_kPa_MAPuThershold "MAP Threshold" VALUE 0x8c054 RL_AINC_KPA_MAPUTHERSHOLD 20000.000000 CU_AINC_KPA_MAPUTHERSHOLD -10000.000000 10000.000000 BYTE_ORDER MSB_FIRST /end CHARACTERISTIC
/begin RECORD_LAYOUT RL_AINC_KPA_MAPUTHERSHOLD FNC_VALUES 1 FLOAT32_IEEE COLUMN_DIR DIRECT /end RECORD_LAYOUT
/begin COMPU_METHOD CU_AINC_KPA_MAPUTHERSHOLD "Conversion method for AINc_kPa_MAPuThershold" RAT_FUNC "%10.1" "kPa" COEFFS 0.000000 1.000000 0.000000 0.000000 0.000000 1.000000 /end COMPU_METHOD
/* Scalar calibration for DDE 'AINc_kPa_OilPress'. */
/begin CHARACTERISTIC AINc_kPa_OilPress "Override value" VALUE 0x8c3e8 RL_AINC_KPA_OILPRESS 1000.000000 CU_AINC_KPA_OILPRESS 0.000000 1000.000000 BYTE_ORDER MSB_FIRST /end CHARACTERISTIC
/begin RECORD_LAYOUT RL_AINC_KPA_OILPRESS FNC_VALUES 1 FLOAT32_IEEE COLUMN_DIR DIRECT /end RECORD_LAYOUT
/begin COMPU_METHOD CU_AINC_KPA_OILPRESS "Conversion method for AINc_kPa_OilPress" RAT_FUNC "%10.2" "kPa" COEFFS 0.000000 1.000000 0.000000 0.000000 0.000000 1.000000 /end COMPU_METHOD
/* Scalar calibration for DDE 'AINc_lam_UEGO1'. */
/begin CHARACTERISTIC AINc_lam_UEGO1 "Override value" VALUE 0x8c424 RL_AINC_LAM_UEGO1 2.000000 CU_AINC_LAM_UEGO1 0.000000 2.000000 BYTE_ORDER MSB_FIRST /end CHARACTERISTIC
/begin RECORD_LAYOUT RL_AINC_LAM_UEGO1 FNC_VALUES 1 FLOAT32_IEEE COLUMN_DIR DIRECT /end RECORD_LAYOUT
/begin COMPU_METHOD CU_AINC_LAM_UEGO1 "Conversion method for AINc_lam_UEGO1" RAT_FUNC "%10.2" "lam" COEFFS 0.000000 1.000000 0.000000 0.000000 0.000000 1.000000 /end COMPU_METHOD
/* Scalar calibration for DDE 'AINc_lam_UEGO2'. */
/begin CHARACTERISTIC AINc_lam_UEGO2 "Override value" VALUE 0x8c42c RL_AINC_LAM_UEGO2 2.000000 CU_AINC_LAM_UEGO2 0.000000 2.000000 BYTE_ORDER MSB_FIRST /end CHARACTERISTIC
/begin RECORD_LAYOUT RL_AINC_LAM_UEGO2 FNC_VALUES 1 FLOAT32_IEEE COLUMN_DIR DIRECT /end RECORD_LAYOUT
/begin COMPU_METHOD CU_AINC_LAM_UEGO2 "Conversion method for AINc_lam_UEGO2" RAT_FUNC "%10.2" "lam" COEFFS 0.000000 1.000000 0.000000 0.000000 0.000000 1.000000 /end COMPU_METHOD
/* Scalar calibration for DDE 'AINc_o_APP1_Raw'. */
/begin CHARACTERISTIC AINc_o_APP1_Raw "Override flag" VALUE 0x8c412 RL_AINC_O_APP1_RAW 1.000000 CU_AINC_O_APP1_RAW 0.000000 1.000000 BYTE_ORDER MSB_FIRST /end CHARACTERISTIC
/begin RECORD_LAYOUT RL_AINC_O_APP1_RAW FNC_VALUES 1 UBYTE COLUMN_DIR DIRECT /end RECORD_LAYOUT
/begin COMPU_METHOD CU_AINC_O_APP1_RAW "Conversion method for AINc_o_APP1_Raw" RAT_FUNC "%10.0" "o" COEFFS 0.000000 1.000000 0.000000 0.000000 0.000000 1.000000 /end COMPU_METHOD
/* Scalar calibration for DDE 'AINc_o_APP1_Valid'. */
/begin CHARACTERISTIC AINc_o_APP1_Valid "Override flag" VALUE 0x8c410 RL_AINC_O_APP1_VALID 1.000000 CU_AINC_O_APP1_VALID 0.000000 1.000000 BYTE_ORDER MSB_FIRST /end CHARACTERISTIC
/begin RECORD_LAYOUT RL_AINC_O_APP1_VALID FNC_VALUES 1 UBYTE COLUMN_DIR DIRECT /end RECORD_LAYOUT
/begin COMPU_METHOD CU_AINC_O_APP1_VALID "Conversion method for AINc_o_APP1_Valid" RAT_FUNC "%10.0" "o" COEFFS 0.000000 1.000000 0.000000 0.000000 0.000000 1.000000 /end COMPU_METHOD
/* Scalar calibration for DDE 'AINc_o_APP2_Raw'. */
/begin CHARACTERISTIC AINc_o_APP2_Raw "Override flag" VALUE 0x8c418 RL_AINC_O_APP2_RAW 1.000000 CU_AINC_O_APP2_RAW 0.000000 1.000000 BYTE_ORDER MSB_FIRST /end CHARACTERISTIC
/begin RECORD_LAYOUT RL_AINC_O_APP2_RAW FNC_VALUES 1 UBYTE COLUMN_DIR DIRECT /end RECORD_LAYOUT
/begin COMPU_METHOD CU_AINC_O_APP2_RAW "Conversion method for AINc_o_APP2_Raw" RAT_FUNC "%10.0" "o" COEFFS 0.000000 1.000000 0.000000 0.000000 0.000000 1.000000 /end COMPU_METHOD
/* Scalar calibration for DDE 'AINc_o_APP2_Valid'. */
/begin CHARACTERISTIC AINc_o_APP2_Valid "Override flag" VALUE 0x8c408 RL_AINC_O_APP2_VALID 1.000000 CU_AINC_O_APP2_VALID 0.000000 1.000000 BYTE_ORDER MSB_FIRST /end CHARACTERISTIC
/begin RECORD_LAYOUT RL_AINC_O_APP2_VALID FNC_VALUES 1 UBYTE COLUMN_DIR DIRECT /end RECORD_LAYOUT
/begin COMPU_METHOD CU_AINC_O_APP2_VALID "Conversion method for AINc_o_APP2_Valid" RAT_FUNC "%10.0" "o" COEFFS 0.000000 1.000000 0.000000 0.000000 0.000000 1.000000 /end COMPU_METHOD
/* Scalar calibration for DDE 'AINc_o_AmbientTemp'. */
/begin CHARACTERISTIC AINc_o_AmbientTemp "Override flag" VALUE 0x8c3ec RL_AINC_O_AMBIENTTEMP 1.000000 CU_AINC_O_AMBIENTTEMP 0.000000 1.000000 BYTE_ORDER MSB_FIRST /end CHARACTERISTIC
/begin RECORD_LAYOUT RL_AINC_O_AMBIENTTEMP FNC_VALUES 1 UBYTE COLUMN_DIR DIRECT /end RECORD_LAYOUT
/begin COMPU_METHOD CU_AINC_O_AMBIENTTEMP "Conversion method for AINc_o_AmbientTemp" RAT_FUNC "%10.0" "o" COEFFS 0.000000 1.000000 0.000000 0.000000 0.000000 1.000000 /end COMPU_METHOD
/* Scalar calibration for DDE 'AINc_o_Baro'. */
/begin CHARACTERISTIC AINc_o_Baro "Override flag" VALUE 0x8c3f8 RL_AINC_O_BARO 1.000000 CU_AINC_O_BARO 0.000000 1.000000 BYTE_ORDER MSB_FIRST /end CHARACTERISTIC
/begin RECORD_LAYOUT RL_AINC_O_BARO FNC_VALUES 1 UBYTE COLUMN_DIR DIRECT /end RECORD_LAYOUT
/begin COMPU_METHOD CU_AINC_O_BARO "Conversion method for AINc_o_Baro" RAT_FUNC "%10.0" "o" COEFFS 0.000000 1.000000 0.000000 0.000000 0.000000 1.000000 /end COMPU_METHOD
/* Scalar calibration for DDE 'AINc_o_CompOutPress'. */
/begin CHARACTERISTIC AINc_o_CompOutPress "Override flag" VALUE 0x8c450 RL_AINC_O_COMPOUTPRESS 1.000000 CU_AINC_O_COMPOUTPRESS 0.000000 1.000000 BYTE_ORDER MSB_FIRST /end CHARACTERISTIC
/begin RECORD_LAYOUT RL_AINC_O_COMPOUTPRESS FNC_VALUES 1 UBYTE COLUMN_DIR DIRECT /end RECORD_LAYOUT
/begin COMPU_METHOD CU_AINC_O_COMPOUTPRESS "Conversion method for AINc_o_CompOutPress" RAT_FUNC "%10.0" "o" COEFFS 0.000000 1.000000 0.000000 0.000000 0.000000 1.000000 /end COMPU_METHOD
/* Scalar calibration for DDE 'AINc_o_CompOutTemp'. */
/begin CHARACTERISTIC AINc_o_CompOutTemp "Override flag" VALUE 0x8c432 RL_AINC_O_COMPOUTTEMP 1.000000 CU_AINC_O_COMPOUTTEMP 0.000000 1.000000 BYTE_ORDER MSB_FIRST /end CHARACTERISTIC
/begin RECORD_LAYOUT RL_AINC_O_COMPOUTTEMP FNC_VALUES 1 UBYTE COLUMN_DIR DIRECT /end RECORD_LAYOUT
/begin COMPU_METHOD CU_AINC_O_COMPOUTTEMP "Conversion method for AINc_o_CompOutTemp" RAT_FUNC "%10.0" "o" COEFFS 0.000000 1.000000 0.000000 0.000000 0.000000 1.000000 /end COMPU_METHOD
/* Scalar calibration for DDE 'AINc_o_CoolantTemp'. */
/begin CHARACTERISTIC AINc_o_CoolantTemp "Override flag" VALUE 0x8c458 RL_AINC_O_COOLANTTEMP 1.000000 CU_AINC_O_COOLANTTEMP 0.000000 1.000000 BYTE_ORDER MSB_FIRST /end CHARACTERISTIC
/begin RECORD_LAYOUT RL_AINC_O_COOLANTTEMP FNC_VALUES 1 UBYTE COLUMN_DIR DIRECT /end RECORD_LAYOUT
/begin COMPU_METHOD CU_AINC_O_COOLANTTEMP "Conversion method for AINc_o_CoolantTemp" RAT_FUNC "%10.0" "o" COEFFS 0.000000 1.000000 0.000000 0.000000 0.000000 1.000000 /end COMPU_METHOD
/* Scalar calibration for DDE 'AINc_o_CylIdxA'. */
/begin CHARACTERISTIC AINc_o_CylIdxA "Override flag" VALUE 0x8c218 RL_AINC_O_CYLIDXA 1.000000 CU_AINC_O_CYLIDXA 0.000000 1.000000 BYTE_ORDER MSB_FIRST /end CHARACTERISTIC
/begin RECORD_LAYOUT RL_AINC_O_CYLIDXA FNC_VALUES 1 UBYTE COLUMN_DIR DIRECT /end RECORD_LAYOUT
/begin COMPU_METHOD CU_AINC_O_CYLIDXA "Conversion method for AINc_o_CylIdxA" RAT_FUNC "%10.0" "o" COEFFS 0.000000 1.000000 0.000000 0.000000 0.000000 1.000000 /end COMPU_METHOD
/* Scalar calibration for DDE 'AINc_o_CylIdxB'. */
/begin CHARACTERISTIC AINc_o_CylIdxB "Override flag" VALUE 0x8c27c RL_AINC_O_CYLIDXB 1.000000 CU_AINC_O_CYLIDXB 0.000000 1.000000 BYTE_ORDER MSB_FIRST /end CHARACTERISTIC
/begin RECORD_LAYOUT RL_AINC_O_CYLIDXB FNC_VALUES 1 UBYTE COLUMN_DIR DIRECT /end RECORD_LAYOUT
/begin COMPU_METHOD CU_AINC_O_CYLIDXB "Conversion method for AINc_o_CylIdxB" RAT_FUNC "%10.0" "o" COEFFS 0.000000 1.000000 0.000000 0.000000 0.000000 1.000000 /end COMPU_METHOD
/* Scalar calibration for DDE 'AINc_o_Cylinder1_Knock'. */
/begin CHARACTERISTIC AINc_o_Cylinder1_Knock "Override flag" VALUE 0x8c3d4 RL_AINC_O_CYLINDER1_KNOCK 1.000000 CU_AINC_O_CYLINDER1_KNOCK 0.000000 1.000000 BYTE_ORDER MSB_FIRST /end CHARACTERISTIC
/begin RECORD_LAYOUT RL_AINC_O_CYLINDER1_KNOCK FNC_VALUES 1 UBYTE COLUMN_DIR DIRECT /end RECORD_LAYOUT
/begin COMPU_METHOD CU_AINC_O_CYLINDER1_KNOCK "Conversion method for AINc_o_Cylinder1_Knock" RAT_FUNC "%10.0" "o" COEFFS 0.000000 1.000000 0.000000 0.000000 0.000000 1.000000 /end COMPU_METHOD
/* Scalar calibration for DDE 'AINc_o_Cylinder2_Knock'. */
/begin CHARACTERISTIC AINc_o_Cylinder2_Knock "Override flag" VALUE 0x8c3dc RL_AINC_O_CYLINDER2_KNOCK 1.000000 CU_AINC_O_CYLINDER2_KNOCK 0.000000 1.000000 BYTE_ORDER MSB_FIRST /end CHARACTERISTIC
/begin RECORD_LAYOUT RL_AINC_O_CYLINDER2_KNOCK FNC_VALUES 1 UBYTE COLUMN_DIR DIRECT /end RECORD_LAYOUT
/begin COMPU_METHOD CU_AINC_O_CYLINDER2_KNOCK "Conversion method for AINc_o_Cylinder2_Knock" RAT_FUNC "%10.0" "o" COEFFS 0.000000 1.000000 0.000000 0.000000 0.000000 1.000000 /end COMPU_METHOD
/* Scalar calibration for DDE 'AINc_o_Cylinder3_Knock'. */
/begin CHARACTERISTIC AINc_o_Cylinder3_Knock "Override flag" VALUE 0x8c3c4 RL_AINC_O_CYLINDER3_KNOCK 1.000000 CU_AINC_O_CYLINDER3_KNOCK 0.000000 1.000000 BYTE_ORDER MSB_FIRST /end CHARACTERISTIC
/begin RECORD_LAYOUT RL_AINC_O_CYLINDER3_KNOCK FNC_VALUES 1 UBYTE COLUMN_DIR DIRECT /end RECORD_LAYOUT
/begin COMPU_METHOD CU_AINC_O_CYLINDER3_KNOCK "Conversion method for AINc_o_Cylinder3_Knock" RAT_FUNC "%10.0" "o" COEFFS 0.000000 1.000000 0.000000 0.000000 0.000000 1.000000 /end COMPU_METHOD
/* Scalar calibration for DDE 'AINc_o_Cylinder4_Knock'. */
/begin CHARACTERISTIC AINc_o_Cylinder4_Knock "Override flag" VALUE 0x8c3cc RL_AINC_O_CYLINDER4_KNOCK 1.000000 CU_AINC_O_CYLINDER4_KNOCK 0.000000 1.000000 BYTE_ORDER MSB_FIRST /end CHARACTERISTIC
/begin RECORD_LAYOUT RL_AINC_O_CYLINDER4_KNOCK FNC_VALUES 1 UBYTE COLUMN_DIR DIRECT /end RECORD_LAYOUT
/begin COMPU_METHOD CU_AINC_O_CYLINDER4_KNOCK "Conversion method for AINc_o_Cylinder4_Knock" RAT_FUNC "%10.0" "o" COEFFS 0.000000 1.000000 0.000000 0.000000 0.000000 1.000000 /end COMPU_METHOD
/* Scalar calibration for DDE 'AINc_o_DC_start'. */
/begin CHARACTERISTIC AINc_o_DC_start "Override flag" VALUE 0x8ce64 RL_AINC_O_DC_START 1.000000 CU_AINC_O_DC_START 0.000000 1.000000 BYTE_ORDER MSB_FIRST /end CHARACTERISTIC
/begin RECORD_LAYOUT RL_AINC_O_DC_START FNC_VALUES 1 UBYTE COLUMN_DIR DIRECT /end RECORD_LAYOUT
/begin COMPU_METHOD CU_AINC_O_DC_START "Conversion method for AINc_o_DC_start" RAT_FUNC "%10.0" "o" COEFFS 0.000000 1.000000 0.000000 0.000000 0.000000 1.000000 /end COMPU_METHOD
/* Scalar calibration for DDE 'AINc_o_EGO11'. */
/begin CHARACTERISTIC AINc_o_EGO11 "Override flag" VALUE 0x8c400 RL_AINC_O_EGO11 1.000000 CU_AINC_O_EGO11 0.000000 1.000000 BYTE_ORDER MSB_FIRST /end CHARACTERISTIC
/begin RECORD_LAYOUT RL_AINC_O_EGO11 FNC_VALUES 1 UBYTE COLUMN_DIR DIRECT /end RECORD_LAYOUT
/begin COMPU_METHOD CU_AINC_O_EGO11 "Conversion method for AINc_o_EGO11" RAT_FUNC "%10.0" "o" COEFFS 0.000000 1.000000 0.000000 0.000000 0.000000 1.000000 /end COMPU_METHOD
/* Scalar calibration for DDE 'AINc_o_EGO12'. */
/begin CHARACTERISTIC AINc_o_EGO12 "Override flag" VALUE 0x8c0ec RL_AINC_O_EGO12 1.000000 CU_AINC_O_EGO12 0.000000 1.000000 BYTE_ORDER MSB_FIRST /end CHARACTERISTIC
/begin RECORD_LAYOUT RL_AINC_O_EGO12 FNC_VALUES 1 UBYTE COLUMN_DIR DIRECT /end RECORD_LAYOUT
/begin COMPU_METHOD CU_AINC_O_EGO12 "Conversion method for AINc_o_EGO12" RAT_FUNC "%10.0" "o" COEFFS 0.000000 1.000000 0.000000 0.000000 0.000000 1.000000 /end COMPU_METHOD
/* Scalar calibration for DDE 'AINc_o_EGO21'. */
/begin CHARACTERISTIC AINc_o_EGO21 "Override flag" VALUE 0x8c3ac RL_AINC_O_EGO21 1.000000 CU_AINC_O_EGO21 0.000000 1.000000 BYTE_ORDER MSB_FIRST /end CHARACTERISTIC
/begin RECORD_LAYOUT RL_AINC_O_EGO21 FNC_VALUES 1 UBYTE COLUMN_DIR DIRECT /end RECORD_LAYOUT
/begin COMPU_METHOD CU_AINC_O_EGO21 "Conversion method for AINc_o_EGO21" RAT_FUNC "%10.0" "o" COEFFS 0.000000 1.000000 0.000000 0.000000 0.000000 1.000000 /end COMPU_METHOD
/* Scalar calibration for DDE 'AINc_o_Eng_running'. */
/begin CHARACTERISTIC AINc_o_Eng_running "Override flag" VALUE 0x8ce6a RL_AINC_O_ENG_RUNNING 1.000000 CU_AINC_O_ENG_RUNNING 0.000000 1.000000 BYTE_ORDER MSB_FIRST /end CHARACTERISTIC
/begin RECORD_LAYOUT RL_AINC_O_ENG_RUNNING FNC_VALUES 1 UBYTE COLUMN_DIR DIRECT /end RECORD_LAYOUT
/begin COMPU_METHOD CU_AINC_O_ENG_RUNNING "Conversion method for AINc_o_Eng_running" RAT_FUNC "%10.0" "o" COEFFS 0.000000 1.000000 0.000000 0.000000 0.000000 1.000000 /end COMPU_METHOD
/* Scalar calibration for DDE 'AINc_o_ExhaustTemp'. */
/begin CHARACTERISTIC AINc_o_ExhaustTemp "Override flag" VALUE 0x8c0cc RL_AINC_O_EXHAUSTTEMP 1.000000 CU_AINC_O_EXHAUSTTEMP 0.000000 1.000000 BYTE_ORDER MSB_FIRST /end CHARACTERISTIC
/begin RECORD_LAYOUT RL_AINC_O_EXHAUSTTEMP FNC_VALUES 1 UBYTE COLUMN_DIR DIRECT /end RECORD_LAYOUT
/begin COMPU_METHOD CU_AINC_O_EXHAUSTTEMP "Conversion method for AINc_o_ExhaustTemp" RAT_FUNC "%10.0" "o" COEFFS 0.000000 1.000000 0.000000 0.000000 0.000000 1.000000 /end COMPU_METHOD
/* Scalar calibration for DDE 'AINc_o_FAP'. */
/begin CHARACTERISTIC AINc_o_FAP "Override flag" VALUE 0x8c3a3 RL_AINC_O_FAP 1.000000 CU_AINC_O_FAP 0.000000 1.000000 BYTE_ORDER MSB_FIRST /end CHARACTERISTIC
/begin RECORD_LAYOUT RL_AINC_O_FAP FNC_VALUES 1 UBYTE COLUMN_DIR DIRECT /end RECORD_LAYOUT
/begin COMPU_METHOD CU_AINC_O_FAP "Conversion method for AINc_o_FAP" RAT_FUNC "%10.0" "o" COEFFS 0.000000 1.000000 0.000000 0.000000 0.000000 1.000000 /end COMPU_METHOD
/* Scalar calibration for DDE 'AINc_o_FuelPress'. */
/begin CHARACTERISTIC AINc_o_FuelPress "Override flag" VALUE 0x8c46c RL_AINC_O_FUELPRESS 1.000000 CU_AINC_O_FUELPRESS 0.000000 1.000000 BYTE_ORDER MSB_FIRST /end CHARACTERISTIC
/begin RECORD_LAYOUT RL_AINC_O_FUELPRESS FNC_VALUES 1 UBYTE COLUMN_DIR DIRECT /end RECORD_LAYOUT
/begin COMPU_METHOD CU_AINC_O_FUELPRESS "Conversion method for AINc_o_FuelPress" RAT_FUNC "%10.0" "o" COEFFS 0.000000 1.000000 0.000000 0.000000 0.000000 1.000000 /end COMPU_METHOD
/* Scalar calibration for DDE 'AINc_o_FuelPressOvrd'. */
/begin CHARACTERISTIC AINc_o_FuelPressOvrd "Override flag for DI volume-mode" VALUE 0x8bf7c RL_AINC_O_FUELPRESSOVRD 1.000000 CU_AINC_O_FUELPRESSOVRD 0.000000 1.000000 BYTE_ORDER MSB_FIRST /end CHARACTERISTIC
/begin RECORD_LAYOUT RL_AINC_O_FUELPRESSOVRD FNC_VALUES 1 UBYTE COLUMN_DIR DIRECT /end RECORD_LAYOUT
/begin COMPU_METHOD CU_AINC_O_FUELPRESSOVRD "Conversion method for AINc_o_FuelPressOvrd" RAT_FUNC "%10.0" "o" COEFFS 0.000000 1.000000 0.000000 0.000000 0.000000 1.000000 /end COMPU_METHOD
/* Scalar calibration for DDE 'AINc_o_FuelTemp'. */
/begin CHARACTERISTIC AINc_o_FuelTemp "Override flag" VALUE 0x8c438 RL_AINC_O_FUELTEMP 1.000000 CU_AINC_O_FUELTEMP 0.000000 1.000000 BYTE_ORDER MSB_FIRST /end CHARACTERISTIC
/begin RECORD_LAYOUT RL_AINC_O_FUELTEMP FNC_VALUES 1 UBYTE COLUMN_DIR DIRECT /end RECORD_LAYOUT
/begin COMPU_METHOD CU_AINC_O_FUELTEMP "Conversion method for AINc_o_FuelTemp" RAT_FUNC "%10.0" "o" COEFFS 0.000000 1.000000 0.000000 0.000000 0.000000 1.000000 /end COMPU_METHOD
/* Scalar calibration for DDE 'AINc_o_IC_start'. */
/begin CHARACTERISTIC AINc_o_IC_start "Override flag" VALUE 0x8ce68 RL_AINC_O_IC_START 1.000000 CU_AINC_O_IC_START 0.000000 1.000000 BYTE_ORDER MSB_FIRST /end CHARACTERISTIC
/begin RECORD_LAYOUT RL_AINC_O_IC_START FNC_VALUES 1 UBYTE COLUMN_DIR DIRECT /end RECORD_LAYOUT
/begin COMPU_METHOD CU_AINC_O_IC_START "Conversion method for AINc_o_IC_start" RAT_FUNC "%10.0" "o" COEFFS 0.000000 1.000000 0.000000 0.000000 0.000000 1.000000 /end COMPU_METHOD
/* Scalar calibration for DDE 'AINc_o_MAP'. */
/begin CHARACTERISTIC AINc_o_MAP "Override flag" VALUE 0x8c464 RL_AINC_O_MAP 1.000000 CU_AINC_O_MAP 0.000000 1.000000 BYTE_ORDER MSB_FIRST /end CHARACTERISTIC
/begin RECORD_LAYOUT RL_AINC_O_MAP FNC_VALUES 1 UBYTE COLUMN_DIR DIRECT /end RECORD_LAYOUT
/begin COMPU_METHOD CU_AINC_O_MAP "Conversion method for AINc_o_MAP" RAT_FUNC "%10.0" "o" COEFFS 0.000000 1.000000 0.000000 0.000000 0.000000 1.000000 /end COMPU_METHOD
/* Scalar calibration for DDE 'AINc_o_MIL_Status'. */
/begin CHARACTERISTIC AINc_o_MIL_Status "(not defined)" VALUE 0x8040d RL_AINC_O_MIL_STATUS 1.000000 CU_AINC_O_MIL_STATUS 0.000000 1.000000 BYTE_ORDER MSB_FIRST /end CHARACTERISTIC
/begin RECORD_LAYOUT RL_AINC_O_MIL_STATUS FNC_VALUES 1 UBYTE COLUMN_DIR DIRECT /end RECORD_LAYOUT
/begin COMPU_METHOD CU_AINC_O_MIL_STATUS "Conversion method for AINc_o_MIL_Status" RAT_FUNC "%10.0" "b" COEFFS 0.000000 1.000000 0.000000 0.000000 0.000000 1.000000 /end COMPU_METHOD
/* Scalar calibration for DDE 'AINc_o_ManifoldTemp'. */
/begin CHARACTERISTIC AINc_o_ManifoldTemp "Override flag" VALUE 0x8c446 RL_AINC_O_MANIFOLDTEMP 1.000000 CU_AINC_O_MANIFOLDTEMP 0.000000 1.000000 BYTE_ORDER MSB_FIRST /end CHARACTERISTIC
/begin RECORD_LAYOUT RL_AINC_O_MANIFOLDTEMP FNC_VALUES 1 UBYTE COLUMN_DIR DIRECT /end RECORD_LAYOUT
/begin COMPU_METHOD CU_AINC_O_MANIFOLDTEMP "Conversion method for AINc_o_ManifoldTemp" RAT_FUNC "%10.0" "o" COEFFS 0.000000 1.000000 0.000000 0.000000 0.000000 1.000000 /end COMPU_METHOD
/* Scalar calibration for DDE 'AINc_o_OilPress'. */
/begin CHARACTERISTIC AINc_o_OilPress "Override flag" VALUE 0x8c3e4 RL_AINC_O_OILPRESS 1.000000 CU_AINC_O_OILPRESS 0.000000 1.000000 BYTE_ORDER MSB_FIRST /end CHARACTERISTIC
/begin RECORD_LAYOUT RL_AINC_O_OILPRESS FNC_VALUES 1 UBYTE COLUMN_DIR DIRECT /end RECORD_LAYOUT
/begin COMPU_METHOD CU_AINC_O_OILPRESS "Conversion method for AINc_o_OilPress" RAT_FUNC "%10.0" "o" COEFFS 0.000000 1.000000 0.000000 0.000000 0.000000 1.000000 /end COMPU_METHOD
/* Scalar calibration for DDE 'AINc_o_OilTemp'. */
/begin CHARACTERISTIC AINc_o_OilTemp "Override flag" VALUE 0x8c40a RL_AINC_O_OILTEMP 1.000000 CU_AINC_O_OILTEMP 0.000000 1.000000 BYTE_ORDER MSB_FIRST /end CHARACTERISTIC
/begin RECORD_LAYOUT RL_AINC_O_OILTEMP FNC_VALUES 1 UBYTE COLUMN_DIR DIRECT /end RECORD_LAYOUT
/begin COMPU_METHOD CU_AINC_O_OILTEMP "Conversion method for AINc_o_OilTemp" RAT_FUNC "%10.0" "o" COEFFS 0.000000 1.000000 0.000000 0.000000 0.000000 1.000000 /end COMPU_METHOD
/* Scalar calibration for DDE 'AINc_o_TP1_Raw'. */
/begin CHARACTERISTIC AINc_o_TP1_Raw "Override flag" VALUE 0x8c3b4 RL_AINC_O_TP1_RAW 1.000000 CU_AINC_O_TP1_RAW 0.000000 1.000000 BYTE_ORDER MSB_FIRST /end CHARACTERISTIC
/begin RECORD_LAYOUT RL_AINC_O_TP1_RAW FNC_VALUES 1 UBYTE COLUMN_DIR DIRECT /end RECORD_LAYOUT
/begin COMPU_METHOD CU_AINC_O_TP1_RAW "Conversion method for AINc_o_TP1_Raw" RAT_FUNC "%10.0" "o" COEFFS 0.000000 1.000000 0.000000 0.000000 0.000000 1.000000 /end COMPU_METHOD
/* Scalar calibration for DDE 'AINc_o_TP2_Raw'. */
/begin CHARACTERISTIC AINc_o_TP2_Raw "Override flag" VALUE 0x8c3bc RL_AINC_O_TP2_RAW 1.000000 CU_AINC_O_TP2_RAW 0.000000 1.000000 BYTE_ORDER MSB_FIRST /end CHARACTERISTIC
/begin RECORD_LAYOUT RL_AINC_O_TP2_RAW FNC_VALUES 1 UBYTE COLUMN_DIR DIRECT /end RECORD_LAYOUT
/begin COMPU_METHOD CU_AINC_O_TP2_RAW "Conversion method for AINc_o_TP2_Raw" RAT_FUNC "%10.0" "o" COEFFS 0.000000 1.000000 0.000000 0.000000 0.000000 1.000000 /end COMPU_METHOD
/* Scalar calibration for DDE 'AINc_o_UEGO1'. */
/begin CHARACTERISTIC AINc_o_UEGO1 "Override flag" VALUE 0x8c420 RL_AINC_O_UEGO1 1.000000 CU_AINC_O_UEGO1 0.000000 1.000000 BYTE_ORDER MSB_FIRST /end CHARACTERISTIC
/begin RECORD_LAYOUT RL_AINC_O_UEGO1 FNC_VALUES 1 UBYTE COLUMN_DIR DIRECT /end RECORD_LAYOUT
/begin COMPU_METHOD CU_AINC_O_UEGO1 "Conversion method for AINc_o_UEGO1" RAT_FUNC "%10.0" "o" COEFFS 0.000000 1.000000 0.000000 0.000000 0.000000 1.000000 /end COMPU_METHOD
/* Scalar calibration for DDE 'AINc_o_UEGO1_Valid'. */
/begin CHARACTERISTIC AINc_o_UEGO1_Valid "Override flag" VALUE 0x8c428 RL_AINC_O_UEGO1_VALID 1.000000 CU_AINC_O_UEGO1_VALID 0.000000 1.000000 BYTE_ORDER MSB_FIRST /end CHARACTERISTIC
/begin RECORD_LAYOUT RL_AINC_O_UEGO1_VALID FNC_VALUES 1 UBYTE COLUMN_DIR DIRECT /end RECORD_LAYOUT
/begin COMPU_METHOD CU_AINC_O_UEGO1_VALID "Conversion method for AINc_o_UEGO1_Valid" RAT_FUNC "%10.0" "o" COEFFS 0.000000 1.000000 0.000000 0.000000 0.000000 1.000000 /end COMPU_METHOD
/* Scalar calibration for DDE 'AINc_o_UEGO2'. */
/begin CHARACTERISTIC AINc_o_UEGO2 "Override flag" VALUE 0x8c42a RL_AINC_O_UEGO2 1.000000 CU_AINC_O_UEGO2 0.000000 1.000000 BYTE_ORDER MSB_FIRST /end CHARACTERISTIC
/begin RECORD_LAYOUT RL_AINC_O_UEGO2 FNC_VALUES 1 UBYTE COLUMN_DIR DIRECT /end RECORD_LAYOUT
/begin COMPU_METHOD CU_AINC_O_UEGO2 "Conversion method for AINc_o_UEGO2" RAT_FUNC "%10.0" "o" COEFFS 0.000000 1.000000 0.000000 0.000000 0.000000 1.000000 /end COMPU_METHOD
/* Scalar calibration for DDE 'AINc_o_UEGO2_Valid'. */
/begin CHARACTERISTIC AINc_o_UEGO2_Valid "Override flag" VALUE 0x8c430 RL_AINC_O_UEGO2_VALID 1.000000 CU_AINC_O_UEGO2_VALID 0.000000 1.000000 BYTE_ORDER MSB_FIRST /end CHARACTERISTIC
/begin RECORD_LAYOUT RL_AINC_O_UEGO2_VALID FNC_VALUES 1 UBYTE COLUMN_DIR DIRECT /end RECORD_LAYOUT
/begin COMPU_METHOD CU_AINC_O_UEGO2_VALID "Conversion method for AINc_o_UEGO2_Valid" RAT_FUNC "%10.0" "o" COEFFS 0.000000 1.000000 0.000000 0.000000 0.000000 1.000000 /end COMPU_METHOD
/* Scalar calibration for DDE 'AINc_o_VBatt'. */
/begin CHARACTERISTIC AINc_o_VBatt "Override flag" VALUE 0x8c088 RL_AINC_O_VBATT 1.000000 CU_AINC_O_VBATT 0.000000 1.000000 BYTE_ORDER MSB_FIRST /end CHARACTERISTIC
/begin RECORD_LAYOUT RL_AINC_O_VBATT FNC_VALUES 1 UBYTE COLUMN_DIR DIRECT /end RECORD_LAYOUT
/begin COMPU_METHOD CU_AINC_O_VBATT "Conversion method for AINc_o_VBatt" RAT_FUNC "%10.0" "o" COEFFS 0.000000 1.000000 0.000000 0.000000 0.000000 1.000000 /end COMPU_METHOD
/* Scalar calibration for DDE 'AINc_o_WU_start'. */
/begin CHARACTERISTIC AINc_o_WU_start "Override flag" VALUE 0x8ce66 RL_AINC_O_WU_START 1.000000 CU_AINC_O_WU_START 0.000000 1.000000 BYTE_ORDER MSB_FIRST /end CHARACTERISTIC
/begin RECORD_LAYOUT RL_AINC_O_WU_START FNC_VALUES 1 UBYTE COLUMN_DIR DIRECT /end RECORD_LAYOUT
/begin COMPU_METHOD CU_AINC_O_WU_START "Conversion method for AINc_o_WU_start" RAT_FUNC "%10.0" "o" COEFFS 0.000000 1.000000 0.000000 0.000000 0.000000 1.000000 /end COMPU_METHOD
/* Scalar calibration for DDE 'AINc_pct_Cylinder1_Knock'. */
/begin CHARACTERISTIC AINc_pct_Cylinder1_Knock "Override value" VALUE 0x8c3d8 RL_AINC_PCT_CYLINDER1_KNOCK 2.000000 CU_AINC_PCT_CYLINDER1_KNOCK 0.000000 2.000000 BYTE_ORDER MSB_FIRST /end CHARACTERISTIC
/begin RECORD_LAYOUT RL_AINC_PCT_CYLINDER1_KNOCK FNC_VALUES 1 FLOAT32_IEEE COLUMN_DIR DIRECT /end RECORD_LAYOUT
/begin COMPU_METHOD CU_AINC_PCT_CYLINDER1_KNOCK "Conversion method for AINc_pct_Cylinder1_Knock" RAT_FUNC "%10.2" "pct" COEFFS 0.000000 1.000000 0.000000 0.000000 0.000000 1.000000 /end COMPU_METHOD
/* Scalar calibration for DDE 'AINc_pct_Cylinder2_Knock'. */
/begin CHARACTERISTIC AINc_pct_Cylinder2_Knock "Override value" VALUE 0x8c3e0 RL_AINC_PCT_CYLINDER2_KNOCK 2.000000 CU_AINC_PCT_CYLINDER2_KNOCK 0.000000 2.000000 BYTE_ORDER MSB_FIRST /end CHARACTERISTIC
/begin RECORD_LAYOUT RL_AINC_PCT_CYLINDER2_KNOCK FNC_VALUES 1 FLOAT32_IEEE COLUMN_DIR DIRECT /end RECORD_LAYOUT
/begin COMPU_METHOD CU_AINC_PCT_CYLINDER2_KNOCK "Conversion method for AINc_pct_Cylinder2_Knock" RAT_FUNC "%10.2" "pct" COEFFS 0.000000 1.000000 0.000000 0.000000 0.000000 1.000000 /end COMPU_METHOD
/* Scalar calibration for DDE 'AINc_pct_Cylinder3_Knock'. */
/begin CHARACTERISTIC AINc_pct_Cylinder3_Knock "Override value" VALUE 0x8c3c8 RL_AINC_PCT_CYLINDER3_KNOCK 2.000000 CU_AINC_PCT_CYLINDER3_KNOCK 0.000000 2.000000 BYTE_ORDER MSB_FIRST /end CHARACTERISTIC
/begin RECORD_LAYOUT RL_AINC_PCT_CYLINDER3_KNOCK FNC_VALUES 1 FLOAT32_IEEE COLUMN_DIR DIRECT /end RECORD_LAYOUT
/begin COMPU_METHOD CU_AINC_PCT_CYLINDER3_KNOCK "Conversion method for AINc_pct_Cylinder3_Knock" RAT_FUNC "%10.2" "pct" COEFFS 0.000000 1.000000 0.000000 0.000000 0.000000 1.000000 /end COMPU_METHOD
/* Scalar calibration for DDE 'AINc_pct_Cylinder4_Knock'. */
/begin CHARACTERISTIC AINc_pct_Cylinder4_Knock "Override value" VALUE 0x8c3d0 RL_AINC_PCT_CYLINDER4_KNOCK 2.000000 CU_AINC_PCT_CYLINDER4_KNOCK 0.000000 2.000000 BYTE_ORDER MSB_FIRST /end CHARACTERISTIC
/begin RECORD_LAYOUT RL_AINC_PCT_CYLINDER4_KNOCK FNC_VALUES 1 FLOAT32_IEEE COLUMN_DIR DIRECT /end RECORD_LAYOUT
/begin COMPU_METHOD CU_AINC_PCT_CYLINDER4_KNOCK "Conversion method for AINc_pct_Cylinder4_Knock" RAT_FUNC "%10.2" "pct" COEFFS 0.000000 1.000000 0.000000 0.000000 0.000000 1.000000 /end COMPU_METHOD
/* Scalar calibration for DDE 'AINc_s_L1DeadTime'. */
/begin CHARACTERISTIC AINc_s_L1DeadTime "(not defined)" VALUE 0x8dc84 RL_AINC_S_L1DEADTIME 1000.000000 CU_AINC_S_L1DEADTIME 0.000000 1000.000000 BYTE_ORDER MSB_FIRST /end CHARACTERISTIC
/begin RECORD_LAYOUT RL_AINC_S_L1DEADTIME FNC_VALUES 1 FLOAT32_IEEE COLUMN_DIR DIRECT /end RECORD_LAYOUT
/begin COMPU_METHOD CU_AINC_S_L1DEADTIME "Conversion method for AINc_s_L1DeadTime" RAT_FUNC "%10.1" "s" COEFFS 0.000000 1.000000 0.000000 0.000000 0.000000 1.000000 /end COMPU_METHOD
/* Scalar calibration for DDE 'AINc_s_L1ResetTime'. */
/begin CHARACTERISTIC AINc_s_L1ResetTime "(not defined)" VALUE 0x8dc80 RL_AINC_S_L1RESETTIME 1000.000000 CU_AINC_S_L1RESETTIME 0.000000 1000.000000 BYTE_ORDER MSB_FIRST /end CHARACTERISTIC
/begin RECORD_LAYOUT RL_AINC_S_L1RESETTIME FNC_VALUES 1 FLOAT32_IEEE COLUMN_DIR DIRECT /end RECORD_LAYOUT
/begin COMPU_METHOD CU_AINC_S_L1RESETTIME "Conversion method for AINc_s_L1ResetTime" RAT_FUNC "%10.1" "s" COEFFS 0.000000 1.000000 0.000000 0.000000 0.000000 1.000000 /end COMPU_METHOD
/* Scalar calibration for DDE 'AINc_s_L2SBDeadTime'. */
/begin CHARACTERISTIC AINc_s_L2SBDeadTime "(not defined)" VALUE 0x8c0b0 RL_AINC_S_L2SBDEADTIME 1000.000000 CU_AINC_S_L2SBDEADTIME 0.000000 1000.000000 BYTE_ORDER MSB_FIRST /end CHARACTERISTIC
/begin RECORD_LAYOUT RL_AINC_S_L2SBDEADTIME FNC_VALUES 1 FLOAT32_IEEE COLUMN_DIR DIRECT /end RECORD_LAYOUT
/begin COMPU_METHOD CU_AINC_S_L2SBDEADTIME "Conversion method for AINc_s_L2SBDeadTime" RAT_FUNC "%10.1" "s" COEFFS 0.000000 1.000000 0.000000 0.000000 0.000000 1.000000 /end COMPU_METHOD
/* Scalar calibration for DDE 'AINc_s_L2SBResetTime'. */
/begin CHARACTERISTIC AINc_s_L2SBResetTime "(not defined)" VALUE 0x8c0b4 RL_AINC_S_L2SBRESETTIME 1000.000000 CU_AINC_S_L2SBRESETTIME 0.000000 1000.000000 BYTE_ORDER MSB_FIRST /end CHARACTERISTIC
/begin RECORD_LAYOUT RL_AINC_S_L2SBRESETTIME FNC_VALUES 1 FLOAT32_IEEE COLUMN_DIR DIRECT /end RECORD_LAYOUT
/begin COMPU_METHOD CU_AINC_S_L2SBRESETTIME "Conversion method for AINc_s_L2SBResetTime" RAT_FUNC "%10.1" "s" COEFFS 0.000000 1.000000 0.000000 0.000000 0.000000 1.000000 /end COMPU_METHOD
/* Scalar calibration for DDE 'AINc_s_NoSyncDelay'. */
/begin CHARACTERISTIC AINc_s_NoSyncDelay "If angular sync is absent for this duration  angular analog inputs will be polled periodically" VALUE 0x8c040 RL_AINC_S_NOSYNCDELAY 4.990000 CU_AINC_S_NOSYNCDELAY 0.010000 5.000000 BYTE_ORDER MSB_FIRST /end CHARACTERISTIC
/begin RECORD_LAYOUT RL_AINC_S_NOSYNCDELAY FNC_VALUES 1 FLOAT32_IEEE COLUMN_DIR DIRECT /end RECORD_LAYOUT
/begin COMPU_METHOD CU_AINC_S_NOSYNCDELAY "Conversion method for AINc_s_NoSyncDelay" RAT_FUNC "%10.2" "s" COEFFS 0.000000 1.000000 0.000000 0.000000 0.000000 1.000000 /end COMPU_METHOD
/* Scalar calibration for DDE 'AINc_s_SyncCranktime'. */
/begin CHARACTERISTIC AINc_s_SyncCranktime "Retardo antes de Cramshaft Valid" VALUE 0x8c4c8 RL_AINC_S_SYNCCRANKTIME 4.990000 CU_AINC_S_SYNCCRANKTIME 0.010000 5.000000 BYTE_ORDER MSB_FIRST /end CHARACTERISTIC
/begin RECORD_LAYOUT RL_AINC_S_SYNCCRANKTIME FNC_VALUES 1 FLOAT32_IEEE COLUMN_DIR DIRECT /end RECORD_LAYOUT
/begin COMPU_METHOD CU_AINC_S_SYNCCRANKTIME "Conversion method for AINc_s_SyncCranktime" RAT_FUNC "%10.2" "s" COEFFS 0.000000 1.000000 0.000000 0.000000 0.000000 1.000000 /end COMPU_METHOD
/* Scalar calibration for DDE 'AINc_s_THRDeadTime'. */
/begin CHARACTERISTIC AINc_s_THRDeadTime "(not defined)" VALUE 0x8c364 RL_AINC_S_THRDEADTIME 1000.000000 CU_AINC_S_THRDEADTIME 0.000000 1000.000000 BYTE_ORDER MSB_FIRST /end CHARACTERISTIC
/begin RECORD_LAYOUT RL_AINC_S_THRDEADTIME FNC_VALUES 1 FLOAT32_IEEE COLUMN_DIR DIRECT /end RECORD_LAYOUT
/begin COMPU_METHOD CU_AINC_S_THRDEADTIME "Conversion method for AINc_s_THRDeadTime" RAT_FUNC "%10.1" "s" COEFFS 0.000000 1.000000 0.000000 0.000000 0.000000 1.000000 /end COMPU_METHOD
/* Scalar calibration for DDE 'AINc_s_THRResetTime'. */
/begin CHARACTERISTIC AINc_s_THRResetTime "(not defined)" VALUE 0x8c368 RL_AINC_S_THRRESETTIME 1000.000000 CU_AINC_S_THRRESETTIME 0.000000 1000.000000 BYTE_ORDER MSB_FIRST /end CHARACTERISTIC
/begin RECORD_LAYOUT RL_AINC_S_THRRESETTIME FNC_VALUES 1 FLOAT32_IEEE COLUMN_DIR DIRECT /end RECORD_LAYOUT
/begin COMPU_METHOD CU_AINC_S_THRRESETTIME "Conversion method for AINc_s_THRResetTime" RAT_FUNC "%10.1" "s" COEFFS 0.000000 1.000000 0.000000 0.000000 0.000000 1.000000 /end COMPU_METHOD
/* Scalar calibration for DDE 'AINc_s_TimeFuelLevel'. */
/begin CHARACTERISTIC AINc_s_TimeFuelLevel "(not defined)" VALUE 0x8c15c RL_AINC_S_TIMEFUELLEVEL 60.000000 CU_AINC_S_TIMEFUELLEVEL 0.000000 60.000000 BYTE_ORDER MSB_FIRST /end CHARACTERISTIC
/begin RECORD_LAYOUT RL_AINC_S_TIMEFUELLEVEL FNC_VALUES 1 FLOAT32_IEEE COLUMN_DIR DIRECT /end RECORD_LAYOUT
/begin COMPU_METHOD CU_AINC_S_TIMEFUELLEVEL "Conversion method for AINc_s_TimeFuelLevel" RAT_FUNC "%10.0" "s" COEFFS 0.000000 1.000000 0.000000 0.000000 0.000000 1.000000 /end COMPU_METHOD
/* Scalar calibration for DDE 'AINc_s_cyl_inj_RDT'. */
/begin CHARACTERISTIC AINc_s_cyl_inj_RDT "(not defined)" VALUE 0x8ccec RL_AINC_S_CYL_INJ_RDT 100.000000 CU_AINC_S_CYL_INJ_RDT 0.000000 100.000000 BYTE_ORDER MSB_FIRST /end CHARACTERISTIC
/begin RECORD_LAYOUT RL_AINC_S_CYL_INJ_RDT FNC_VALUES 1 FLOAT32_IEEE COLUMN_DIR DIRECT /end RECORD_LAYOUT
/begin COMPU_METHOD CU_AINC_S_CYL_INJ_RDT "Conversion method for AINc_s_cyl_inj_RDT" RAT_FUNC "%10.3" "s" COEFFS 0.000000 1.000000 0.000000 0.000000 0.000000 1.000000 /end COMPU_METHOD
/* Scalar calibration for DDE 'AINc_s_cyl_inj_SDT'. */
/begin CHARACTERISTIC AINc_s_cyl_inj_SDT "(not defined)" VALUE 0x8cce8 RL_AINC_S_CYL_INJ_SDT 100.000000 CU_AINC_S_CYL_INJ_SDT 0.000000 100.000000 BYTE_ORDER MSB_FIRST /end CHARACTERISTIC
/begin RECORD_LAYOUT RL_AINC_S_CYL_INJ_SDT FNC_VALUES 1 FLOAT32_IEEE COLUMN_DIR DIRECT /end RECORD_LAYOUT
/begin COMPU_METHOD CU_AINC_S_CYL_INJ_SDT "Conversion method for AINc_s_cyl_inj_SDT" RAT_FUNC "%10.3" "s" COEFFS 0.000000 1.000000 0.000000 0.000000 0.000000 1.000000 /end COMPU_METHOD
/* Map (1d) calibration for DDE 'AINm_NU_FuelPress_z'. */
/begin CHARACTERISTIC AINm_NU_FuelPress_z "Sensor transfer function for DI volume-mode" CURVE 0x8d4d4 RL_AINM_NU_FUELPRESS_Z 100.000000 CU_AINM_NU_FUELPRESS_Z 0.000000 100.000000
 /begin AXIS_DESCR COM_AXIS NO_INPUT_QUANTITY CU_AINM_NU_FUELPRESS_X 2 0.000000 5.000000 AXIS_PTS_REF APD_AINM_NU_FUELPRESS_X /end AXIS_DESCR
 BYTE_ORDER MSB_FIRST /end CHARACTERISTIC
/begin RECORD_LAYOUT RL_AINM_NU_FUELPRESS_Z FNC_VALUES 1 FLOAT32_IEEE COLUMN_DIR DIRECT /end RECORD_LAYOUT
/begin COMPU_METHOD CU_AINM_NU_FUELPRESS_Z "Conversion method for AINm_NU_FuelPress_z" RAT_FUNC "%10.1" "MPa" COEFFS 0.000000 1.000000 0.000000 0.000000 0.000000 1.000000 /end COMPU_METHOD
/begin AXIS_PTS APD_AINM_NU_FUELPRESS_X "Sensor transfer function for DI volume-mode" 0x8d4cc NO_INPUT_QUANTITY RL_AINM_NU_FUELPRESS_X 5.000000 CU_AINM_NU_FUELPRESS_X 2 0.0 5.0 BYTE_ORDER MSB_FIRST /end AXIS_PTS
/begin RECORD_LAYOUT RL_AINM_NU_FUELPRESS_X AXIS_PTS_X 1 FLOAT32_IEEE INDEX_INCR DIRECT /end RECORD_LAYOUT
/begin COMPU_METHOD CU_AINM_NU_FUELPRESS_X "Conversion method for AINm_NU_FuelPress_x" RAT_FUNC "%10.3" "V" COEFFS 0.000000 1.000000 0.000000 0.000000 0.000000 1.000000 /end COMPU_METHOD
/* Map (1d) calibration for DDE 'AINm_NU_KnockGain_z'. */
/begin CHARACTERISTIC AINm_NU_KnockGain_z "Knock window start angle offset as a function of engine speed" CURVE 0x8c2c8 RL_AINM_NU_KNOCKGAIN_Z 1.000000 CU_AINM_NU_KNOCKGAIN_Z 0.000000 1.000000
 /begin AXIS_DESCR COM_AXIS NO_INPUT_QUANTITY CU_AINM_NU_KNOCKGAIN_X 6 0.000000 8000.000000 AXIS_PTS_REF APD_AINM_NU_KNOCKGAIN_X /end AXIS_DESCR
 BYTE_ORDER MSB_FIRST /end CHARACTERISTIC
/begin RECORD_LAYOUT RL_AINM_NU_KNOCKGAIN_Z FNC_VALUES 1 FLOAT32_IEEE COLUMN_DIR DIRECT /end RECORD_LAYOUT
/begin COMPU_METHOD CU_AINM_NU_KNOCKGAIN_Z "Conversion method for AINm_NU_KnockGain_z" RAT_FUNC "%10.3" "NU" COEFFS 0.000000 1.000000 0.000000 0.000000 0.000000 1.000000 /end COMPU_METHOD
/begin AXIS_PTS APD_AINM_NU_KNOCKGAIN_X "Knock window start angle offset as a function of engine speed" 0x8c2b0 NO_INPUT_QUANTITY RL_AINM_NU_KNOCKGAIN_X 8000.000000 CU_AINM_NU_KNOCKGAIN_X 6 0.0 8000.0 BYTE_ORDER MSB_FIRST /end AXIS_PTS
/begin RECORD_LAYOUT RL_AINM_NU_KNOCKGAIN_X AXIS_PTS_X 1 FLOAT32_IEEE INDEX_INCR DIRECT /end RECORD_LAYOUT
/begin COMPU_METHOD CU_AINM_NU_KNOCKGAIN_X "Conversion method for AINm_NU_KnockGain_x" RAT_FUNC "%10.0" "RPM" COEFFS 0.000000 1.000000 0.000000 0.000000 0.000000 1.000000 /end COMPU_METHOD
/* Map (1d) calibration for DDE 'AINm_NU_KnockOfst_z'. */
/begin CHARACTERISTIC AINm_NU_KnockOfst_z "(not defined)" CURVE 0x8c298 RL_AINM_NU_KNOCKOFST_Z 5.000000 CU_AINM_NU_KNOCKOFST_Z 0.000000 5.000000
 /begin AXIS_DESCR COM_AXIS NO_INPUT_QUANTITY CU_AINM_NU_KNOCKOFST_X 6 0.000000 8000.000000 AXIS_PTS_REF APD_AINM_NU_KNOCKOFST_X /end AXIS_DESCR
 BYTE_ORDER MSB_FIRST /end CHARACTERISTIC
/begin RECORD_LAYOUT RL_AINM_NU_KNOCKOFST_Z FNC_VALUES 1 FLOAT32_IEEE COLUMN_DIR DIRECT /end RECORD_LAYOUT
/begin COMPU_METHOD CU_AINM_NU_KNOCKOFST_Z "Conversion method for AINm_NU_KnockOfst_z" RAT_FUNC "%10.3" "V" COEFFS 0.000000 1.000000 0.000000 0.000000 0.000000 1.000000 /end COMPU_METHOD
/begin AXIS_PTS APD_AINM_NU_KNOCKOFST_X "(not defined)" 0x8c280 NO_INPUT_QUANTITY RL_AINM_NU_KNOCKOFST_X 8000.000000 CU_AINM_NU_KNOCKOFST_X 6 0.0 8000.0 BYTE_ORDER MSB_FIRST /end AXIS_PTS
/begin RECORD_LAYOUT RL_AINM_NU_KNOCKOFST_X AXIS_PTS_X 1 FLOAT32_IEEE INDEX_INCR DIRECT /end RECORD_LAYOUT
/begin COMPU_METHOD CU_AINM_NU_KNOCKOFST_X "Conversion method for AINm_NU_KnockOfst_x" RAT_FUNC "%10.0" "RPM" COEFFS 0.000000 1.000000 0.000000 0.000000 0.000000 1.000000 /end COMPU_METHOD
/* Map (1d) calibration for DDE 'AINm_deg_KnockWinDur_z'. */
/begin CHARACTERISTIC AINm_deg_KnockWinDur_z "Knock window end angle" CURVE 0x8c1d0 RL_AINM_DEG_KNOCKWINDUR_Z 200.000000 CU_AINM_DEG_KNOCKWINDUR_Z 0.000000 200.000000
 /begin AXIS_DESCR COM_AXIS NO_INPUT_QUANTITY CU_AINM_DEG_KNOCKWINDUR_X 6 0.000000 8000.000000 AXIS_PTS_REF APD_AINM_DEG_KNOCKWINDUR_X /end AXIS_DESCR
 BYTE_ORDER MSB_FIRST /end CHARACTERISTIC
/begin RECORD_LAYOUT RL_AINM_DEG_KNOCKWINDUR_Z FNC_VALUES 1 FLOAT32_IEEE COLUMN_DIR DIRECT /end RECORD_LAYOUT
/begin COMPU_METHOD CU_AINM_DEG_KNOCKWINDUR_Z "Conversion method for AINm_deg_KnockWinDur_z" RAT_FUNC "%10.1" "deg" COEFFS 0.000000 1.000000 0.000000 0.000000 0.000000 1.000000 /end COMPU_METHOD
/begin AXIS_PTS APD_AINM_DEG_KNOCKWINDUR_X "Knock window start angle" 0x8c1b8 NO_INPUT_QUANTITY RL_AINM_DEG_KNOCKWINDUR_X 8000.000000 CU_AINM_DEG_KNOCKWINDUR_X 6 0.0 8000.0 BYTE_ORDER MSB_FIRST /end AXIS_PTS
/begin RECORD_LAYOUT RL_AINM_DEG_KNOCKWINDUR_X AXIS_PTS_X 1 FLOAT32_IEEE INDEX_INCR DIRECT /end RECORD_LAYOUT
/begin COMPU_METHOD CU_AINM_DEG_KNOCKWINDUR_X "Conversion method for AINm_deg_KnockWinDur_x" RAT_FUNC "%10.0" "RPM" COEFFS 0.000000 1.000000 0.000000 0.000000 0.000000 1.000000 /end COMPU_METHOD
/* Map (1d) calibration for DDE 'AINm_deg_KnockWinStartOfst_z'. */
/begin CHARACTERISTIC AINm_deg_KnockWinStartOfst_z "Knock window duration as a function of engine speed" CURVE 0x8c200 RL_AINM_DEG_KNOCKWINSTARTOFST_Z 200.000000 CU_AINM_DEG_KNOCKWINSTARTOFST_Z -100.000000 100.000000
 /begin AXIS_DESCR COM_AXIS NO_INPUT_QUANTITY CU_AINM_DEG_KNOCKWINSTARTOFST_X 6 0.000000 8000.000000 AXIS_PTS_REF APD_AINM_DEG_KNOCKWINSTARTOFST0 /end AXIS_DESCR
 BYTE_ORDER MSB_FIRST /end CHARACTERISTIC
/begin RECORD_LAYOUT RL_AINM_DEG_KNOCKWINSTARTOFST_Z FNC_VALUES 1 FLOAT32_IEEE COLUMN_DIR DIRECT /end RECORD_LAYOUT
/begin COMPU_METHOD CU_AINM_DEG_KNOCKWINSTARTOFST_Z "Conversion method for AINm_deg_KnockWinStartOfst_z" RAT_FUNC "%10.1" "deg" COEFFS 0.000000 1.000000 0.000000 0.000000 0.000000 1.000000 /end COMPU_METHOD
/begin AXIS_PTS APD_AINM_DEG_KNOCKWINSTARTOFST0 "Knock window duration as a function of engine speed" 0x8c1e8 NO_INPUT_QUANTITY RL_AINM_DEG_KNOCKWINSTARTOFST_X 8000.000000 CU_AINM_DEG_KNOCKWINSTARTOFST_X 6 0.0 8000.0 BYTE_ORDER MSB_FIRST /end AXIS_PTS
/begin RECORD_LAYOUT RL_AINM_DEG_KNOCKWINSTARTOFST_X AXIS_PTS_X 1 FLOAT32_IEEE INDEX_INCR DIRECT /end RECORD_LAYOUT
/begin COMPU_METHOD CU_AINM_DEG_KNOCKWINSTARTOFST_X "Conversion method for AINm_deg_KnockWinStartOfst_x" RAT_FUNC "%10.0" "RPM" COEFFS 0.000000 1.000000 0.000000 0.000000 0.000000 1.000000 /end COMPU_METHOD
/* Vector/array calibration for DDE 'AINv_C_AmbientTemp_TF'. */
/begin CHARACTERISTIC AINv_C_AmbientTemp_TF "Sensor transfer function" VAL_BLK 0x8dc4c RL_AINV_C_AMBIENTTEMP_TF 240.000000 CU_AINV_C_AMBIENTTEMP_TF -40.000000 200.000000 NUMBER 13 BYTE_ORDER MSB_FIRST /end CHARACTERISTIC
/begin RECORD_LAYOUT RL_AINV_C_AMBIENTTEMP_TF FNC_VALUES 1 FLOAT32_IEEE COLUMN_DIR DIRECT /end RECORD_LAYOUT
/begin COMPU_METHOD CU_AINV_C_AMBIENTTEMP_TF "Conversion method for AINv_C_AmbientTemp_TF" RAT_FUNC "%10.3" "NU" COEFFS 0.000000 1.000000 0.000000 0.000000 0.000000 1.000000 /end COMPU_METHOD
/* Vector/array calibration for DDE 'AINv_C_CoolantTemp_TF'. */
/begin CHARACTERISTIC AINv_C_CoolantTemp_TF "Sensor transfer function" VAL_BLK 0x8dc1c RL_AINV_C_COOLANTTEMP_TF 240.000000 CU_AINV_C_COOLANTTEMP_TF -40.000000 200.000000 NUMBER 12 BYTE_ORDER MSB_FIRST /end CHARACTERISTIC
/begin RECORD_LAYOUT RL_AINV_C_COOLANTTEMP_TF FNC_VALUES 1 FLOAT32_IEEE COLUMN_DIR DIRECT /end RECORD_LAYOUT
/begin COMPU_METHOD CU_AINV_C_COOLANTTEMP_TF "Conversion method for AINv_C_CoolantTemp_TF" RAT_FUNC "%10.3" "NU" COEFFS 0.000000 1.000000 0.000000 0.000000 0.000000 1.000000 /end COMPU_METHOD
/* Vector/array calibration for DDE 'AINv_C_ExTemp_TF'. */
/begin CHARACTERISTIC AINv_C_ExTemp_TF "Sensor transfer function" VAL_BLK 0x8dbbc RL_AINV_C_EXTEMP_TF 1040.000000 CU_AINV_C_EXTEMP_TF -40.000000 1000.000000 NUMBER 24 BYTE_ORDER MSB_FIRST /end CHARACTERISTIC
/begin RECORD_LAYOUT RL_AINV_C_EXTEMP_TF FNC_VALUES 1 FLOAT32_IEEE COLUMN_DIR DIRECT /end RECORD_LAYOUT
/begin COMPU_METHOD CU_AINV_C_EXTEMP_TF "Conversion method for AINv_C_ExTemp_TF" RAT_FUNC "%10.3" "NU" COEFFS 0.000000 1.000000 0.000000 0.000000 0.000000 1.000000 /end COMPU_METHOD
/* Vector/array calibration for DDE 'AINv_C_FuelTemp_TF'. */
/begin CHARACTERISTIC AINv_C_FuelTemp_TF "Sensor transfer function" VAL_BLK 0x8db28 RL_AINV_C_FUELTEMP_TF 240.000000 CU_AINV_C_FUELTEMP_TF -40.000000 200.000000 NUMBER 37 BYTE_ORDER MSB_FIRST /end CHARACTERISTIC
/begin RECORD_LAYOUT RL_AINV_C_FUELTEMP_TF FNC_VALUES 1 FLOAT32_IEEE COLUMN_DIR DIRECT /end RECORD_LAYOUT
/begin COMPU_METHOD CU_AINV_C_FUELTEMP_TF "Conversion method for AINv_C_FuelTemp_TF" RAT_FUNC "%10.3" "NU" COEFFS 0.000000 1.000000 0.000000 0.000000 0.000000 1.000000 /end COMPU_METHOD
/* Vector/array calibration for DDE 'AINv_C_ManifoldTemp_TF'. */
/begin CHARACTERISTIC AINv_C_ManifoldTemp_TF "Sensor transfer function" VAL_BLK 0x8dae8 RL_AINV_C_MANIFOLDTEMP_TF 240.000000 CU_AINV_C_MANIFOLDTEMP_TF -40.000000 200.000000 NUMBER 16 BYTE_ORDER MSB_FIRST /end CHARACTERISTIC
/begin RECORD_LAYOUT RL_AINV_C_MANIFOLDTEMP_TF FNC_VALUES 1 FLOAT32_IEEE COLUMN_DIR DIRECT /end RECORD_LAYOUT
/begin COMPU_METHOD CU_AINV_C_MANIFOLDTEMP_TF "Conversion method for AINv_C_ManifoldTemp_TF" RAT_FUNC "%10.3" "NU" COEFFS 0.000000 1.000000 0.000000 0.000000 0.000000 1.000000 /end COMPU_METHOD
/* Vector/array calibration for DDE 'AINv_NU_KnockFilterGain'. */
/begin CHARACTERISTIC AINv_NU_KnockFilterGain "Gain applied to the knock transducer signal as a function of cylinder" VAL_BLK 0x8c21c RL_AINV_NU_KNOCKFILTERGAIN 1.889000 CU_AINV_NU_KNOCKFILTERGAIN 0.111000 2.000000 NUMBER 8 BYTE_ORDER MSB_FIRST /end CHARACTERISTIC
/begin RECORD_LAYOUT RL_AINV_NU_KNOCKFILTERGAIN FNC_VALUES 1 FLOAT32_IEEE COLUMN_DIR DIRECT /end RECORD_LAYOUT
/begin COMPU_METHOD CU_AINV_NU_KNOCKFILTERGAIN "Conversion method for AINv_NU_KnockFilterGain" RAT_FUNC "%10.2" "NU" COEFFS 0.000000 1.000000 0.000000 0.000000 0.000000 1.000000 /end COMPU_METHOD
/* Vector/array calibration for DDE 'AINv_V_AmbientTemp_TF'. */
/begin CHARACTERISTIC AINv_V_AmbientTemp_TF "Sensor transfer function" VAL_BLK 0x8dab4 RL_AINV_V_AMBIENTTEMP_TF 5.000000 CU_AINV_V_AMBIENTTEMP_TF 0.000000 5.000000 NUMBER 13 BYTE_ORDER MSB_FIRST /end CHARACTERISTIC
/begin RECORD_LAYOUT RL_AINV_V_AMBIENTTEMP_TF FNC_VALUES 1 FLOAT32_IEEE COLUMN_DIR DIRECT /end RECORD_LAYOUT
/begin COMPU_METHOD CU_AINV_V_AMBIENTTEMP_TF "Conversion method for AINv_V_AmbientTemp_TF" RAT_FUNC "%10.3" "V" COEFFS 0.000000 1.000000 0.000000 0.000000 0.000000 1.000000 /end COMPU_METHOD
/* Vector/array calibration for DDE 'AINv_V_CoolantTemp_TF'. */
/begin CHARACTERISTIC AINv_V_CoolantTemp_TF "Sensor transfer function" VAL_BLK 0x8da84 RL_AINV_V_COOLANTTEMP_TF 5.000000 CU_AINV_V_COOLANTTEMP_TF 0.000000 5.000000 NUMBER 12 BYTE_ORDER MSB_FIRST /end CHARACTERISTIC
/begin RECORD_LAYOUT RL_AINV_V_COOLANTTEMP_TF FNC_VALUES 1 FLOAT32_IEEE COLUMN_DIR DIRECT /end RECORD_LAYOUT
/begin COMPU_METHOD CU_AINV_V_COOLANTTEMP_TF "Conversion method for AINv_V_CoolantTemp_TF" RAT_FUNC "%10.2" "V" COEFFS 0.000000 1.000000 0.000000 0.000000 0.000000 1.000000 /end COMPU_METHOD
/* Vector/array calibration for DDE 'AINv_V_ExTemp_TF'. */
/begin CHARACTERISTIC AINv_V_ExTemp_TF "Sensor transfer function" VAL_BLK 0x8da24 RL_AINV_V_EXTEMP_TF 5.000000 CU_AINV_V_EXTEMP_TF 0.000000 5.000000 NUMBER 24 BYTE_ORDER MSB_FIRST /end CHARACTERISTIC
/begin RECORD_LAYOUT RL_AINV_V_EXTEMP_TF FNC_VALUES 1 FLOAT32_IEEE COLUMN_DIR DIRECT /end RECORD_LAYOUT
/begin COMPU_METHOD CU_AINV_V_EXTEMP_TF "Conversion method for AINv_V_ExTemp_TF" RAT_FUNC "%10.3" "V" COEFFS 0.000000 1.000000 0.000000 0.000000 0.000000 1.000000 /end COMPU_METHOD
/* Vector/array calibration for DDE 'AINv_V_FuelPress_TF'. */
/begin CHARACTERISTIC AINv_V_FuelPress_TF "Sensor transfer function" VAL_BLK 0x8da1c RL_AINV_V_FUELPRESS_TF 5.000000 CU_AINV_V_FUELPRESS_TF 0.000000 5.000000 NUMBER 2 BYTE_ORDER MSB_FIRST /end CHARACTERISTIC
/begin RECORD_LAYOUT RL_AINV_V_FUELPRESS_TF FNC_VALUES 1 FLOAT32_IEEE COLUMN_DIR DIRECT /end RECORD_LAYOUT
/begin COMPU_METHOD CU_AINV_V_FUELPRESS_TF "Conversion method for AINv_V_FuelPress_TF" RAT_FUNC "%10.2" "V" COEFFS 0.000000 1.000000 0.000000 0.000000 0.000000 1.000000 /end COMPU_METHOD
/* Vector/array calibration for DDE 'AINv_V_FuelTemp_TF'. */
/begin CHARACTERISTIC AINv_V_FuelTemp_TF "Sensor transfer function" VAL_BLK 0x8d988 RL_AINV_V_FUELTEMP_TF 5.000000 CU_AINV_V_FUELTEMP_TF 0.000000 5.000000 NUMBER 37 BYTE_ORDER MSB_FIRST /end CHARACTERISTIC
/begin RECORD_LAYOUT RL_AINV_V_FUELTEMP_TF FNC_VALUES 1 FLOAT32_IEEE COLUMN_DIR DIRECT /end RECORD_LAYOUT
/begin COMPU_METHOD CU_AINV_V_FUELTEMP_TF "Conversion method for AINv_V_FuelTemp_TF" RAT_FUNC "%10.3" "V" COEFFS 0.000000 1.000000 0.000000 0.000000 0.000000 1.000000 /end COMPU_METHOD
/* Vector/array calibration for DDE 'AINv_V_ManifoldTemp_TF'. */
/begin CHARACTERISTIC AINv_V_ManifoldTemp_TF "Sensor transfer function" VAL_BLK 0x8d948 RL_AINV_V_MANIFOLDTEMP_TF 5.000000 CU_AINV_V_MANIFOLDTEMP_TF 0.000000 5.000000 NUMBER 16 BYTE_ORDER MSB_FIRST /end CHARACTERISTIC
/begin RECORD_LAYOUT RL_AINV_V_MANIFOLDTEMP_TF FNC_VALUES 1 FLOAT32_IEEE COLUMN_DIR DIRECT /end RECORD_LAYOUT
/begin COMPU_METHOD CU_AINV_V_MANIFOLDTEMP_TF "Conversion method for AINv_V_ManifoldTemp_TF" RAT_FUNC "%10.2" "V" COEFFS 0.000000 1.000000 0.000000 0.000000 0.000000 1.000000 /end COMPU_METHOD
/* Vector/array calibration for DDE 'AINv_bar_FuelPress_TF'. */
/begin CHARACTERISTIC AINv_bar_FuelPress_TF "Sensor transfer function" VAL_BLK 0x8d940 RL_AINV_BAR_FUELPRESS_TF 1000.000000 CU_AINV_BAR_FUELPRESS_TF 0.000000 1000.000000 NUMBER 2 BYTE_ORDER MSB_FIRST /end CHARACTERISTIC
/begin RECORD_LAYOUT RL_AINV_BAR_FUELPRESS_TF FNC_VALUES 1 FLOAT32_IEEE COLUMN_DIR DIRECT /end RECORD_LAYOUT
/begin COMPU_METHOD CU_AINV_BAR_FUELPRESS_TF "Conversion method for AINv_bar_FuelPress_TF" RAT_FUNC "%10.3" "bar" COEFFS 0.000000 1.000000 0.000000 0.000000 0.000000 1.000000 /end COMPU_METHOD
/* Vector/array calibration for DDE 'AINv_deg_MAP_SampleAngles'. */
/begin CHARACTERISTIC AINv_deg_MAP_SampleAngles "Input sampling angle Cyl1 TDC relative. Note- values are quantized to 6 deg increments." VAL_BLK 0x8bfe0 RL_AINV_DEG_MAP_SAMPLEANGLES 1439.000000 CU_AINV_DEG_MAP_SAMPLEANGLES -720.000000 719.000000 NUMBER 16 BYTE_ORDER MSB_FIRST /end CHARACTERISTIC
/begin RECORD_LAYOUT RL_AINV_DEG_MAP_SAMPLEANGLES FNC_VALUES 1 FLOAT32_IEEE COLUMN_DIR DIRECT /end RECORD_LAYOUT
/begin COMPU_METHOD CU_AINV_DEG_MAP_SAMPLEANGLES "Conversion method for AINv_deg_MAP_SampleAngles" RAT_FUNC "%10.0" "deg" COEFFS 0.000000 1.000000 0.000000 0.000000 0.000000 1.000000 /end COMPU_METHOD
/* Vector/array calibration for DDE 'AINv_kHz_KnockFilterFrq'. */
/begin CHARACTERISTIC AINv_kHz_KnockFilterFrq "Bandpass centre frequency applied to knock transducer signal as a function of cylinder" VAL_BLK 0x8c23c RL_AINV_KHZ_KNOCKFILTERFRQ 18.760000 CU_AINV_KHZ_KNOCKFILTERFRQ 1.220000 19.980000 NUMBER 8 BYTE_ORDER MSB_FIRST /end CHARACTERISTIC
/begin RECORD_LAYOUT RL_AINV_KHZ_KNOCKFILTERFRQ FNC_VALUES 1 FLOAT32_IEEE COLUMN_DIR DIRECT /end RECORD_LAYOUT
/begin COMPU_METHOD CU_AINV_KHZ_KNOCKFILTERFRQ "Conversion method for AINv_kHz_KnockFilterFrq" RAT_FUNC "%10.2" "kHz" COEFFS 0.000000 1.000000 0.000000 0.000000 0.000000 1.000000 /end COMPU_METHOD
/* Vector/array calibration for DDE 'AINv_us_KnockFilterIntegrator'. */
/begin CHARACTERISTIC AINv_us_KnockFilterIntegrator "Integration time constant applied to knock transduder as a function of cylinder" VAL_BLK 0x8c25c RL_AINV_US_KNOCKFILTERINTEGRAT0 560.000000 CU_AINV_US_KNOCKFILTERINTEGRAT0 40.000000 600.000000 NUMBER 8 BYTE_ORDER MSB_FIRST /end CHARACTERISTIC
/begin RECORD_LAYOUT RL_AINV_US_KNOCKFILTERINTEGRAT0 FNC_VALUES 1 FLOAT32_IEEE COLUMN_DIR DIRECT /end RECORD_LAYOUT
/begin COMPU_METHOD CU_AINV_US_KNOCKFILTERINTEGRAT0 "Conversion method for AINv_us_KnockFilterIntegrator" RAT_FUNC "%10.2" "us" COEFFS 0.000000 1.000000 0.000000 0.000000 0.000000 1.000000 /end COMPU_METHOD
/* Scalar calibration for DDE 'AMBc_b_OBDTempOK'. */
/begin CHARACTERISTIC AMBc_b_OBDTempOK "Override value" VALUE 0x8ce5d RL_AMBC_B_OBDTEMPOK 1.000000 CU_AMBC_B_OBDTEMPOK 0.000000 1.000000 BYTE_ORDER MSB_FIRST /end CHARACTERISTIC
/begin RECORD_LAYOUT RL_AMBC_B_OBDTEMPOK FNC_VALUES 1 UBYTE COLUMN_DIR DIRECT /end RECORD_LAYOUT
/begin COMPU_METHOD CU_AMBC_B_OBDTEMPOK "Conversion method for AMBc_b_OBDTempOK" RAT_FUNC "%10.0" "b" COEFFS 0.000000 1.000000 0.000000 0.000000 0.000000 1.000000 /end COMPU_METHOD
/* Scalar calibration for DDE 'AMBc_o_OBDTempOK'. */
/begin CHARACTERISTIC AMBc_o_OBDTempOK "Override flag" VALUE 0x8ce5c RL_AMBC_O_OBDTEMPOK 1.000000 CU_AMBC_O_OBDTEMPOK 0.000000 1.000000 BYTE_ORDER MSB_FIRST /end CHARACTERISTIC
/begin RECORD_LAYOUT RL_AMBC_O_OBDTEMPOK FNC_VALUES 1 UBYTE COLUMN_DIR DIRECT /end RECORD_LAYOUT
/begin COMPU_METHOD CU_AMBC_O_OBDTEMPOK "Conversion method for AMBc_o_OBDTempOK" RAT_FUNC "%10.0" "o" COEFFS 0.000000 1.000000 0.000000 0.000000 0.000000 1.000000 /end COMPU_METHOD
/* Scalar calibration for DDE 'AMEc_C_ChargeTemp'. */
/begin CHARACTERISTIC AMEc_C_ChargeTemp "Charge temperature override value" VALUE 0x80c40 RL_AMEC_C_CHARGETEMP 240.000000 CU_AMEC_C_CHARGETEMP -40.000000 200.000000 BYTE_ORDER MSB_FIRST /end CHARACTERISTIC
/begin RECORD_LAYOUT RL_AMEC_C_CHARGETEMP FNC_VALUES 1 FLOAT32_IEEE COLUMN_DIR DIRECT /end RECORD_LAYOUT
/begin COMPU_METHOD CU_AMEC_C_CHARGETEMP "Conversion method for AMEc_C_ChargeTemp" RAT_FUNC "%10.0" "C" COEFFS 0.000000 1.000000 0.000000 0.000000 0.000000 1.000000 /end COMPU_METHOD
/* Scalar calibration for DDE 'AMEc_Hz_ChargeTempLPF'. */
/begin CHARACTERISTIC AMEc_Hz_ChargeTempLPF "Lowpass filter cutoff frq applied to charge temp estimate" VALUE 0x80c38 RL_AMEC_HZ_CHARGETEMPLPF 99.900000 CU_AMEC_HZ_CHARGETEMPLPF 0.100000 100.000000 BYTE_ORDER MSB_FIRST /end CHARACTERISTIC
/begin RECORD_LAYOUT RL_AMEC_HZ_CHARGETEMPLPF FNC_VALUES 1 FLOAT32_IEEE COLUMN_DIR DIRECT /end RECORD_LAYOUT
/begin COMPU_METHOD CU_AMEC_HZ_CHARGETEMPLPF "Conversion method for AMEc_Hz_ChargeTempLPF" RAT_FUNC "%10.1" "Hz" COEFFS 0.000000 1.000000 0.000000 0.000000 0.000000 1.000000 /end COMPU_METHOD
/* Scalar calibration for DDE 'AMEc_Hz_LoadFiltCutoff'. */
/begin CHARACTERISTIC AMEc_Hz_LoadFiltCutoff "Filter cutoff frequency for load estimate" VALUE 0x8106c RL_AMEC_HZ_LOADFILTCUTOFF 99999.999900 CU_AMEC_HZ_LOADFILTCUTOFF 0.000100 100000.000000 BYTE_ORDER MSB_FIRST /end CHARACTERISTIC
/begin RECORD_LAYOUT RL_AMEC_HZ_LOADFILTCUTOFF FNC_VALUES 1 FLOAT32_IEEE COLUMN_DIR DIRECT /end RECORD_LAYOUT
/begin COMPU_METHOD CU_AMEC_HZ_LOADFILTCUTOFF "Conversion method for AMEc_Hz_LoadFiltCutoff" RAT_FUNC "%10.2" "Hz" COEFFS 0.000000 1.000000 0.000000 0.000000 0.000000 1.000000 /end COMPU_METHOD
/* Scalar calibration for DDE 'AMEc_Hz_MassAirFlowLPF'. */
/begin CHARACTERISTIC AMEc_Hz_MassAirFlowLPF "LPF cutoff frq for air mass estimate" VALUE 0x81060 RL_AMEC_HZ_MASSAIRFLOWLPF 99.900000 CU_AMEC_HZ_MASSAIRFLOWLPF 0.100000 100.000000 BYTE_ORDER MSB_FIRST /end CHARACTERISTIC
/begin RECORD_LAYOUT RL_AMEC_HZ_MASSAIRFLOWLPF FNC_VALUES 1 FLOAT32_IEEE COLUMN_DIR DIRECT /end RECORD_LAYOUT
/begin COMPU_METHOD CU_AMEC_HZ_MASSAIRFLOWLPF "Conversion method for AMEc_Hz_MassAirFlowLPF" RAT_FUNC "%10.1" "Hz" COEFFS 0.000000 1.000000 0.000000 0.000000 0.000000 1.000000 /end COMPU_METHOD
/* Scalar calibration for DDE 'AMEc_NU_DmndHPF'. */
/begin CHARACTERISTIC AMEc_NU_DmndHPF "Transient detection HPF time constant" VALUE 0x80f7c RL_AMEC_NU_DMNDHPF 1.000000 CU_AMEC_NU_DMNDHPF 0.000000 1.000000 BYTE_ORDER MSB_FIRST /end CHARACTERISTIC
/begin RECORD_LAYOUT RL_AMEC_NU_DMNDHPF FNC_VALUES 1 FLOAT32_IEEE COLUMN_DIR DIRECT /end RECORD_LAYOUT
/begin COMPU_METHOD CU_AMEC_NU_DMNDHPF "Conversion method for AMEc_NU_DmndHPF" RAT_FUNC "%10.2" "NU" COEFFS 0.000000 1.000000 0.000000 0.000000 0.000000 1.000000 /end COMPU_METHOD
/* Scalar calibration for DDE 'AMEc_b_EnableMAF'. */
/begin CHARACTERISTIC AMEc_b_EnableMAF "Allow AME to make use of the MAF-sensor-based airflow estimate" VALUE 0x80e15 RL_AMEC_B_ENABLEMAF 1.000000 CU_AMEC_B_ENABLEMAF 0.000000 1.000000 BYTE_ORDER MSB_FIRST /end CHARACTERISTIC
/begin RECORD_LAYOUT RL_AMEC_B_ENABLEMAF FNC_VALUES 1 UBYTE COLUMN_DIR DIRECT /end RECORD_LAYOUT
/begin COMPU_METHOD CU_AMEC_B_ENABLEMAF "Conversion method for AMEc_b_EnableMAF" RAT_FUNC "%10.0" "b" COEFFS 0.000000 1.000000 0.000000 0.000000 0.000000 1.000000 /end COMPU_METHOD
/* Scalar calibration for DDE 'AMEc_b_EnableSD'. */
/begin CHARACTERISTIC AMEc_b_EnableSD "Allow AME to make use of the speed-density (MAP-based) airflow estimate. Setting this to zero will ignore the UseMAF table and command 100% MAF-based at all times." VALUE 0x80e14 RL_AMEC_B_ENABLESD 1.000000 CU_AMEC_B_ENABLESD 0.000000 1.000000 BYTE_ORDER MSB_FIRST /end CHARACTERISTIC
/begin RECORD_LAYOUT RL_AMEC_B_ENABLESD FNC_VALUES 1 UBYTE COLUMN_DIR DIRECT /end RECORD_LAYOUT
/begin COMPU_METHOD CU_AMEC_B_ENABLESD "Conversion method for AMEc_b_EnableSD" RAT_FUNC "%10.0" "b" COEFFS 0.000000 1.000000 0.000000 0.000000 0.000000 1.000000 /end COMPU_METHOD
/* Scalar calibration for DDE 'AMEc_gps_FreshMassAirFlow'. */
/begin CHARACTERISTIC AMEc_gps_FreshMassAirFlow "Override value" VALUE 0x81068 RL_AMEC_GPS_FRESHMASSAIRFLOW 1000.000000 CU_AMEC_GPS_FRESHMASSAIRFLOW 0.000000 1000.000000 BYTE_ORDER MSB_FIRST /end CHARACTERISTIC
/begin RECORD_LAYOUT RL_AMEC_GPS_FRESHMASSAIRFLOW FNC_VALUES 1 FLOAT32_IEEE COLUMN_DIR DIRECT /end RECORD_LAYOUT
/begin COMPU_METHOD CU_AMEC_GPS_FRESHMASSAIRFLOW "Conversion method for AMEc_gps_FreshMassAirFlow" RAT_FUNC "%10.1" "gps" COEFFS 0.000000 1.000000 0.000000 0.000000 0.000000 1.000000 /end COMPU_METHOD
/* Scalar calibration for DDE 'AMEc_kPa_Baro'. */
/begin CHARACTERISTIC AMEc_kPa_Baro "Override value" VALUE 0x8be50 RL_AMEC_KPA_BARO 200.000000 CU_AMEC_KPA_BARO 0.000000 200.000000 BYTE_ORDER MSB_FIRST /end CHARACTERISTIC
/begin RECORD_LAYOUT RL_AMEC_KPA_BARO FNC_VALUES 1 FLOAT32_IEEE COLUMN_DIR DIRECT /end RECORD_LAYOUT
/begin COMPU_METHOD CU_AMEC_KPA_BARO "Conversion method for AMEc_kPa_Baro" RAT_FUNC "%10.0" "kPa" COEFFS 0.000000 1.000000 0.000000 0.000000 0.000000 1.000000 /end COMPU_METHOD
/* Scalar calibration for DDE 'AMEc_kPa_BaroMax'. */
/begin CHARACTERISTIC AMEc_kPa_BaroMax "Sanity limits for Baro learning" VALUE 0x86fbc RL_AMEC_KPA_BAROMAX 150.000000 CU_AMEC_KPA_BAROMAX 0.000000 150.000000 BYTE_ORDER MSB_FIRST /end CHARACTERISTIC
/begin RECORD_LAYOUT RL_AMEC_KPA_BAROMAX FNC_VALUES 1 FLOAT32_IEEE COLUMN_DIR DIRECT /end RECORD_LAYOUT
/begin COMPU_METHOD CU_AMEC_KPA_BAROMAX "Conversion method for AMEc_kPa_BaroMax" RAT_FUNC "%10.0" "kPa" COEFFS 0.000000 1.000000 0.000000 0.000000 0.000000 1.000000 /end COMPU_METHOD
/* Scalar calibration for DDE 'AMEc_kPa_BaroMin'. */
/begin CHARACTERISTIC AMEc_kPa_BaroMin "Sanity limits for Baro learning" VALUE 0x86fb8 RL_AMEC_KPA_BAROMIN 150.000000 CU_AMEC_KPA_BAROMIN 0.000000 150.000000 BYTE_ORDER MSB_FIRST /end CHARACTERISTIC
/begin RECORD_LAYOUT RL_AMEC_KPA_BAROMIN FNC_VALUES 1 FLOAT32_IEEE COLUMN_DIR DIRECT /end RECORD_LAYOUT
/begin COMPU_METHOD CU_AMEC_KPA_BAROMIN "Conversion method for AMEc_kPa_BaroMin" RAT_FUNC "%10.0" "kPa" COEFFS 0.000000 1.000000 0.000000 0.000000 0.000000 1.000000 /end COMPU_METHOD
/* Scalar calibration for DDE 'AMEc_mg_FreshAirMass'. */
/begin CHARACTERISTIC AMEc_mg_FreshAirMass "Fresh air mass override value" VALUE 0x83524 RL_AMEC_MG_FRESHAIRMASS 0.000000 CU_AMEC_MG_FRESHAIRMASS 0.000000 0.000000 BYTE_ORDER MSB_FIRST /end CHARACTERISTIC
/begin RECORD_LAYOUT RL_AMEC_MG_FRESHAIRMASS FNC_VALUES 1 FLOAT32_IEEE COLUMN_DIR DIRECT /end RECORD_LAYOUT
/begin COMPU_METHOD CU_AMEC_MG_FRESHAIRMASS "Conversion method for AMEc_mg_FreshAirMass" RAT_FUNC "%10.1" "mg" COEFFS 0.000000 1.000000 0.000000 0.000000 0.000000 1.000000 /end COMPU_METHOD
/* Scalar calibration for DDE 'AMEc_o_Baro'. */
/begin CHARACTERISTIC AMEc_o_Baro "Override flag" VALUE 0x8be4c RL_AMEC_O_BARO 1.000000 CU_AMEC_O_BARO 0.000000 1.000000 BYTE_ORDER MSB_FIRST /end CHARACTERISTIC
/begin RECORD_LAYOUT RL_AMEC_O_BARO FNC_VALUES 1 UBYTE COLUMN_DIR DIRECT /end RECORD_LAYOUT
/begin COMPU_METHOD CU_AMEC_O_BARO "Conversion method for AMEc_o_Baro" RAT_FUNC "%10.0" "o" COEFFS 0.000000 1.000000 0.000000 0.000000 0.000000 1.000000 /end COMPU_METHOD
/* Scalar calibration for DDE 'AMEc_o_ChargeTemp'. */
/begin CHARACTERISTIC AMEc_o_ChargeTemp "Charge temperature override flag" VALUE 0x80c3c RL_AMEC_O_CHARGETEMP 1.000000 CU_AMEC_O_CHARGETEMP 0.000000 1.000000 BYTE_ORDER MSB_FIRST /end CHARACTERISTIC
/begin RECORD_LAYOUT RL_AMEC_O_CHARGETEMP FNC_VALUES 1 UBYTE COLUMN_DIR DIRECT /end RECORD_LAYOUT
/begin COMPU_METHOD CU_AMEC_O_CHARGETEMP "Conversion method for AMEc_o_ChargeTemp" RAT_FUNC "%10.0" "o" COEFFS 0.000000 1.000000 0.000000 0.000000 0.000000 1.000000 /end COMPU_METHOD
/* Scalar calibration for DDE 'AMEc_o_FreshAirMass'. */
/begin CHARACTERISTIC AMEc_o_FreshAirMass "Fresh air mass override flag" VALUE 0x83520 RL_AMEC_O_FRESHAIRMASS 1.000000 CU_AMEC_O_FRESHAIRMASS 0.000000 1.000000 BYTE_ORDER MSB_FIRST /end CHARACTERISTIC
/begin RECORD_LAYOUT RL_AMEC_O_FRESHAIRMASS FNC_VALUES 1 UBYTE COLUMN_DIR DIRECT /end RECORD_LAYOUT
/begin COMPU_METHOD CU_AMEC_O_FRESHAIRMASS "Conversion method for AMEc_o_FreshAirMass" RAT_FUNC "%10.0" "b" COEFFS 0.000000 1.000000 0.000000 0.000000 0.000000 1.000000 /end COMPU_METHOD
/* Scalar calibration for DDE 'AMEc_o_FreshMassAirFlow'. */
/begin CHARACTERISTIC AMEc_o_FreshMassAirFlow "Override flag" VALUE 0x81064 RL_AMEC_O_FRESHMASSAIRFLOW 1.000000 CU_AMEC_O_FRESHMASSAIRFLOW 0.000000 1.000000 BYTE_ORDER MSB_FIRST /end CHARACTERISTIC
/begin RECORD_LAYOUT RL_AMEC_O_FRESHMASSAIRFLOW FNC_VALUES 1 UBYTE COLUMN_DIR DIRECT /end RECORD_LAYOUT
/begin COMPU_METHOD CU_AMEC_O_FRESHMASSAIRFLOW "Conversion method for AMEc_o_FreshMassAirFlow" RAT_FUNC "%10.0" "o" COEFFS 0.000000 1.000000 0.000000 0.000000 0.000000 1.000000 /end COMPU_METHOD
/* Scalar calibration for DDE 'AMEc_o_Load'. */
/begin CHARACTERISTIC AMEc_o_Load "Override flag" VALUE 0x81070 RL_AMEC_O_LOAD 1.000000 CU_AMEC_O_LOAD 0.000000 1.000000 BYTE_ORDER MSB_FIRST /end CHARACTERISTIC
/begin RECORD_LAYOUT RL_AMEC_O_LOAD FNC_VALUES 1 UBYTE COLUMN_DIR DIRECT /end RECORD_LAYOUT
/begin COMPU_METHOD CU_AMEC_O_LOAD "Conversion method for AMEc_o_Load" RAT_FUNC "%10.0" "o" COEFFS 0.000000 1.000000 0.000000 0.000000 0.000000 1.000000 /end COMPU_METHOD
/* Scalar calibration for DDE 'AMEc_o_VolEff'. */
/begin CHARACTERISTIC AMEc_o_VolEff "Override flag for volumetric efficiency" VALUE 0x80a58 RL_AMEC_O_VOLEFF 1.000000 CU_AMEC_O_VOLEFF 0.000000 1.000000 BYTE_ORDER MSB_FIRST /end CHARACTERISTIC
/begin RECORD_LAYOUT RL_AMEC_O_VOLEFF FNC_VALUES 1 UBYTE COLUMN_DIR DIRECT /end RECORD_LAYOUT
/begin COMPU_METHOD CU_AMEC_O_VOLEFF "Conversion method for AMEc_o_VolEff" RAT_FUNC "%10.0" "o" COEFFS 0.000000 1.000000 0.000000 0.000000 0.000000 1.000000 /end COMPU_METHOD
/* Scalar calibration for DDE 'AMEc_pct_DemandHPF_Thrsh'. */
/begin CHARACTERISTIC AMEc_pct_DemandHPF_Thrsh "Transient detection threshold" VALUE 0x80f80 RL_AMEC_PCT_DEMANDHPF_THRSH 1000.000000 CU_AMEC_PCT_DEMANDHPF_THRSH 0.000000 1000.000000 BYTE_ORDER MSB_FIRST /end CHARACTERISTIC
/begin RECORD_LAYOUT RL_AMEC_PCT_DEMANDHPF_THRSH FNC_VALUES 1 FLOAT32_IEEE COLUMN_DIR DIRECT /end RECORD_LAYOUT
/begin COMPU_METHOD CU_AMEC_PCT_DEMANDHPF_THRSH "Conversion method for AMEc_pct_DemandHPF_Thrsh" RAT_FUNC "%10.2" "pct" COEFFS 0.000000 1.000000 0.000000 0.000000 0.000000 1.000000 /end COMPU_METHOD
/* Scalar calibration for DDE 'AMEc_pct_Load'. */
/begin CHARACTERISTIC AMEc_pct_Load "Override value" VALUE 0x81074 RL_AMEC_PCT_LOAD 2.000000 CU_AMEC_PCT_LOAD 0.000000 2.000000 BYTE_ORDER MSB_FIRST /end CHARACTERISTIC
/begin RECORD_LAYOUT RL_AMEC_PCT_LOAD FNC_VALUES 1 FLOAT32_IEEE COLUMN_DIR DIRECT /end RECORD_LAYOUT
/begin COMPU_METHOD CU_AMEC_PCT_LOAD "Conversion method for AMEc_pct_Load" RAT_FUNC "%10.2" "pct" COEFFS 0.000000 1.000000 0.000000 0.000000 0.000000 1.000000 /end COMPU_METHOD
/* Scalar calibration for DDE 'AMEc_pct_VolEff'. */
/begin CHARACTERISTIC AMEc_pct_VolEff "Override value for volumetric efficiency" VALUE 0x80a5c RL_AMEC_PCT_VOLEFF 1.400000 CU_AMEC_PCT_VOLEFF 0.100000 1.500000 BYTE_ORDER MSB_FIRST /end CHARACTERISTIC
/begin RECORD_LAYOUT RL_AMEC_PCT_VOLEFF FNC_VALUES 1 FLOAT32_IEEE COLUMN_DIR DIRECT /end RECORD_LAYOUT
/begin COMPU_METHOD CU_AMEC_PCT_VOLEFF "Conversion method for AMEc_pct_VolEff" RAT_FUNC "%10.2" "pct" COEFFS 0.000000 1.000000 0.000000 0.000000 0.000000 1.000000 /end COMPU_METHOD
/* Scalar calibration for DDE 'AMEc_s_BaroLearnDbnc'. */
/begin CHARACTERISTIC AMEc_s_BaroLearnDbnc "Engine must be stopped for this duration before MAP will be used for Baro determination" VALUE 0x86fb4 RL_AMEC_S_BAROLEARNDBNC 1.000000 CU_AMEC_S_BAROLEARNDBNC 0.000000 1.000000 BYTE_ORDER MSB_FIRST /end CHARACTERISTIC
/begin RECORD_LAYOUT RL_AMEC_S_BAROLEARNDBNC FNC_VALUES 1 FLOAT32_IEEE COLUMN_DIR DIRECT /end RECORD_LAYOUT
/begin COMPU_METHOD CU_AMEC_S_BAROLEARNDBNC "Conversion method for AMEc_s_BaroLearnDbnc" RAT_FUNC "%10.2" "s" COEFFS 0.000000 1.000000 0.000000 0.000000 0.000000 1.000000 /end COMPU_METHOD
/* Map (2d) calibration for DDE 'AMEm_NU_ChargeTempCF_z'. */
/begin CHARACTERISTIC AMEm_NU_ChargeTempCF_z "Charge temperature compensation table data" MAP 0x80ab8 RL_AMEM_NU_CHARGETEMPCF_Z 1.000000 CU_AMEM_NU_CHARGETEMPCF_Z 0.000000 1.000000
 /begin AXIS_DESCR COM_AXIS NO_INPUT_QUANTITY CU_AMEM_NU_CHARGETEMPCF_X 8 0.000000 10000.000000 AXIS_PTS_REF APD_AMEM_NU_CHARGETEMPCF_X /end AXIS_DESCR
 /begin AXIS_DESCR COM_AXIS NO_INPUT_QUANTITY CU_AMEM_NU_CHARGETEMPCF_Y 12 0.000000 500.000000 AXIS_PTS_REF APD_AMEM_NU_CHARGETEMPCF_Y /end AXIS_DESCR
 BYTE_ORDER MSB_FIRST /end CHARACTERISTIC
/begin RECORD_LAYOUT RL_AMEM_NU_CHARGETEMPCF_Z FNC_VALUES 1 FLOAT32_IEEE COLUMN_DIR DIRECT /end RECORD_LAYOUT
/begin COMPU_METHOD CU_AMEM_NU_CHARGETEMPCF_Z "Conversion method for AMEm_NU_ChargeTempCF_z" RAT_FUNC "%10.2" "pct" COEFFS 0.000000 1.000000 0.000000 0.000000 0.000000 1.000000 /end COMPU_METHOD
/begin AXIS_PTS APD_AMEM_NU_CHARGETEMPCF_X "Charge temperature compensation table engine speed axis" 0x80a68 NO_INPUT_QUANTITY RL_AMEM_NU_CHARGETEMPCF_X 10000.000000 CU_AMEM_NU_CHARGETEMPCF_X 8 0.0 10000.0 BYTE_ORDER MSB_FIRST /end AXIS_PTS
/begin RECORD_LAYOUT RL_AMEM_NU_CHARGETEMPCF_X AXIS_PTS_X 1 FLOAT32_IEEE INDEX_INCR DIRECT /end RECORD_LAYOUT
/begin COMPU_METHOD CU_AMEM_NU_CHARGETEMPCF_X "Conversion method for AMEm_NU_ChargeTempCF_x" RAT_FUNC "%10.0" "RPM" COEFFS 0.000000 1.000000 0.000000 0.000000 0.000000 1.000000 /end COMPU_METHOD
/begin AXIS_PTS APD_AMEM_NU_CHARGETEMPCF_Y "Charge temperature compensation table MAP axis" 0x80a88 NO_INPUT_QUANTITY RL_AMEM_NU_CHARGETEMPCF_Y 500.000000 CU_AMEM_NU_CHARGETEMPCF_Y 12 0.0 500.0 BYTE_ORDER MSB_FIRST /end AXIS_PTS
/begin RECORD_LAYOUT RL_AMEM_NU_CHARGETEMPCF_Y AXIS_PTS_X 1 FLOAT32_IEEE INDEX_INCR DIRECT /end RECORD_LAYOUT
/begin COMPU_METHOD CU_AMEM_NU_CHARGETEMPCF_Y "Conversion method for AMEm_NU_ChargeTempCF_y" RAT_FUNC "%10.0" "kPa" COEFFS 0.000000 1.000000 0.000000 0.000000 0.000000 1.000000 /end COMPU_METHOD
/* Map (2d) calibration for DDE 'AMEm_NU_MAF_Ofst_z'. */
/begin CHARACTERISTIC AMEm_NU_MAF_Ofst_z "(gps offset) MAF sensor trim table" MAP 0x80e5c RL_AMEM_NU_MAF_OFST_Z 1.600000 CU_AMEM_NU_MAF_OFST_Z -0.800000 0.800000
 /begin AXIS_DESCR COM_AXIS NO_INPUT_QUANTITY CU_AMEM_NU_MAF_OFST_X 8 0.000000 10000.000000 AXIS_PTS_REF APD_AMEM_NU_MAF_OFST_X /end AXIS_DESCR
 /begin AXIS_DESCR COM_AXIS NO_INPUT_QUANTITY CU_AMEM_NU_MAF_OFST_Y 9 0.000000 300.000000 AXIS_PTS_REF APD_AMEM_NU_MAF_OFST_Y /end AXIS_DESCR
 BYTE_ORDER MSB_FIRST /end CHARACTERISTIC
/begin RECORD_LAYOUT RL_AMEM_NU_MAF_OFST_Z FNC_VALUES 1 FLOAT32_IEEE COLUMN_DIR DIRECT /end RECORD_LAYOUT
/begin COMPU_METHOD CU_AMEM_NU_MAF_OFST_Z "Conversion method for AMEm_NU_MAF_Ofst_z" RAT_FUNC "%10.2" "pct" COEFFS 0.000000 1.000000 0.000000 0.000000 0.000000 1.000000 /end COMPU_METHOD
/begin AXIS_PTS APD_AMEM_NU_MAF_OFST_X "(RPM) MAF sensor trim table" 0x80e18 NO_INPUT_QUANTITY RL_AMEM_NU_MAF_OFST_X 10000.000000 CU_AMEM_NU_MAF_OFST_X 8 0.0 10000.0 BYTE_ORDER MSB_FIRST /end AXIS_PTS
/begin RECORD_LAYOUT RL_AMEM_NU_MAF_OFST_X AXIS_PTS_X 1 FLOAT32_IEEE INDEX_INCR DIRECT /end RECORD_LAYOUT
/begin COMPU_METHOD CU_AMEM_NU_MAF_OFST_X "Conversion method for AMEm_NU_MAF_Ofst_x" RAT_FUNC "%10.0" "RPM" COEFFS 0.000000 1.000000 0.000000 0.000000 0.000000 1.000000 /end COMPU_METHOD
/begin AXIS_PTS APD_AMEM_NU_MAF_OFST_Y "(gps raw signal) MAF sensor trim table" 0x80e38 NO_INPUT_QUANTITY RL_AMEM_NU_MAF_OFST_Y 300.000000 CU_AMEM_NU_MAF_OFST_Y 9 0.0 300.0 BYTE_ORDER MSB_FIRST /end AXIS_PTS
/begin RECORD_LAYOUT RL_AMEM_NU_MAF_OFST_Y AXIS_PTS_X 1 FLOAT32_IEEE INDEX_INCR DIRECT /end RECORD_LAYOUT
/begin COMPU_METHOD CU_AMEM_NU_MAF_OFST_Y "Conversion method for AMEm_NU_MAF_Ofst_y" RAT_FUNC "%10.0" "gps" COEFFS 0.000000 1.000000 0.000000 0.000000 0.000000 1.000000 /end COMPU_METHOD
/* Map (1d) calibration for DDE 'AMEm_NU_ResidualPress_z'. */
/begin CHARACTERISTIC AMEm_NU_ResidualPress_z "z axis of map to compensate charge pressure for the inefficiencies in induction system" CURVE 0x80580 RL_AMEM_NU_RESIDUALPRESS_Z 100.000000 CU_AMEM_NU_RESIDUALPRESS_Z -50.000000 50.000000
 /begin AXIS_DESCR COM_AXIS NO_INPUT_QUANTITY CU_AMEM_NU_RESIDUALPRESS_X 22 0.000000 9000.000000 AXIS_PTS_REF APD_AMEM_NU_RESIDUALPRESS_X /end AXIS_DESCR
 BYTE_ORDER MSB_FIRST /end CHARACTERISTIC
/begin RECORD_LAYOUT RL_AMEM_NU_RESIDUALPRESS_Z FNC_VALUES 1 FLOAT32_IEEE COLUMN_DIR DIRECT /end RECORD_LAYOUT
/begin COMPU_METHOD CU_AMEM_NU_RESIDUALPRESS_Z "Conversion method for AMEm_NU_ResidualPress_z" RAT_FUNC "%10.1" "kPa" COEFFS 0.000000 1.000000 0.000000 0.000000 0.000000 1.000000 /end COMPU_METHOD
/begin AXIS_PTS APD_AMEM_NU_RESIDUALPRESS_X "x axis of map to compensate charge pressure for the inefficiencies in induction system" 0x80528 NO_INPUT_QUANTITY RL_AMEM_NU_RESIDUALPRESS_X 9000.000000 CU_AMEM_NU_RESIDUALPRESS_X 22 0.0 9000.0 BYTE_ORDER MSB_FIRST /end AXIS_PTS
/begin RECORD_LAYOUT RL_AMEM_NU_RESIDUALPRESS_X AXIS_PTS_X 1 FLOAT32_IEEE INDEX_INCR DIRECT /end RECORD_LAYOUT
/begin COMPU_METHOD CU_AMEM_NU_RESIDUALPRESS_X "Conversion method for AMEm_NU_ResidualPress_x" RAT_FUNC "%10.0" "RPM" COEFFS 0.000000 1.000000 0.000000 0.000000 0.000000 1.000000 /end COMPU_METHOD
/* Map (2d) calibration for DDE 'AMEm_NU_UseDemandTime_z'. */
/begin CHARACTERISTIC AMEm_NU_UseDemandTime_z "Use demand time table data" MAP 0x80fb8 RL_AMEM_NU_USEDEMANDTIME_Z 2.000000 CU_AMEM_NU_USEDEMANDTIME_Z 0.000000 2.000000
 /begin AXIS_DESCR COM_AXIS NO_INPUT_QUANTITY CU_AMEM_NU_USEDEMANDTIME_X 6 0.000000 10000.000000 AXIS_PTS_REF APD_AMEM_NU_USEDEMANDTIME_X /end AXIS_DESCR
 /begin AXIS_DESCR COM_AXIS NO_INPUT_QUANTITY CU_AMEM_NU_USEDEMANDTIME_Y 7 -1.000000 1.000000 AXIS_PTS_REF APD_AMEM_NU_USEDEMANDTIME_Y /end AXIS_DESCR
 BYTE_ORDER MSB_FIRST /end CHARACTERISTIC
/begin RECORD_LAYOUT RL_AMEM_NU_USEDEMANDTIME_Z FNC_VALUES 1 FLOAT32_IEEE COLUMN_DIR DIRECT /end RECORD_LAYOUT
/begin COMPU_METHOD CU_AMEM_NU_USEDEMANDTIME_Z "Conversion method for AMEm_NU_UseDemandTime_z" RAT_FUNC "%10.3" "s" COEFFS 0.000000 1.000000 0.000000 0.000000 0.000000 1.000000 /end COMPU_METHOD
/begin AXIS_PTS APD_AMEM_NU_USEDEMANDTIME_X "Use demand time table engine speed axis" 0x80f84 NO_INPUT_QUANTITY RL_AMEM_NU_USEDEMANDTIME_X 10000.000000 CU_AMEM_NU_USEDEMANDTIME_X 6 0.0 10000.0 BYTE_ORDER MSB_FIRST /end AXIS_PTS
/begin RECORD_LAYOUT RL_AMEM_NU_USEDEMANDTIME_X AXIS_PTS_X 1 FLOAT32_IEEE INDEX_INCR DIRECT /end RECORD_LAYOUT
/begin COMPU_METHOD CU_AMEM_NU_USEDEMANDTIME_X "Conversion method for AMEm_NU_UseDemandTime_x" RAT_FUNC "%10.3" "NU" COEFFS 0.000000 1.000000 0.000000 0.000000 0.000000 1.000000 /end COMPU_METHOD
/begin AXIS_PTS APD_AMEM_NU_USEDEMANDTIME_Y "Use demand time table HPF peak axis" 0x80f9c NO_INPUT_QUANTITY RL_AMEM_NU_USEDEMANDTIME_Y 2.000000 CU_AMEM_NU_USEDEMANDTIME_Y 7 -1.0 1.0 BYTE_ORDER MSB_FIRST /end AXIS_PTS
/begin RECORD_LAYOUT RL_AMEM_NU_USEDEMANDTIME_Y AXIS_PTS_X 1 FLOAT32_IEEE INDEX_INCR DIRECT /end RECORD_LAYOUT
/begin COMPU_METHOD CU_AMEM_NU_USEDEMANDTIME_Y "Conversion method for AMEm_NU_UseDemandTime_y" RAT_FUNC "%10.2" "RPM" COEFFS 0.000000 1.000000 0.000000 0.000000 0.000000 1.000000 /end COMPU_METHOD
/* Map (2d) calibration for DDE 'AMEm_NU_UseMAF_z'. */
/begin CHARACTERISTIC AMEm_NU_UseMAF_z "Select between MAF- and MAP-based airflow estimates. Use this calmap to select the most accurate method given the current operating condition." MAP 0x80c94 RL_AMEM_NU_USEMAF_Z 1.000000 CU_AMEM_NU_USEMAF_Z 0.000000 1.000000
 /begin AXIS_DESCR COM_AXIS NO_INPUT_QUANTITY CU_AMEM_NU_USEMAF_X 8 0.000000 10000.000000 AXIS_PTS_REF APD_AMEM_NU_USEMAF_X /end AXIS_DESCR
 /begin AXIS_DESCR COM_AXIS NO_INPUT_QUANTITY CU_AMEM_NU_USEMAF_Y 12 0.000000 500.000000 AXIS_PTS_REF APD_AMEM_NU_USEMAF_Y /end AXIS_DESCR
 BYTE_ORDER MSB_FIRST /end CHARACTERISTIC
/begin RECORD_LAYOUT RL_AMEM_NU_USEMAF_Z FNC_VALUES 1 FLOAT32_IEEE COLUMN_DIR DIRECT /end RECORD_LAYOUT
/begin COMPU_METHOD CU_AMEM_NU_USEMAF_Z "Conversion method for AMEm_NU_UseMAF_z" RAT_FUNC "%10.2" "pct" COEFFS 0.000000 1.000000 0.000000 0.000000 0.000000 1.000000 /end COMPU_METHOD
/begin AXIS_PTS APD_AMEM_NU_USEMAF_X "Estimate selection x-axis" 0x80c44 NO_INPUT_QUANTITY RL_AMEM_NU_USEMAF_X 10000.000000 CU_AMEM_NU_USEMAF_X 8 0.0 10000.0 BYTE_ORDER MSB_FIRST /end AXIS_PTS
/begin RECORD_LAYOUT RL_AMEM_NU_USEMAF_X AXIS_PTS_X 1 FLOAT32_IEEE INDEX_INCR DIRECT /end RECORD_LAYOUT
/begin COMPU_METHOD CU_AMEM_NU_USEMAF_X "Conversion method for AMEm_NU_UseMAF_x" RAT_FUNC "%10.0" "RPM" COEFFS 0.000000 1.000000 0.000000 0.000000 0.000000 1.000000 /end COMPU_METHOD
/begin AXIS_PTS APD_AMEM_NU_USEMAF_Y "Estimate selection y-axis" 0x80c64 NO_INPUT_QUANTITY RL_AMEM_NU_USEMAF_Y 500.000000 CU_AMEM_NU_USEMAF_Y 12 0.0 500.0 BYTE_ORDER MSB_FIRST /end AXIS_PTS
/begin RECORD_LAYOUT RL_AMEM_NU_USEMAF_Y AXIS_PTS_X 1 FLOAT32_IEEE INDEX_INCR DIRECT /end RECORD_LAYOUT
/begin COMPU_METHOD CU_AMEM_NU_USEMAF_Y "Conversion method for AMEm_NU_UseMAF_y" RAT_FUNC "%10.0" "kPa" COEFFS 0.000000 1.000000 0.000000 0.000000 0.000000 1.000000 /end COMPU_METHOD
/* Map (2d) calibration for DDE 'AMEm_NU_VolEff_z'. */
/begin CHARACTERISTIC AMEm_NU_VolEff_z "Volumetric Efficiency table data" MAP 0x80658 RL_AMEM_NU_VOLEFF_Z 2.000000 CU_AMEM_NU_VOLEFF_Z 0.000000 2.000000
 /begin AXIS_DESCR COM_AXIS NO_INPUT_QUANTITY CU_AMEM_NU_VOLEFF_X 16 0.000000 9000.000000 AXIS_PTS_REF APD_AMEM_NU_VOLEFF_X /end AXIS_DESCR
 /begin AXIS_DESCR COM_AXIS NO_INPUT_QUANTITY CU_AMEM_NU_VOLEFF_Y 16 0.000000 250.000000 AXIS_PTS_REF APD_AMEM_NU_VOLEFF_Y /end AXIS_DESCR
 BYTE_ORDER MSB_FIRST /end CHARACTERISTIC
/begin RECORD_LAYOUT RL_AMEM_NU_VOLEFF_Z FNC_VALUES 1 FLOAT32_IEEE COLUMN_DIR DIRECT /end RECORD_LAYOUT
/begin COMPU_METHOD CU_AMEM_NU_VOLEFF_Z "Conversion method for AMEm_NU_VolEff_z" RAT_FUNC "%10.4" "pct" COEFFS 0.000000 1.000000 0.000000 0.000000 0.000000 1.000000 /end COMPU_METHOD
/begin AXIS_PTS APD_AMEM_NU_VOLEFF_X "Volumetric efficiency table engine speed axis" 0x805d8 NO_INPUT_QUANTITY RL_AMEM_NU_VOLEFF_X 9000.000000 CU_AMEM_NU_VOLEFF_X 16 0.0 9000.0 BYTE_ORDER MSB_FIRST /end AXIS_PTS
/begin RECORD_LAYOUT RL_AMEM_NU_VOLEFF_X AXIS_PTS_X 1 FLOAT32_IEEE INDEX_INCR DIRECT /end RECORD_LAYOUT
/begin COMPU_METHOD CU_AMEM_NU_VOLEFF_X "Conversion method for AMEm_NU_VolEff_x" RAT_FUNC "%10.0" "RPM" COEFFS 0.000000 1.000000 0.000000 0.000000 0.000000 1.000000 /end COMPU_METHOD
/begin AXIS_PTS APD_AMEM_NU_VOLEFF_Y "Volumetric efficiency table MAP axis" 0x80618 NO_INPUT_QUANTITY RL_AMEM_NU_VOLEFF_Y 250.000000 CU_AMEM_NU_VOLEFF_Y 16 0.0 250.0 BYTE_ORDER MSB_FIRST /end AXIS_PTS
/begin RECORD_LAYOUT RL_AMEM_NU_VOLEFF_Y AXIS_PTS_X 1 FLOAT32_IEEE INDEX_INCR DIRECT /end RECORD_LAYOUT
/begin COMPU_METHOD CU_AMEM_NU_VOLEFF_Y "Conversion method for AMEm_NU_VolEff_y" RAT_FUNC "%10.0" "kPa" COEFFS 0.000000 1.000000 0.000000 0.000000 0.000000 1.000000 /end COMPU_METHOD
/* Scalar calibration for DDE 'APPc_Hz_APP1_LPF'. */
/begin CHARACTERISTIC APPc_Hz_APP1_LPF "Filter Constant for raw accel pedal position 1 sensor signal" VALUE 0x81e20 RL_APPC_HZ_APP1_LPF 100.000000 CU_APPC_HZ_APP1_LPF 0.000000 100.000000 BYTE_ORDER MSB_FIRST /end CHARACTERISTIC
/begin RECORD_LAYOUT RL_APPC_HZ_APP1_LPF FNC_VALUES 1 FLOAT32_IEEE COLUMN_DIR DIRECT /end RECORD_LAYOUT
/begin COMPU_METHOD CU_APPC_HZ_APP1_LPF "Conversion method for APPc_Hz_APP1_LPF" RAT_FUNC "%10.2" "Hz" COEFFS 0.000000 1.000000 0.000000 0.000000 0.000000 1.000000 /end COMPU_METHOD
/* Scalar calibration for DDE 'APPc_Hz_APP2_LPF'. */
/begin CHARACTERISTIC APPc_Hz_APP2_LPF "Filter Constant for raw accel pedal position 2 sensor signal" VALUE 0x81dfc RL_APPC_HZ_APP2_LPF 100.000000 CU_APPC_HZ_APP2_LPF 0.000000 100.000000 BYTE_ORDER MSB_FIRST /end CHARACTERISTIC
/begin RECORD_LAYOUT RL_APPC_HZ_APP2_LPF FNC_VALUES 1 FLOAT32_IEEE COLUMN_DIR DIRECT /end RECORD_LAYOUT
/begin COMPU_METHOD CU_APPC_HZ_APP2_LPF "Conversion method for APPc_Hz_APP2_LPF" RAT_FUNC "%10.2" "Hz" COEFFS 0.000000 1.000000 0.000000 0.000000 0.000000 1.000000 /end COMPU_METHOD
/* Scalar calibration for DDE 'APPc_NU_APP1_ZeroCreepUpRate'. */
/begin CHARACTERISTIC APPc_NU_APP1_ZeroCreepUpRate "(V/s) Zero-position endstop increment rate when learn criteria are not met" VALUE 0x81e2c RL_APPC_NU_APP1_ZEROCREEPUPRATE 0.100000 CU_APPC_NU_APP1_ZEROCREEPUPRATE 0.000000 0.100000 BYTE_ORDER MSB_FIRST /end CHARACTERISTIC
/begin RECORD_LAYOUT RL_APPC_NU_APP1_ZEROCREEPUPRATE FNC_VALUES 1 FLOAT32_IEEE COLUMN_DIR DIRECT /end RECORD_LAYOUT
/begin COMPU_METHOD CU_APPC_NU_APP1_ZEROCREEPUPRATE "Conversion method for APPc_NU_APP1_ZeroCreepUpRate" RAT_FUNC "%10.4" "NU" COEFFS 0.000000 1.000000 0.000000 0.000000 0.000000 1.000000 /end COMPU_METHOD
/* Scalar calibration for DDE 'APPc_NU_APP2_ZeroCreepUpRate'. */
/begin CHARACTERISTIC APPc_NU_APP2_ZeroCreepUpRate "(V/s) Zero-position endstop increment rate when learn criteria are not met" VALUE 0x81e0c RL_APPC_NU_APP2_ZEROCREEPUPRATE 0.100000 CU_APPC_NU_APP2_ZEROCREEPUPRATE 0.000000 0.100000 BYTE_ORDER MSB_FIRST /end CHARACTERISTIC
/begin RECORD_LAYOUT RL_APPC_NU_APP2_ZEROCREEPUPRATE FNC_VALUES 1 FLOAT32_IEEE COLUMN_DIR DIRECT /end RECORD_LAYOUT
/begin COMPU_METHOD CU_APPC_NU_APP2_ZEROCREEPUPRATE "Conversion method for APPc_NU_APP2_ZeroCreepUpRate" RAT_FUNC "%10.4" "NU" COEFFS 0.000000 1.000000 0.000000 0.000000 0.000000 1.000000 /end COMPU_METHOD
/* Scalar calibration for DDE 'APPc_NU_EEC1TorqueMode'. */
/begin CHARACTERISTIC APPc_NU_EEC1TorqueMode "(not defined)" VALUE 0x8bdc4 RL_APPC_NU_EEC1TORQUEMODE 20.000000 CU_APPC_NU_EEC1TORQUEMODE 0.000000 20.000000 BYTE_ORDER MSB_FIRST /end CHARACTERISTIC
/begin RECORD_LAYOUT RL_APPC_NU_EEC1TORQUEMODE FNC_VALUES 1 FLOAT32_IEEE COLUMN_DIR DIRECT /end RECORD_LAYOUT
/begin COMPU_METHOD CU_APPC_NU_EEC1TORQUEMODE "Conversion method for APPc_NU_EEC1TorqueMode" RAT_FUNC "%10.0" "NU" COEFFS 0.000000 1.000000 0.000000 0.000000 0.000000 1.000000 /end COMPU_METHOD
/* Scalar calibration for DDE 'APPc_NU_RPM2Hz'. */
/begin CHARACTERISTIC APPc_NU_RPM2Hz "factor de conversion" VALUE 0x8cd2c RL_APPC_NU_RPM2HZ 1000.000000 CU_APPC_NU_RPM2HZ 0.000000 1000.000000 BYTE_ORDER MSB_FIRST /end CHARACTERISTIC
/begin RECORD_LAYOUT RL_APPC_NU_RPM2HZ FNC_VALUES 1 FLOAT32_IEEE COLUMN_DIR DIRECT /end RECORD_LAYOUT
/begin COMPU_METHOD CU_APPC_NU_RPM2HZ "Conversion method for APPc_NU_RPM2Hz" RAT_FUNC "%10.3" "NU" COEFFS 0.000000 1.000000 0.000000 0.000000 0.000000 1.000000 /end COMPU_METHOD
/* Scalar calibration for DDE 'APPc_NU_VehSpeed_Gain'. */
/begin CHARACTERISTIC APPc_NU_VehSpeed_Gain "factor de conversion" VALUE 0x8ce54 RL_APPC_NU_VEHSPEED_GAIN 1000.000000 CU_APPC_NU_VEHSPEED_GAIN 0.000000 1000.000000 BYTE_ORDER MSB_FIRST /end CHARACTERISTIC
/begin RECORD_LAYOUT RL_APPC_NU_VEHSPEED_GAIN FNC_VALUES 1 FLOAT32_IEEE COLUMN_DIR DIRECT /end RECORD_LAYOUT
/begin COMPU_METHOD CU_APPC_NU_VEHSPEED_GAIN "Conversion method for APPc_NU_VehSpeed_Gain" RAT_FUNC "%10.3" "NU" COEFFS 0.000000 1.000000 0.000000 0.000000 0.000000 1.000000 /end COMPU_METHOD
/* Scalar calibration for DDE 'APPc_NU_VehSpeed_Ofst'. */
/begin CHARACTERISTIC APPc_NU_VehSpeed_Ofst "factor de conversion" VALUE 0x8ce58 RL_APPC_NU_VEHSPEED_OFST 1000.000000 CU_APPC_NU_VEHSPEED_OFST 0.000000 1000.000000 BYTE_ORDER MSB_FIRST /end CHARACTERISTIC
/begin RECORD_LAYOUT RL_APPC_NU_VEHSPEED_OFST FNC_VALUES 1 FLOAT32_IEEE COLUMN_DIR DIRECT /end RECORD_LAYOUT
/begin COMPU_METHOD CU_APPC_NU_VEHSPEED_OFST "Conversion method for APPc_NU_VehSpeed_Ofst" RAT_FUNC "%10.3" "NU" COEFFS 0.000000 1.000000 0.000000 0.000000 0.000000 1.000000 /end COMPU_METHOD
/* Scalar calibration for DDE 'APPc_Nm_DrvrDmndTq'. */
/begin CHARACTERISTIC APPc_Nm_DrvrDmndTq "Drvr demand torque override value" VALUE 0x831a4 RL_APPC_NM_DRVRDMNDTQ 200.000000 CU_APPC_NM_DRVRDMNDTQ 0.000000 200.000000 BYTE_ORDER MSB_FIRST /end CHARACTERISTIC
/begin RECORD_LAYOUT RL_APPC_NM_DRVRDMNDTQ FNC_VALUES 1 FLOAT32_IEEE COLUMN_DIR DIRECT /end RECORD_LAYOUT
/begin COMPU_METHOD CU_APPC_NM_DRVRDMNDTQ "Conversion method for APPc_Nm_DrvrDmndTq" RAT_FUNC "%10.2" "Nm" COEFFS 0.000000 1.000000 0.000000 0.000000 0.000000 1.000000 /end COMPU_METHOD
/* Scalar calibration for DDE 'APPc_Nm_DrvrTqDmndMax'. */
/begin CHARACTERISTIC APPc_Nm_DrvrTqDmndMax "Maximum possible driver torque demand" VALUE 0x831a8 RL_APPC_NM_DRVRTQDMNDMAX 1000.000000 CU_APPC_NM_DRVRTQDMNDMAX 0.000000 1000.000000 BYTE_ORDER MSB_FIRST /end CHARACTERISTIC
/begin RECORD_LAYOUT RL_APPC_NM_DRVRTQDMNDMAX FNC_VALUES 1 FLOAT32_IEEE COLUMN_DIR DIRECT /end RECORD_LAYOUT
/begin COMPU_METHOD CU_APPC_NM_DRVRTQDMNDMAX "Conversion method for APPc_Nm_DrvrTqDmndMax" RAT_FUNC "%10.2" "Nm" COEFFS 0.000000 1.000000 0.000000 0.000000 0.000000 1.000000 /end COMPU_METHOD
/* Scalar calibration for DDE 'APPc_Nm_DrvrTqDmndMin'. */
/begin CHARACTERISTIC APPc_Nm_DrvrTqDmndMin "Minimum possible driver torque demand or engine braking" VALUE 0x831ac RL_APPC_NM_DRVRTQDMNDMIN 1000.000000 CU_APPC_NM_DRVRTQDMNDMIN -1000.000000 0.000000 BYTE_ORDER MSB_FIRST /end CHARACTERISTIC
/begin RECORD_LAYOUT RL_APPC_NM_DRVRTQDMNDMIN FNC_VALUES 1 FLOAT32_IEEE COLUMN_DIR DIRECT /end RECORD_LAYOUT
/begin COMPU_METHOD CU_APPC_NM_DRVRTQDMNDMIN "Conversion method for APPc_Nm_DrvrTqDmndMin" RAT_FUNC "%10.2" "Nm" COEFFS 0.000000 1.000000 0.000000 0.000000 0.000000 1.000000 /end COMPU_METHOD
/* Scalar calibration for DDE 'APPc_V_FullLearnDfltValAPP1'. */
/begin CHARACTERISTIC APPc_V_FullLearnDfltValAPP1 "Full pedal learn default value for accelerator pedal position sensor 1" VALUE 0x918e4 RL_APPC_V_FULLLEARNDFLTVALAPP1 5.000000 CU_APPC_V_FULLLEARNDFLTVALAPP1 0.000000 5.000000 BYTE_ORDER MSB_FIRST /end CHARACTERISTIC
/begin RECORD_LAYOUT RL_APPC_V_FULLLEARNDFLTVALAPP1 FNC_VALUES 1 FLOAT32_IEEE COLUMN_DIR DIRECT /end RECORD_LAYOUT
/begin COMPU_METHOD CU_APPC_V_FULLLEARNDFLTVALAPP1 "Conversion method for APPc_V_FullLearnDfltValAPP1" RAT_FUNC "%10.3" "V" COEFFS 0.000000 1.000000 0.000000 0.000000 0.000000 1.000000 /end COMPU_METHOD
/* Scalar calibration for DDE 'APPc_V_FullLearnDfltValAPP2'. */
/begin CHARACTERISTIC APPc_V_FullLearnDfltValAPP2 "Full pedal learn default value for accelerator pedal position sensor 2" VALUE 0x918e0 RL_APPC_V_FULLLEARNDFLTVALAPP2 5.000000 CU_APPC_V_FULLLEARNDFLTVALAPP2 0.000000 5.000000 BYTE_ORDER MSB_FIRST /end CHARACTERISTIC
/begin RECORD_LAYOUT RL_APPC_V_FULLLEARNDFLTVALAPP2 FNC_VALUES 1 FLOAT32_IEEE COLUMN_DIR DIRECT /end RECORD_LAYOUT
/begin COMPU_METHOD CU_APPC_V_FULLLEARNDFLTVALAPP2 "Conversion method for APPc_V_FullLearnDfltValAPP2" RAT_FUNC "%10.3" "V" COEFFS 0.000000 1.000000 0.000000 0.000000 0.000000 1.000000 /end COMPU_METHOD
/* Scalar calibration for DDE 'APPc_V_FullLearnHiLimAPP1'. */
/begin CHARACTERISTIC APPc_V_FullLearnHiLimAPP1 "Maximum accelerator pedal position sensor signal 1 to enable Full pedal learn" VALUE 0x81e34 RL_APPC_V_FULLLEARNHILIMAPP1 5.000000 CU_APPC_V_FULLLEARNHILIMAPP1 0.000000 5.000000 BYTE_ORDER MSB_FIRST /end CHARACTERISTIC
/begin RECORD_LAYOUT RL_APPC_V_FULLLEARNHILIMAPP1 FNC_VALUES 1 FLOAT32_IEEE COLUMN_DIR DIRECT /end RECORD_LAYOUT
/begin COMPU_METHOD CU_APPC_V_FULLLEARNHILIMAPP1 "Conversion method for APPc_V_FullLearnHiLimAPP1" RAT_FUNC "%10.3" "V" COEFFS 0.000000 1.000000 0.000000 0.000000 0.000000 1.000000 /end COMPU_METHOD
/* Scalar calibration for DDE 'APPc_V_FullLearnHiLimAPP2'. */
/begin CHARACTERISTIC APPc_V_FullLearnHiLimAPP2 "Maximum accelerator pedal position sensor signal 2 to enable Full pedal learn" VALUE 0x81e18 RL_APPC_V_FULLLEARNHILIMAPP2 5.000000 CU_APPC_V_FULLLEARNHILIMAPP2 0.000000 5.000000 BYTE_ORDER MSB_FIRST /end CHARACTERISTIC
/begin RECORD_LAYOUT RL_APPC_V_FULLLEARNHILIMAPP2 FNC_VALUES 1 FLOAT32_IEEE COLUMN_DIR DIRECT /end RECORD_LAYOUT
/begin COMPU_METHOD CU_APPC_V_FULLLEARNHILIMAPP2 "Conversion method for APPc_V_FullLearnHiLimAPP2" RAT_FUNC "%10.3" "V" COEFFS 0.000000 1.000000 0.000000 0.000000 0.000000 1.000000 /end COMPU_METHOD
/* Scalar calibration for DDE 'APPc_V_FullLearnLoLimAPP1'. */
/begin CHARACTERISTIC APPc_V_FullLearnLoLimAPP1 "Minimum accelerator pedal position sensor signal 1 to enable Full pedal learn" VALUE 0x81e30 RL_APPC_V_FULLLEARNLOLIMAPP1 5.000000 CU_APPC_V_FULLLEARNLOLIMAPP1 0.000000 5.000000 BYTE_ORDER MSB_FIRST /end CHARACTERISTIC
/begin RECORD_LAYOUT RL_APPC_V_FULLLEARNLOLIMAPP1 FNC_VALUES 1 FLOAT32_IEEE COLUMN_DIR DIRECT /end RECORD_LAYOUT
/begin COMPU_METHOD CU_APPC_V_FULLLEARNLOLIMAPP1 "Conversion method for APPc_V_FullLearnLoLimAPP1" RAT_FUNC "%10.3" "V" COEFFS 0.000000 1.000000 0.000000 0.000000 0.000000 1.000000 /end COMPU_METHOD
/* Scalar calibration for DDE 'APPc_V_FullLearnLoLimAPP2'. */
/begin CHARACTERISTIC APPc_V_FullLearnLoLimAPP2 "Minimum accelerator pedal position sensor signal 2 to enable Full pedal learn" VALUE 0x81e14 RL_APPC_V_FULLLEARNLOLIMAPP2 5.000000 CU_APPC_V_FULLLEARNLOLIMAPP2 0.000000 5.000000 BYTE_ORDER MSB_FIRST /end CHARACTERISTIC
/begin RECORD_LAYOUT RL_APPC_V_FULLLEARNLOLIMAPP2 FNC_VALUES 1 FLOAT32_IEEE COLUMN_DIR DIRECT /end RECORD_LAYOUT
/begin COMPU_METHOD CU_APPC_V_FULLLEARNLOLIMAPP2 "Conversion method for APPc_V_FullLearnLoLimAPP2" RAT_FUNC "%10.3" "V" COEFFS 0.000000 1.000000 0.000000 0.000000 0.000000 1.000000 /end COMPU_METHOD
/* Scalar calibration for DDE 'APPc_V_ZeroLearnDfltValAPP1'. */
/begin CHARACTERISTIC APPc_V_ZeroLearnDfltValAPP1 "Zero pedal learn default value for accelerator pedal position sensor 1" VALUE 0x80444 RL_APPC_V_ZEROLEARNDFLTVALAPP1 5.000000 CU_APPC_V_ZEROLEARNDFLTVALAPP1 0.000000 5.000000 BYTE_ORDER MSB_FIRST /end CHARACTERISTIC
/begin RECORD_LAYOUT RL_APPC_V_ZEROLEARNDFLTVALAPP1 FNC_VALUES 1 FLOAT32_IEEE COLUMN_DIR DIRECT /end RECORD_LAYOUT
/begin COMPU_METHOD CU_APPC_V_ZEROLEARNDFLTVALAPP1 "Conversion method for APPc_V_ZeroLearnDfltValAPP1" RAT_FUNC "%10.3" "V" COEFFS 0.000000 1.000000 0.000000 0.000000 0.000000 1.000000 /end COMPU_METHOD
/* Scalar calibration for DDE 'APPc_V_ZeroLearnDfltValAPP2'. */
/begin CHARACTERISTIC APPc_V_ZeroLearnDfltValAPP2 "Zero pedal learn default value for accelerator pedal position sensor 2" VALUE 0x80440 RL_APPC_V_ZEROLEARNDFLTVALAPP2 5.000000 CU_APPC_V_ZEROLEARNDFLTVALAPP2 0.000000 5.000000 BYTE_ORDER MSB_FIRST /end CHARACTERISTIC
/begin RECORD_LAYOUT RL_APPC_V_ZEROLEARNDFLTVALAPP2 FNC_VALUES 1 FLOAT32_IEEE COLUMN_DIR DIRECT /end RECORD_LAYOUT
/begin COMPU_METHOD CU_APPC_V_ZEROLEARNDFLTVALAPP2 "Conversion method for APPc_V_ZeroLearnDfltValAPP2" RAT_FUNC "%10.3" "V" COEFFS 0.000000 1.000000 0.000000 0.000000 0.000000 1.000000 /end COMPU_METHOD
/* Scalar calibration for DDE 'APPc_V_ZeroLearnHiLimAPP1'. */
/begin CHARACTERISTIC APPc_V_ZeroLearnHiLimAPP1 "Maximum accelerator pedal position sensor signal 1 to enable zero pedal learn" VALUE 0x81e28 RL_APPC_V_ZEROLEARNHILIMAPP1 5.000000 CU_APPC_V_ZEROLEARNHILIMAPP1 0.000000 5.000000 BYTE_ORDER MSB_FIRST /end CHARACTERISTIC
/begin RECORD_LAYOUT RL_APPC_V_ZEROLEARNHILIMAPP1 FNC_VALUES 1 FLOAT32_IEEE COLUMN_DIR DIRECT /end RECORD_LAYOUT
/begin COMPU_METHOD CU_APPC_V_ZEROLEARNHILIMAPP1 "Conversion method for APPc_V_ZeroLearnHiLimAPP1" RAT_FUNC "%10.3" "V" COEFFS 0.000000 1.000000 0.000000 0.000000 0.000000 1.000000 /end COMPU_METHOD
/* Scalar calibration for DDE 'APPc_V_ZeroLearnHiLimAPP2'. */
/begin CHARACTERISTIC APPc_V_ZeroLearnHiLimAPP2 "Maximum accelerator pedal position sensor signal 2 to enable zero pedal learn" VALUE 0x81e08 RL_APPC_V_ZEROLEARNHILIMAPP2 5.000000 CU_APPC_V_ZEROLEARNHILIMAPP2 0.000000 5.000000 BYTE_ORDER MSB_FIRST /end CHARACTERISTIC
/begin RECORD_LAYOUT RL_APPC_V_ZEROLEARNHILIMAPP2 FNC_VALUES 1 FLOAT32_IEEE COLUMN_DIR DIRECT /end RECORD_LAYOUT
/begin COMPU_METHOD CU_APPC_V_ZEROLEARNHILIMAPP2 "Conversion method for APPc_V_ZeroLearnHiLimAPP2" RAT_FUNC "%10.3" "V" COEFFS 0.000000 1.000000 0.000000 0.000000 0.000000 1.000000 /end COMPU_METHOD
/* Scalar calibration for DDE 'APPc_V_ZeroLearnLoLimAPP1'. */
/begin CHARACTERISTIC APPc_V_ZeroLearnLoLimAPP1 "Minimum accelerator pedal position sensor signal 1 to enable zero pedal learn" VALUE 0x81e24 RL_APPC_V_ZEROLEARNLOLIMAPP1 5.000000 CU_APPC_V_ZEROLEARNLOLIMAPP1 0.000000 5.000000 BYTE_ORDER MSB_FIRST /end CHARACTERISTIC
/begin RECORD_LAYOUT RL_APPC_V_ZEROLEARNLOLIMAPP1 FNC_VALUES 1 FLOAT32_IEEE COLUMN_DIR DIRECT /end RECORD_LAYOUT
/begin COMPU_METHOD CU_APPC_V_ZEROLEARNLOLIMAPP1 "Conversion method for APPc_V_ZeroLearnLoLimAPP1" RAT_FUNC "%10.3" "V" COEFFS 0.000000 1.000000 0.000000 0.000000 0.000000 1.000000 /end COMPU_METHOD
/* Scalar calibration for DDE 'APPc_V_ZeroLearnLoLimAPP2'. */
/begin CHARACTERISTIC APPc_V_ZeroLearnLoLimAPP2 "Minimum accelerator pedal position sensor signal 2 to enable zero pedal learn" VALUE 0x81e04 RL_APPC_V_ZEROLEARNLOLIMAPP2 5.000000 CU_APPC_V_ZEROLEARNLOLIMAPP2 0.000000 5.000000 BYTE_ORDER MSB_FIRST /end CHARACTERISTIC
/begin RECORD_LAYOUT RL_APPC_V_ZEROLEARNLOLIMAPP2 FNC_VALUES 1 FLOAT32_IEEE COLUMN_DIR DIRECT /end RECORD_LAYOUT
/begin COMPU_METHOD CU_APPC_V_ZEROLEARNLOLIMAPP2 "Conversion method for APPc_V_ZeroLearnLoLimAPP2" RAT_FUNC "%10.3" "V" COEFFS 0.000000 1.000000 0.000000 0.000000 0.000000 1.000000 /end COMPU_METHOD
/* Scalar calibration for DDE 'APPc_b_APP1_Inverted'. */
/begin CHARACTERISTIC APPc_b_APP1_Inverted "Accelerator pedal position 1 inverted flag" VALUE 0x81e38 RL_APPC_B_APP1_INVERTED 1.000000 CU_APPC_B_APP1_INVERTED 0.000000 1.000000 BYTE_ORDER MSB_FIRST /end CHARACTERISTIC
/begin RECORD_LAYOUT RL_APPC_B_APP1_INVERTED FNC_VALUES 1 UBYTE COLUMN_DIR DIRECT /end RECORD_LAYOUT
/begin COMPU_METHOD CU_APPC_B_APP1_INVERTED "Conversion method for APPc_b_APP1_Inverted" RAT_FUNC "%10.0" "b" COEFFS 0.000000 1.000000 0.000000 0.000000 0.000000 1.000000 /end COMPU_METHOD
/* Scalar calibration for DDE 'APPc_b_APP2_Inverted'. */
/begin CHARACTERISTIC APPc_b_APP2_Inverted "Accelerator pedal position 1 inverted flag" VALUE 0x81e1d RL_APPC_B_APP2_INVERTED 1.000000 CU_APPC_B_APP2_INVERTED 0.000000 1.000000 BYTE_ORDER MSB_FIRST /end CHARACTERISTIC
/begin RECORD_LAYOUT RL_APPC_B_APP2_INVERTED FNC_VALUES 1 UBYTE COLUMN_DIR DIRECT /end RECORD_LAYOUT
/begin COMPU_METHOD CU_APPC_B_APP2_INVERTED "Conversion method for APPc_b_APP2_Inverted" RAT_FUNC "%10.0" "b" COEFFS 0.000000 1.000000 0.000000 0.000000 0.000000 1.000000 /end COMPU_METHOD
/* Scalar calibration for DDE 'APPc_b_BrakePedal_actv'. */
/begin CHARACTERISTIC APPc_b_BrakePedal_actv "(not defined)" VALUE 0x81e49 RL_APPC_B_BRAKEPEDAL_ACTV 1.000000 CU_APPC_B_BRAKEPEDAL_ACTV 0.000000 1.000000 BYTE_ORDER MSB_FIRST /end CHARACTERISTIC
/begin RECORD_LAYOUT RL_APPC_B_BRAKEPEDAL_ACTV FNC_VALUES 1 UBYTE COLUMN_DIR DIRECT /end RECORD_LAYOUT
/begin COMPU_METHOD CU_APPC_B_BRAKEPEDAL_ACTV "Conversion method for APPc_b_BrakePedal_actv" RAT_FUNC "%10.0" "b" COEFFS 0.000000 1.000000 0.000000 0.000000 0.000000 1.000000 /end COMPU_METHOD
/* Scalar calibration for DDE 'APPc_b_EEC1TorqueSelector'. */
/begin CHARACTERISTIC APPc_b_EEC1TorqueSelector "(not defined)" VALUE 0x8bdc1 RL_APPC_B_EEC1TORQUESELECTOR 1.000000 CU_APPC_B_EEC1TORQUESELECTOR 0.000000 1.000000 BYTE_ORDER MSB_FIRST /end CHARACTERISTIC
/begin RECORD_LAYOUT RL_APPC_B_EEC1TORQUESELECTOR FNC_VALUES 1 UBYTE COLUMN_DIR DIRECT /end RECORD_LAYOUT
/begin COMPU_METHOD CU_APPC_B_EEC1TORQUESELECTOR "Conversion method for APPc_b_EEC1TorqueSelector" RAT_FUNC "%10.0" "b" COEFFS 0.000000 1.000000 0.000000 0.000000 0.000000 1.000000 /end COMPU_METHOD
/* Scalar calibration for DDE 'APPc_b_Fault'. */
/begin CHARACTERISTIC APPc_b_Fault "APP faulted override value" VALUE 0x8be63 RL_APPC_B_FAULT 1.000000 CU_APPC_B_FAULT 0.000000 1.000000 BYTE_ORDER MSB_FIRST /end CHARACTERISTIC
/begin RECORD_LAYOUT RL_APPC_B_FAULT FNC_VALUES 1 UBYTE COLUMN_DIR DIRECT /end RECORD_LAYOUT
/begin COMPU_METHOD CU_APPC_B_FAULT "Conversion method for APPc_b_Fault" RAT_FUNC "%10.0" "b" COEFFS 0.000000 1.000000 0.000000 0.000000 0.000000 1.000000 /end COMPU_METHOD
/* Scalar calibration for DDE 'APPc_b_FullLearnEnbl'. */
/begin CHARACTERISTIC APPc_b_FullLearnEnbl "Full pedal learn enable for accelerator pedal position sensor 1" VALUE 0x81e10 RL_APPC_B_FULLLEARNENBL 1.000000 CU_APPC_B_FULLLEARNENBL 0.000000 1.000000 BYTE_ORDER MSB_FIRST /end CHARACTERISTIC
/begin RECORD_LAYOUT RL_APPC_B_FULLLEARNENBL FNC_VALUES 1 UBYTE COLUMN_DIR DIRECT /end RECORD_LAYOUT
/begin COMPU_METHOD CU_APPC_B_FULLLEARNENBL "Conversion method for APPc_b_FullLearnEnbl" RAT_FUNC "%10.0" "b" COEFFS 0.000000 1.000000 0.000000 0.000000 0.000000 1.000000 /end COMPU_METHOD
/* Scalar calibration for DDE 'APPc_b_ResetFaultLatch'. */
/begin CHARACTERISTIC APPc_b_ResetFaultLatch "Set to 1 to reset fault latch without power cycling" VALUE 0x86fc2 RL_APPC_B_RESETFAULTLATCH 1.000000 CU_APPC_B_RESETFAULTLATCH 0.000000 1.000000 BYTE_ORDER MSB_FIRST /end CHARACTERISTIC
/begin RECORD_LAYOUT RL_APPC_B_RESETFAULTLATCH FNC_VALUES 1 UBYTE COLUMN_DIR DIRECT /end RECORD_LAYOUT
/begin COMPU_METHOD CU_APPC_B_RESETFAULTLATCH "Conversion method for APPc_b_ResetFaultLatch" RAT_FUNC "%10.0" "b" COEFFS 0.000000 1.000000 0.000000 0.000000 0.000000 1.000000 /end COMPU_METHOD
/* Scalar calibration for DDE 'APPc_b_ResetNVM'. */
/begin CHARACTERISTIC APPc_b_ResetNVM "Reset learned values to defaults" VALUE 0x81e1c RL_APPC_B_RESETNVM 1.000000 CU_APPC_B_RESETNVM 0.000000 1.000000 BYTE_ORDER MSB_FIRST /end CHARACTERISTIC
/begin RECORD_LAYOUT RL_APPC_B_RESETNVM FNC_VALUES 1 UBYTE COLUMN_DIR DIRECT /end RECORD_LAYOUT
/begin COMPU_METHOD CU_APPC_B_RESETNVM "Conversion method for APPc_b_ResetNVM" RAT_FUNC "%10.0" "b" COEFFS 0.000000 1.000000 0.000000 0.000000 0.000000 1.000000 /end COMPU_METHOD
/* Scalar calibration for DDE 'APPc_b_SpeedLimitActv'. */
/begin CHARACTERISTIC APPc_b_SpeedLimitActv "Speed Limit Activation" VALUE 0x81e4a RL_APPC_B_SPEEDLIMITACTV 1.000000 CU_APPC_B_SPEEDLIMITACTV 0.000000 1.000000 BYTE_ORDER MSB_FIRST /end CHARACTERISTIC
/begin RECORD_LAYOUT RL_APPC_B_SPEEDLIMITACTV FNC_VALUES 1 UBYTE COLUMN_DIR DIRECT /end RECORD_LAYOUT
/begin COMPU_METHOD CU_APPC_B_SPEEDLIMITACTV "Conversion method for APPc_b_SpeedLimitActv" RAT_FUNC "%10.0" "b" COEFFS 0.000000 1.000000 0.000000 0.000000 0.000000 1.000000 /end COMPU_METHOD
/* Scalar calibration for DDE 'APPc_b_UseTransGear'. */
/begin CHARACTERISTIC APPc_b_UseTransGear "Enable per-gear pedal maps (otherwise only use 1st gear map)" VALUE 0x8245c RL_APPC_B_USETRANSGEAR 1.000000 CU_APPC_B_USETRANSGEAR 0.000000 1.000000 BYTE_ORDER MSB_FIRST /end CHARACTERISTIC
/begin RECORD_LAYOUT RL_APPC_B_USETRANSGEAR FNC_VALUES 1 UBYTE COLUMN_DIR DIRECT /end RECORD_LAYOUT
/begin COMPU_METHOD CU_APPC_B_USETRANSGEAR "Conversion method for APPc_b_UseTransGear" RAT_FUNC "%10.0" "b" COEFFS 0.000000 1.000000 0.000000 0.000000 0.000000 1.000000 /end COMPU_METHOD
/* Scalar calibration for DDE 'APPc_b_idleRPMVh'. */
/begin CHARACTERISTIC APPc_b_idleRPMVh "Enable more pedal maps (otherwise only use idle map)" VALUE 0x83055 RL_APPC_B_IDLERPMVH 1.000000 CU_APPC_B_IDLERPMVH 0.000000 1.000000 BYTE_ORDER MSB_FIRST /end CHARACTERISTIC
/begin RECORD_LAYOUT RL_APPC_B_IDLERPMVH FNC_VALUES 1 UBYTE COLUMN_DIR DIRECT /end RECORD_LAYOUT
/begin COMPU_METHOD CU_APPC_B_IDLERPMVH "Conversion method for APPc_b_idleRPMVh" RAT_FUNC "%10.0" "b" COEFFS 0.000000 1.000000 0.000000 0.000000 0.000000 1.000000 /end COMPU_METHOD
/* Scalar calibration for DDE 'APPc_b_pedalmode'. */
/begin CHARACTERISTIC APPc_b_pedalmode "Enable more pedal maps (otherwise only use idle map)" VALUE 0x83054 RL_APPC_B_PEDALMODE 1.000000 CU_APPC_B_PEDALMODE 0.000000 1.000000 BYTE_ORDER MSB_FIRST /end CHARACTERISTIC
/begin RECORD_LAYOUT RL_APPC_B_PEDALMODE FNC_VALUES 1 UBYTE COLUMN_DIR DIRECT /end RECORD_LAYOUT
/begin COMPU_METHOD CU_APPC_B_PEDALMODE "Conversion method for APPc_b_pedalmode" RAT_FUNC "%10.0" "b" COEFFS 0.000000 1.000000 0.000000 0.000000 0.000000 1.000000 /end COMPU_METHOD
/* Scalar calibration for DDE 'APPc_e_PdlMode'. */
/begin CHARACTERISTIC APPc_e_PdlMode "Pdl Mode override value" VALUE 0x825b1 RL_APPC_E_PDLMODE 2.000000 CU_APPC_E_PDLMODE 0.000000 2.000000 BYTE_ORDER MSB_FIRST /end CHARACTERISTIC
/begin RECORD_LAYOUT RL_APPC_E_PDLMODE FNC_VALUES 1 UBYTE COLUMN_DIR DIRECT /end RECORD_LAYOUT
/begin COMPU_METHOD CU_APPC_E_PDLMODE "Conversion method for APPc_e_PdlMode" TAB_VERB "%12.0" "e" COMPU_TAB_REF CT_APPC_E_PDLMODE /end COMPU_METHOD
/begin COMPU_VTAB CT_APPC_E_PDLMODE "Conversion method for APPc_e_PdlMode" TAB_VERB 3 0 "APPk_e_Zero" 1 "APPk_e_Partial" 2 "APPk_e_Full" /end COMPU_VTAB
/* Scalar calibration for DDE 'APPc_kmh_SpeedLimitSetpoint'. */
/begin CHARACTERISTIC APPc_kmh_SpeedLimitSetpoint "Setponit Speed Limit" VALUE 0x81da0 RL_APPC_KMH_SPEEDLIMITSETPOINT 150.000000 CU_APPC_KMH_SPEEDLIMITSETPOINT 0.000000 150.000000 BYTE_ORDER MSB_FIRST /end CHARACTERISTIC
/begin RECORD_LAYOUT RL_APPC_KMH_SPEEDLIMITSETPOINT FNC_VALUES 1 FLOAT32_IEEE COLUMN_DIR DIRECT /end RECORD_LAYOUT
/begin COMPU_METHOD CU_APPC_KMH_SPEEDLIMITSETPOINT "Conversion method for APPc_kmh_SpeedLimitSetpoint" RAT_FUNC "%10.1" "kph" COEFFS 0.000000 1.000000 0.000000 0.000000 0.000000 1.000000 /end COMPU_METHOD
/* Scalar calibration for DDE 'APPc_kph_VehSpeed'. */
/begin CHARACTERISTIC APPc_kph_VehSpeed "Override value" VALUE 0x8ce50 RL_APPC_KPH_VEHSPEED 250.000000 CU_APPC_KPH_VEHSPEED 0.000000 250.000000 BYTE_ORDER MSB_FIRST /end CHARACTERISTIC
/begin RECORD_LAYOUT RL_APPC_KPH_VEHSPEED FNC_VALUES 1 FLOAT32_IEEE COLUMN_DIR DIRECT /end RECORD_LAYOUT
/begin COMPU_METHOD CU_APPC_KPH_VEHSPEED "Conversion method for APPc_kph_VehSpeed" RAT_FUNC "%10.2" "pct" COEFFS 0.000000 1.000000 0.000000 0.000000 0.000000 1.000000 /end COMPU_METHOD
/* Scalar calibration for DDE 'APPc_kph_ZeroLearnSpdThrsh'. */
/begin CHARACTERISTIC APPc_kph_ZeroLearnSpdThrsh "Stationary speed threshold for zero pedal learn" VALUE 0x81e00 RL_APPC_KPH_ZEROLEARNSPDTHRSH 5.000000 CU_APPC_KPH_ZEROLEARNSPDTHRSH 0.000000 5.000000 BYTE_ORDER MSB_FIRST /end CHARACTERISTIC
/begin RECORD_LAYOUT RL_APPC_KPH_ZEROLEARNSPDTHRSH FNC_VALUES 1 FLOAT32_IEEE COLUMN_DIR DIRECT /end RECORD_LAYOUT
/begin COMPU_METHOD CU_APPC_KPH_ZEROLEARNSPDTHRSH "Conversion method for APPc_kph_ZeroLearnSpdThrsh" RAT_FUNC "%10.1" "kph" COEFFS 0.000000 1.000000 0.000000 0.000000 0.000000 1.000000 /end COMPU_METHOD
/* Scalar calibration for DDE 'APPc_o_BrakePedal_actv'. */
/begin CHARACTERISTIC APPc_o_BrakePedal_actv "(not defined)" VALUE 0x81e48 RL_APPC_O_BRAKEPEDAL_ACTV 1.000000 CU_APPC_O_BRAKEPEDAL_ACTV 0.000000 1.000000 BYTE_ORDER MSB_FIRST /end CHARACTERISTIC
/begin RECORD_LAYOUT RL_APPC_O_BRAKEPEDAL_ACTV FNC_VALUES 1 UBYTE COLUMN_DIR DIRECT /end RECORD_LAYOUT
/begin COMPU_METHOD CU_APPC_O_BRAKEPEDAL_ACTV "Conversion method for APPc_o_BrakePedal_actv" RAT_FUNC "%10.0" "o" COEFFS 0.000000 1.000000 0.000000 0.000000 0.000000 1.000000 /end COMPU_METHOD
/* Scalar calibration for DDE 'APPc_o_Dmnd'. */
/begin CHARACTERISTIC APPc_o_Dmnd "Arbitrated pedal position override flag" VALUE 0x87a92 RL_APPC_O_DMND 1.000000 CU_APPC_O_DMND 0.000000 1.000000 BYTE_ORDER MSB_FIRST /end CHARACTERISTIC
/begin RECORD_LAYOUT RL_APPC_O_DMND FNC_VALUES 1 UBYTE COLUMN_DIR DIRECT /end RECORD_LAYOUT
/begin COMPU_METHOD CU_APPC_O_DMND "Conversion method for APPc_o_Dmnd" RAT_FUNC "%10.0" "o" COEFFS 0.000000 1.000000 0.000000 0.000000 0.000000 1.000000 /end COMPU_METHOD
/* Scalar calibration for DDE 'APPc_o_DrvrDmndTq'. */
/begin CHARACTERISTIC APPc_o_DrvrDmndTq "Drvr demand torque override flag" VALUE 0x831a0 RL_APPC_O_DRVRDMNDTQ 1.000000 CU_APPC_O_DRVRDMNDTQ 0.000000 1.000000 BYTE_ORDER MSB_FIRST /end CHARACTERISTIC
/begin RECORD_LAYOUT RL_APPC_O_DRVRDMNDTQ FNC_VALUES 1 UBYTE COLUMN_DIR DIRECT /end RECORD_LAYOUT
/begin COMPU_METHOD CU_APPC_O_DRVRDMNDTQ "Conversion method for APPc_o_DrvrDmndTq" RAT_FUNC "%10.0" "o" COEFFS 0.000000 1.000000 0.000000 0.000000 0.000000 1.000000 /end COMPU_METHOD
/* Scalar calibration for DDE 'APPc_o_Fault'. */
/begin CHARACTERISTIC APPc_o_Fault "APP faulted override flag" VALUE 0x8be62 RL_APPC_O_FAULT 1.000000 CU_APPC_O_FAULT 0.000000 1.000000 BYTE_ORDER MSB_FIRST /end CHARACTERISTIC
/begin RECORD_LAYOUT RL_APPC_O_FAULT FNC_VALUES 1 UBYTE COLUMN_DIR DIRECT /end RECORD_LAYOUT
/begin COMPU_METHOD CU_APPC_O_FAULT "Conversion method for APPc_o_Fault" RAT_FUNC "%10.0" "o" COEFFS 0.000000 1.000000 0.000000 0.000000 0.000000 1.000000 /end COMPU_METHOD
/* Scalar calibration for DDE 'APPc_o_IN'. */
/begin CHARACTERISTIC APPc_o_IN "Override flag" VALUE 0x8cd30 RL_APPC_O_IN 1.000000 CU_APPC_O_IN 0.000000 1.000000 BYTE_ORDER MSB_FIRST /end CHARACTERISTIC
/begin RECORD_LAYOUT RL_APPC_O_IN FNC_VALUES 1 UBYTE COLUMN_DIR DIRECT /end RECORD_LAYOUT
/begin COMPU_METHOD CU_APPC_O_IN "Conversion method for APPc_o_IN" RAT_FUNC "%10.0" "o" COEFFS 0.000000 1.000000 0.000000 0.000000 0.000000 1.000000 /end COMPU_METHOD
/* Scalar calibration for DDE 'APPc_o_OUT'. */
/begin CHARACTERISTIC APPc_o_OUT "Override flag" VALUE 0x8cd24 RL_APPC_O_OUT 1.000000 CU_APPC_O_OUT 0.000000 1.000000 BYTE_ORDER MSB_FIRST /end CHARACTERISTIC
/begin RECORD_LAYOUT RL_APPC_O_OUT FNC_VALUES 1 UBYTE COLUMN_DIR DIRECT /end RECORD_LAYOUT
/begin COMPU_METHOD CU_APPC_O_OUT "Conversion method for APPc_o_OUT" RAT_FUNC "%10.0" "o" COEFFS 0.000000 1.000000 0.000000 0.000000 0.000000 1.000000 /end COMPU_METHOD
/* Scalar calibration for DDE 'APPc_o_PdlMode'. */
/begin CHARACTERISTIC APPc_o_PdlMode "Pdl mode override flag" VALUE 0x825b0 RL_APPC_O_PDLMODE 1.000000 CU_APPC_O_PDLMODE 0.000000 1.000000 BYTE_ORDER MSB_FIRST /end CHARACTERISTIC
/begin RECORD_LAYOUT RL_APPC_O_PDLMODE FNC_VALUES 1 UBYTE COLUMN_DIR DIRECT /end RECORD_LAYOUT
/begin COMPU_METHOD CU_APPC_O_PDLMODE "Conversion method for APPc_o_PdlMode" RAT_FUNC "%10.0" "o" COEFFS 0.000000 1.000000 0.000000 0.000000 0.000000 1.000000 /end COMPU_METHOD
/* Scalar calibration for DDE 'APPc_o_VehSpeed'. */
/begin CHARACTERISTIC APPc_o_VehSpeed "Override flag" VALUE 0x8ce4c RL_APPC_O_VEHSPEED 1.000000 CU_APPC_O_VEHSPEED 0.000000 1.000000 BYTE_ORDER MSB_FIRST /end CHARACTERISTIC
/begin RECORD_LAYOUT RL_APPC_O_VEHSPEED FNC_VALUES 1 UBYTE COLUMN_DIR DIRECT /end RECORD_LAYOUT
/begin COMPU_METHOD CU_APPC_O_VEHSPEED "Conversion method for APPc_o_VehSpeed" RAT_FUNC "%10.0" "o" COEFFS 0.000000 1.000000 0.000000 0.000000 0.000000 1.000000 /end COMPU_METHOD
/* Scalar calibration for DDE 'APPc_pct_APP1_Wgt'. */
/begin CHARACTERISTIC APPc_pct_APP1_Wgt "Weighing factor for determining final pedal position" VALUE 0x81e44 RL_APPC_PCT_APP1_WGT 1.000000 CU_APPC_PCT_APP1_WGT 0.000000 1.000000 BYTE_ORDER MSB_FIRST /end CHARACTERISTIC
/begin RECORD_LAYOUT RL_APPC_PCT_APP1_WGT FNC_VALUES 1 FLOAT32_IEEE COLUMN_DIR DIRECT /end RECORD_LAYOUT
/begin COMPU_METHOD CU_APPC_PCT_APP1_WGT "Conversion method for APPc_pct_APP1_Wgt" RAT_FUNC "%10.2" "pct" COEFFS 0.000000 1.000000 0.000000 0.000000 0.000000 1.000000 /end COMPU_METHOD
/* Scalar calibration for DDE 'APPc_pct_CorrFltLim'. */
/begin CHARACTERISTIC APPc_pct_CorrFltLim "Corr fault threshold" VALUE 0x81e3c RL_APPC_PCT_CORRFLTLIM 10.000000 CU_APPC_PCT_CORRFLTLIM 0.000000 10.000000 BYTE_ORDER MSB_FIRST /end CHARACTERISTIC
/begin RECORD_LAYOUT RL_APPC_PCT_CORRFLTLIM FNC_VALUES 1 FLOAT32_IEEE COLUMN_DIR DIRECT /end RECORD_LAYOUT
/begin COMPU_METHOD CU_APPC_PCT_CORRFLTLIM "Conversion method for APPc_pct_CorrFltLim" RAT_FUNC "%10.4" "pct" COEFFS 0.000000 1.000000 0.000000 0.000000 0.000000 1.000000 /end COMPU_METHOD
/* Scalar calibration for DDE 'APPc_pct_Dmnd'. */
/begin CHARACTERISTIC APPc_pct_Dmnd "Arbitrated pedal position override value" VALUE 0x87a94 RL_APPC_PCT_DMND 1.000000 CU_APPC_PCT_DMND 0.000000 1.000000 BYTE_ORDER MSB_FIRST /end CHARACTERISTIC
/begin RECORD_LAYOUT RL_APPC_PCT_DMND FNC_VALUES 1 FLOAT32_IEEE COLUMN_DIR DIRECT /end RECORD_LAYOUT
/begin COMPU_METHOD CU_APPC_PCT_DMND "Conversion method for APPc_pct_Dmnd" RAT_FUNC "%10.2" "pct" COEFFS 0.000000 1.000000 0.000000 0.000000 0.000000 1.000000 /end COMPU_METHOD
/* Scalar calibration for DDE 'APPc_pct_PdlModeFull'. */
/begin CHARACTERISTIC APPc_pct_PdlModeFull "Full open pedal position threshold" VALUE 0x825ac RL_APPC_PCT_PDLMODEFULL 1.000000 CU_APPC_PCT_PDLMODEFULL 0.000000 1.000000 BYTE_ORDER MSB_FIRST /end CHARACTERISTIC
/begin RECORD_LAYOUT RL_APPC_PCT_PDLMODEFULL FNC_VALUES 1 FLOAT32_IEEE COLUMN_DIR DIRECT /end RECORD_LAYOUT
/begin COMPU_METHOD CU_APPC_PCT_PDLMODEFULL "Conversion method for APPc_pct_PdlModeFull" RAT_FUNC "%10.2" "pct" COEFFS 0.000000 1.000000 0.000000 0.000000 0.000000 1.000000 /end COMPU_METHOD
/* Scalar calibration for DDE 'APPc_pct_PdlModeHyst'. */
/begin CHARACTERISTIC APPc_pct_PdlModeHyst "Pdl mode hysteresis" VALUE 0x825a8 RL_APPC_PCT_PDLMODEHYST 1.000000 CU_APPC_PCT_PDLMODEHYST 0.000000 1.000000 BYTE_ORDER MSB_FIRST /end CHARACTERISTIC
/begin RECORD_LAYOUT RL_APPC_PCT_PDLMODEHYST FNC_VALUES 1 FLOAT32_IEEE COLUMN_DIR DIRECT /end RECORD_LAYOUT
/begin COMPU_METHOD CU_APPC_PCT_PDLMODEHYST "Conversion method for APPc_pct_PdlModeHyst" RAT_FUNC "%10.2" "pct" COEFFS 0.000000 1.000000 0.000000 0.000000 0.000000 1.000000 /end COMPU_METHOD
/* Scalar calibration for DDE 'APPc_pct_PdlModeZero'. */
/begin CHARACTERISTIC APPc_pct_PdlModeZero "Zero pedal position threshold" VALUE 0x825a4 RL_APPC_PCT_PDLMODEZERO 1.000000 CU_APPC_PCT_PDLMODEZERO 0.000000 1.000000 BYTE_ORDER MSB_FIRST /end CHARACTERISTIC
/begin RECORD_LAYOUT RL_APPC_PCT_PDLMODEZERO FNC_VALUES 1 FLOAT32_IEEE COLUMN_DIR DIRECT /end RECORD_LAYOUT
/begin COMPU_METHOD CU_APPC_PCT_PDLMODEZERO "Conversion method for APPc_pct_PdlModeZero" RAT_FUNC "%10.2" "pct" COEFFS 0.000000 1.000000 0.000000 0.000000 0.000000 1.000000 /end COMPU_METHOD
/* Scalar calibration for DDE 'APPc_rpm_IN'. */
/begin CHARACTERISTIC APPc_rpm_IN "Override value" VALUE 0x8cd34 RL_APPC_RPM_IN 10000.000000 CU_APPC_RPM_IN 0.000000 10000.000000 BYTE_ORDER MSB_FIRST /end CHARACTERISTIC
/begin RECORD_LAYOUT RL_APPC_RPM_IN FNC_VALUES 1 FLOAT32_IEEE COLUMN_DIR DIRECT /end RECORD_LAYOUT
/begin COMPU_METHOD CU_APPC_RPM_IN "Conversion method for APPc_rpm_IN" RAT_FUNC "%10.0" "NU" COEFFS 0.000000 1.000000 0.000000 0.000000 0.000000 1.000000 /end COMPU_METHOD
/* Scalar calibration for DDE 'APPc_rpm_OUT'. */
/begin CHARACTERISTIC APPc_rpm_OUT "Override value" VALUE 0x8cd28 RL_APPC_RPM_OUT 10000.000000 CU_APPC_RPM_OUT 0.000000 10000.000000 BYTE_ORDER MSB_FIRST /end CHARACTERISTIC
/begin RECORD_LAYOUT RL_APPC_RPM_OUT FNC_VALUES 1 FLOAT32_IEEE COLUMN_DIR DIRECT /end RECORD_LAYOUT
/begin COMPU_METHOD CU_APPC_RPM_OUT "Conversion method for APPc_rpm_OUT" RAT_FUNC "%10.0" "NU" COEFFS 0.000000 1.000000 0.000000 0.000000 0.000000 1.000000 /end COMPU_METHOD
/* Scalar calibration for DDE 'APPc_s_CorrFltDelay'. */
/begin CHARACTERISTIC APPc_s_CorrFltDelay "Time before correlation fault is declared active" VALUE 0x81e40 RL_APPC_S_CORRFLTDELAY 60.000000 CU_APPC_S_CORRFLTDELAY 0.000000 60.000000 BYTE_ORDER MSB_FIRST /end CHARACTERISTIC
/begin RECORD_LAYOUT RL_APPC_S_CORRFLTDELAY FNC_VALUES 1 FLOAT32_IEEE COLUMN_DIR DIRECT /end RECORD_LAYOUT
/begin COMPU_METHOD CU_APPC_S_CORRFLTDELAY "Conversion method for APPc_s_CorrFltDelay" RAT_FUNC "%10.3" "s" COEFFS 0.000000 1.000000 0.000000 0.000000 0.000000 1.000000 /end COMPU_METHOD
/* Scalar calibration for DDE 'APPca_V_FullLearnDfltValAPP1'. */
/begin CHARACTERISTIC APPca_V_FullLearnDfltValAPP1 "Full pedal learn default value for accelerator pedal position sensor 1" VALUE 0x4000f470 RL_APPCA_V_FULLLEARNDFLTVALAPP1 5.000000 CU_APPCA_V_FULLLEARNDFLTVALAPP1 0.000000 5.000000 BYTE_ORDER MSB_FIRST /end CHARACTERISTIC
/begin RECORD_LAYOUT RL_APPCA_V_FULLLEARNDFLTVALAPP1 FNC_VALUES 1 FLOAT32_IEEE COLUMN_DIR DIRECT /end RECORD_LAYOUT
/begin COMPU_METHOD CU_APPCA_V_FULLLEARNDFLTVALAPP1 "Conversion method for APPca_V_FullLearnDfltValAPP1" RAT_FUNC "%10.3" "V" COEFFS 0.000000 1.000000 0.000000 0.000000 0.000000 1.000000 /end COMPU_METHOD
/* Scalar calibration for DDE 'APPca_V_FullLearnDfltValAPP2'. */
/begin CHARACTERISTIC APPca_V_FullLearnDfltValAPP2 "Full pedal learn default value for accelerator pedal position sensor 2" VALUE 0x4000f46c RL_APPCA_V_FULLLEARNDFLTVALAPP2 5.000000 CU_APPCA_V_FULLLEARNDFLTVALAPP2 0.000000 5.000000 BYTE_ORDER MSB_FIRST /end CHARACTERISTIC
/begin RECORD_LAYOUT RL_APPCA_V_FULLLEARNDFLTVALAPP2 FNC_VALUES 1 FLOAT32_IEEE COLUMN_DIR DIRECT /end RECORD_LAYOUT
/begin COMPU_METHOD CU_APPCA_V_FULLLEARNDFLTVALAPP2 "Conversion method for APPca_V_FullLearnDfltValAPP2" RAT_FUNC "%10.3" "V" COEFFS 0.000000 1.000000 0.000000 0.000000 0.000000 1.000000 /end COMPU_METHOD
/* Map (2d) calibration for DDE 'APPm_NU_DrvrTqDmndFallRate_z'. */
/begin CHARACTERISTIC APPm_NU_DrvrTqDmndFallRate_z "(Nm/s) Drvr demand torque decreasing slew rate map" MAP 0x83128 RL_APPM_NU_DRVRTQDMNDFALLRATE_Z 100000.000000 CU_APPM_NU_DRVRTQDMNDFALLRATE_Z -100000.000000 0.000000
 /begin AXIS_DESCR COM_AXIS NO_INPUT_QUANTITY CU_APPM_NU_DRVRTQDMNDFALLRATE_X 6 0.000000 255.000000 AXIS_PTS_REF APD_APPM_NU_DRVRTQDMNDFALLRATE2 /end AXIS_DESCR
 /begin AXIS_DESCR COM_AXIS NO_INPUT_QUANTITY CU_APPM_NU_DRVRTQDMNDFALLRATE_Y 5 0.000000 1.000000 AXIS_PTS_REF APD_APPM_NU_DRVRTQDMNDFALLRATE1 /end AXIS_DESCR
 BYTE_ORDER MSB_FIRST /end CHARACTERISTIC
/begin RECORD_LAYOUT RL_APPM_NU_DRVRTQDMNDFALLRATE_Z FNC_VALUES 1 FLOAT32_IEEE COLUMN_DIR DIRECT /end RECORD_LAYOUT
/begin COMPU_METHOD CU_APPM_NU_DRVRTQDMNDFALLRATE_Z "Conversion method for APPm_NU_DrvrTqDmndFallRate_z" RAT_FUNC "%10.0" "NU" COEFFS 0.000000 1.000000 0.000000 0.000000 0.000000 1.000000 /end COMPU_METHOD
/begin AXIS_PTS APD_APPM_NU_DRVRTQDMNDFALLRATE2 "(gear) Drvr demand torque decreasing slew rate gear axis" 0x830fc NO_INPUT_QUANTITY RL_APPM_NU_DRVRTQDMNDFALLRATE_X 255.000000 CU_APPM_NU_DRVRTQDMNDFALLRATE_X 6 0.0 255.0 BYTE_ORDER MSB_FIRST /end AXIS_PTS
/begin RECORD_LAYOUT RL_APPM_NU_DRVRTQDMNDFALLRATE_X AXIS_PTS_X 1 FLOAT32_IEEE INDEX_INCR DIRECT /end RECORD_LAYOUT
/begin COMPU_METHOD CU_APPM_NU_DRVRTQDMNDFALLRATE_X "Conversion method for APPm_NU_DrvrTqDmndFallRate_x" RAT_FUNC "%10.0" "e" COEFFS 0.000000 1.000000 0.000000 0.000000 0.000000 1.000000 /end COMPU_METHOD
/begin AXIS_PTS APD_APPM_NU_DRVRTQDMNDFALLRATE1 "(pct APP) Drvr demand torque decreasing slew rate pedal position axis" 0x83114 NO_INPUT_QUANTITY RL_APPM_NU_DRVRTQDMNDFALLRATE_Y 1.000000 CU_APPM_NU_DRVRTQDMNDFALLRATE_Y 5 0.0 1.0 BYTE_ORDER MSB_FIRST /end AXIS_PTS
/begin RECORD_LAYOUT RL_APPM_NU_DRVRTQDMNDFALLRATE_Y AXIS_PTS_X 1 FLOAT32_IEEE INDEX_INCR DIRECT /end RECORD_LAYOUT
/begin COMPU_METHOD CU_APPM_NU_DRVRTQDMNDFALLRATE_Y "Conversion method for APPm_NU_DrvrTqDmndFallRate_y" RAT_FUNC "%10.2" "pct" COEFFS 0.000000 1.000000 0.000000 0.000000 0.000000 1.000000 /end COMPU_METHOD
/* Map (2d) calibration for DDE 'APPm_NU_DrvrTqDmndRiseRate_z'. */
/begin CHARACTERISTIC APPm_NU_DrvrTqDmndRiseRate_z "(Nm/s) Drvr demand torque increasing slew rate map" MAP 0x83084 RL_APPM_NU_DRVRTQDMNDRISERATE_Z 100000.000000 CU_APPM_NU_DRVRTQDMNDRISERATE_Z 0.000000 100000.000000
 /begin AXIS_DESCR COM_AXIS NO_INPUT_QUANTITY CU_APPM_NU_DRVRTQDMNDRISERATE_X 6 0.000000 255.000000 AXIS_PTS_REF APD_APPM_NU_DRVRTQDMNDRISERATE2 /end AXIS_DESCR
 /begin AXIS_DESCR COM_AXIS NO_INPUT_QUANTITY CU_APPM_NU_DRVRTQDMNDRISERATE_Y 5 0.000000 1.000000 AXIS_PTS_REF APD_APPM_NU_DRVRTQDMNDRISERATE0 /end AXIS_DESCR
 BYTE_ORDER MSB_FIRST /end CHARACTERISTIC
/begin RECORD_LAYOUT RL_APPM_NU_DRVRTQDMNDRISERATE_Z FNC_VALUES 1 FLOAT32_IEEE COLUMN_DIR DIRECT /end RECORD_LAYOUT
/begin COMPU_METHOD CU_APPM_NU_DRVRTQDMNDRISERATE_Z "Conversion method for APPm_NU_DrvrTqDmndRiseRate_z" RAT_FUNC "%10.0" "NU" COEFFS 0.000000 1.000000 0.000000 0.000000 0.000000 1.000000 /end COMPU_METHOD
/begin AXIS_PTS APD_APPM_NU_DRVRTQDMNDRISERATE2 "(gear) Drvr demand torque increasing slew rate gear axis" 0x83058 NO_INPUT_QUANTITY RL_APPM_NU_DRVRTQDMNDRISERATE_X 255.000000 CU_APPM_NU_DRVRTQDMNDRISERATE_X 6 0.0 255.0 BYTE_ORDER MSB_FIRST /end AXIS_PTS
/begin RECORD_LAYOUT RL_APPM_NU_DRVRTQDMNDRISERATE_X AXIS_PTS_X 1 FLOAT32_IEEE INDEX_INCR DIRECT /end RECORD_LAYOUT
/begin COMPU_METHOD CU_APPM_NU_DRVRTQDMNDRISERATE_X "Conversion method for APPm_NU_DrvrTqDmndRiseRate_x" RAT_FUNC "%10.0" "e" COEFFS 0.000000 1.000000 0.000000 0.000000 0.000000 1.000000 /end COMPU_METHOD
/begin AXIS_PTS APD_APPM_NU_DRVRTQDMNDRISERATE0 "(pct APP) Drvr demand torque increasing slew rate pedal position axis" 0x83070 NO_INPUT_QUANTITY RL_APPM_NU_DRVRTQDMNDRISERATE_Y 1.000000 CU_APPM_NU_DRVRTQDMNDRISERATE_Y 5 0.0 1.0 BYTE_ORDER MSB_FIRST /end AXIS_PTS
/begin RECORD_LAYOUT RL_APPM_NU_DRVRTQDMNDRISERATE_Y AXIS_PTS_X 1 FLOAT32_IEEE INDEX_INCR DIRECT /end RECORD_LAYOUT
/begin COMPU_METHOD CU_APPM_NU_DRVRTQDMNDRISERATE_Y "Conversion method for APPm_NU_DrvrTqDmndRiseRate_y" RAT_FUNC "%10.2" "pct" COEFFS 0.000000 1.000000 0.000000 0.000000 0.000000 1.000000 /end COMPU_METHOD
/* Map (1d) calibration for DDE 'APPm_NU_SpeedLimitGain_z'. */
/begin CHARACTERISTIC APPm_NU_SpeedLimitGain_z "Speed Limit pedal multiplier" CURVE 0x81dd0 RL_APPM_NU_SPEEDLIMITGAIN_Z 1.000000 CU_APPM_NU_SPEEDLIMITGAIN_Z 0.000000 1.000000
 /begin AXIS_DESCR COM_AXIS NO_INPUT_QUANTITY CU_APPM_NU_SPEEDLIMITGAIN_X 11 -10.000000 10.000000 AXIS_PTS_REF APD_APPM_NU_SPEEDLIMITGAIN_X /end AXIS_DESCR
 BYTE_ORDER MSB_FIRST /end CHARACTERISTIC
/begin RECORD_LAYOUT RL_APPM_NU_SPEEDLIMITGAIN_Z FNC_VALUES 1 FLOAT32_IEEE COLUMN_DIR DIRECT /end RECORD_LAYOUT
/begin COMPU_METHOD CU_APPM_NU_SPEEDLIMITGAIN_Z "Conversion method for APPm_NU_SpeedLimitGain_z" RAT_FUNC "%10.2" "NU" COEFFS 0.000000 1.000000 0.000000 0.000000 0.000000 1.000000 /end COMPU_METHOD
/begin AXIS_PTS APD_APPM_NU_SPEEDLIMITGAIN_X "Substrate actual speed to Speed Limit Setpoint" 0x81da4 NO_INPUT_QUANTITY RL_APPM_NU_SPEEDLIMITGAIN_X 20.000000 CU_APPM_NU_SPEEDLIMITGAIN_X 11 -10.0 10.0 BYTE_ORDER MSB_FIRST /end AXIS_PTS
/begin RECORD_LAYOUT RL_APPM_NU_SPEEDLIMITGAIN_X AXIS_PTS_X 1 FLOAT32_IEEE INDEX_INCR DIRECT /end RECORD_LAYOUT
/begin COMPU_METHOD CU_APPM_NU_SPEEDLIMITGAIN_X "Conversion method for APPm_NU_SpeedLimitGain_x" RAT_FUNC "%10.2" "kph" COEFFS 0.000000 1.000000 0.000000 0.000000 0.000000 1.000000 /end COMPU_METHOD
/* Map (1d) calibration for DDE 'APPm_Nm_DrvrTqDmndMapIdle_z'. */
/begin CHARACTERISTIC APPm_Nm_DrvrTqDmndMapIdle_z "Drvr torque demand map during idle" CURVE 0x8241c RL_APPM_NM_DRVRTQDMNDMAPIDLE_Z 1500.000000 CU_APPM_NM_DRVRTQDMNDMAPIDLE_Z -500.000000 1000.000000
 /begin AXIS_DESCR COM_AXIS NO_INPUT_QUANTITY CU_APPM_NM_DRVRTQDMNDMAPIDLE_X 16 0.000000 1.000000 AXIS_PTS_REF APD_APPM_NM_DRVRTQDMNDMAPIDLE_X /end AXIS_DESCR
 BYTE_ORDER MSB_FIRST /end CHARACTERISTIC
/begin RECORD_LAYOUT RL_APPM_NM_DRVRTQDMNDMAPIDLE_Z FNC_VALUES 1 FLOAT32_IEEE COLUMN_DIR DIRECT /end RECORD_LAYOUT
/begin COMPU_METHOD CU_APPM_NM_DRVRTQDMNDMAPIDLE_Z "Conversion method for APPm_Nm_DrvrTqDmndMapIdle_z" RAT_FUNC "%10.1" "Nm" COEFFS 0.000000 1.000000 0.000000 0.000000 0.000000 1.000000 /end COMPU_METHOD
/begin AXIS_PTS APD_APPM_NM_DRVRTQDMNDMAPIDLE_X "(pct APP) Drvr torque demand map pedal position axis for idle" 0x823dc NO_INPUT_QUANTITY RL_APPM_NM_DRVRTQDMNDMAPIDLE_X 1.000000 CU_APPM_NM_DRVRTQDMNDMAPIDLE_X 16 0.0 1.0 BYTE_ORDER MSB_FIRST /end AXIS_PTS
/begin RECORD_LAYOUT RL_APPM_NM_DRVRTQDMNDMAPIDLE_X AXIS_PTS_X 1 FLOAT32_IEEE INDEX_INCR DIRECT /end RECORD_LAYOUT
/begin COMPU_METHOD CU_APPM_NM_DRVRTQDMNDMAPIDLE_X "Conversion method for APPm_Nm_DrvrTqDmndMapIdle_x" RAT_FUNC "%10.2" "pct" COEFFS 0.000000 1.000000 0.000000 0.000000 0.000000 1.000000 /end COMPU_METHOD
/* Map (2d) calibration for DDE 'APPm_Nm_DrvrTqDmndMap_1_z'. */
/begin CHARACTERISTIC APPm_Nm_DrvrTqDmndMap_1_z "Drvr torque demand map data for 1st gear" MAP 0x82e94 RL_APPM_NM_DRVRTQDMNDMAP_1_Z 1500.000000 CU_APPM_NM_DRVRTQDMNDMAP_1_Z -500.000000 1000.000000
 /begin AXIS_DESCR COM_AXIS NO_INPUT_QUANTITY CU_APPM_NM_DRVRTQDMNDMAP_1_X 16 0.000000 1.000000 AXIS_PTS_REF APD_APPM_NM_DRVRTQDMNDMAP_1_X /end AXIS_DESCR
 /begin AXIS_DESCR COM_AXIS NO_INPUT_QUANTITY CU_APPM_NM_DRVRTQDMNDMAP_1_Y 7 0.000000 200.000000 AXIS_PTS_REF APD_APPM_NM_DRVRTQDMNDMAP_1_Y /end AXIS_DESCR
 BYTE_ORDER MSB_FIRST /end CHARACTERISTIC
/begin RECORD_LAYOUT RL_APPM_NM_DRVRTQDMNDMAP_1_Z FNC_VALUES 1 FLOAT32_IEEE COLUMN_DIR DIRECT /end RECORD_LAYOUT
/begin COMPU_METHOD CU_APPM_NM_DRVRTQDMNDMAP_1_Z "Conversion method for APPm_Nm_DrvrTqDmndMap_1_z" RAT_FUNC "%10.1" "Nm" COEFFS 0.000000 1.000000 0.000000 0.000000 0.000000 1.000000 /end COMPU_METHOD
/begin AXIS_PTS APD_APPM_NM_DRVRTQDMNDMAP_1_X "(pct APP) Drvr torque demand map pedal position axis for 1st gear" 0x82e38 NO_INPUT_QUANTITY RL_APPM_NM_DRVRTQDMNDMAP_1_X 1.000000 CU_APPM_NM_DRVRTQDMNDMAP_1_X 16 0.0 1.0 BYTE_ORDER MSB_FIRST /end AXIS_PTS
/begin RECORD_LAYOUT RL_APPM_NM_DRVRTQDMNDMAP_1_X AXIS_PTS_X 1 FLOAT32_IEEE INDEX_INCR DIRECT /end RECORD_LAYOUT
/begin COMPU_METHOD CU_APPM_NM_DRVRTQDMNDMAP_1_X "Conversion method for APPm_Nm_DrvrTqDmndMap_1_x" RAT_FUNC "%10.2" "pct" COEFFS 0.000000 1.000000 0.000000 0.000000 0.000000 1.000000 /end COMPU_METHOD
/begin AXIS_PTS APD_APPM_NM_DRVRTQDMNDMAP_1_Y "Drvr torque demand map vehicle speed axis for 1st gear" 0x82e78 NO_INPUT_QUANTITY RL_APPM_NM_DRVRTQDMNDMAP_1_Y 200.000000 CU_APPM_NM_DRVRTQDMNDMAP_1_Y 7 0.0 200.0 BYTE_ORDER MSB_FIRST /end AXIS_PTS
/begin RECORD_LAYOUT RL_APPM_NM_DRVRTQDMNDMAP_1_Y AXIS_PTS_X 1 FLOAT32_IEEE INDEX_INCR DIRECT /end RECORD_LAYOUT
/begin COMPU_METHOD CU_APPM_NM_DRVRTQDMNDMAP_1_Y "Conversion method for APPm_Nm_DrvrTqDmndMap_1_y" RAT_FUNC "%10.0" "kph" COEFFS 0.000000 1.000000 0.000000 0.000000 0.000000 1.000000 /end COMPU_METHOD
/* Map (2d) calibration for DDE 'APPm_Nm_DrvrTqDmndMap_2_z'. */
/begin CHARACTERISTIC APPm_Nm_DrvrTqDmndMap_2_z "Drvr torque demand map data for 2nd gear" MAP 0x82c78 RL_APPM_NM_DRVRTQDMNDMAP_2_Z 1500.000000 CU_APPM_NM_DRVRTQDMNDMAP_2_Z -500.000000 1000.000000
 /begin AXIS_DESCR COM_AXIS NO_INPUT_QUANTITY CU_APPM_NM_DRVRTQDMNDMAP_2_X 16 0.000000 1.000000 AXIS_PTS_REF APD_APPM_NM_DRVRTQDMNDMAP_2_X /end AXIS_DESCR
 /begin AXIS_DESCR COM_AXIS NO_INPUT_QUANTITY CU_APPM_NM_DRVRTQDMNDMAP_2_Y 7 0.000000 200.000000 AXIS_PTS_REF APD_APPM_NM_DRVRTQDMNDMAP_2_Y /end AXIS_DESCR
 BYTE_ORDER MSB_FIRST /end CHARACTERISTIC
/begin RECORD_LAYOUT RL_APPM_NM_DRVRTQDMNDMAP_2_Z FNC_VALUES 1 FLOAT32_IEEE COLUMN_DIR DIRECT /end RECORD_LAYOUT
/begin COMPU_METHOD CU_APPM_NM_DRVRTQDMNDMAP_2_Z "Conversion method for APPm_Nm_DrvrTqDmndMap_2_z" RAT_FUNC "%10.1" "Nm" COEFFS 0.000000 1.000000 0.000000 0.000000 0.000000 1.000000 /end COMPU_METHOD
/begin AXIS_PTS APD_APPM_NM_DRVRTQDMNDMAP_2_X "(pct APP) Drvr torque demand map pedal position axis for 2nd gear" 0x82c1c NO_INPUT_QUANTITY RL_APPM_NM_DRVRTQDMNDMAP_2_X 1.000000 CU_APPM_NM_DRVRTQDMNDMAP_2_X 16 0.0 1.0 BYTE_ORDER MSB_FIRST /end AXIS_PTS
/begin RECORD_LAYOUT RL_APPM_NM_DRVRTQDMNDMAP_2_X AXIS_PTS_X 1 FLOAT32_IEEE INDEX_INCR DIRECT /end RECORD_LAYOUT
/begin COMPU_METHOD CU_APPM_NM_DRVRTQDMNDMAP_2_X "Conversion method for APPm_Nm_DrvrTqDmndMap_2_x" RAT_FUNC "%10.2" "pct" COEFFS 0.000000 1.000000 0.000000 0.000000 0.000000 1.000000 /end COMPU_METHOD
/begin AXIS_PTS APD_APPM_NM_DRVRTQDMNDMAP_2_Y "Drvr torque demand map vehicle speed axis for 2nd gear" 0x82c5c NO_INPUT_QUANTITY RL_APPM_NM_DRVRTQDMNDMAP_2_Y 200.000000 CU_APPM_NM_DRVRTQDMNDMAP_2_Y 7 0.0 200.0 BYTE_ORDER MSB_FIRST /end AXIS_PTS
/begin RECORD_LAYOUT RL_APPM_NM_DRVRTQDMNDMAP_2_Y AXIS_PTS_X 1 FLOAT32_IEEE INDEX_INCR DIRECT /end RECORD_LAYOUT
/begin COMPU_METHOD CU_APPM_NM_DRVRTQDMNDMAP_2_Y "Conversion method for APPm_Nm_DrvrTqDmndMap_2_y" RAT_FUNC "%10.0" "kph" COEFFS 0.000000 1.000000 0.000000 0.000000 0.000000 1.000000 /end COMPU_METHOD
/* Map (2d) calibration for DDE 'APPm_Nm_DrvrTqDmndMap_3_z'. */
/begin CHARACTERISTIC APPm_Nm_DrvrTqDmndMap_3_z "Drvr torque demand map data for 3rd gear" MAP 0x82a5c RL_APPM_NM_DRVRTQDMNDMAP_3_Z 1500.000000 CU_APPM_NM_DRVRTQDMNDMAP_3_Z -500.000000 1000.000000
 /begin AXIS_DESCR COM_AXIS NO_INPUT_QUANTITY CU_APPM_NM_DRVRTQDMNDMAP_3_X 16 0.000000 1.000000 AXIS_PTS_REF APD_APPM_NM_DRVRTQDMNDMAP_3_X /end AXIS_DESCR
 /begin AXIS_DESCR COM_AXIS NO_INPUT_QUANTITY CU_APPM_NM_DRVRTQDMNDMAP_3_Y 7 0.000000 200.000000 AXIS_PTS_REF APD_APPM_NM_DRVRTQDMNDMAP_3_Y /end AXIS_DESCR
 BYTE_ORDER MSB_FIRST /end CHARACTERISTIC
/begin RECORD_LAYOUT RL_APPM_NM_DRVRTQDMNDMAP_3_Z FNC_VALUES 1 FLOAT32_IEEE COLUMN_DIR DIRECT /end RECORD_LAYOUT
/begin COMPU_METHOD CU_APPM_NM_DRVRTQDMNDMAP_3_Z "Conversion method for APPm_Nm_DrvrTqDmndMap_3_z" RAT_FUNC "%10.1" "Nm" COEFFS 0.000000 1.000000 0.000000 0.000000 0.000000 1.000000 /end COMPU_METHOD
/begin AXIS_PTS APD_APPM_NM_DRVRTQDMNDMAP_3_X "(pct APP) Drvr torque demand map pedal position axis for 3rd gear" 0x82a00 NO_INPUT_QUANTITY RL_APPM_NM_DRVRTQDMNDMAP_3_X 1.000000 CU_APPM_NM_DRVRTQDMNDMAP_3_X 16 0.0 1.0 BYTE_ORDER MSB_FIRST /end AXIS_PTS
/begin RECORD_LAYOUT RL_APPM_NM_DRVRTQDMNDMAP_3_X AXIS_PTS_X 1 FLOAT32_IEEE INDEX_INCR DIRECT /end RECORD_LAYOUT
/begin COMPU_METHOD CU_APPM_NM_DRVRTQDMNDMAP_3_X "Conversion method for APPm_Nm_DrvrTqDmndMap_3_x" RAT_FUNC "%10.2" "pct" COEFFS 0.000000 1.000000 0.000000 0.000000 0.000000 1.000000 /end COMPU_METHOD
/begin AXIS_PTS APD_APPM_NM_DRVRTQDMNDMAP_3_Y "Drvr torque demand map vehicle speed axis for 3rd gear" 0x82a40 NO_INPUT_QUANTITY RL_APPM_NM_DRVRTQDMNDMAP_3_Y 200.000000 CU_APPM_NM_DRVRTQDMNDMAP_3_Y 7 0.0 200.0 BYTE_ORDER MSB_FIRST /end AXIS_PTS
/begin RECORD_LAYOUT RL_APPM_NM_DRVRTQDMNDMAP_3_Y AXIS_PTS_X 1 FLOAT32_IEEE INDEX_INCR DIRECT /end RECORD_LAYOUT
/begin COMPU_METHOD CU_APPM_NM_DRVRTQDMNDMAP_3_Y "Conversion method for APPm_Nm_DrvrTqDmndMap_3_y" RAT_FUNC "%10.0" "kph" COEFFS 0.000000 1.000000 0.000000 0.000000 0.000000 1.000000 /end COMPU_METHOD
/* Map (2d) calibration for DDE 'APPm_Nm_DrvrTqDmndMap_4_z'. */
/begin CHARACTERISTIC APPm_Nm_DrvrTqDmndMap_4_z "Drvr torque demand map data for 4th gear" MAP 0x82840 RL_APPM_NM_DRVRTQDMNDMAP_4_Z 1500.000000 CU_APPM_NM_DRVRTQDMNDMAP_4_Z -500.000000 1000.000000
 /begin AXIS_DESCR COM_AXIS NO_INPUT_QUANTITY CU_APPM_NM_DRVRTQDMNDMAP_4_X 16 0.000000 1.000000 AXIS_PTS_REF APD_APPM_NM_DRVRTQDMNDMAP_4_X /end AXIS_DESCR
 /begin AXIS_DESCR COM_AXIS NO_INPUT_QUANTITY CU_APPM_NM_DRVRTQDMNDMAP_4_Y 7 0.000000 200.000000 AXIS_PTS_REF APD_APPM_NM_DRVRTQDMNDMAP_4_Y /end AXIS_DESCR
 BYTE_ORDER MSB_FIRST /end CHARACTERISTIC
/begin RECORD_LAYOUT RL_APPM_NM_DRVRTQDMNDMAP_4_Z FNC_VALUES 1 FLOAT32_IEEE COLUMN_DIR DIRECT /end RECORD_LAYOUT
/begin COMPU_METHOD CU_APPM_NM_DRVRTQDMNDMAP_4_Z "Conversion method for APPm_Nm_DrvrTqDmndMap_4_z" RAT_FUNC "%10.1" "Nm" COEFFS 0.000000 1.000000 0.000000 0.000000 0.000000 1.000000 /end COMPU_METHOD
/begin AXIS_PTS APD_APPM_NM_DRVRTQDMNDMAP_4_X "(pct APP) Drvr torque demand map pedal position axis for 4th gear" 0x827e4 NO_INPUT_QUANTITY RL_APPM_NM_DRVRTQDMNDMAP_4_X 1.000000 CU_APPM_NM_DRVRTQDMNDMAP_4_X 16 0.0 1.0 BYTE_ORDER MSB_FIRST /end AXIS_PTS
/begin RECORD_LAYOUT RL_APPM_NM_DRVRTQDMNDMAP_4_X AXIS_PTS_X 1 FLOAT32_IEEE INDEX_INCR DIRECT /end RECORD_LAYOUT
/begin COMPU_METHOD CU_APPM_NM_DRVRTQDMNDMAP_4_X "Conversion method for APPm_Nm_DrvrTqDmndMap_4_x" RAT_FUNC "%10.2" "pct" COEFFS 0.000000 1.000000 0.000000 0.000000 0.000000 1.000000 /end COMPU_METHOD
/begin AXIS_PTS APD_APPM_NM_DRVRTQDMNDMAP_4_Y "Drvr torque demand map vehicle speed axis for 4th gear" 0x82824 NO_INPUT_QUANTITY RL_APPM_NM_DRVRTQDMNDMAP_4_Y 200.000000 CU_APPM_NM_DRVRTQDMNDMAP_4_Y 7 0.0 200.0 BYTE_ORDER MSB_FIRST /end AXIS_PTS
/begin RECORD_LAYOUT RL_APPM_NM_DRVRTQDMNDMAP_4_Y AXIS_PTS_X 1 FLOAT32_IEEE INDEX_INCR DIRECT /end RECORD_LAYOUT
/begin COMPU_METHOD CU_APPM_NM_DRVRTQDMNDMAP_4_Y "Conversion method for APPm_Nm_DrvrTqDmndMap_4_y" RAT_FUNC "%10.0" "kph" COEFFS 0.000000 1.000000 0.000000 0.000000 0.000000 1.000000 /end COMPU_METHOD
/* Map (2d) calibration for DDE 'APPm_Nm_DrvrTqDmndMap_5_z'. */
/begin CHARACTERISTIC APPm_Nm_DrvrTqDmndMap_5_z "Drvr torque demand map data for 5th gear" MAP 0x82624 RL_APPM_NM_DRVRTQDMNDMAP_5_Z 1500.000000 CU_APPM_NM_DRVRTQDMNDMAP_5_Z -500.000000 1000.000000
 /begin AXIS_DESCR COM_AXIS NO_INPUT_QUANTITY CU_APPM_NM_DRVRTQDMNDMAP_5_X 16 0.000000 1.000000 AXIS_PTS_REF APD_APPM_NM_DRVRTQDMNDMAP_5_X /end AXIS_DESCR
 /begin AXIS_DESCR COM_AXIS NO_INPUT_QUANTITY CU_APPM_NM_DRVRTQDMNDMAP_5_Y 7 0.000000 200.000000 AXIS_PTS_REF APD_APPM_NM_DRVRTQDMNDMAP_5_Y /end AXIS_DESCR
 BYTE_ORDER MSB_FIRST /end CHARACTERISTIC
/begin RECORD_LAYOUT RL_APPM_NM_DRVRTQDMNDMAP_5_Z FNC_VALUES 1 FLOAT32_IEEE COLUMN_DIR DIRECT /end RECORD_LAYOUT
/begin COMPU_METHOD CU_APPM_NM_DRVRTQDMNDMAP_5_Z "Conversion method for APPm_Nm_DrvrTqDmndMap_5_z" RAT_FUNC "%10.1" "Nm" COEFFS 0.000000 1.000000 0.000000 0.000000 0.000000 1.000000 /end COMPU_METHOD
/begin AXIS_PTS APD_APPM_NM_DRVRTQDMNDMAP_5_X "(pct APP) Drvr torque demand map pedal position axis for 5th gear" 0x825c8 NO_INPUT_QUANTITY RL_APPM_NM_DRVRTQDMNDMAP_5_X 1.000000 CU_APPM_NM_DRVRTQDMNDMAP_5_X 16 0.0 1.0 BYTE_ORDER MSB_FIRST /end AXIS_PTS
/begin RECORD_LAYOUT RL_APPM_NM_DRVRTQDMNDMAP_5_X AXIS_PTS_X 1 FLOAT32_IEEE INDEX_INCR DIRECT /end RECORD_LAYOUT
/begin COMPU_METHOD CU_APPM_NM_DRVRTQDMNDMAP_5_X "Conversion method for APPm_Nm_DrvrTqDmndMap_5_x" RAT_FUNC "%10.2" "pct" COEFFS 0.000000 1.000000 0.000000 0.000000 0.000000 1.000000 /end COMPU_METHOD
/begin AXIS_PTS APD_APPM_NM_DRVRTQDMNDMAP_5_Y "Drvr torque demand map vehicle speed axis for 5th gear" 0x82608 NO_INPUT_QUANTITY RL_APPM_NM_DRVRTQDMNDMAP_5_Y 200.000000 CU_APPM_NM_DRVRTQDMNDMAP_5_Y 7 0.0 200.0 BYTE_ORDER MSB_FIRST /end AXIS_PTS
/begin RECORD_LAYOUT RL_APPM_NM_DRVRTQDMNDMAP_5_Y AXIS_PTS_X 1 FLOAT32_IEEE INDEX_INCR DIRECT /end RECORD_LAYOUT
/begin COMPU_METHOD CU_APPM_NM_DRVRTQDMNDMAP_5_Y "Conversion method for APPm_Nm_DrvrTqDmndMap_5_y" RAT_FUNC "%10.0" "kph" COEFFS 0.000000 1.000000 0.000000 0.000000 0.000000 1.000000 /end COMPU_METHOD
/* Map (2d) calibration for DDE 'APPm_Nm_DrvrTqDmndMap_IDLE_z'. */
/begin CHARACTERISTIC APPm_Nm_DrvrTqDmndMap_IDLE_z "Drvr torque demand map data for 5th gear" MAP 0x81edc RL_APPM_NM_DRVRTQDMNDMAP_IDLE_Z 1500.000000 CU_APPM_NM_DRVRTQDMNDMAP_IDLE_Z -500.000000 1000.000000
 /begin AXIS_DESCR COM_AXIS NO_INPUT_QUANTITY CU_APPM_NM_DRVRTQDMNDMAP_IDLE_X 16 0.000000 1.000000 AXIS_PTS_REF APD_APPM_NM_DRVRTQDMNDMAP_IDLE2 /end AXIS_DESCR
 /begin AXIS_DESCR COM_AXIS NO_INPUT_QUANTITY CU_APPM_NM_DRVRTQDMNDMAP_IDLE_Y 20 0.000000 5000.000000 AXIS_PTS_REF APD_APPM_NM_DRVRTQDMNDMAP_IDLE1 /end AXIS_DESCR
 BYTE_ORDER MSB_FIRST /end CHARACTERISTIC
/begin RECORD_LAYOUT RL_APPM_NM_DRVRTQDMNDMAP_IDLE_Z FNC_VALUES 1 FLOAT32_IEEE COLUMN_DIR DIRECT /end RECORD_LAYOUT
/begin COMPU_METHOD CU_APPM_NM_DRVRTQDMNDMAP_IDLE_Z "Conversion method for APPm_Nm_DrvrTqDmndMap_IDLE_z" RAT_FUNC "%10.1" "Nm" COEFFS 0.000000 1.000000 0.000000 0.000000 0.000000 1.000000 /end COMPU_METHOD
/begin AXIS_PTS APD_APPM_NM_DRVRTQDMNDMAP_IDLE2 "(pct APP) Drvr torque demand map pedal position axis for idle" 0x81e4c NO_INPUT_QUANTITY RL_APPM_NM_DRVRTQDMNDMAP_IDLE_X 1.000000 CU_APPM_NM_DRVRTQDMNDMAP_IDLE_X 16 0.0 1.0 BYTE_ORDER MSB_FIRST /end AXIS_PTS
/begin RECORD_LAYOUT RL_APPM_NM_DRVRTQDMNDMAP_IDLE_X AXIS_PTS_X 1 FLOAT32_IEEE INDEX_INCR DIRECT /end RECORD_LAYOUT
/begin COMPU_METHOD CU_APPM_NM_DRVRTQDMNDMAP_IDLE_X "Conversion method for APPm_Nm_DrvrTqDmndMap_IDLE_x" RAT_FUNC "%10.2" "pct" COEFFS 0.000000 1.000000 0.000000 0.000000 0.000000 1.000000 /end COMPU_METHOD
/begin AXIS_PTS APD_APPM_NM_DRVRTQDMNDMAP_IDLE1 "Drvr torque demand map vehicle speed axis for 5th gear" 0x81e8c NO_INPUT_QUANTITY RL_APPM_NM_DRVRTQDMNDMAP_IDLE_Y 5000.000000 CU_APPM_NM_DRVRTQDMNDMAP_IDLE_Y 20 0.0 5000.0 BYTE_ORDER MSB_FIRST /end AXIS_PTS
/begin RECORD_LAYOUT RL_APPM_NM_DRVRTQDMNDMAP_IDLE_Y AXIS_PTS_X 1 FLOAT32_IEEE INDEX_INCR DIRECT /end RECORD_LAYOUT
/begin COMPU_METHOD CU_APPM_NM_DRVRTQDMNDMAP_IDLE_Y "Conversion method for APPm_Nm_DrvrTqDmndMap_IDLE_y" RAT_FUNC "%10.0" "RPM" COEFFS 0.000000 1.000000 0.000000 0.000000 0.000000 1.000000 /end COMPU_METHOD
/* Scalar calibration for DDE 'BAFc_mg_FuelRqst1'. */
/begin CHARACTERISTIC BAFc_mg_FuelRqst1 "Override value" VALUE 0x84b00 RL_BAFC_MG_FUELRQST1 100.000000 CU_BAFC_MG_FUELRQST1 0.000000 100.000000 BYTE_ORDER MSB_FIRST /end CHARACTERISTIC
/begin RECORD_LAYOUT RL_BAFC_MG_FUELRQST1 FNC_VALUES 1 FLOAT32_IEEE COLUMN_DIR DIRECT /end RECORD_LAYOUT
/begin COMPU_METHOD CU_BAFC_MG_FUELRQST1 "Conversion method for BAFc_mg_FuelRqst1" RAT_FUNC "%10.2" "mg" COEFFS 0.000000 1.000000 0.000000 0.000000 0.000000 1.000000 /end COMPU_METHOD
/* Scalar calibration for DDE 'BAFc_o_FuelRqst1'. */
/begin CHARACTERISTIC BAFc_o_FuelRqst1 "Override flag" VALUE 0x84afc RL_BAFC_O_FUELRQST1 1.000000 CU_BAFC_O_FUELRQST1 0.000000 1.000000 BYTE_ORDER MSB_FIRST /end CHARACTERISTIC
/begin RECORD_LAYOUT RL_BAFC_O_FUELRQST1 FNC_VALUES 1 UBYTE COLUMN_DIR DIRECT /end RECORD_LAYOUT
/begin COMPU_METHOD CU_BAFC_O_FUELRQST1 "Conversion method for BAFc_o_FuelRqst1" RAT_FUNC "%10.0" "o" COEFFS 0.000000 1.000000 0.000000 0.000000 0.000000 1.000000 /end COMPU_METHOD
/* Map (2d) calibration for DDE 'BAFm_NU_BaseFuelCI_z'. */
/begin CHARACTERISTIC BAFm_NU_BaseFuelCI_z "Diesel Engine Base Fuel" MAP 0x84618 RL_BAFM_NU_BASEFUELCI_Z 200.000000 CU_BAFM_NU_BASEFUELCI_Z 0.000000 200.000000
 /begin AXIS_DESCR COM_AXIS NO_INPUT_QUANTITY CU_BAFM_NU_BASEFUELCI_X 5 0.000000 500.000000 AXIS_PTS_REF APD_BAFM_NU_BASEFUELCI_X /end AXIS_DESCR
 /begin AXIS_DESCR COM_AXIS NO_INPUT_QUANTITY CU_BAFM_NU_BASEFUELCI_Y 5 0.000000 10000.000000 AXIS_PTS_REF APD_BAFM_NU_BASEFUELCI_Y /end AXIS_DESCR
 BYTE_ORDER MSB_FIRST /end CHARACTERISTIC
/begin RECORD_LAYOUT RL_BAFM_NU_BASEFUELCI_Z FNC_VALUES 1 FLOAT32_IEEE COLUMN_DIR DIRECT /end RECORD_LAYOUT
/begin COMPU_METHOD CU_BAFM_NU_BASEFUELCI_Z "Conversion method for BAFm_NU_BaseFuelCI_z" RAT_FUNC "%10.2" "mg" COEFFS 0.000000 1.000000 0.000000 0.000000 0.000000 1.000000 /end COMPU_METHOD
/begin AXIS_PTS APD_BAFM_NU_BASEFUELCI_X "Torque Request" 0x845f0 NO_INPUT_QUANTITY RL_BAFM_NU_BASEFUELCI_X 500.000000 CU_BAFM_NU_BASEFUELCI_X 5 0.0 500.0 BYTE_ORDER MSB_FIRST /end AXIS_PTS
/begin RECORD_LAYOUT RL_BAFM_NU_BASEFUELCI_X AXIS_PTS_X 1 FLOAT32_IEEE INDEX_INCR DIRECT /end RECORD_LAYOUT
/begin COMPU_METHOD CU_BAFM_NU_BASEFUELCI_X "Conversion method for BAFm_NU_BaseFuelCI_x" RAT_FUNC "%10.2" "Nm" COEFFS 0.000000 1.000000 0.000000 0.000000 0.000000 1.000000 /end COMPU_METHOD
/begin AXIS_PTS APD_BAFM_NU_BASEFUELCI_Y "Engine Speed" 0x84604 NO_INPUT_QUANTITY RL_BAFM_NU_BASEFUELCI_Y 10000.000000 CU_BAFM_NU_BASEFUELCI_Y 5 0.0 10000.0 BYTE_ORDER MSB_FIRST /end AXIS_PTS
/begin RECORD_LAYOUT RL_BAFM_NU_BASEFUELCI_Y AXIS_PTS_X 1 FLOAT32_IEEE INDEX_INCR DIRECT /end RECORD_LAYOUT
/begin COMPU_METHOD CU_BAFM_NU_BASEFUELCI_Y "Conversion method for BAFm_NU_BaseFuelCI_y" RAT_FUNC "%10.2" "RPM" COEFFS 0.000000 1.000000 0.000000 0.000000 0.000000 1.000000 /end COMPU_METHOD
/* Map (2d) calibration for DDE 'BAFm_NU_TransientFuelGain_z'. */
/begin CHARACTERISTIC BAFm_NU_TransientFuelGain_z "SOI map data for Run pulse 1" MAP 0x846fc RL_BAFM_NU_TRANSIENTFUELGAIN_Z 1440.000000 CU_BAFM_NU_TRANSIENTFUELGAIN_Z -720.000000 720.000000
 /begin AXIS_DESCR COM_AXIS NO_INPUT_QUANTITY CU_BAFM_NU_TRANSIENTFUELGAIN_X 16 0.000000 10000.000000 AXIS_PTS_REF APD_BAFM_NU_TRANSIENTFUELGAIN_X /end AXIS_DESCR
 /begin AXIS_DESCR COM_AXIS NO_INPUT_QUANTITY CU_BAFM_NU_TRANSIENTFUELGAIN_Y 16 -500.000000 500.000000 AXIS_PTS_REF APD_BAFM_NU_TRANSIENTFUELGAIN_Y /end AXIS_DESCR
 BYTE_ORDER MSB_FIRST /end CHARACTERISTIC
/begin RECORD_LAYOUT RL_BAFM_NU_TRANSIENTFUELGAIN_Z FNC_VALUES 1 FLOAT32_IEEE COLUMN_DIR DIRECT /end RECORD_LAYOUT
/begin COMPU_METHOD CU_BAFM_NU_TRANSIENTFUELGAIN_Z "Conversion method for BAFm_NU_TransientFuelGain_z" RAT_FUNC "%10.0" "adv" COEFFS 0.000000 1.000000 0.000000 0.000000 0.000000 1.000000 /end COMPU_METHOD
/begin AXIS_PTS APD_BAFM_NU_TRANSIENTFUELGAIN_X "SOI map for Run pulse 1 engine speed axis" 0x8467c NO_INPUT_QUANTITY RL_BAFM_NU_TRANSIENTFUELGAIN_X 10000.000000 CU_BAFM_NU_TRANSIENTFUELGAIN_X 16 0.0 10000.0 BYTE_ORDER MSB_FIRST /end AXIS_PTS
/begin RECORD_LAYOUT RL_BAFM_NU_TRANSIENTFUELGAIN_X AXIS_PTS_X 1 FLOAT32_IEEE INDEX_INCR DIRECT /end RECORD_LAYOUT
/begin COMPU_METHOD CU_BAFM_NU_TRANSIENTFUELGAIN_X "Conversion method for BAFm_NU_TransientFuelGain_x" RAT_FUNC "%10.0" "RPM" COEFFS 0.000000 1.000000 0.000000 0.000000 0.000000 1.000000 /end COMPU_METHOD
/begin AXIS_PTS APD_BAFM_NU_TRANSIENTFUELGAIN_Y "SOI map for Run pulse 1 torque demand axis" 0x846bc NO_INPUT_QUANTITY RL_BAFM_NU_TRANSIENTFUELGAIN_Y 1000.000000 CU_BAFM_NU_TRANSIENTFUELGAIN_Y 16 -500.0 500.0 BYTE_ORDER MSB_FIRST /end AXIS_PTS
/begin RECORD_LAYOUT RL_BAFM_NU_TRANSIENTFUELGAIN_Y AXIS_PTS_X 1 FLOAT32_IEEE INDEX_INCR DIRECT /end RECORD_LAYOUT
/begin COMPU_METHOD CU_BAFM_NU_TRANSIENTFUELGAIN_Y "Conversion method for BAFm_NU_TransientFuelGain_y" RAT_FUNC "%10.1" "Nm" COEFFS 0.000000 1.000000 0.000000 0.000000 0.000000 1.000000 /end COMPU_METHOD
/* Scalar calibration for DDE 'BARc_b_OBDPressOK'. */
/begin CHARACTERISTIC BARc_b_OBDPressOK "Override value" VALUE 0x8ce61 RL_BARC_B_OBDPRESSOK 1.000000 CU_BARC_B_OBDPRESSOK 0.000000 1.000000 BYTE_ORDER MSB_FIRST /end CHARACTERISTIC
/begin RECORD_LAYOUT RL_BARC_B_OBDPRESSOK FNC_VALUES 1 UBYTE COLUMN_DIR DIRECT /end RECORD_LAYOUT
/begin COMPU_METHOD CU_BARC_B_OBDPRESSOK "Conversion method for BARc_b_OBDPressOK" RAT_FUNC "%10.0" "b" COEFFS 0.000000 1.000000 0.000000 0.000000 0.000000 1.000000 /end COMPU_METHOD
/* Scalar calibration for DDE 'BARc_o_OBDPressOK'. */
/begin CHARACTERISTIC BARc_o_OBDPressOK "Override flag" VALUE 0x8ce60 RL_BARC_O_OBDPRESSOK 1.000000 CU_BARC_O_OBDPRESSOK 0.000000 1.000000 BYTE_ORDER MSB_FIRST /end CHARACTERISTIC
/begin RECORD_LAYOUT RL_BARC_O_OBDPRESSOK FNC_VALUES 1 UBYTE COLUMN_DIR DIRECT /end RECORD_LAYOUT
/begin COMPU_METHOD CU_BARC_O_OBDPRESSOK "Conversion method for BARc_o_OBDPressOK" RAT_FUNC "%10.0" "o" COEFFS 0.000000 1.000000 0.000000 0.000000 0.000000 1.000000 /end COMPU_METHOD
/* Scalar calibration for DDE 'BASc_adv_BaseSpark'. */
/begin CHARACTERISTIC BASc_adv_BaseSpark "Override value" VALUE 0x81980 RL_BASC_ADV_BASESPARK 80.000000 CU_BASC_ADV_BASESPARK -40.000000 40.000000 BYTE_ORDER MSB_FIRST /end CHARACTERISTIC
/begin RECORD_LAYOUT RL_BASC_ADV_BASESPARK FNC_VALUES 1 FLOAT32_IEEE COLUMN_DIR DIRECT /end RECORD_LAYOUT
/begin COMPU_METHOD CU_BASC_ADV_BASESPARK "Conversion method for BASc_adv_BaseSpark" RAT_FUNC "%10.1" "adv" COEFFS 0.000000 1.000000 0.000000 0.000000 0.000000 1.000000 /end COMPU_METHOD
/* Scalar calibration for DDE 'BASc_cnt_KnockEventCalThrsh'. */
/begin CHARACTERISTIC BASc_cnt_KnockEventCalThrsh "Calibratable number of times for Eng  knocked above which different fuel type is used" VALUE 0x814f8 RL_BASC_CNT_KNOCKEVENTCALTHRSH 1000.000000 CU_BASC_CNT_KNOCKEVENTCALTHRSH 0.000000 1000.000000 BYTE_ORDER MSB_FIRST /end CHARACTERISTIC
/begin RECORD_LAYOUT RL_BASC_CNT_KNOCKEVENTCALTHRSH FNC_VALUES 1 UWORD COLUMN_DIR DIRECT /end RECORD_LAYOUT
/begin COMPU_METHOD CU_BASC_CNT_KNOCKEVENTCALTHRSH "Conversion method for BASc_cnt_KnockEventCalThrsh" RAT_FUNC "%10.0" "cnt" COEFFS 0.000000 1.000000 0.000000 0.000000 0.000000 1.000000 /end COMPU_METHOD
/* Scalar calibration for DDE 'BASc_o_BaseSpark'. */
/begin CHARACTERISTIC BASc_o_BaseSpark "Override flag" VALUE 0x8197c RL_BASC_O_BASESPARK 1.000000 CU_BASC_O_BASESPARK 0.000000 1.000000 BYTE_ORDER MSB_FIRST /end CHARACTERISTIC
/begin RECORD_LAYOUT RL_BASC_O_BASESPARK FNC_VALUES 1 UBYTE COLUMN_DIR DIRECT /end RECORD_LAYOUT
/begin COMPU_METHOD CU_BASC_O_BASESPARK "Conversion method for BASc_o_BaseSpark" RAT_FUNC "%10.0" "o" COEFFS 0.000000 1.000000 0.000000 0.000000 0.000000 1.000000 /end COMPU_METHOD
/* Map (2d) calibration for DDE 'BASm_NU_CrankingSpark_z'. */
/begin CHARACTERISTIC BASm_NU_CrankingSpark_z "Cranking Advance Angle z-axis" MAP 0x80484 RL_BASM_NU_CRANKINGSPARK_Z 80.000000 CU_BASM_NU_CRANKINGSPARK_Z -40.000000 40.000000
 /begin AXIS_DESCR COM_AXIS NO_INPUT_QUANTITY CU_BASM_NU_CRANKINGSPARK_X 6 0.000000 10000.000000 AXIS_PTS_REF APD_BASM_NU_CRANKINGSPARK_X /end AXIS_DESCR
 /begin AXIS_DESCR COM_AXIS NO_INPUT_QUANTITY CU_BASM_NU_CRANKINGSPARK_Y 6 -40.000000 140.000000 AXIS_PTS_REF APD_BASM_NU_CRANKINGSPARK_Y /end AXIS_DESCR
 BYTE_ORDER MSB_FIRST /end CHARACTERISTIC
/begin RECORD_LAYOUT RL_BASM_NU_CRANKINGSPARK_Z FNC_VALUES 1 FLOAT32_IEEE COLUMN_DIR DIRECT /end RECORD_LAYOUT
/begin COMPU_METHOD CU_BASM_NU_CRANKINGSPARK_Z "Conversion method for BASm_NU_CrankingSpark_z" RAT_FUNC "%10.1" "adv" COEFFS 0.000000 1.000000 0.000000 0.000000 0.000000 1.000000 /end COMPU_METHOD
/begin AXIS_PTS APD_BASM_NU_CRANKINGSPARK_X "Cranking Advance Angle Engine Speed axis" 0x80454 NO_INPUT_QUANTITY RL_BASM_NU_CRANKINGSPARK_X 10000.000000 CU_BASM_NU_CRANKINGSPARK_X 6 0.0 10000.0 BYTE_ORDER MSB_FIRST /end AXIS_PTS
/begin RECORD_LAYOUT RL_BASM_NU_CRANKINGSPARK_X AXIS_PTS_X 1 FLOAT32_IEEE INDEX_INCR DIRECT /end RECORD_LAYOUT
/begin COMPU_METHOD CU_BASM_NU_CRANKINGSPARK_X "Conversion method for BASm_NU_CrankingSpark_x" RAT_FUNC "%10.0" "RPM" COEFFS 0.000000 1.000000 0.000000 0.000000 0.000000 1.000000 /end COMPU_METHOD
/begin AXIS_PTS APD_BASM_NU_CRANKINGSPARK_Y "Cranking Advance Angle ECT axis" 0x8046c NO_INPUT_QUANTITY RL_BASM_NU_CRANKINGSPARK_Y 180.000000 CU_BASM_NU_CRANKINGSPARK_Y 6 -40.0 140.0 BYTE_ORDER MSB_FIRST /end AXIS_PTS
/begin RECORD_LAYOUT RL_BASM_NU_CRANKINGSPARK_Y AXIS_PTS_X 1 FLOAT32_IEEE INDEX_INCR DIRECT /end RECORD_LAYOUT
/begin COMPU_METHOD CU_BASM_NU_CRANKINGSPARK_Y "Conversion method for BASm_NU_CrankingSpark_y" RAT_FUNC "%10.0" "C" COEFFS 0.000000 1.000000 0.000000 0.000000 0.000000 1.000000 /end COMPU_METHOD
/* Map (2d) calibration for DDE 'BASm_NU_MBT_SparkLowGradeFuel_z'. */
/begin CHARACTERISTIC BASm_NU_MBT_SparkLowGradeFuel_z "Ignition Advance Angle based on Fuel Type 2 (Low Grade Fuel) z-axis" MAP 0x810f8 RL_BASM_NU_MBT_SPARKLOWGRADEFU2 2000.000000 CU_BASM_NU_MBT_SPARKLOWGRADEFU2 -1000.000000 1000.000000
 /begin AXIS_DESCR COM_AXIS NO_INPUT_QUANTITY CU_BASM_NU_MBT_SPARKLOWGRADEFU0 16 0.000000 10000.000000 AXIS_PTS_REF APD_BASM_NU_MBT_SPARKLOWGRADEF0 /end AXIS_DESCR
 /begin AXIS_DESCR COM_AXIS NO_INPUT_QUANTITY CU_BASM_NU_MBT_SPARKLOWGRADEFU1 16 0.000000 3.000000 AXIS_PTS_REF APD_BASM_NU_MBT_SPARKLOWGRADEF1 /end AXIS_DESCR
 BYTE_ORDER MSB_FIRST /end CHARACTERISTIC
/begin RECORD_LAYOUT RL_BASM_NU_MBT_SPARKLOWGRADEFU2 FNC_VALUES 1 FLOAT32_IEEE COLUMN_DIR DIRECT /end RECORD_LAYOUT
/begin COMPU_METHOD CU_BASM_NU_MBT_SPARKLOWGRADEFU2 "Conversion method for BASm_NU_MBT_SparkLowGradeFuel_z" RAT_FUNC "%10.1" "adv" COEFFS 0.000000 1.000000 0.000000 0.000000 0.000000 1.000000 /end COMPU_METHOD
/begin AXIS_PTS APD_BASM_NU_MBT_SPARKLOWGRADEF0 "Ignition Advance Angle based on Fuel Type 2 (Low Grade Fuel) Eng Speed x-axis" 0x81078 NO_INPUT_QUANTITY RL_BASM_NU_MBT_SPARKLOWGRADEFU0 10000.000000 CU_BASM_NU_MBT_SPARKLOWGRADEFU0 16 0.0 10000.0 BYTE_ORDER MSB_FIRST /end AXIS_PTS
/begin RECORD_LAYOUT RL_BASM_NU_MBT_SPARKLOWGRADEFU0 AXIS_PTS_X 1 FLOAT32_IEEE INDEX_INCR DIRECT /end RECORD_LAYOUT
/begin COMPU_METHOD CU_BASM_NU_MBT_SPARKLOWGRADEFU0 "Conversion method for BASm_NU_MBT_SparkLowGradeFuel_x" RAT_FUNC "%10.0" "RPM" COEFFS 0.000000 1.000000 0.000000 0.000000 0.000000 1.000000 /end COMPU_METHOD
/begin AXIS_PTS APD_BASM_NU_MBT_SPARKLOWGRADEF1 "Ignition Advance Angle based on Fuel Type 2 (Low Grade Fuel) Eng Load y-axis" 0x810b8 NO_INPUT_QUANTITY RL_BASM_NU_MBT_SPARKLOWGRADEFU1 3.000000 CU_BASM_NU_MBT_SPARKLOWGRADEFU1 16 0.0 3.0 BYTE_ORDER MSB_FIRST /end AXIS_PTS
/begin RECORD_LAYOUT RL_BASM_NU_MBT_SPARKLOWGRADEFU1 AXIS_PTS_X 1 FLOAT32_IEEE INDEX_INCR DIRECT /end RECORD_LAYOUT
/begin COMPU_METHOD CU_BASM_NU_MBT_SPARKLOWGRADEFU1 "Conversion method for BASm_NU_MBT_SparkLowGradeFuel_y" RAT_FUNC "%10.2" "pct" COEFFS 0.000000 1.000000 0.000000 0.000000 0.000000 1.000000 /end COMPU_METHOD
/* Map (2d) calibration for DDE 'BASm_NU_MBT_Spark_z'. */
/begin CHARACTERISTIC BASm_NU_MBT_Spark_z "(adv) Base spark table z-axis output" MAP 0x8157c RL_BASM_NU_MBT_SPARK_Z 2000.000000 CU_BASM_NU_MBT_SPARK_Z -1000.000000 1000.000000
 /begin AXIS_DESCR COM_AXIS NO_INPUT_QUANTITY CU_BASM_NU_MBT_SPARK_X 16 0.000000 10000.000000 AXIS_PTS_REF APD_BASM_NU_MBT_SPARK_X /end AXIS_DESCR
 /begin AXIS_DESCR COM_AXIS NO_INPUT_QUANTITY CU_BASM_NU_MBT_SPARK_Y 16 0.000000 3.000000 AXIS_PTS_REF APD_BASM_NU_MBT_SPARK_Y /end AXIS_DESCR
 BYTE_ORDER MSB_FIRST /end CHARACTERISTIC
/begin RECORD_LAYOUT RL_BASM_NU_MBT_SPARK_Z FNC_VALUES 1 FLOAT32_IEEE COLUMN_DIR DIRECT /end RECORD_LAYOUT
/begin COMPU_METHOD CU_BASM_NU_MBT_SPARK_Z "Conversion method for BASm_NU_MBT_Spark_z" RAT_FUNC "%10.1" "adv" COEFFS 0.000000 1.000000 0.000000 0.000000 0.000000 1.000000 /end COMPU_METHOD
/begin AXIS_PTS APD_BASM_NU_MBT_SPARK_X "(RPM) Base spark table x-axis lookup" 0x814fc NO_INPUT_QUANTITY RL_BASM_NU_MBT_SPARK_X 10000.000000 CU_BASM_NU_MBT_SPARK_X 16 0.0 10000.0 BYTE_ORDER MSB_FIRST /end AXIS_PTS
/begin RECORD_LAYOUT RL_BASM_NU_MBT_SPARK_X AXIS_PTS_X 1 FLOAT32_IEEE INDEX_INCR DIRECT /end RECORD_LAYOUT
/begin COMPU_METHOD CU_BASM_NU_MBT_SPARK_X "Conversion method for BASm_NU_MBT_Spark_x" RAT_FUNC "%10.0" "RPM" COEFFS 0.000000 1.000000 0.000000 0.000000 0.000000 1.000000 /end COMPU_METHOD
/begin AXIS_PTS APD_BASM_NU_MBT_SPARK_Y "(pct load) Base spark table x-axis lookup" 0x8153c NO_INPUT_QUANTITY RL_BASM_NU_MBT_SPARK_Y 3.000000 CU_BASM_NU_MBT_SPARK_Y 16 0.0 3.0 BYTE_ORDER MSB_FIRST /end AXIS_PTS
/begin RECORD_LAYOUT RL_BASM_NU_MBT_SPARK_Y AXIS_PTS_X 1 FLOAT32_IEEE INDEX_INCR DIRECT /end RECORD_LAYOUT
/begin COMPU_METHOD CU_BASM_NU_MBT_SPARK_Y "Conversion method for BASm_NU_MBT_Spark_y" RAT_FUNC "%10.2" "pct" COEFFS 0.000000 1.000000 0.000000 0.000000 0.000000 1.000000 /end COMPU_METHOD
/* Scalar calibration for DDE 'CALc_V_UoffsetDfltValue'. */
/begin CHARACTERISTIC CALc_V_UoffsetDfltValue "Uoffset NVM default value" VALUE 0x91d20 RL_CALC_V_UOFFSETDFLTVALUE 5.000000 CU_CALC_V_UOFFSETDFLTVALUE 0.000000 5.000000 BYTE_ORDER MSB_FIRST /end CHARACTERISTIC
/begin RECORD_LAYOUT RL_CALC_V_UOFFSETDFLTVALUE FNC_VALUES 1 FLOAT32_IEEE COLUMN_DIR DIRECT /end RECORD_LAYOUT
/begin COMPU_METHOD CU_CALC_V_UOFFSETDFLTVALUE "Conversion method for CALc_V_UoffsetDfltValue" RAT_FUNC "%10.2" "V" COEFFS 0.000000 1.000000 0.000000 0.000000 0.000000 1.000000 /end COMPU_METHOD
/* Scalar calibration for DDE 'CALc_b_EnblCalibrationMode_A'. */
/begin CHARACTERISTIC CALc_b_EnblCalibrationMode_A "Boolean to enable calibration mode" VALUE 0x8d511 RL_CALC_B_ENBLCALIBRATIONMODE_A 1.000000 CU_CALC_B_ENBLCALIBRATIONMODE_A 0.000000 1.000000 BYTE_ORDER MSB_FIRST /end CHARACTERISTIC
/begin RECORD_LAYOUT RL_CALC_B_ENBLCALIBRATIONMODE_A FNC_VALUES 1 UBYTE COLUMN_DIR DIRECT /end RECORD_LAYOUT
/begin COMPU_METHOD CU_CALC_B_ENBLCALIBRATIONMODE_A "Conversion method for CALc_b_EnblCalibrationMode_A" RAT_FUNC "%10.0" "b" COEFFS 0.000000 1.000000 0.000000 0.000000 0.000000 1.000000 /end COMPU_METHOD
/* Scalar calibration for DDE 'CALc_b_EnblCalibrationMode_B'. */
/begin CHARACTERISTIC CALc_b_EnblCalibrationMode_B "Boolean to enable calibration mode" VALUE 0x8d510 RL_CALC_B_ENBLCALIBRATIONMODE_B 1.000000 CU_CALC_B_ENBLCALIBRATIONMODE_B 0.000000 1.000000 BYTE_ORDER MSB_FIRST /end CHARACTERISTIC
/begin RECORD_LAYOUT RL_CALC_B_ENBLCALIBRATIONMODE_B FNC_VALUES 1 UBYTE COLUMN_DIR DIRECT /end RECORD_LAYOUT
/begin COMPU_METHOD CU_CALC_B_ENBLCALIBRATIONMODE_B "Conversion method for CALc_b_EnblCalibrationMode_B" RAT_FUNC "%10.0" "b" COEFFS 0.000000 1.000000 0.000000 0.000000 0.000000 1.000000 /end COMPU_METHOD
/* Scalar calibration for DDE 'CALc_b_ResetUoffset_A'. */
/begin CHARACTERISTIC CALc_b_ResetUoffset_A "Boolean to reset Uoffset NVM value" VALUE 0x8d50f RL_CALC_B_RESETUOFFSET_A 1.000000 CU_CALC_B_RESETUOFFSET_A 0.000000 1.000000 BYTE_ORDER MSB_FIRST /end CHARACTERISTIC
/begin RECORD_LAYOUT RL_CALC_B_RESETUOFFSET_A FNC_VALUES 1 UBYTE COLUMN_DIR DIRECT /end RECORD_LAYOUT
/begin COMPU_METHOD CU_CALC_B_RESETUOFFSET_A "Conversion method for CALc_b_ResetUoffset_A" RAT_FUNC "%10.0" "b" COEFFS 0.000000 1.000000 0.000000 0.000000 0.000000 1.000000 /end COMPU_METHOD
/* Scalar calibration for DDE 'CALc_b_ResetUoffset_B'. */
/begin CHARACTERISTIC CALc_b_ResetUoffset_B "Boolean to reset Uoffset NVM value" VALUE 0x8d50e RL_CALC_B_RESETUOFFSET_B 1.000000 CU_CALC_B_RESETUOFFSET_B 0.000000 1.000000 BYTE_ORDER MSB_FIRST /end CHARACTERISTIC
/begin RECORD_LAYOUT RL_CALC_B_RESETUOFFSET_B FNC_VALUES 1 UBYTE COLUMN_DIR DIRECT /end RECORD_LAYOUT
/begin COMPU_METHOD CU_CALC_B_RESETUOFFSET_B "Conversion method for CALc_b_ResetUoffset_B" RAT_FUNC "%10.0" "b" COEFFS 0.000000 1.000000 0.000000 0.000000 0.000000 1.000000 /end COMPU_METHOD
/* Scalar calibration for DDE 'CALca_V_UoffsetDfltValue'. */
/begin CHARACTERISTIC CALca_V_UoffsetDfltValue "Uoffset NVM default value" VALUE 0x4000f8ac RL_CALCA_V_UOFFSETDFLTVALUE 5.000000 CU_CALCA_V_UOFFSETDFLTVALUE 0.000000 5.000000 BYTE_ORDER MSB_FIRST /end CHARACTERISTIC
/begin RECORD_LAYOUT RL_CALCA_V_UOFFSETDFLTVALUE FNC_VALUES 1 FLOAT32_IEEE COLUMN_DIR DIRECT /end RECORD_LAYOUT
/begin COMPU_METHOD CU_CALCA_V_UOFFSETDFLTVALUE "Conversion method for CALca_V_UoffsetDfltValue" RAT_FUNC "%10.2" "V" COEFFS 0.000000 1.000000 0.000000 0.000000 0.000000 1.000000 /end COMPU_METHOD
/* Scalar calibration for DDE 'CINc_NU_EngOvrCtrMd_ESP'. */
/begin CHARACTERISTIC CINc_NU_EngOvrCtrMd_ESP "Override value" VALUE 0x8c48c RL_CINC_NU_ENGOVRCTRMD_ESP 1000.000000 CU_CINC_NU_ENGOVRCTRMD_ESP 0.000000 1000.000000 BYTE_ORDER MSB_FIRST /end CHARACTERISTIC
/begin RECORD_LAYOUT RL_CINC_NU_ENGOVRCTRMD_ESP FNC_VALUES 1 FLOAT32_IEEE COLUMN_DIR DIRECT /end RECORD_LAYOUT
/begin COMPU_METHOD CU_CINC_NU_ENGOVRCTRMD_ESP "Conversion method for CINc_NU_EngOvrCtrMd_ESP" RAT_FUNC "%10.0" "NU" COEFFS 0.000000 1.000000 0.000000 0.000000 0.000000 1.000000 /end COMPU_METHOD
/* Scalar calibration for DDE 'CINc_NU_EngOvrCtrMd_TCM'. */
/begin CHARACTERISTIC CINc_NU_EngOvrCtrMd_TCM "Override value" VALUE 0x8c4a4 RL_CINC_NU_ENGOVRCTRMD_TCM 1000.000000 CU_CINC_NU_ENGOVRCTRMD_TCM 0.000000 1000.000000 BYTE_ORDER MSB_FIRST /end CHARACTERISTIC
/begin RECORD_LAYOUT RL_CINC_NU_ENGOVRCTRMD_TCM FNC_VALUES 1 FLOAT32_IEEE COLUMN_DIR DIRECT /end RECORD_LAYOUT
/begin COMPU_METHOD CU_CINC_NU_ENGOVRCTRMD_TCM "Conversion method for CINc_NU_EngOvrCtrMd_TCM" RAT_FUNC "%10.0" "NU" COEFFS 0.000000 1.000000 0.000000 0.000000 0.000000 1.000000 /end COMPU_METHOD
/* Scalar calibration for DDE 'CINc_NU_OvrCtrMd_ESP'. */
/begin CHARACTERISTIC CINc_NU_OvrCtrMd_ESP "Override value" VALUE 0x8c47c RL_CINC_NU_OVRCTRMD_ESP 1000.000000 CU_CINC_NU_OVRCTRMD_ESP 0.000000 1000.000000 BYTE_ORDER MSB_FIRST /end CHARACTERISTIC
/begin RECORD_LAYOUT RL_CINC_NU_OVRCTRMD_ESP FNC_VALUES 1 FLOAT32_IEEE COLUMN_DIR DIRECT /end RECORD_LAYOUT
/begin COMPU_METHOD CU_CINC_NU_OVRCTRMD_ESP "Conversion method for CINc_NU_OvrCtrMd_ESP" RAT_FUNC "%10.0" "NU" COEFFS 0.000000 1.000000 0.000000 0.000000 0.000000 1.000000 /end COMPU_METHOD
/* Scalar calibration for DDE 'CINc_NU_OvrCtrMd_TCM'. */
/begin CHARACTERISTIC CINc_NU_OvrCtrMd_TCM "Override value" VALUE 0x8c494 RL_CINC_NU_OVRCTRMD_TCM 1000.000000 CU_CINC_NU_OVRCTRMD_TCM 0.000000 1000.000000 BYTE_ORDER MSB_FIRST /end CHARACTERISTIC
/begin RECORD_LAYOUT RL_CINC_NU_OVRCTRMD_TCM FNC_VALUES 1 FLOAT32_IEEE COLUMN_DIR DIRECT /end RECORD_LAYOUT
/begin COMPU_METHOD CU_CINC_NU_OVRCTRMD_TCM "Conversion method for CINc_NU_OvrCtrMd_TCM" RAT_FUNC "%10.0" "NU" COEFFS 0.000000 1.000000 0.000000 0.000000 0.000000 1.000000 /end COMPU_METHOD
/* Scalar calibration for DDE 'CINc_o_EngOvrCtrMd_ESP'. */
/begin CHARACTERISTIC CINc_o_EngOvrCtrMd_ESP "Override flag" VALUE 0x8c488 RL_CINC_O_ENGOVRCTRMD_ESP 1.000000 CU_CINC_O_ENGOVRCTRMD_ESP 0.000000 1.000000 BYTE_ORDER MSB_FIRST /end CHARACTERISTIC
/begin RECORD_LAYOUT RL_CINC_O_ENGOVRCTRMD_ESP FNC_VALUES 1 UBYTE COLUMN_DIR DIRECT /end RECORD_LAYOUT
/begin COMPU_METHOD CU_CINC_O_ENGOVRCTRMD_ESP "Conversion method for CINc_o_EngOvrCtrMd_ESP" RAT_FUNC "%10.0" "o" COEFFS 0.000000 1.000000 0.000000 0.000000 0.000000 1.000000 /end COMPU_METHOD
/* Scalar calibration for DDE 'CINc_o_EngOvrCtrMd_TCM'. */
/begin CHARACTERISTIC CINc_o_EngOvrCtrMd_TCM "Override flag" VALUE 0x8c4a0 RL_CINC_O_ENGOVRCTRMD_TCM 1.000000 CU_CINC_O_ENGOVRCTRMD_TCM 0.000000 1.000000 BYTE_ORDER MSB_FIRST /end CHARACTERISTIC
/begin RECORD_LAYOUT RL_CINC_O_ENGOVRCTRMD_TCM FNC_VALUES 1 UBYTE COLUMN_DIR DIRECT /end RECORD_LAYOUT
/begin COMPU_METHOD CU_CINC_O_ENGOVRCTRMD_TCM "Conversion method for CINc_o_EngOvrCtrMd_TCM" RAT_FUNC "%10.0" "o" COEFFS 0.000000 1.000000 0.000000 0.000000 0.000000 1.000000 /end COMPU_METHOD
/* Scalar calibration for DDE 'CINc_o_OvrCtrMd_ESP'. */
/begin CHARACTERISTIC CINc_o_OvrCtrMd_ESP "Override flag" VALUE 0x8c478 RL_CINC_O_OVRCTRMD_ESP 1.000000 CU_CINC_O_OVRCTRMD_ESP 0.000000 1.000000 BYTE_ORDER MSB_FIRST /end CHARACTERISTIC
/begin RECORD_LAYOUT RL_CINC_O_OVRCTRMD_ESP FNC_VALUES 1 UBYTE COLUMN_DIR DIRECT /end RECORD_LAYOUT
/begin COMPU_METHOD CU_CINC_O_OVRCTRMD_ESP "Conversion method for CINc_o_OvrCtrMd_ESP" RAT_FUNC "%10.0" "o" COEFFS 0.000000 1.000000 0.000000 0.000000 0.000000 1.000000 /end COMPU_METHOD
/* Scalar calibration for DDE 'CINc_o_OvrCtrMd_TCM'. */
/begin CHARACTERISTIC CINc_o_OvrCtrMd_TCM "Override flag" VALUE 0x8c490 RL_CINC_O_OVRCTRMD_TCM 1.000000 CU_CINC_O_OVRCTRMD_TCM 0.000000 1.000000 BYTE_ORDER MSB_FIRST /end CHARACTERISTIC
/begin RECORD_LAYOUT RL_CINC_O_OVRCTRMD_TCM FNC_VALUES 1 UBYTE COLUMN_DIR DIRECT /end RECORD_LAYOUT
/begin COMPU_METHOD CU_CINC_O_OVRCTRMD_TCM "Conversion method for CINc_o_OvrCtrMd_TCM" RAT_FUNC "%10.0" "o" COEFFS 0.000000 1.000000 0.000000 0.000000 0.000000 1.000000 /end COMPU_METHOD
/* Scalar calibration for DDE 'CINc_o_TqCtrRq_ESP'. */
/begin CHARACTERISTIC CINc_o_TqCtrRq_ESP "Override flag" VALUE 0x8c480 RL_CINC_O_TQCTRRQ_ESP 1.000000 CU_CINC_O_TQCTRRQ_ESP 0.000000 1.000000 BYTE_ORDER MSB_FIRST /end CHARACTERISTIC
/begin RECORD_LAYOUT RL_CINC_O_TQCTRRQ_ESP FNC_VALUES 1 UBYTE COLUMN_DIR DIRECT /end RECORD_LAYOUT
/begin COMPU_METHOD CU_CINC_O_TQCTRRQ_ESP "Conversion method for CINc_o_TqCtrRq_ESP" RAT_FUNC "%10.0" "o" COEFFS 0.000000 1.000000 0.000000 0.000000 0.000000 1.000000 /end COMPU_METHOD
/* Scalar calibration for DDE 'CINc_o_TqCtrRq_TCM'. */
/begin CHARACTERISTIC CINc_o_TqCtrRq_TCM "Override flag" VALUE 0x8c498 RL_CINC_O_TQCTRRQ_TCM 1.000000 CU_CINC_O_TQCTRRQ_TCM 0.000000 1.000000 BYTE_ORDER MSB_FIRST /end CHARACTERISTIC
/begin RECORD_LAYOUT RL_CINC_O_TQCTRRQ_TCM FNC_VALUES 1 UBYTE COLUMN_DIR DIRECT /end RECORD_LAYOUT
/begin COMPU_METHOD CU_CINC_O_TQCTRRQ_TCM "Conversion method for CINc_o_TqCtrRq_TCM" RAT_FUNC "%10.0" "o" COEFFS 0.000000 1.000000 0.000000 0.000000 0.000000 1.000000 /end COMPU_METHOD
/* Scalar calibration for DDE 'CINc_pct_TqCtrRq_ESP'. */
/begin CHARACTERISTIC CINc_pct_TqCtrRq_ESP "Override value" VALUE 0x8c484 RL_CINC_PCT_TQCTRRQ_ESP 1000.000000 CU_CINC_PCT_TQCTRRQ_ESP 0.000000 1000.000000 BYTE_ORDER MSB_FIRST /end CHARACTERISTIC
/begin RECORD_LAYOUT RL_CINC_PCT_TQCTRRQ_ESP FNC_VALUES 1 FLOAT32_IEEE COLUMN_DIR DIRECT /end RECORD_LAYOUT
/begin COMPU_METHOD CU_CINC_PCT_TQCTRRQ_ESP "Conversion method for CINc_pct_TqCtrRq_ESP" RAT_FUNC "%10.0" "pct" COEFFS 0.000000 1.000000 0.000000 0.000000 0.000000 1.000000 /end COMPU_METHOD
/* Scalar calibration for DDE 'CINc_pct_TqCtrRq_TCM'. */
/begin CHARACTERISTIC CINc_pct_TqCtrRq_TCM "Override value" VALUE 0x8c49c RL_CINC_PCT_TQCTRRQ_TCM 1000.000000 CU_CINC_PCT_TQCTRRQ_TCM 0.000000 1000.000000 BYTE_ORDER MSB_FIRST /end CHARACTERISTIC
/begin RECORD_LAYOUT RL_CINC_PCT_TQCTRRQ_TCM FNC_VALUES 1 FLOAT32_IEEE COLUMN_DIR DIRECT /end RECORD_LAYOUT
/begin COMPU_METHOD CU_CINC_PCT_TQCTRRQ_TCM "Conversion method for CINc_pct_TqCtrRq_TCM" RAT_FUNC "%10.0" "pct" COEFFS 0.000000 1.000000 0.000000 0.000000 0.000000 1.000000 /end COMPU_METHOD
/* Scalar calibration for DDE 'CLFc_C_LTFT_EngineTempMax'. */
/begin CHARACTERISTIC CLFc_C_LTFT_EngineTempMax "EngineTemp must be within this range for LTFT to update" VALUE 0x83600 RL_CLFC_C_LTFT_ENGINETEMPMAX 70.000000 CU_CLFC_C_LTFT_ENGINETEMPMAX 80.000000 150.000000 BYTE_ORDER MSB_FIRST /end CHARACTERISTIC
/begin RECORD_LAYOUT RL_CLFC_C_LTFT_ENGINETEMPMAX FNC_VALUES 1 FLOAT32_IEEE COLUMN_DIR DIRECT /end RECORD_LAYOUT
/begin COMPU_METHOD CU_CLFC_C_LTFT_ENGINETEMPMAX "Conversion method for CLFc_C_LTFT_EngineTempMax" RAT_FUNC "%10.0" "C" COEFFS 0.000000 1.000000 0.000000 0.000000 0.000000 1.000000 /end COMPU_METHOD
/* Scalar calibration for DDE 'CLFc_C_LTFT_EngineTempMin'. */
/begin CHARACTERISTIC CLFc_C_LTFT_EngineTempMin "EngineTemp must be within this range for LTFT to update" VALUE 0x835fc RL_CLFC_C_LTFT_ENGINETEMPMIN 80.000000 CU_CLFC_C_LTFT_ENGINETEMPMIN 20.000000 100.000000 BYTE_ORDER MSB_FIRST /end CHARACTERISTIC
/begin RECORD_LAYOUT RL_CLFC_C_LTFT_ENGINETEMPMIN FNC_VALUES 1 FLOAT32_IEEE COLUMN_DIR DIRECT /end RECORD_LAYOUT
/begin COMPU_METHOD CU_CLFC_C_LTFT_ENGINETEMPMIN "Conversion method for CLFc_C_LTFT_EngineTempMin" RAT_FUNC "%10.0" "C" COEFFS 0.000000 1.000000 0.000000 0.000000 0.000000 1.000000 /end COMPU_METHOD
/* Scalar calibration for DDE 'CLFc_Hz_DTermLPF'. */
/begin CHARACTERISTIC CLFc_Hz_DTermLPF "Filter cutoff for D-term LPF" VALUE 0x83e28 RL_CLFC_HZ_DTERMLPF 49.990000 CU_CLFC_HZ_DTERMLPF 0.010000 50.000000 BYTE_ORDER MSB_FIRST /end CHARACTERISTIC
/begin RECORD_LAYOUT RL_CLFC_HZ_DTERMLPF FNC_VALUES 1 FLOAT32_IEEE COLUMN_DIR DIRECT /end RECORD_LAYOUT
/begin COMPU_METHOD CU_CLFC_HZ_DTERMLPF "Conversion method for CLFc_Hz_DTermLPF" RAT_FUNC "%10.2" "Hz" COEFFS 0.000000 1.000000 0.000000 0.000000 0.000000 1.000000 /end COMPU_METHOD
/* Scalar calibration for DDE 'CLFc_Hz_ErrorThrshLPF'. */
/begin CHARACTERISTIC CLFc_Hz_ErrorThrshLPF "Filter cutoff for stable-detection LPF" VALUE 0x835f0 RL_CLFC_HZ_ERRORTHRSHLPF 49.990000 CU_CLFC_HZ_ERRORTHRSHLPF 0.010000 50.000000 BYTE_ORDER MSB_FIRST /end CHARACTERISTIC
/begin RECORD_LAYOUT RL_CLFC_HZ_ERRORTHRSHLPF FNC_VALUES 1 FLOAT32_IEEE COLUMN_DIR DIRECT /end RECORD_LAYOUT
/begin COMPU_METHOD CU_CLFC_HZ_ERRORTHRSHLPF "Conversion method for CLFc_Hz_ErrorThrshLPF" RAT_FUNC "%10.2" "Hz" COEFFS 0.000000 1.000000 0.000000 0.000000 0.000000 1.000000 /end COMPU_METHOD
/* Scalar calibration for DDE 'CLFc_NU_EngSpdHPF_TC'. */
/begin CHARACTERISTIC CLFc_NU_EngSpdHPF_TC "HPF time-constant" VALUE 0x835dc RL_CLFC_NU_ENGSPDHPF_TC 1.990000 CU_CLFC_NU_ENGSPDHPF_TC 0.010000 2.000000 BYTE_ORDER MSB_FIRST /end CHARACTERISTIC
/begin RECORD_LAYOUT RL_CLFC_NU_ENGSPDHPF_TC FNC_VALUES 1 FLOAT32_IEEE COLUMN_DIR DIRECT /end RECORD_LAYOUT
/begin COMPU_METHOD CU_CLFC_NU_ENGSPDHPF_TC "Conversion method for CLFc_NU_EngSpdHPF_TC" RAT_FUNC "%10.2" "NU" COEFFS 0.000000 1.000000 0.000000 0.000000 0.000000 1.000000 /end COMPU_METHOD
/* Scalar calibration for DDE 'CLFc_NU_LoadHPF_TC'. */
/begin CHARACTERISTIC CLFc_NU_LoadHPF_TC "HPF time-constant" VALUE 0x835e4 RL_CLFC_NU_LOADHPF_TC 1.990000 CU_CLFC_NU_LOADHPF_TC 0.010000 2.000000 BYTE_ORDER MSB_FIRST /end CHARACTERISTIC
/begin RECORD_LAYOUT RL_CLFC_NU_LOADHPF_TC FNC_VALUES 1 FLOAT32_IEEE COLUMN_DIR DIRECT /end RECORD_LAYOUT
/begin COMPU_METHOD CU_CLFC_NU_LOADHPF_TC "Conversion method for CLFc_NU_LoadHPF_TC" RAT_FUNC "%10.2" "NU" COEFFS 0.000000 1.000000 0.000000 0.000000 0.000000 1.000000 /end COMPU_METHOD
/* Scalar calibration for DDE 'CLFc_NU_PID_GainScale'. */
/begin CHARACTERISTIC CLFc_NU_PID_GainScale "PID gain multiplier for display precision convenience" VALUE 0x83e24 RL_CLFC_NU_PID_GAINSCALE 9999.999900 CU_CLFC_NU_PID_GAINSCALE 0.000100 10000.000000 BYTE_ORDER MSB_FIRST /end CHARACTERISTIC
/begin RECORD_LAYOUT RL_CLFC_NU_PID_GAINSCALE FNC_VALUES 1 FLOAT32_IEEE COLUMN_DIR DIRECT /end RECORD_LAYOUT
/begin COMPU_METHOD CU_CLFC_NU_PID_GAINSCALE "Conversion method for CLFc_NU_PID_GainScale" RAT_FUNC "%10.4" "NU" COEFFS 0.000000 1.000000 0.000000 0.000000 0.000000 1.000000 /end COMPU_METHOD
/* Scalar calibration for DDE 'CLFc_RPM_EngSpdHPF_Thrsh'. */
/begin CHARACTERISTIC CLFc_RPM_EngSpdHPF_Thrsh "HPF steady-state threshold" VALUE 0x835e0 RL_CLFC_RPM_ENGSPDHPF_THRSH 500.000000 CU_CLFC_RPM_ENGSPDHPF_THRSH 0.000000 500.000000 BYTE_ORDER MSB_FIRST /end CHARACTERISTIC
/begin RECORD_LAYOUT RL_CLFC_RPM_ENGSPDHPF_THRSH FNC_VALUES 1 FLOAT32_IEEE COLUMN_DIR DIRECT /end RECORD_LAYOUT
/begin COMPU_METHOD CU_CLFC_RPM_ENGSPDHPF_THRSH "Conversion method for CLFc_RPM_EngSpdHPF_Thrsh" RAT_FUNC "%10.0" "RPM" COEFFS 0.000000 1.000000 0.000000 0.000000 0.000000 1.000000 /end COMPU_METHOD
/* Scalar calibration for DDE 'CLFc_b_AllowITermReset'. */
/begin CHARACTERISTIC CLFc_b_AllowITermReset "Anti-windup logic enable" VALUE 0x8369c RL_CLFC_B_ALLOWITERMRESET 1.000000 CU_CLFC_B_ALLOWITERMRESET 0.000000 1.000000 BYTE_ORDER MSB_FIRST /end CHARACTERISTIC
/begin RECORD_LAYOUT RL_CLFC_B_ALLOWITERMRESET FNC_VALUES 1 UBYTE COLUMN_DIR DIRECT /end RECORD_LAYOUT
/begin COMPU_METHOD CU_CLFC_B_ALLOWITERMRESET "Conversion method for CLFc_b_AllowITermReset" RAT_FUNC "%10.0" "b" COEFFS 0.000000 1.000000 0.000000 0.000000 0.000000 1.000000 /end COMPU_METHOD
/* Scalar calibration for DDE 'CLFc_b_DitherLamErrorActv'. */
/begin CHARACTERISTIC CLFc_b_DitherLamErrorActv "Override flag" VALUE 0x835cd RL_CLFC_B_DITHERLAMERRORACTV 1.000000 CU_CLFC_B_DITHERLAMERRORACTV 0.000000 1.000000 BYTE_ORDER MSB_FIRST /end CHARACTERISTIC
/begin RECORD_LAYOUT RL_CLFC_B_DITHERLAMERRORACTV FNC_VALUES 1 UBYTE COLUMN_DIR DIRECT /end RECORD_LAYOUT
/begin COMPU_METHOD CU_CLFC_B_DITHERLAMERRORACTV "Conversion method for CLFc_b_DitherLamErrorActv" RAT_FUNC "%10.0" "o" COEFFS 0.000000 1.000000 0.000000 0.000000 0.000000 1.000000 /end COMPU_METHOD
/* Scalar calibration for DDE 'CLFc_b_EnblDither'. */
/begin CHARACTERISTIC CLFc_b_EnblDither "Enable lambda-1 dither pattern for CAT O2 management" VALUE 0x878cc RL_CLFC_B_ENBLDITHER 1.000000 CU_CLFC_B_ENBLDITHER 0.000000 1.000000 BYTE_ORDER MSB_FIRST /end CHARACTERISTIC
/begin RECORD_LAYOUT RL_CLFC_B_ENBLDITHER FNC_VALUES 1 UBYTE COLUMN_DIR DIRECT /end RECORD_LAYOUT
/begin COMPU_METHOD CU_CLFC_B_ENBLDITHER "Conversion method for CLFc_b_EnblDither" RAT_FUNC "%10.0" "b" COEFFS 0.000000 1.000000 0.000000 0.000000 0.000000 1.000000 /end COMPU_METHOD
/* Scalar calibration for DDE 'CLFc_b_EnblFB1'. */
/begin CHARACTERISTIC CLFc_b_EnblFB1 "Enable cal" VALUE 0x835ec RL_CLFC_B_ENBLFB1 1.000000 CU_CLFC_B_ENBLFB1 0.000000 1.000000 BYTE_ORDER MSB_FIRST /end CHARACTERISTIC
/begin RECORD_LAYOUT RL_CLFC_B_ENBLFB1 FNC_VALUES 1 UBYTE COLUMN_DIR DIRECT /end RECORD_LAYOUT
/begin COMPU_METHOD CU_CLFC_B_ENBLFB1 "Conversion method for CLFc_b_EnblFB1" RAT_FUNC "%10.0" "b" COEFFS 0.000000 1.000000 0.000000 0.000000 0.000000 1.000000 /end COMPU_METHOD
/* Scalar calibration for DDE 'CLFc_b_EnblFB2'. */
/begin CHARACTERISTIC CLFc_b_EnblFB2 "Enable cal" VALUE 0x83e38 RL_CLFC_B_ENBLFB2 1.000000 CU_CLFC_B_ENBLFB2 0.000000 1.000000 BYTE_ORDER MSB_FIRST /end CHARACTERISTIC
/begin RECORD_LAYOUT RL_CLFC_B_ENBLFB2 FNC_VALUES 1 UBYTE COLUMN_DIR DIRECT /end RECORD_LAYOUT
/begin COMPU_METHOD CU_CLFC_B_ENBLFB2 "Conversion method for CLFc_b_EnblFB2" RAT_FUNC "%10.0" "b" COEFFS 0.000000 1.000000 0.000000 0.000000 0.000000 1.000000 /end COMPU_METHOD
/* Scalar calibration for DDE 'CLFc_b_EnblLTFT1'. */
/begin CHARACTERISTIC CLFc_b_EnblLTFT1 "Enable updates to long-term trim" VALUE 0x83608 RL_CLFC_B_ENBLLTFT1 1.000000 CU_CLFC_B_ENBLLTFT1 0.000000 1.000000 BYTE_ORDER MSB_FIRST /end CHARACTERISTIC
/begin RECORD_LAYOUT RL_CLFC_B_ENBLLTFT1 FNC_VALUES 1 UBYTE COLUMN_DIR DIRECT /end RECORD_LAYOUT
/begin COMPU_METHOD CU_CLFC_B_ENBLLTFT1 "Conversion method for CLFc_b_EnblLTFT1" RAT_FUNC "%10.0" "b" COEFFS 0.000000 1.000000 0.000000 0.000000 0.000000 1.000000 /end COMPU_METHOD
/* Scalar calibration for DDE 'CLFc_b_EnblLTFT2'. */
/begin CHARACTERISTIC CLFc_b_EnblLTFT2 "Enable updates to long-term trim" VALUE 0x83e39 RL_CLFC_B_ENBLLTFT2 1.000000 CU_CLFC_B_ENBLLTFT2 0.000000 1.000000 BYTE_ORDER MSB_FIRST /end CHARACTERISTIC
/begin RECORD_LAYOUT RL_CLFC_B_ENBLLTFT2 FNC_VALUES 1 UBYTE COLUMN_DIR DIRECT /end RECORD_LAYOUT
/begin COMPU_METHOD CU_CLFC_B_ENBLLTFT2 "Conversion method for CLFc_b_EnblLTFT2" RAT_FUNC "%10.0" "b" COEFFS 0.000000 1.000000 0.000000 0.000000 0.000000 1.000000 /end COMPU_METHOD
/* Scalar calibration for DDE 'CLFc_b_FB1_Active'. */
/begin CHARACTERISTIC CLFc_b_FB1_Active "Override value" VALUE 0x8be75 RL_CLFC_B_FB1_ACTIVE 1.000000 CU_CLFC_B_FB1_ACTIVE 0.000000 1.000000 BYTE_ORDER MSB_FIRST /end CHARACTERISTIC
/begin RECORD_LAYOUT RL_CLFC_B_FB1_ACTIVE FNC_VALUES 1 UBYTE COLUMN_DIR DIRECT /end RECORD_LAYOUT
/begin COMPU_METHOD CU_CLFC_B_FB1_ACTIVE "Conversion method for CLFc_b_FB1_Active" RAT_FUNC "%10.0" "b" COEFFS 0.000000 1.000000 0.000000 0.000000 0.000000 1.000000 /end COMPU_METHOD
/* Scalar calibration for DDE 'CLFc_b_FB2_Active'. */
/begin CHARACTERISTIC CLFc_b_FB2_Active "Override value" VALUE 0x8be77 RL_CLFC_B_FB2_ACTIVE 1.000000 CU_CLFC_B_FB2_ACTIVE 0.000000 1.000000 BYTE_ORDER MSB_FIRST /end CHARACTERISTIC
/begin RECORD_LAYOUT RL_CLFC_B_FB2_ACTIVE FNC_VALUES 1 UBYTE COLUMN_DIR DIRECT /end RECORD_LAYOUT
/begin COMPU_METHOD CU_CLFC_B_FB2_ACTIVE "Conversion method for CLFc_b_FB2_Active" RAT_FUNC "%10.0" "b" COEFFS 0.000000 1.000000 0.000000 0.000000 0.000000 1.000000 /end COMPU_METHOD
/* Scalar calibration for DDE 'CLFc_b_LTFT1_Reset'. */
/begin CHARACTERISTIC CLFc_b_LTFT1_Reset "Manual flag to reset NVM table" VALUE 0x83610 RL_CLFC_B_LTFT1_RESET 1.000000 CU_CLFC_B_LTFT1_RESET 0.000000 1.000000 BYTE_ORDER MSB_FIRST /end CHARACTERISTIC
/begin RECORD_LAYOUT RL_CLFC_B_LTFT1_RESET FNC_VALUES 1 UBYTE COLUMN_DIR DIRECT /end RECORD_LAYOUT
/begin COMPU_METHOD CU_CLFC_B_LTFT1_RESET "Conversion method for CLFc_b_LTFT1_Reset" RAT_FUNC "%10.0" "b" COEFFS 0.000000 1.000000 0.000000 0.000000 0.000000 1.000000 /end COMPU_METHOD
/* Scalar calibration for DDE 'CLFc_b_LTFT2_Reset'. */
/begin CHARACTERISTIC CLFc_b_LTFT2_Reset "Manual flag to reset NVM table" VALUE 0x83e3a RL_CLFC_B_LTFT2_RESET 1.000000 CU_CLFC_B_LTFT2_RESET 0.000000 1.000000 BYTE_ORDER MSB_FIRST /end CHARACTERISTIC
/begin RECORD_LAYOUT RL_CLFC_B_LTFT2_RESET FNC_VALUES 1 UBYTE COLUMN_DIR DIRECT /end RECORD_LAYOUT
/begin COMPU_METHOD CU_CLFC_B_LTFT2_RESET "Conversion method for CLFc_b_LTFT2_Reset" RAT_FUNC "%10.0" "b" COEFFS 0.000000 1.000000 0.000000 0.000000 0.000000 1.000000 /end COMPU_METHOD
/* Scalar calibration for DDE 'CLFc_lam_FB1_Ctrl'. */
/begin CHARACTERISTIC CLFc_lam_FB1_Ctrl "Override value" VALUE 0x83e3c RL_CLFC_LAM_FB1_CTRL 1.000000 CU_CLFC_LAM_FB1_CTRL -0.500000 0.500000 BYTE_ORDER MSB_FIRST /end CHARACTERISTIC
/begin RECORD_LAYOUT RL_CLFC_LAM_FB1_CTRL FNC_VALUES 1 FLOAT32_IEEE COLUMN_DIR DIRECT /end RECORD_LAYOUT
/begin COMPU_METHOD CU_CLFC_LAM_FB1_CTRL "Conversion method for CLFc_lam_FB1_Ctrl" RAT_FUNC "%10.3" "lam" COEFFS 0.000000 1.000000 0.000000 0.000000 0.000000 1.000000 /end COMPU_METHOD
/* Scalar calibration for DDE 'CLFc_lam_FB2_Ctrl'. */
/begin CHARACTERISTIC CLFc_lam_FB2_Ctrl "Override value" VALUE 0x86fa8 RL_CLFC_LAM_FB2_CTRL 1.000000 CU_CLFC_LAM_FB2_CTRL -0.500000 0.500000 BYTE_ORDER MSB_FIRST /end CHARACTERISTIC
/begin RECORD_LAYOUT RL_CLFC_LAM_FB2_CTRL FNC_VALUES 1 FLOAT32_IEEE COLUMN_DIR DIRECT /end RECORD_LAYOUT
/begin COMPU_METHOD CU_CLFC_LAM_FB2_CTRL "Conversion method for CLFc_lam_FB2_Ctrl" RAT_FUNC "%10.3" "lam" COEFFS 0.000000 1.000000 0.000000 0.000000 0.000000 1.000000 /end COMPU_METHOD
/* Scalar calibration for DDE 'CLFc_lam_FB_IMax'. */
/begin CHARACTERISTIC CLFc_lam_FB_IMax "Integral rangelimit" VALUE 0x83694 RL_CLFC_LAM_FB_IMAX 1.000000 CU_CLFC_LAM_FB_IMAX 0.000000 1.000000 BYTE_ORDER MSB_FIRST /end CHARACTERISTIC
/begin RECORD_LAYOUT RL_CLFC_LAM_FB_IMAX FNC_VALUES 1 FLOAT32_IEEE COLUMN_DIR DIRECT /end RECORD_LAYOUT
/begin COMPU_METHOD CU_CLFC_LAM_FB_IMAX "Conversion method for CLFc_lam_FB_IMax" RAT_FUNC "%10.2" "lam" COEFFS 0.000000 1.000000 0.000000 0.000000 0.000000 1.000000 /end COMPU_METHOD
/* Scalar calibration for DDE 'CLFc_lam_FB_IMin'. */
/begin CHARACTERISTIC CLFc_lam_FB_IMin "Integral rangelimit" VALUE 0x83698 RL_CLFC_LAM_FB_IMIN 2.000000 CU_CLFC_LAM_FB_IMIN -1.000000 1.000000 BYTE_ORDER MSB_FIRST /end CHARACTERISTIC
/begin RECORD_LAYOUT RL_CLFC_LAM_FB_IMIN FNC_VALUES 1 FLOAT32_IEEE COLUMN_DIR DIRECT /end RECORD_LAYOUT
/begin COMPU_METHOD CU_CLFC_LAM_FB_IMIN "Conversion method for CLFc_lam_FB_IMin" RAT_FUNC "%10.2" "lam" COEFFS 0.000000 1.000000 0.000000 0.000000 0.000000 1.000000 /end COMPU_METHOD
/* Scalar calibration for DDE 'CLFc_lam_FB_StableThrsh'. */
/begin CHARACTERISTIC CLFc_lam_FB_StableThrsh "FB control error stability threshold" VALUE 0x835f4 RL_CLFC_LAM_FB_STABLETHRSH 0.500000 CU_CLFC_LAM_FB_STABLETHRSH 0.000000 0.500000 BYTE_ORDER MSB_FIRST /end CHARACTERISTIC
/begin RECORD_LAYOUT RL_CLFC_LAM_FB_STABLETHRSH FNC_VALUES 1 FLOAT32_IEEE COLUMN_DIR DIRECT /end RECORD_LAYOUT
/begin COMPU_METHOD CU_CLFC_LAM_FB_STABLETHRSH "Conversion method for CLFc_lam_FB_StableThrsh" RAT_FUNC "%10.3" "lam" COEFFS 0.000000 1.000000 0.000000 0.000000 0.000000 1.000000 /end COMPU_METHOD
/* Scalar calibration for DDE 'CLFc_lam_ITermResetThrsh'. */
/begin CHARACTERISTIC CLFc_lam_ITermResetThrsh "Anti-windup logic error threshold" VALUE 0x836a0 RL_CLFC_LAM_ITERMRESETTHRSH 2.000000 CU_CLFC_LAM_ITERMRESETTHRSH -1.000000 1.000000 BYTE_ORDER MSB_FIRST /end CHARACTERISTIC
/begin RECORD_LAYOUT RL_CLFC_LAM_ITERMRESETTHRSH FNC_VALUES 1 FLOAT32_IEEE COLUMN_DIR DIRECT /end RECORD_LAYOUT
/begin COMPU_METHOD CU_CLFC_LAM_ITERMRESETTHRSH "Conversion method for CLFc_lam_ITermResetThrsh" RAT_FUNC "%10.3" "lam" COEFFS 0.000000 1.000000 0.000000 0.000000 0.000000 1.000000 /end COMPU_METHOD
/* Scalar calibration for DDE 'CLFc_lam_LTFT1'. */
/begin CHARACTERISTIC CLFc_lam_LTFT1 "Override value" VALUE 0x83e44 RL_CLFC_LAM_LTFT1 1.000000 CU_CLFC_LAM_LTFT1 -0.500000 0.500000 BYTE_ORDER MSB_FIRST /end CHARACTERISTIC
/begin RECORD_LAYOUT RL_CLFC_LAM_LTFT1 FNC_VALUES 1 FLOAT32_IEEE COLUMN_DIR DIRECT /end RECORD_LAYOUT
/begin COMPU_METHOD CU_CLFC_LAM_LTFT1 "Conversion method for CLFc_lam_LTFT1" RAT_FUNC "%10.3" "lam" COEFFS 0.000000 1.000000 0.000000 0.000000 0.000000 1.000000 /end COMPU_METHOD
/* Scalar calibration for DDE 'CLFc_lam_LTFT2'. */
/begin CHARACTERISTIC CLFc_lam_LTFT2 "Override value" VALUE 0x86fb0 RL_CLFC_LAM_LTFT2 1.000000 CU_CLFC_LAM_LTFT2 -0.500000 0.500000 BYTE_ORDER MSB_FIRST /end CHARACTERISTIC
/begin RECORD_LAYOUT RL_CLFC_LAM_LTFT2 FNC_VALUES 1 FLOAT32_IEEE COLUMN_DIR DIRECT /end RECORD_LAYOUT
/begin COMPU_METHOD CU_CLFC_LAM_LTFT2 "Conversion method for CLFc_lam_LTFT2" RAT_FUNC "%10.3" "lam" COEFFS 0.000000 1.000000 0.000000 0.000000 0.000000 1.000000 /end COMPU_METHOD
/* Scalar calibration for DDE 'CLFc_lam_LeanStep'. */
/begin CHARACTERISTIC CLFc_lam_LeanStep "Lambda adder during lean phase of dither pattern" VALUE 0x878d8 RL_CLFC_LAM_LEANSTEP 0.200000 CU_CLFC_LAM_LEANSTEP 0.000000 0.200000 BYTE_ORDER MSB_FIRST /end CHARACTERISTIC
/begin RECORD_LAYOUT RL_CLFC_LAM_LEANSTEP FNC_VALUES 1 FLOAT32_IEEE COLUMN_DIR DIRECT /end RECORD_LAYOUT
/begin COMPU_METHOD CU_CLFC_LAM_LEANSTEP "Conversion method for CLFc_lam_LeanStep" RAT_FUNC "%10.3" "lam" COEFFS 0.000000 1.000000 0.000000 0.000000 0.000000 1.000000 /end COMPU_METHOD
/* Scalar calibration for DDE 'CLFc_lam_O2_Dither1'. */
/begin CHARACTERISTIC CLFc_lam_O2_Dither1 "Override value" VALUE 0x8be68 RL_CLFC_LAM_O2_DITHER1 1.000000 CU_CLFC_LAM_O2_DITHER1 -0.500000 0.500000 BYTE_ORDER MSB_FIRST /end CHARACTERISTIC
/begin RECORD_LAYOUT RL_CLFC_LAM_O2_DITHER1 FNC_VALUES 1 FLOAT32_IEEE COLUMN_DIR DIRECT /end RECORD_LAYOUT
/begin COMPU_METHOD CU_CLFC_LAM_O2_DITHER1 "Conversion method for CLFc_lam_O2_Dither1" RAT_FUNC "%10.3" "lam" COEFFS 0.000000 1.000000 0.000000 0.000000 0.000000 1.000000 /end COMPU_METHOD
/* Scalar calibration for DDE 'CLFc_lam_O2_Dither2'. */
/begin CHARACTERISTIC CLFc_lam_O2_Dither2 "Override value" VALUE 0x8be7c RL_CLFC_LAM_O2_DITHER2 1.000000 CU_CLFC_LAM_O2_DITHER2 -0.500000 0.500000 BYTE_ORDER MSB_FIRST /end CHARACTERISTIC
/begin RECORD_LAYOUT RL_CLFC_LAM_O2_DITHER2 FNC_VALUES 1 FLOAT32_IEEE COLUMN_DIR DIRECT /end RECORD_LAYOUT
/begin COMPU_METHOD CU_CLFC_LAM_O2_DITHER2 "Conversion method for CLFc_lam_O2_Dither2" RAT_FUNC "%10.3" "lam" COEFFS 0.000000 1.000000 0.000000 0.000000 0.000000 1.000000 /end COMPU_METHOD
/* Scalar calibration for DDE 'CLFc_lam_RichStep'. */
/begin CHARACTERISTIC CLFc_lam_RichStep "Lambda adder during rich phase of dither pattern" VALUE 0x878dc RL_CLFC_LAM_RICHSTEP 0.200000 CU_CLFC_LAM_RICHSTEP -0.200000 0.000000 BYTE_ORDER MSB_FIRST /end CHARACTERISTIC
/begin RECORD_LAYOUT RL_CLFC_LAM_RICHSTEP FNC_VALUES 1 FLOAT32_IEEE COLUMN_DIR DIRECT /end RECORD_LAYOUT
/begin COMPU_METHOD CU_CLFC_LAM_RICHSTEP "Conversion method for CLFc_lam_RichStep" RAT_FUNC "%10.3" "lam" COEFFS 0.000000 1.000000 0.000000 0.000000 0.000000 1.000000 /end COMPU_METHOD
/* Scalar calibration for DDE 'CLFc_lam_StoicThrshMax'. */
/begin CHARACTERISTIC CLFc_lam_StoicThrshMax "BaseAFR command range where dither is active" VALUE 0x878d4 RL_CLFC_LAM_STOICTHRSHMAX 0.200000 CU_CLFC_LAM_STOICTHRSHMAX 0.900000 1.100000 BYTE_ORDER MSB_FIRST /end CHARACTERISTIC
/begin RECORD_LAYOUT RL_CLFC_LAM_STOICTHRSHMAX FNC_VALUES 1 FLOAT32_IEEE COLUMN_DIR DIRECT /end RECORD_LAYOUT
/begin COMPU_METHOD CU_CLFC_LAM_STOICTHRSHMAX "Conversion method for CLFc_lam_StoicThrshMax" RAT_FUNC "%10.3" "lam" COEFFS 0.000000 1.000000 0.000000 0.000000 0.000000 1.000000 /end COMPU_METHOD
/* Scalar calibration for DDE 'CLFc_lam_StoicThrshMin'. */
/begin CHARACTERISTIC CLFc_lam_StoicThrshMin "BaseAFR command range where dither is active" VALUE 0x878d0 RL_CLFC_LAM_STOICTHRSHMIN 0.200000 CU_CLFC_LAM_STOICTHRSHMIN 0.900000 1.100000 BYTE_ORDER MSB_FIRST /end CHARACTERISTIC
/begin RECORD_LAYOUT RL_CLFC_LAM_STOICTHRSHMIN FNC_VALUES 1 FLOAT32_IEEE COLUMN_DIR DIRECT /end RECORD_LAYOUT
/begin COMPU_METHOD CU_CLFC_LAM_STOICTHRSHMIN "Conversion method for CLFc_lam_StoicThrshMin" RAT_FUNC "%10.3" "lam" COEFFS 0.000000 1.000000 0.000000 0.000000 0.000000 1.000000 /end COMPU_METHOD
/* Scalar calibration for DDE 'CLFc_lam_UEGO1_Max'. */
/begin CHARACTERISTIC CLFc_lam_UEGO1_Max "Sensor valid range for FB control" VALUE 0x835d4 RL_CLFC_LAM_UEGO1_MAX 1.800000 CU_CLFC_LAM_UEGO1_MAX 0.200000 2.000000 BYTE_ORDER MSB_FIRST /end CHARACTERISTIC
/begin RECORD_LAYOUT RL_CLFC_LAM_UEGO1_MAX FNC_VALUES 1 FLOAT32_IEEE COLUMN_DIR DIRECT /end RECORD_LAYOUT
/begin COMPU_METHOD CU_CLFC_LAM_UEGO1_MAX "Conversion method for CLFc_lam_UEGO1_Max" RAT_FUNC "%10.2" "lam" COEFFS 0.000000 1.000000 0.000000 0.000000 0.000000 1.000000 /end COMPU_METHOD
/* Scalar calibration for DDE 'CLFc_lam_UEGO1_Min'. */
/begin CHARACTERISTIC CLFc_lam_UEGO1_Min "Sensor valid range for FB control" VALUE 0x835d0 RL_CLFC_LAM_UEGO1_MIN 1.800000 CU_CLFC_LAM_UEGO1_MIN 0.200000 2.000000 BYTE_ORDER MSB_FIRST /end CHARACTERISTIC
/begin RECORD_LAYOUT RL_CLFC_LAM_UEGO1_MIN FNC_VALUES 1 FLOAT32_IEEE COLUMN_DIR DIRECT /end RECORD_LAYOUT
/begin COMPU_METHOD CU_CLFC_LAM_UEGO1_MIN "Conversion method for CLFc_lam_UEGO1_Min" RAT_FUNC "%10.2" "lam" COEFFS 0.000000 1.000000 0.000000 0.000000 0.000000 1.000000 /end COMPU_METHOD
/* Scalar calibration for DDE 'CLFc_lam_UEGO2_Max'. */
/begin CHARACTERISTIC CLFc_lam_UEGO2_Max "Sensor valid range for FB control" VALUE 0x83e30 RL_CLFC_LAM_UEGO2_MAX 1.800000 CU_CLFC_LAM_UEGO2_MAX 0.200000 2.000000 BYTE_ORDER MSB_FIRST /end CHARACTERISTIC
/begin RECORD_LAYOUT RL_CLFC_LAM_UEGO2_MAX FNC_VALUES 1 FLOAT32_IEEE COLUMN_DIR DIRECT /end RECORD_LAYOUT
/begin COMPU_METHOD CU_CLFC_LAM_UEGO2_MAX "Conversion method for CLFc_lam_UEGO2_Max" RAT_FUNC "%10.2" "lam" COEFFS 0.000000 1.000000 0.000000 0.000000 0.000000 1.000000 /end COMPU_METHOD
/* Scalar calibration for DDE 'CLFc_lam_UEGO2_Min'. */
/begin CHARACTERISTIC CLFc_lam_UEGO2_Min "Sensor valid range for FB control" VALUE 0x83e2c RL_CLFC_LAM_UEGO2_MIN 1.800000 CU_CLFC_LAM_UEGO2_MIN 0.200000 2.000000 BYTE_ORDER MSB_FIRST /end CHARACTERISTIC
/begin RECORD_LAYOUT RL_CLFC_LAM_UEGO2_MIN FNC_VALUES 1 FLOAT32_IEEE COLUMN_DIR DIRECT /end RECORD_LAYOUT
/begin COMPU_METHOD CU_CLFC_LAM_UEGO2_MIN "Conversion method for CLFc_lam_UEGO2_Min" RAT_FUNC "%10.2" "lam" COEFFS 0.000000 1.000000 0.000000 0.000000 0.000000 1.000000 /end COMPU_METHOD
/* Scalar calibration for DDE 'CLFc_o_DitherLamErrorActv'. */
/begin CHARACTERISTIC CLFc_o_DitherLamErrorActv "Override value" VALUE 0x835cc RL_CLFC_O_DITHERLAMERRORACTV 1.000000 CU_CLFC_O_DITHERLAMERRORACTV 0.000000 1.000000 BYTE_ORDER MSB_FIRST /end CHARACTERISTIC
/begin RECORD_LAYOUT RL_CLFC_O_DITHERLAMERRORACTV FNC_VALUES 1 UBYTE COLUMN_DIR DIRECT /end RECORD_LAYOUT
/begin COMPU_METHOD CU_CLFC_O_DITHERLAMERRORACTV "Conversion method for CLFc_o_DitherLamErrorActv" RAT_FUNC "%10.0" "b" COEFFS 0.000000 1.000000 0.000000 0.000000 0.000000 1.000000 /end COMPU_METHOD
/* Scalar calibration for DDE 'CLFc_o_FB1_Active'. */
/begin CHARACTERISTIC CLFc_o_FB1_Active "Override flag" VALUE 0x8be74 RL_CLFC_O_FB1_ACTIVE 1.000000 CU_CLFC_O_FB1_ACTIVE 0.000000 1.000000 BYTE_ORDER MSB_FIRST /end CHARACTERISTIC
/begin RECORD_LAYOUT RL_CLFC_O_FB1_ACTIVE FNC_VALUES 1 UBYTE COLUMN_DIR DIRECT /end RECORD_LAYOUT
/begin COMPU_METHOD CU_CLFC_O_FB1_ACTIVE "Conversion method for CLFc_o_FB1_Active" RAT_FUNC "%10.0" "o" COEFFS 0.000000 1.000000 0.000000 0.000000 0.000000 1.000000 /end COMPU_METHOD
/* Scalar calibration for DDE 'CLFc_o_FB1_Ctrl'. */
/begin CHARACTERISTIC CLFc_o_FB1_Ctrl "Override flag" VALUE 0x83e3b RL_CLFC_O_FB1_CTRL 1.000000 CU_CLFC_O_FB1_CTRL 0.000000 1.000000 BYTE_ORDER MSB_FIRST /end CHARACTERISTIC
/begin RECORD_LAYOUT RL_CLFC_O_FB1_CTRL FNC_VALUES 1 UBYTE COLUMN_DIR DIRECT /end RECORD_LAYOUT
/begin COMPU_METHOD CU_CLFC_O_FB1_CTRL "Conversion method for CLFc_o_FB1_Ctrl" RAT_FUNC "%10.0" "o" COEFFS 0.000000 1.000000 0.000000 0.000000 0.000000 1.000000 /end COMPU_METHOD
/* Scalar calibration for DDE 'CLFc_o_FB2_Active'. */
/begin CHARACTERISTIC CLFc_o_FB2_Active "Override flag" VALUE 0x8be76 RL_CLFC_O_FB2_ACTIVE 1.000000 CU_CLFC_O_FB2_ACTIVE 0.000000 1.000000 BYTE_ORDER MSB_FIRST /end CHARACTERISTIC
/begin RECORD_LAYOUT RL_CLFC_O_FB2_ACTIVE FNC_VALUES 1 UBYTE COLUMN_DIR DIRECT /end RECORD_LAYOUT
/begin COMPU_METHOD CU_CLFC_O_FB2_ACTIVE "Conversion method for CLFc_o_FB2_Active" RAT_FUNC "%10.0" "o" COEFFS 0.000000 1.000000 0.000000 0.000000 0.000000 1.000000 /end COMPU_METHOD
/* Scalar calibration for DDE 'CLFc_o_FB2_Ctrl'. */
/begin CHARACTERISTIC CLFc_o_FB2_Ctrl "Override flag" VALUE 0x86fa6 RL_CLFC_O_FB2_CTRL 1.000000 CU_CLFC_O_FB2_CTRL 0.000000 1.000000 BYTE_ORDER MSB_FIRST /end CHARACTERISTIC
/begin RECORD_LAYOUT RL_CLFC_O_FB2_CTRL FNC_VALUES 1 UBYTE COLUMN_DIR DIRECT /end RECORD_LAYOUT
/begin COMPU_METHOD CU_CLFC_O_FB2_CTRL "Conversion method for CLFc_o_FB2_Ctrl" RAT_FUNC "%10.0" "o" COEFFS 0.000000 1.000000 0.000000 0.000000 0.000000 1.000000 /end COMPU_METHOD
/* Scalar calibration for DDE 'CLFc_o_LTFT1'. */
/begin CHARACTERISTIC CLFc_o_LTFT1 "Override flag" VALUE 0x83e40 RL_CLFC_O_LTFT1 1.000000 CU_CLFC_O_LTFT1 0.000000 1.000000 BYTE_ORDER MSB_FIRST /end CHARACTERISTIC
/begin RECORD_LAYOUT RL_CLFC_O_LTFT1 FNC_VALUES 1 UBYTE COLUMN_DIR DIRECT /end RECORD_LAYOUT
/begin COMPU_METHOD CU_CLFC_O_LTFT1 "Conversion method for CLFc_o_LTFT1" RAT_FUNC "%10.0" "o" COEFFS 0.000000 1.000000 0.000000 0.000000 0.000000 1.000000 /end COMPU_METHOD
/* Scalar calibration for DDE 'CLFc_o_LTFT2'. */
/begin CHARACTERISTIC CLFc_o_LTFT2 "Override flag" VALUE 0x86fac RL_CLFC_O_LTFT2 1.000000 CU_CLFC_O_LTFT2 0.000000 1.000000 BYTE_ORDER MSB_FIRST /end CHARACTERISTIC
/begin RECORD_LAYOUT RL_CLFC_O_LTFT2 FNC_VALUES 1 UBYTE COLUMN_DIR DIRECT /end RECORD_LAYOUT
/begin COMPU_METHOD CU_CLFC_O_LTFT2 "Conversion method for CLFc_o_LTFT2" RAT_FUNC "%10.0" "o" COEFFS 0.000000 1.000000 0.000000 0.000000 0.000000 1.000000 /end COMPU_METHOD
/* Scalar calibration for DDE 'CLFc_o_O2_Dither1'. */
/begin CHARACTERISTIC CLFc_o_O2_Dither1 "Override flag" VALUE 0x8be64 RL_CLFC_O_O2_DITHER1 1.000000 CU_CLFC_O_O2_DITHER1 0.000000 1.000000 BYTE_ORDER MSB_FIRST /end CHARACTERISTIC
/begin RECORD_LAYOUT RL_CLFC_O_O2_DITHER1 FNC_VALUES 1 UBYTE COLUMN_DIR DIRECT /end RECORD_LAYOUT
/begin COMPU_METHOD CU_CLFC_O_O2_DITHER1 "Conversion method for CLFc_o_O2_Dither1" RAT_FUNC "%10.0" "o" COEFFS 0.000000 1.000000 0.000000 0.000000 0.000000 1.000000 /end COMPU_METHOD
/* Scalar calibration for DDE 'CLFc_o_O2_Dither2'. */
/begin CHARACTERISTIC CLFc_o_O2_Dither2 "Override flag" VALUE 0x8be78 RL_CLFC_O_O2_DITHER2 1.000000 CU_CLFC_O_O2_DITHER2 0.000000 1.000000 BYTE_ORDER MSB_FIRST /end CHARACTERISTIC
/begin RECORD_LAYOUT RL_CLFC_O_O2_DITHER2 FNC_VALUES 1 UBYTE COLUMN_DIR DIRECT /end RECORD_LAYOUT
/begin COMPU_METHOD CU_CLFC_O_O2_DITHER2 "Conversion method for CLFc_o_O2_Dither2" RAT_FUNC "%10.0" "o" COEFFS 0.000000 1.000000 0.000000 0.000000 0.000000 1.000000 /end COMPU_METHOD
/* Scalar calibration for DDE 'CLFc_pct_LoadHPF_Thrsh'. */
/begin CHARACTERISTIC CLFc_pct_LoadHPF_Thrsh "HPF steady-state threshold" VALUE 0x835e8 RL_CLFC_PCT_LOADHPF_THRSH 0.500000 CU_CLFC_PCT_LOADHPF_THRSH 0.000000 0.500000 BYTE_ORDER MSB_FIRST /end CHARACTERISTIC
/begin RECORD_LAYOUT RL_CLFC_PCT_LOADHPF_THRSH FNC_VALUES 1 FLOAT32_IEEE COLUMN_DIR DIRECT /end RECORD_LAYOUT
/begin COMPU_METHOD CU_CLFC_PCT_LOADHPF_THRSH "Conversion method for CLFc_pct_LoadHPF_Thrsh" RAT_FUNC "%10.3" "pct" COEFFS 0.000000 1.000000 0.000000 0.000000 0.000000 1.000000 /end COMPU_METHOD
/* Scalar calibration for DDE 'CLFc_s_DitherActiveDbnc'. */
/begin CHARACTERISTIC CLFc_s_DitherActiveDbnc "Delay between SlowFB activation and dither application" VALUE 0x878c8 RL_CLFC_S_DITHERACTIVEDBNC 10.000000 CU_CLFC_S_DITHERACTIVEDBNC 0.000000 10.000000 BYTE_ORDER MSB_FIRST /end CHARACTERISTIC
/begin RECORD_LAYOUT RL_CLFC_S_DITHERACTIVEDBNC FNC_VALUES 1 FLOAT32_IEEE COLUMN_DIR DIRECT /end RECORD_LAYOUT
/begin COMPU_METHOD CU_CLFC_S_DITHERACTIVEDBNC "Conversion method for CLFc_s_DitherActiveDbnc" RAT_FUNC "%10.2" "s" COEFFS 0.000000 1.000000 0.000000 0.000000 0.000000 1.000000 /end COMPU_METHOD
/* Scalar calibration for DDE 'CLFc_s_DitherActiveHold'. */
/begin CHARACTERISTIC CLFc_s_DitherActiveHold "Delay between SlowFB activation and dither application" VALUE 0x878c4 RL_CLFC_S_DITHERACTIVEHOLD 10.000000 CU_CLFC_S_DITHERACTIVEHOLD 0.000000 10.000000 BYTE_ORDER MSB_FIRST /end CHARACTERISTIC
/begin RECORD_LAYOUT RL_CLFC_S_DITHERACTIVEHOLD FNC_VALUES 1 FLOAT32_IEEE COLUMN_DIR DIRECT /end RECORD_LAYOUT
/begin COMPU_METHOD CU_CLFC_S_DITHERACTIVEHOLD "Conversion method for CLFc_s_DitherActiveHold" RAT_FUNC "%10.2" "s" COEFFS 0.000000 1.000000 0.000000 0.000000 0.000000 1.000000 /end COMPU_METHOD
/* Scalar calibration for DDE 'CLFc_s_FB_StableDbnc'. */
/begin CHARACTERISTIC CLFc_s_FB_StableDbnc "Error must be less than threshold for this duration to transition to slow feedback" VALUE 0x8bea4 RL_CLFC_S_FB_STABLEDBNC 9.990000 CU_CLFC_S_FB_STABLEDBNC 0.010000 10.000000 BYTE_ORDER MSB_FIRST /end CHARACTERISTIC
/begin RECORD_LAYOUT RL_CLFC_S_FB_STABLEDBNC FNC_VALUES 1 FLOAT32_IEEE COLUMN_DIR DIRECT /end RECORD_LAYOUT
/begin COMPU_METHOD CU_CLFC_S_FB_STABLEDBNC "Conversion method for CLFc_s_FB_StableDbnc" RAT_FUNC "%10.2" "s" COEFFS 0.000000 1.000000 0.000000 0.000000 0.000000 1.000000 /end COMPU_METHOD
/* Scalar calibration for DDE 'CLFc_s_FB_UnstableDbnc'. */
/begin CHARACTERISTIC CLFc_s_FB_UnstableDbnc "If error exceeds this threshold during slow feedback then return to fast feedback" VALUE 0x835f8 RL_CLFC_S_FB_UNSTABLEDBNC 9.990000 CU_CLFC_S_FB_UNSTABLEDBNC 0.010000 10.000000 BYTE_ORDER MSB_FIRST /end CHARACTERISTIC
/begin RECORD_LAYOUT RL_CLFC_S_FB_UNSTABLEDBNC FNC_VALUES 1 FLOAT32_IEEE COLUMN_DIR DIRECT /end RECORD_LAYOUT
/begin COMPU_METHOD CU_CLFC_S_FB_UNSTABLEDBNC "Conversion method for CLFc_s_FB_UnstableDbnc" RAT_FUNC "%10.2" "s" COEFFS 0.000000 1.000000 0.000000 0.000000 0.000000 1.000000 /end COMPU_METHOD
/* Scalar calibration for DDE 'CLFc_s_LTFT_ActiveDbnc'. */
/begin CHARACTERISTIC CLFc_s_LTFT_ActiveDbnc "Delay between SlowFB activation and LTFT update" VALUE 0x83604 RL_CLFC_S_LTFT_ACTIVEDBNC 10.000000 CU_CLFC_S_LTFT_ACTIVEDBNC 0.000000 10.000000 BYTE_ORDER MSB_FIRST /end CHARACTERISTIC
/begin RECORD_LAYOUT RL_CLFC_S_LTFT_ACTIVEDBNC FNC_VALUES 1 FLOAT32_IEEE COLUMN_DIR DIRECT /end RECORD_LAYOUT
/begin COMPU_METHOD CU_CLFC_S_LTFT_ACTIVEDBNC "Conversion method for CLFc_s_LTFT_ActiveDbnc" RAT_FUNC "%10.2" "s" COEFFS 0.000000 1.000000 0.000000 0.000000 0.000000 1.000000 /end COMPU_METHOD
/* Scalar calibration for DDE 'CLFc_s_LTFT_RefreshPeriod'. */
/begin CHARACTERISTIC CLFc_s_LTFT_RefreshPeriod "If SlowFB remains active the LTFT will be updated at this rate" VALUE 0x8360c RL_CLFC_S_LTFT_REFRESHPERIOD 59.900000 CU_CLFC_S_LTFT_REFRESHPERIOD 0.100000 60.000000 BYTE_ORDER MSB_FIRST /end CHARACTERISTIC
/begin RECORD_LAYOUT RL_CLFC_S_LTFT_REFRESHPERIOD FNC_VALUES 1 FLOAT32_IEEE COLUMN_DIR DIRECT /end RECORD_LAYOUT
/begin COMPU_METHOD CU_CLFC_S_LTFT_REFRESHPERIOD "Conversion method for CLFc_s_LTFT_RefreshPeriod" RAT_FUNC "%10.1" "s" COEFFS 0.000000 1.000000 0.000000 0.000000 0.000000 1.000000 /end COMPU_METHOD
/end MODULE
/end PROJECT
