ASAP2_VERSION 1 31
/begin PROJECT M670_Engine_Control_1.2.0_M670_000 "BeGas B430LG Turbocharged engine"
/begin HEADER "Begas Motor 2017-2022 (c)" VERSION "1_2_0" /end HEADER
/begin MODULE OpenECU_M670_000 ""
/* Scalar calibration for DDE 'ADMc_C_ComprNormRefTemp'. */
/begin CHARACTERISTIC ADMc_C_ComprNormRefTemp "Normalized Compressor Reference Temperature" VALUE 0x84f98 RL_ADMC_C_COMPRNORMREFTEMP 400.000000 CU_ADMC_C_COMPRNORMREFTEMP -100.000000 300.000000 BYTE_ORDER MSB_FIRST /end CHARACTERISTIC
/begin RECORD_LAYOUT RL_ADMC_C_COMPRNORMREFTEMP FNC_VALUES 1 FLOAT32_IEEE COLUMN_DIR DIRECT /end RECORD_LAYOUT
/begin COMPU_METHOD CU_ADMC_C_COMPRNORMREFTEMP "Conversion method for ADMc_C_ComprNormRefTemp" RAT_FUNC "%10.0" "C" COEFFS 0.000000 1.000000 0.000000 0.000000 0.000000 1.000000 /end COMPU_METHOD
/* Scalar calibration for DDE 'ADMc_NU_AlphaL1'. */
/begin CHARACTERISTIC ADMc_NU_AlphaL1 "MAF Calibratable Gain 1" VALUE 0x86f58 RL_ADMC_NU_ALPHAL1 2000.000000 CU_ADMC_NU_ALPHAL1 -1000.000000 1000.000000 BYTE_ORDER MSB_FIRST /end CHARACTERISTIC
/begin RECORD_LAYOUT RL_ADMC_NU_ALPHAL1 FNC_VALUES 1 FLOAT32_IEEE COLUMN_DIR DIRECT /end RECORD_LAYOUT
/begin COMPU_METHOD CU_ADMC_NU_ALPHAL1 "Conversion method for ADMc_NU_AlphaL1" RAT_FUNC "%10.2" "NU" COEFFS 0.000000 1.000000 0.000000 0.000000 0.000000 1.000000 /end COMPU_METHOD
/* Scalar calibration for DDE 'ADMc_NU_AlphaL2'. */
/begin CHARACTERISTIC ADMc_NU_AlphaL2 "MAF Calibratable Gain 2" VALUE 0x86f54 RL_ADMC_NU_ALPHAL2 2000.000000 CU_ADMC_NU_ALPHAL2 -1000.000000 1000.000000 BYTE_ORDER MSB_FIRST /end CHARACTERISTIC
/begin RECORD_LAYOUT RL_ADMC_NU_ALPHAL2 FNC_VALUES 1 FLOAT32_IEEE COLUMN_DIR DIRECT /end RECORD_LAYOUT
/begin COMPU_METHOD CU_ADMC_NU_ALPHAL2 "Conversion method for ADMc_NU_AlphaL2" RAT_FUNC "%10.2" "NU" COEFFS 0.000000 1.000000 0.000000 0.000000 0.000000 1.000000 /end COMPU_METHOD
/* Scalar calibration for DDE 'ADMc_NU_AlphaL3'. */
/begin CHARACTERISTIC ADMc_NU_AlphaL3 "MAF Calibratable Gain 3" VALUE 0x86f60 RL_ADMC_NU_ALPHAL3 2000.000000 CU_ADMC_NU_ALPHAL3 -1000.000000 1000.000000 BYTE_ORDER MSB_FIRST /end CHARACTERISTIC
/begin RECORD_LAYOUT RL_ADMC_NU_ALPHAL3 FNC_VALUES 1 FLOAT32_IEEE COLUMN_DIR DIRECT /end RECORD_LAYOUT
/begin COMPU_METHOD CU_ADMC_NU_ALPHAL3 "Conversion method for ADMc_NU_AlphaL3" RAT_FUNC "%10.2" "NU" COEFFS 0.000000 1.000000 0.000000 0.000000 0.000000 1.000000 /end COMPU_METHOD
/* Scalar calibration for DDE 'ADMc_NU_AlphaL4'. */
/begin CHARACTERISTIC ADMc_NU_AlphaL4 "MAF Calibratable Gain 4" VALUE 0x86f64 RL_ADMC_NU_ALPHAL4 2000.000000 CU_ADMC_NU_ALPHAL4 -1000.000000 1000.000000 BYTE_ORDER MSB_FIRST /end CHARACTERISTIC
/begin RECORD_LAYOUT RL_ADMC_NU_ALPHAL4 FNC_VALUES 1 FLOAT32_IEEE COLUMN_DIR DIRECT /end RECORD_LAYOUT
/begin COMPU_METHOD CU_ADMC_NU_ALPHAL4 "Conversion method for ADMc_NU_AlphaL4" RAT_FUNC "%10.2" "NU" COEFFS 0.000000 1.000000 0.000000 0.000000 0.000000 1.000000 /end COMPU_METHOD
/* Scalar calibration for DDE 'ADMc_NU_AlphaL5'. */
/begin CHARACTERISTIC ADMc_NU_AlphaL5 "MAF Calibratable Gain 5" VALUE 0x86f5c RL_ADMC_NU_ALPHAL5 2000.000000 CU_ADMC_NU_ALPHAL5 -1000.000000 1000.000000 BYTE_ORDER MSB_FIRST /end CHARACTERISTIC
/begin RECORD_LAYOUT RL_ADMC_NU_ALPHAL5 FNC_VALUES 1 FLOAT32_IEEE COLUMN_DIR DIRECT /end RECORD_LAYOUT
/begin COMPU_METHOD CU_ADMC_NU_ALPHAL5 "Conversion method for ADMc_NU_AlphaL5" RAT_FUNC "%10.2" "NU" COEFFS 0.000000 1.000000 0.000000 0.000000 0.000000 1.000000 /end COMPU_METHOD
/* Scalar calibration for DDE 'ADMc_NU_AlphaL6'. */
/begin CHARACTERISTIC ADMc_NU_AlphaL6 "MAF Calibratable Gain 6" VALUE 0x86f68 RL_ADMC_NU_ALPHAL6 2000.000000 CU_ADMC_NU_ALPHAL6 -1000.000000 1000.000000 BYTE_ORDER MSB_FIRST /end CHARACTERISTIC
/begin RECORD_LAYOUT RL_ADMC_NU_ALPHAL6 FNC_VALUES 1 FLOAT32_IEEE COLUMN_DIR DIRECT /end RECORD_LAYOUT
/begin COMPU_METHOD CU_ADMC_NU_ALPHAL6 "Conversion method for ADMc_NU_AlphaL6" RAT_FUNC "%10.2" "NU" COEFFS 0.000000 1.000000 0.000000 0.000000 0.000000 1.000000 /end COMPU_METHOD
/* Scalar calibration for DDE 'ADMc_NU_BoostITermMax'. */
/begin CHARACTERISTIC ADMc_NU_BoostITermMax "Maximum limit on integral effort in MAF feedback control" VALUE 0x85c6c RL_ADMC_NU_BOOSTITERMMAX 40.000000 CU_ADMC_NU_BOOSTITERMMAX 0.000000 40.000000 BYTE_ORDER MSB_FIRST /end CHARACTERISTIC
/begin RECORD_LAYOUT RL_ADMC_NU_BOOSTITERMMAX FNC_VALUES 1 FLOAT32_IEEE COLUMN_DIR DIRECT /end RECORD_LAYOUT
/begin COMPU_METHOD CU_ADMC_NU_BOOSTITERMMAX "Conversion method for ADMc_NU_BoostITermMax" RAT_FUNC "%10.2" "NU" COEFFS 0.000000 1.000000 0.000000 0.000000 0.000000 1.000000 /end COMPU_METHOD
/* Scalar calibration for DDE 'ADMc_NU_BoostITermMin'. */
/begin CHARACTERISTIC ADMc_NU_BoostITermMin "Minimum limit on integral effort in MAF feedback control" VALUE 0x85c68 RL_ADMC_NU_BOOSTITERMMIN 40.000000 CU_ADMC_NU_BOOSTITERMMIN -40.000000 0.000000 BYTE_ORDER MSB_FIRST /end CHARACTERISTIC
/begin RECORD_LAYOUT RL_ADMC_NU_BOOSTITERMMIN FNC_VALUES 1 FLOAT32_IEEE COLUMN_DIR DIRECT /end RECORD_LAYOUT
/begin COMPU_METHOD CU_ADMC_NU_BOOSTITERMMIN "Conversion method for ADMc_NU_BoostITermMin" RAT_FUNC "%10.2" "NU" COEFFS 0.000000 1.000000 0.000000 0.000000 0.000000 1.000000 /end COMPU_METHOD
/* Scalar calibration for DDE 'ADMc_NU_ComprSurgeProxLim'. */
/begin CHARACTERISTIC ADMc_NU_ComprSurgeProxLim "Compressor Surge Proximity limit" VALUE 0x84fd8 RL_ADMC_NU_COMPRSURGEPROXLIM 3.000000 CU_ADMC_NU_COMPRSURGEPROXLIM -1.000000 2.000000 BYTE_ORDER MSB_FIRST /end CHARACTERISTIC
/begin RECORD_LAYOUT RL_ADMC_NU_COMPRSURGEPROXLIM FNC_VALUES 1 FLOAT32_IEEE COLUMN_DIR DIRECT /end RECORD_LAYOUT
/begin COMPU_METHOD CU_ADMC_NU_COMPRSURGEPROXLIM "Conversion method for ADMc_NU_ComprSurgeProxLim" RAT_FUNC "%10.2" "NU" COEFFS 0.000000 1.000000 0.000000 0.000000 0.000000 1.000000 /end COMPU_METHOD
/* Scalar calibration for DDE 'ADMc_NU_ThRqstFallRate'. */
/begin CHARACTERISTIC ADMc_NU_ThRqstFallRate "Ratelim on ThFlowAreaTrgtRaw" VALUE 0x867d0 RL_ADMC_NU_THRQSTFALLRATE 10000.000000 CU_ADMC_NU_THRQSTFALLRATE -10000.000000 0.000000 BYTE_ORDER MSB_FIRST /end CHARACTERISTIC
/begin RECORD_LAYOUT RL_ADMC_NU_THRQSTFALLRATE FNC_VALUES 1 FLOAT32_IEEE COLUMN_DIR DIRECT /end RECORD_LAYOUT
/begin COMPU_METHOD CU_ADMC_NU_THRQSTFALLRATE "Conversion method for ADMc_NU_ThRqstFallRate" RAT_FUNC "%10.1" "NU" COEFFS 0.000000 1.000000 0.000000 0.000000 0.000000 1.000000 /end COMPU_METHOD
/* Scalar calibration for DDE 'ADMc_NU_ThRqstRiseRate'. */
/begin CHARACTERISTIC ADMc_NU_ThRqstRiseRate "Ratelim on ThFlowAreaTrgtRaw" VALUE 0x867d4 RL_ADMC_NU_THRQSTRISERATE 10000.000000 CU_ADMC_NU_THRQSTRISERATE 0.000000 10000.000000 BYTE_ORDER MSB_FIRST /end CHARACTERISTIC
/begin RECORD_LAYOUT RL_ADMC_NU_THRQSTRISERATE FNC_VALUES 1 FLOAT32_IEEE COLUMN_DIR DIRECT /end RECORD_LAYOUT
/begin COMPU_METHOD CU_ADMC_NU_THRQSTRISERATE "Conversion method for ADMc_NU_ThRqstRiseRate" RAT_FUNC "%10.1" "NU" COEFFS 0.000000 1.000000 0.000000 0.000000 0.000000 1.000000 /end COMPU_METHOD
/* Scalar calibration for DDE 'ADMc_NU_TqToMassAirFlowGain_k2'. */
/begin CHARACTERISTIC ADMc_NU_TqToMassAirFlowGain_k2 "Calibratable Gain for Torque Calculation2" VALUE 0x85a2c RL_ADMC_NU_TQTOMASSAIRFLOWGAIN0 2000.000000 CU_ADMC_NU_TQTOMASSAIRFLOWGAIN0 -1000.000000 1000.000000 BYTE_ORDER MSB_FIRST /end CHARACTERISTIC
/begin RECORD_LAYOUT RL_ADMC_NU_TQTOMASSAIRFLOWGAIN0 FNC_VALUES 1 FLOAT32_IEEE COLUMN_DIR DIRECT /end RECORD_LAYOUT
/begin COMPU_METHOD CU_ADMC_NU_TQTOMASSAIRFLOWGAIN0 "Conversion method for ADMc_NU_TqToMassAirFlowGain_k2" RAT_FUNC "%10.2" "NU" COEFFS 0.000000 1.000000 0.000000 0.000000 0.000000 1.000000 /end COMPU_METHOD
/* Scalar calibration for DDE 'ADMc_RPM_TurSpdThrsh'. */
/begin CHARACTERISTIC ADMc_RPM_TurSpdThrsh "Turbo Overspeed Limit" VALUE 0x84fe0 RL_ADMC_RPM_TURSPDTHRSH 300000.000000 CU_ADMC_RPM_TURSPDTHRSH 0.000000 300000.000000 BYTE_ORDER MSB_FIRST /end CHARACTERISTIC
/begin RECORD_LAYOUT RL_ADMC_RPM_TURSPDTHRSH FNC_VALUES 1 FLOAT32_IEEE COLUMN_DIR DIRECT /end RECORD_LAYOUT
/begin COMPU_METHOD CU_ADMC_RPM_TURSPDTHRSH "Conversion method for ADMc_RPM_TurSpdThrsh" RAT_FUNC "%10.0" "RPM" COEFFS 0.000000 1.000000 0.000000 0.000000 0.000000 1.000000 /end COMPU_METHOD
/* Scalar calibration for DDE 'ADMc_b_ResetBoostITerm'. */
/begin CHARACTERISTIC ADMc_b_ResetBoostITerm "Reset the MAF feedback controller" VALUE 0x85c64 RL_ADMC_B_RESETBOOSTITERM 1.000000 CU_ADMC_B_RESETBOOSTITERM 0.000000 1.000000 BYTE_ORDER MSB_FIRST /end CHARACTERISTIC
/begin RECORD_LAYOUT RL_ADMC_B_RESETBOOSTITERM FNC_VALUES 1 UBYTE COLUMN_DIR DIRECT /end RECORD_LAYOUT
/begin COMPU_METHOD CU_ADMC_B_RESETBOOSTITERM "Conversion method for ADMc_b_ResetBoostITerm" RAT_FUNC "%10.0" "b" COEFFS 0.000000 1.000000 0.000000 0.000000 0.000000 1.000000 /end COMPU_METHOD
/* Scalar calibration for DDE 'ADMc_b_ResetThrottleITerm'. */
/begin CHARACTERISTIC ADMc_b_ResetThrottleITerm "Reset the MAF feedback controller" VALUE 0x866a4 RL_ADMC_B_RESETTHROTTLEITERM 1.000000 CU_ADMC_B_RESETTHROTTLEITERM 0.000000 1.000000 BYTE_ORDER MSB_FIRST /end CHARACTERISTIC
/begin RECORD_LAYOUT RL_ADMC_B_RESETTHROTTLEITERM FNC_VALUES 1 UBYTE COLUMN_DIR DIRECT /end RECORD_LAYOUT
/begin COMPU_METHOD CU_ADMC_B_RESETTHROTTLEITERM "Conversion method for ADMc_b_ResetThrottleITerm" RAT_FUNC "%10.0" "b" COEFFS 0.000000 1.000000 0.000000 0.000000 0.000000 1.000000 /end COMPU_METHOD
/* Scalar calibration for DDE 'ADMc_b_TurOverspeed'. */
/begin CHARACTERISTIC ADMc_b_TurOverspeed "Override value" VALUE 0x8b869 RL_ADMC_B_TUROVERSPEED 1.000000 CU_ADMC_B_TUROVERSPEED 0.000000 1.000000 BYTE_ORDER MSB_FIRST /end CHARACTERISTIC
/begin RECORD_LAYOUT RL_ADMC_B_TUROVERSPEED FNC_VALUES 1 UBYTE COLUMN_DIR DIRECT /end RECORD_LAYOUT
/begin COMPU_METHOD CU_ADMC_B_TUROVERSPEED "Conversion method for ADMc_b_TurOverspeed" RAT_FUNC "%10.0" "b" COEFFS 0.000000 1.000000 0.000000 0.000000 0.000000 1.000000 /end COMPU_METHOD
/* Scalar calibration for DDE 'ADMc_b_TurboCancelThrottleITerm'. */
/begin CHARACTERISTIC ADMc_b_TurboCancelThrottleITerm "Override value" VALUE 0x8669d RL_ADMC_B_TURBOCANCELTHROTTLEI0 1.000000 CU_ADMC_B_TURBOCANCELTHROTTLEI0 0.000000 1.000000 BYTE_ORDER MSB_FIRST /end CHARACTERISTIC
/begin RECORD_LAYOUT RL_ADMC_B_TURBOCANCELTHROTTLEI0 FNC_VALUES 1 UBYTE COLUMN_DIR DIRECT /end RECORD_LAYOUT
/begin COMPU_METHOD CU_ADMC_B_TURBOCANCELTHROTTLEI0 "Conversion method for ADMc_b_TurboCancelThrottleITerm" RAT_FUNC "%10.0" "b" COEFFS 0.000000 1.000000 0.000000 0.000000 0.000000 1.000000 /end COMPU_METHOD
/* Scalar calibration for DDE 'ADMc_b_UseLUT_ThCorr'. */
/begin CHARACTERISTIC ADMc_b_UseLUT_ThCorr "Select between equations and LUT-based throttle correction for VCP" VALUE 0x86fa5 RL_ADMC_B_USELUT_THCORR 1.000000 CU_ADMC_B_USELUT_THCORR 0.000000 1.000000 BYTE_ORDER MSB_FIRST /end CHARACTERISTIC
/begin RECORD_LAYOUT RL_ADMC_B_USELUT_THCORR FNC_VALUES 1 UBYTE COLUMN_DIR DIRECT /end RECORD_LAYOUT
/begin COMPU_METHOD CU_ADMC_B_USELUT_THCORR "Conversion method for ADMc_b_UseLUT_ThCorr" RAT_FUNC "%10.0" "b" COEFFS 0.000000 1.000000 0.000000 0.000000 0.000000 1.000000 /end COMPU_METHOD
/* Scalar calibration for DDE 'ADMc_cm2_ComprInArea'. */
/begin CHARACTERISTIC ADMc_cm2_ComprInArea "Compressor Inlet Area" VALUE 0x84fd0 RL_ADMC_CM2_COMPRINAREA 100.000000 CU_ADMC_CM2_COMPRINAREA 0.000000 100.000000 BYTE_ORDER MSB_FIRST /end CHARACTERISTIC
/begin RECORD_LAYOUT RL_ADMC_CM2_COMPRINAREA FNC_VALUES 1 FLOAT32_IEEE COLUMN_DIR DIRECT /end RECORD_LAYOUT
/begin COMPU_METHOD CU_ADMC_CM2_COMPRINAREA "Conversion method for ADMc_cm2_ComprInArea" RAT_FUNC "%10.2" "cm2" COEFFS 0.000000 1.000000 0.000000 0.000000 0.000000 1.000000 /end COMPU_METHOD
/* Scalar calibration for DDE 'ADMc_cm2_ComprOutArea'. */
/begin CHARACTERISTIC ADMc_cm2_ComprOutArea "Compressor Outlet Area" VALUE 0x84fd4 RL_ADMC_CM2_COMPROUTAREA 100.000000 CU_ADMC_CM2_COMPROUTAREA 0.000000 100.000000 BYTE_ORDER MSB_FIRST /end CHARACTERISTIC
/begin RECORD_LAYOUT RL_ADMC_CM2_COMPROUTAREA FNC_VALUES 1 FLOAT32_IEEE COLUMN_DIR DIRECT /end RECORD_LAYOUT
/begin COMPU_METHOD CU_ADMC_CM2_COMPROUTAREA "Conversion method for ADMc_cm2_ComprOutArea" RAT_FUNC "%10.2" "cm2" COEFFS 0.000000 1.000000 0.000000 0.000000 0.000000 1.000000 /end COMPU_METHOD
/* Scalar calibration for DDE 'ADMc_deg_CorrThAngCranking'. */
/begin CHARACTERISTIC ADMc_deg_CorrThAngCranking "Default Corrected Throttle Angle during Cranking" VALUE 0x87aa0 RL_ADMC_DEG_CORRTHANGCRANKING 2000.000000 CU_ADMC_DEG_CORRTHANGCRANKING -1000.000000 1000.000000 BYTE_ORDER MSB_FIRST /end CHARACTERISTIC
/begin RECORD_LAYOUT RL_ADMC_DEG_CORRTHANGCRANKING FNC_VALUES 1 FLOAT32_IEEE COLUMN_DIR DIRECT /end RECORD_LAYOUT
/begin COMPU_METHOD CU_ADMC_DEG_CORRTHANGCRANKING "Conversion method for ADMc_deg_CorrThAngCranking" RAT_FUNC "%10.2" "deg" COEFFS 0.000000 1.000000 0.000000 0.000000 0.000000 1.000000 /end COMPU_METHOD
/* Scalar calibration for DDE 'ADMc_deg_DFC_ThAngTrgt'. */
/begin CHARACTERISTIC ADMc_deg_DFC_ThAngTrgt "ETC command during decel fuel cut" VALUE 0x87aa4 RL_ADMC_DEG_DFC_THANGTRGT 105.000000 CU_ADMC_DEG_DFC_THANGTRGT -5.000000 100.000000 BYTE_ORDER MSB_FIRST /end CHARACTERISTIC
/begin RECORD_LAYOUT RL_ADMC_DEG_DFC_THANGTRGT FNC_VALUES 1 FLOAT32_IEEE COLUMN_DIR DIRECT /end RECORD_LAYOUT
/begin COMPU_METHOD CU_ADMC_DEG_DFC_THANGTRGT "Conversion method for ADMc_deg_DFC_ThAngTrgt" RAT_FUNC "%10.0" "deg" COEFFS 0.000000 1.000000 0.000000 0.000000 0.000000 1.000000 /end COMPU_METHOD
/* Scalar calibration for DDE 'ADMc_deg_ThrottleTrgt'. */
/begin CHARACTERISTIC ADMc_deg_ThrottleTrgt "Manual Value of Throttle Angle Correction" VALUE 0x87a9c RL_ADMC_DEG_THROTTLETRGT 105.000000 CU_ADMC_DEG_THROTTLETRGT -5.000000 100.000000 BYTE_ORDER MSB_FIRST /end CHARACTERISTIC
/begin RECORD_LAYOUT RL_ADMC_DEG_THROTTLETRGT FNC_VALUES 1 FLOAT32_IEEE COLUMN_DIR DIRECT /end RECORD_LAYOUT
/begin COMPU_METHOD CU_ADMC_DEG_THROTTLETRGT "Conversion method for ADMc_deg_ThrottleTrgt" RAT_FUNC "%10.1" "deg" COEFFS 0.000000 1.000000 0.000000 0.000000 0.000000 1.000000 /end COMPU_METHOD
/* Scalar calibration for DDE 'ADMc_e_VCP_Method'. */
/begin CHARACTERISTIC ADMc_e_VCP_Method "Input to choose between different VCP Angle Calculations" VALUE 0x8bbb8 RL_ADMC_E_VCP_METHOD 2.000000 CU_ADMC_E_VCP_METHOD 0.000000 2.000000 BYTE_ORDER MSB_FIRST /end CHARACTERISTIC
/begin RECORD_LAYOUT RL_ADMC_E_VCP_METHOD FNC_VALUES 1 UBYTE COLUMN_DIR DIRECT /end RECORD_LAYOUT
/begin COMPU_METHOD CU_ADMC_E_VCP_METHOD "Conversion method for ADMc_e_VCP_Method" TAB_VERB "%12.0" "e" COMPU_TAB_REF CT_ADMC_E_VCP_METHOD /end COMPU_METHOD
/begin COMPU_VTAB CT_ADMC_E_VCP_METHOD "Conversion method for ADMc_e_VCP_Method" TAB_VERB 3 0 "ADMk_e_VCP_Auto" 1 "ADMk_e_VCP_RunOnly" 2 "ADMk_e_VCP_SingleCal" /end COMPU_VTAB
/* Scalar calibration for DDE 'ADMc_gps_AirDemandRAW'. */
/begin CHARACTERISTIC ADMc_gps_AirDemandRAW "Manual Value of Torque air demand" VALUE 0x8be3c RL_ADMC_GPS_AIRDEMANDRAW 300.000000 CU_ADMC_GPS_AIRDEMANDRAW 0.000000 300.000000 BYTE_ORDER MSB_FIRST /end CHARACTERISTIC
/begin RECORD_LAYOUT RL_ADMC_GPS_AIRDEMANDRAW FNC_VALUES 1 FLOAT32_IEEE COLUMN_DIR DIRECT /end RECORD_LAYOUT
/begin COMPU_METHOD CU_ADMC_GPS_AIRDEMANDRAW "Conversion method for ADMc_gps_AirDemandRAW" RAT_FUNC "%10.3" "gps" COEFFS 0.000000 1.000000 0.000000 0.000000 0.000000 1.000000 /end COMPU_METHOD
/* Scalar calibration for DDE 'ADMc_gps_BoostFB_ErrorDbnd'. */
/begin CHARACTERISTIC ADMc_gps_BoostFB_ErrorDbnd "Deadband on MAF target error for feedback control" VALUE 0x85c60 RL_ADMC_GPS_BOOSTFB_ERRORDBND 10.000000 CU_ADMC_GPS_BOOSTFB_ERRORDBND 0.000000 10.000000 BYTE_ORDER MSB_FIRST /end CHARACTERISTIC
/begin RECORD_LAYOUT RL_ADMC_GPS_BOOSTFB_ERRORDBND FNC_VALUES 1 FLOAT32_IEEE COLUMN_DIR DIRECT /end RECORD_LAYOUT
/begin COMPU_METHOD CU_ADMC_GPS_BOOSTFB_ERRORDBND "Conversion method for ADMc_gps_BoostFB_ErrorDbnd" RAT_FUNC "%10.1" "gps" COEFFS 0.000000 1.000000 0.000000 0.000000 0.000000 1.000000 /end COMPU_METHOD
/* Scalar calibration for DDE 'ADMc_gps_MAF_Trgt'. */
/begin CHARACTERISTIC ADMc_gps_MAF_Trgt "Target mass air flow override value" VALUE 0x85a34 RL_ADMC_GPS_MAF_TRGT 1000.000000 CU_ADMC_GPS_MAF_TRGT 0.000000 1000.000000 BYTE_ORDER MSB_FIRST /end CHARACTERISTIC
/begin RECORD_LAYOUT RL_ADMC_GPS_MAF_TRGT FNC_VALUES 1 FLOAT32_IEEE COLUMN_DIR DIRECT /end RECORD_LAYOUT
/begin COMPU_METHOD CU_ADMC_GPS_MAF_TRGT "Conversion method for ADMc_gps_MAF_Trgt" RAT_FUNC "%10.1" "gps" COEFFS 0.000000 1.000000 0.000000 0.000000 0.000000 1.000000 /end COMPU_METHOD
/* Scalar calibration for DDE 'ADMc_gps_ThrottleFB_Dbnd'. */
/begin CHARACTERISTIC ADMc_gps_ThrottleFB_Dbnd "Deadband on MAF target error for feedback control" VALUE 0x866a0 RL_ADMC_GPS_THROTTLEFB_DBND 10.000000 CU_ADMC_GPS_THROTTLEFB_DBND 0.000000 10.000000 BYTE_ORDER MSB_FIRST /end CHARACTERISTIC
/begin RECORD_LAYOUT RL_ADMC_GPS_THROTTLEFB_DBND FNC_VALUES 1 FLOAT32_IEEE COLUMN_DIR DIRECT /end RECORD_LAYOUT
/begin COMPU_METHOD CU_ADMC_GPS_THROTTLEFB_DBND "Conversion method for ADMc_gps_ThrottleFB_Dbnd" RAT_FUNC "%10.1" "gps" COEFFS 0.000000 1.000000 0.000000 0.000000 0.000000 1.000000 /end COMPU_METHOD
/* Scalar calibration for DDE 'ADMc_kPa_BoostFB_Dbnd'. */
/begin CHARACTERISTIC ADMc_kPa_BoostFB_Dbnd "FB control effort deadband" VALUE 0x85c70 RL_ADMC_KPA_BOOSTFB_DBND 2000.000000 CU_ADMC_KPA_BOOSTFB_DBND -1000.000000 1000.000000 BYTE_ORDER MSB_FIRST /end CHARACTERISTIC
/begin RECORD_LAYOUT RL_ADMC_KPA_BOOSTFB_DBND FNC_VALUES 1 FLOAT32_IEEE COLUMN_DIR DIRECT /end RECORD_LAYOUT
/begin COMPU_METHOD CU_ADMC_KPA_BOOSTFB_DBND "Conversion method for ADMc_kPa_BoostFB_Dbnd" RAT_FUNC "%10.2" "kPa" COEFFS 0.000000 1.000000 0.000000 0.000000 0.000000 1.000000 /end COMPU_METHOD
/* Scalar calibration for DDE 'ADMc_kPa_BoostFB_Max'. */
/begin CHARACTERISTIC ADMc_kPa_BoostFB_Max "FB control effort saturation Upper Limit for MAP" VALUE 0x85c74 RL_ADMC_KPA_BOOSTFB_MAX 100.000000 CU_ADMC_KPA_BOOSTFB_MAX 0.000000 100.000000 BYTE_ORDER MSB_FIRST /end CHARACTERISTIC
/begin RECORD_LAYOUT RL_ADMC_KPA_BOOSTFB_MAX FNC_VALUES 1 FLOAT32_IEEE COLUMN_DIR DIRECT /end RECORD_LAYOUT
/begin COMPU_METHOD CU_ADMC_KPA_BOOSTFB_MAX "Conversion method for ADMc_kPa_BoostFB_Max" RAT_FUNC "%10.2" "kPa" COEFFS 0.000000 1.000000 0.000000 0.000000 0.000000 1.000000 /end COMPU_METHOD
/* Scalar calibration for DDE 'ADMc_kPa_BoostFB_Min'. */
/begin CHARACTERISTIC ADMc_kPa_BoostFB_Min "FB control effort saturation Lower Limit for MAP" VALUE 0x85c78 RL_ADMC_KPA_BOOSTFB_MIN 100.000000 CU_ADMC_KPA_BOOSTFB_MIN -100.000000 0.000000 BYTE_ORDER MSB_FIRST /end CHARACTERISTIC
/begin RECORD_LAYOUT RL_ADMC_KPA_BOOSTFB_MIN FNC_VALUES 1 FLOAT32_IEEE COLUMN_DIR DIRECT /end RECORD_LAYOUT
/begin COMPU_METHOD CU_ADMC_KPA_BOOSTFB_MIN "Conversion method for ADMc_kPa_BoostFB_Min" RAT_FUNC "%10.2" "kPa" COEFFS 0.000000 1.000000 0.000000 0.000000 0.000000 1.000000 /end COMPU_METHOD
/* Scalar calibration for DDE 'ADMc_kPa_BoostPressTrgt'. */
/begin CHARACTERISTIC ADMc_kPa_BoostPressTrgt "Override signal for Target Boost Pressure" VALUE 0x8b860 RL_ADMC_KPA_BOOSTPRESSTRGT 500.000000 CU_ADMC_KPA_BOOSTPRESSTRGT 0.000000 500.000000 BYTE_ORDER MSB_FIRST /end CHARACTERISTIC
/begin RECORD_LAYOUT RL_ADMC_KPA_BOOSTPRESSTRGT FNC_VALUES 1 FLOAT32_IEEE COLUMN_DIR DIRECT /end RECORD_LAYOUT
/begin COMPU_METHOD CU_ADMC_KPA_BOOSTPRESSTRGT "Conversion method for ADMc_kPa_BoostPressTrgt" RAT_FUNC "%10.0" "kPa" COEFFS 0.000000 1.000000 0.000000 0.000000 0.000000 1.000000 /end COMPU_METHOD
/* Scalar calibration for DDE 'ADMc_kPa_ComprNormRefPress'. */
/begin CHARACTERISTIC ADMc_kPa_ComprNormRefPress "Normalized Compressor Reference Pressure" VALUE 0x84f9c RL_ADMC_KPA_COMPRNORMREFPRESS 500.000000 CU_ADMC_KPA_COMPRNORMREFPRESS 0.000000 500.000000 BYTE_ORDER MSB_FIRST /end CHARACTERISTIC
/begin RECORD_LAYOUT RL_ADMC_KPA_COMPRNORMREFPRESS FNC_VALUES 1 FLOAT32_IEEE COLUMN_DIR DIRECT /end RECORD_LAYOUT
/begin COMPU_METHOD CU_ADMC_KPA_COMPRNORMREFPRESS "Conversion method for ADMc_kPa_ComprNormRefPress" RAT_FUNC "%10.0" "kPa" COEFFS 0.000000 1.000000 0.000000 0.000000 0.000000 1.000000 /end COMPU_METHOD
/* Scalar calibration for DDE 'ADMc_kPa_CrankingBoostPressTrgt'. */
/begin CHARACTERISTIC ADMc_kPa_CrankingBoostPressTrgt "Default Target MAP during Cranking" VALUE 0x8b864 RL_ADMC_KPA_CRANKINGBOOSTPRESS0 500.000000 CU_ADMC_KPA_CRANKINGBOOSTPRESS0 0.000000 500.000000 BYTE_ORDER MSB_FIRST /end CHARACTERISTIC
/begin RECORD_LAYOUT RL_ADMC_KPA_CRANKINGBOOSTPRESS0 FNC_VALUES 1 FLOAT32_IEEE COLUMN_DIR DIRECT /end RECORD_LAYOUT
/begin COMPU_METHOD CU_ADMC_KPA_CRANKINGBOOSTPRESS0 "Conversion method for ADMc_kPa_CrankingBoostPressTrgt" RAT_FUNC "%10.0" "kPa" COEFFS 0.000000 1.000000 0.000000 0.000000 0.000000 1.000000 /end COMPU_METHOD
/* Scalar calibration for DDE 'ADMc_kPa_SrgChkTrgtBoost'. */
/begin CHARACTERISTIC ADMc_kPa_SrgChkTrgtBoost "MAP target during surge or choke" VALUE 0x86100 RL_ADMC_KPA_SRGCHKTRGTBOOST 150.000000 CU_ADMC_KPA_SRGCHKTRGTBOOST 50.000000 200.000000 BYTE_ORDER MSB_FIRST /end CHARACTERISTIC
/begin RECORD_LAYOUT RL_ADMC_KPA_SRGCHKTRGTBOOST FNC_VALUES 1 FLOAT32_IEEE COLUMN_DIR DIRECT /end RECORD_LAYOUT
/begin COMPU_METHOD CU_ADMC_KPA_SRGCHKTRGTBOOST "Conversion method for ADMc_kPa_SrgChkTrgtBoost" RAT_FUNC "%10.2" "kPa" COEFFS 0.000000 1.000000 0.000000 0.000000 0.000000 1.000000 /end COMPU_METHOD
/* Scalar calibration for DDE 'ADMc_lam_MaxLimit'. */
/begin CHARACTERISTIC ADMc_lam_MaxLimit "Maximum lambda for combustion" VALUE 0x85a24 RL_ADMC_LAM_MAXLIMIT 5.000000 CU_ADMC_LAM_MAXLIMIT 0.000000 5.000000 BYTE_ORDER MSB_FIRST /end CHARACTERISTIC
/begin RECORD_LAYOUT RL_ADMC_LAM_MAXLIMIT FNC_VALUES 1 FLOAT32_IEEE COLUMN_DIR DIRECT /end RECORD_LAYOUT
/begin COMPU_METHOD CU_ADMC_LAM_MAXLIMIT "Conversion method for ADMc_lam_MaxLimit" RAT_FUNC "%10.2" "lam" COEFFS 0.000000 1.000000 0.000000 0.000000 0.000000 1.000000 /end COMPU_METHOD
/* Scalar calibration for DDE 'ADMc_lam_MinLimit'. */
/begin CHARACTERISTIC ADMc_lam_MinLimit "Minimum lambda for combustion" VALUE 0x85a28 RL_ADMC_LAM_MINLIMIT 1.000000 CU_ADMC_LAM_MINLIMIT 0.000000 1.000000 BYTE_ORDER MSB_FIRST /end CHARACTERISTIC
/begin RECORD_LAYOUT RL_ADMC_LAM_MINLIMIT FNC_VALUES 1 FLOAT32_IEEE COLUMN_DIR DIRECT /end RECORD_LAYOUT
/begin COMPU_METHOD CU_ADMC_LAM_MINLIMIT "Conversion method for ADMc_lam_MinLimit" RAT_FUNC "%10.2" "lam" COEFFS 0.000000 1.000000 0.000000 0.000000 0.000000 1.000000 /end COMPU_METHOD
/* Scalar calibration for DDE 'ADMc_o_AirDemand'. */
/begin CHARACTERISTIC ADMc_o_AirDemand "Override signal for Throttle Angle Correction" VALUE 0x8be6e RL_ADMC_O_AIRDEMAND 1.000000 CU_ADMC_O_AIRDEMAND 0.000000 1.000000 BYTE_ORDER MSB_FIRST /end CHARACTERISTIC
/begin RECORD_LAYOUT RL_ADMC_O_AIRDEMAND FNC_VALUES 1 UBYTE COLUMN_DIR DIRECT /end RECORD_LAYOUT
/begin COMPU_METHOD CU_ADMC_O_AIRDEMAND "Conversion method for ADMc_o_AirDemand" RAT_FUNC "%10.0" "o" COEFFS 0.000000 1.000000 0.000000 0.000000 0.000000 1.000000 /end COMPU_METHOD
/* Scalar calibration for DDE 'ADMc_o_AirDemandRAW'. */
/begin CHARACTERISTIC ADMc_o_AirDemandRAW "Override signal for Torque air demand" VALUE 0x8be3a RL_ADMC_O_AIRDEMANDRAW 1.000000 CU_ADMC_O_AIRDEMANDRAW 0.000000 1.000000 BYTE_ORDER MSB_FIRST /end CHARACTERISTIC
/begin RECORD_LAYOUT RL_ADMC_O_AIRDEMANDRAW FNC_VALUES 1 UBYTE COLUMN_DIR DIRECT /end RECORD_LAYOUT
/begin COMPU_METHOD CU_ADMC_O_AIRDEMANDRAW "Conversion method for ADMc_o_AirDemandRAW" RAT_FUNC "%10.0" "o" COEFFS 0.000000 1.000000 0.000000 0.000000 0.000000 1.000000 /end COMPU_METHOD
/* Scalar calibration for DDE 'ADMc_o_BoostPressTrgt'. */
/begin CHARACTERISTIC ADMc_o_BoostPressTrgt "Manual Value of Target Boost Pressure" VALUE 0x8b85c RL_ADMC_O_BOOSTPRESSTRGT 1.000000 CU_ADMC_O_BOOSTPRESSTRGT 0.000000 1.000000 BYTE_ORDER MSB_FIRST /end CHARACTERISTIC
/begin RECORD_LAYOUT RL_ADMC_O_BOOSTPRESSTRGT FNC_VALUES 1 UBYTE COLUMN_DIR DIRECT /end RECORD_LAYOUT
/begin COMPU_METHOD CU_ADMC_O_BOOSTPRESSTRGT "Conversion method for ADMc_o_BoostPressTrgt" RAT_FUNC "%10.0" "o" COEFFS 0.000000 1.000000 0.000000 0.000000 0.000000 1.000000 /end COMPU_METHOD
/* Scalar calibration for DDE 'ADMc_o_MAF_Trgt'. */
/begin CHARACTERISTIC ADMc_o_MAF_Trgt "Target mass air flow override flag" VALUE 0x85a30 RL_ADMC_O_MAF_TRGT 1.000000 CU_ADMC_O_MAF_TRGT 0.000000 1.000000 BYTE_ORDER MSB_FIRST /end CHARACTERISTIC
/begin RECORD_LAYOUT RL_ADMC_O_MAF_TRGT FNC_VALUES 1 UBYTE COLUMN_DIR DIRECT /end RECORD_LAYOUT
/begin COMPU_METHOD CU_ADMC_O_MAF_TRGT "Conversion method for ADMc_o_MAF_Trgt" RAT_FUNC "%10.0" "o" COEFFS 0.000000 1.000000 0.000000 0.000000 0.000000 1.000000 /end COMPU_METHOD
/* Scalar calibration for DDE 'ADMc_o_ThrottleTrgt'. */
/begin CHARACTERISTIC ADMc_o_ThrottleTrgt "Override signal for Throttle Angle Correction" VALUE 0x87a98 RL_ADMC_O_THROTTLETRGT 1.000000 CU_ADMC_O_THROTTLETRGT 0.000000 1.000000 BYTE_ORDER MSB_FIRST /end CHARACTERISTIC
/begin RECORD_LAYOUT RL_ADMC_O_THROTTLETRGT FNC_VALUES 1 UBYTE COLUMN_DIR DIRECT /end RECORD_LAYOUT
/begin COMPU_METHOD CU_ADMC_O_THROTTLETRGT "Conversion method for ADMc_o_ThrottleTrgt" RAT_FUNC "%10.0" "o" COEFFS 0.000000 1.000000 0.000000 0.000000 0.000000 1.000000 /end COMPU_METHOD
/* Scalar calibration for DDE 'ADMc_o_TurOverspeed'. */
/begin CHARACTERISTIC ADMc_o_TurOverspeed "Override flag" VALUE 0x8b868 RL_ADMC_O_TUROVERSPEED 1.000000 CU_ADMC_O_TUROVERSPEED 0.000000 1.000000 BYTE_ORDER MSB_FIRST /end CHARACTERISTIC
/begin RECORD_LAYOUT RL_ADMC_O_TUROVERSPEED FNC_VALUES 1 UBYTE COLUMN_DIR DIRECT /end RECORD_LAYOUT
/begin COMPU_METHOD CU_ADMC_O_TUROVERSPEED "Conversion method for ADMc_o_TurOverspeed" RAT_FUNC "%10.0" "o" COEFFS 0.000000 1.000000 0.000000 0.000000 0.000000 1.000000 /end COMPU_METHOD
/* Scalar calibration for DDE 'ADMc_o_TurboCancelThrottleITerm'. */
/begin CHARACTERISTIC ADMc_o_TurboCancelThrottleITerm "Override flag" VALUE 0x8669c RL_ADMC_O_TURBOCANCELTHROTTLEI0 1.000000 CU_ADMC_O_TURBOCANCELTHROTTLEI0 0.000000 1.000000 BYTE_ORDER MSB_FIRST /end CHARACTERISTIC
/begin RECORD_LAYOUT RL_ADMC_O_TURBOCANCELTHROTTLEI0 FNC_VALUES 1 UBYTE COLUMN_DIR DIRECT /end RECORD_LAYOUT
/begin COMPU_METHOD CU_ADMC_O_TURBOCANCELTHROTTLEI0 "Conversion method for ADMc_o_TurboCancelThrottleITerm" RAT_FUNC "%10.0" "o" COEFFS 0.000000 1.000000 0.000000 0.000000 0.000000 1.000000 /end COMPU_METHOD
/* Scalar calibration for DDE 'ADMc_o_VCP_Trgt'. */
/begin CHARACTERISTIC ADMc_o_VCP_Trgt "Intake Cam Angle Override input" VALUE 0x8bbac RL_ADMC_O_VCP_TRGT 1.000000 CU_ADMC_O_VCP_TRGT 0.000000 1.000000 BYTE_ORDER MSB_FIRST /end CHARACTERISTIC
/begin RECORD_LAYOUT RL_ADMC_O_VCP_TRGT FNC_VALUES 1 UBYTE COLUMN_DIR DIRECT /end RECORD_LAYOUT
/begin COMPU_METHOD CU_ADMC_O_VCP_TRGT "Conversion method for ADMc_o_VCP_Trgt" RAT_FUNC "%10.0" "o" COEFFS 0.000000 1.000000 0.000000 0.000000 0.000000 1.000000 /end COMPU_METHOD
/* Scalar calibration for DDE 'ADMc_pct_AirDemand'. */
/begin CHARACTERISTIC ADMc_pct_AirDemand "Manual Value of Throttle Angle Correction" VALUE 0x8be70 RL_ADMC_PCT_AIRDEMAND 3.000000 CU_ADMC_PCT_AIRDEMAND 0.000000 3.000000 BYTE_ORDER MSB_FIRST /end CHARACTERISTIC
/begin RECORD_LAYOUT RL_ADMC_PCT_AIRDEMAND FNC_VALUES 1 FLOAT32_IEEE COLUMN_DIR DIRECT /end RECORD_LAYOUT
/begin COMPU_METHOD CU_ADMC_PCT_AIRDEMAND "Conversion method for ADMc_pct_AirDemand" RAT_FUNC "%10.2" "pct" COEFFS 0.000000 1.000000 0.000000 0.000000 0.000000 1.000000 /end COMPU_METHOD
/* Scalar calibration for DDE 'ADMc_pct_ThrottleFB_Dbnd'. */
/begin CHARACTERISTIC ADMc_pct_ThrottleFB_Dbnd "FB control effort deadband" VALUE 0x867c4 RL_ADMC_PCT_THROTTLEFB_DBND 2000.000000 CU_ADMC_PCT_THROTTLEFB_DBND -1000.000000 1000.000000 BYTE_ORDER MSB_FIRST /end CHARACTERISTIC
/begin RECORD_LAYOUT RL_ADMC_PCT_THROTTLEFB_DBND FNC_VALUES 1 FLOAT32_IEEE COLUMN_DIR DIRECT /end RECORD_LAYOUT
/begin COMPU_METHOD CU_ADMC_PCT_THROTTLEFB_DBND "Conversion method for ADMc_pct_ThrottleFB_Dbnd" RAT_FUNC "%10.2" "pct" COEFFS 0.000000 1.000000 0.000000 0.000000 0.000000 1.000000 /end COMPU_METHOD
/* Scalar calibration for DDE 'ADMc_pct_ThrottleFB_Max'. */
/begin CHARACTERISTIC ADMc_pct_ThrottleFB_Max "FB control effort saturation Upper Limit for Throttle flow area" VALUE 0x867c8 RL_ADMC_PCT_THROTTLEFB_MAX 5.000000 CU_ADMC_PCT_THROTTLEFB_MAX 0.000000 5.000000 BYTE_ORDER MSB_FIRST /end CHARACTERISTIC
/begin RECORD_LAYOUT RL_ADMC_PCT_THROTTLEFB_MAX FNC_VALUES 1 FLOAT32_IEEE COLUMN_DIR DIRECT /end RECORD_LAYOUT
/begin COMPU_METHOD CU_ADMC_PCT_THROTTLEFB_MAX "Conversion method for ADMc_pct_ThrottleFB_Max" RAT_FUNC "%10.2" "pct" COEFFS 0.000000 1.000000 0.000000 0.000000 0.000000 1.000000 /end COMPU_METHOD
/* Scalar calibration for DDE 'ADMc_pct_ThrottleFB_Min'. */
/begin CHARACTERISTIC ADMc_pct_ThrottleFB_Min "FB control effort saturation Lower Limit for throttle flow area" VALUE 0x867cc RL_ADMC_PCT_THROTTLEFB_MIN 6.000000 CU_ADMC_PCT_THROTTLEFB_MIN -5.000000 1.000000 BYTE_ORDER MSB_FIRST /end CHARACTERISTIC
/begin RECORD_LAYOUT RL_ADMC_PCT_THROTTLEFB_MIN FNC_VALUES 1 FLOAT32_IEEE COLUMN_DIR DIRECT /end RECORD_LAYOUT
/begin COMPU_METHOD CU_ADMC_PCT_THROTTLEFB_MIN "Conversion method for ADMc_pct_ThrottleFB_Min" RAT_FUNC "%10.2" "pct" COEFFS 0.000000 1.000000 0.000000 0.000000 0.000000 1.000000 /end COMPU_METHOD
/* Scalar calibration for DDE 'ADMc_pct_ThrottleITermMax'. */
/begin CHARACTERISTIC ADMc_pct_ThrottleITermMax "Maximum limit on integral effort in MAF feedback control" VALUE 0x866ac RL_ADMC_PCT_THROTTLEITERMMAX 1.000000 CU_ADMC_PCT_THROTTLEITERMMAX 0.000000 1.000000 BYTE_ORDER MSB_FIRST /end CHARACTERISTIC
/begin RECORD_LAYOUT RL_ADMC_PCT_THROTTLEITERMMAX FNC_VALUES 1 FLOAT32_IEEE COLUMN_DIR DIRECT /end RECORD_LAYOUT
/begin COMPU_METHOD CU_ADMC_PCT_THROTTLEITERMMAX "Conversion method for ADMc_pct_ThrottleITermMax" RAT_FUNC "%10.2" "pct" COEFFS 0.000000 1.000000 0.000000 0.000000 0.000000 1.000000 /end COMPU_METHOD
/* Scalar calibration for DDE 'ADMc_pct_ThrottleITermMin'. */
/begin CHARACTERISTIC ADMc_pct_ThrottleITermMin "Minimum limit on integral effort in MAF feedback control" VALUE 0x866a8 RL_ADMC_PCT_THROTTLEITERMMIN 1.000000 CU_ADMC_PCT_THROTTLEITERMMIN -1.000000 0.000000 BYTE_ORDER MSB_FIRST /end CHARACTERISTIC
/begin RECORD_LAYOUT RL_ADMC_PCT_THROTTLEITERMMIN FNC_VALUES 1 FLOAT32_IEEE COLUMN_DIR DIRECT /end RECORD_LAYOUT
/begin COMPU_METHOD CU_ADMC_PCT_THROTTLEITERMMIN "Conversion method for ADMc_pct_ThrottleITermMin" RAT_FUNC "%10.2" "pct" COEFFS 0.000000 1.000000 0.000000 0.000000 0.000000 1.000000 /end COMPU_METHOD
/* Scalar calibration for DDE 'ADMc_ret_DFC_VCP_Trgt'. */
/begin CHARACTERISTIC ADMc_ret_DFC_VCP_Trgt "VCP command during decel fuel cut" VALUE 0x8bbb4 RL_ADMC_RET_DFC_VCP_TRGT 105.000000 CU_ADMC_RET_DFC_VCP_TRGT -5.000000 100.000000 BYTE_ORDER MSB_FIRST /end CHARACTERISTIC
/begin RECORD_LAYOUT RL_ADMC_RET_DFC_VCP_TRGT FNC_VALUES 1 FLOAT32_IEEE COLUMN_DIR DIRECT /end RECORD_LAYOUT
/begin COMPU_METHOD CU_ADMC_RET_DFC_VCP_TRGT "Conversion method for ADMc_ret_DFC_VCP_Trgt" RAT_FUNC "%10.0" "ret" COEFFS 0.000000 1.000000 0.000000 0.000000 0.000000 1.000000 /end COMPU_METHOD
/* Scalar calibration for DDE 'ADMc_ret_VCP_FixedTrgt'. */
/begin CHARACTERISTIC ADMc_ret_VCP_FixedTrgt "Manual Input Intake Cam angle" VALUE 0x8bbbc RL_ADMC_RET_VCP_FIXEDTRGT 105.000000 CU_ADMC_RET_VCP_FIXEDTRGT -5.000000 100.000000 BYTE_ORDER MSB_FIRST /end CHARACTERISTIC
/begin RECORD_LAYOUT RL_ADMC_RET_VCP_FIXEDTRGT FNC_VALUES 1 FLOAT32_IEEE COLUMN_DIR DIRECT /end RECORD_LAYOUT
/begin COMPU_METHOD CU_ADMC_RET_VCP_FIXEDTRGT "Conversion method for ADMc_ret_VCP_FixedTrgt" RAT_FUNC "%10.1" "ret" COEFFS 0.000000 1.000000 0.000000 0.000000 0.000000 1.000000 /end COMPU_METHOD
/* Scalar calibration for DDE 'ADMc_ret_VCP_Trgt'. */
/begin CHARACTERISTIC ADMc_ret_VCP_Trgt "Intake Cam Angle Override value" VALUE 0x8bbb0 RL_ADMC_RET_VCP_TRGT 105.000000 CU_ADMC_RET_VCP_TRGT -5.000000 100.000000 BYTE_ORDER MSB_FIRST /end CHARACTERISTIC
/begin RECORD_LAYOUT RL_ADMC_RET_VCP_TRGT FNC_VALUES 1 FLOAT32_IEEE COLUMN_DIR DIRECT /end RECORD_LAYOUT
/begin COMPU_METHOD CU_ADMC_RET_VCP_TRGT "Conversion method for ADMc_ret_VCP_Trgt" RAT_FUNC "%10.2" "ret" COEFFS 0.000000 1.000000 0.000000 0.000000 0.000000 1.000000 /end COMPU_METHOD
/* Scalar calibration for DDE 'ADMc_s_OverspeedDbnc'. */
/begin CHARACTERISTIC ADMc_s_OverspeedDbnc "debounce time limit for overspeed" VALUE 0x84fe4 RL_ADMC_S_OVERSPEEDDBNC 5.000000 CU_ADMC_S_OVERSPEEDDBNC 0.000000 5.000000 BYTE_ORDER MSB_FIRST /end CHARACTERISTIC
/begin RECORD_LAYOUT RL_ADMC_S_OVERSPEEDDBNC FNC_VALUES 1 FLOAT32_IEEE COLUMN_DIR DIRECT /end RECORD_LAYOUT
/begin COMPU_METHOD CU_ADMC_S_OVERSPEEDDBNC "Conversion method for ADMc_s_OverspeedDbnc" RAT_FUNC "%10.2" "s" COEFFS 0.000000 1.000000 0.000000 0.000000 0.000000 1.000000 /end COMPU_METHOD
/* Scalar calibration for DDE 'ADMc_s_SurgeDbnc'. */
/begin CHARACTERISTIC ADMc_s_SurgeDbnc "Surge Debounce time calibratable value" VALUE 0x84fdc RL_ADMC_S_SURGEDBNC 1000.000000 CU_ADMC_S_SURGEDBNC 0.000000 1000.000000 BYTE_ORDER MSB_FIRST /end CHARACTERISTIC
/begin RECORD_LAYOUT RL_ADMC_S_SURGEDBNC FNC_VALUES 1 FLOAT32_IEEE COLUMN_DIR DIRECT /end RECORD_LAYOUT
/begin COMPU_METHOD CU_ADMC_S_SURGEDBNC "Conversion method for ADMc_s_SurgeDbnc" RAT_FUNC "%10.2" "s" COEFFS 0.000000 1.000000 0.000000 0.000000 0.000000 1.000000 /end COMPU_METHOD
/* Scalar calibration for DDE 'ADMc_s_UseTurboDbnc'. */
/begin CHARACTERISTIC ADMc_s_UseTurboDbnc "Debounce timer" VALUE 0x86698 RL_ADMC_S_USETURBODBNC 1.000000 CU_ADMC_S_USETURBODBNC 0.000000 1.000000 BYTE_ORDER MSB_FIRST /end CHARACTERISTIC
/begin RECORD_LAYOUT RL_ADMC_S_USETURBODBNC FNC_VALUES 1 FLOAT32_IEEE COLUMN_DIR DIRECT /end RECORD_LAYOUT
/begin COMPU_METHOD CU_ADMC_S_USETURBODBNC "Conversion method for ADMc_s_UseTurboDbnc" RAT_FUNC "%10.2" "s" COEFFS 0.000000 1.000000 0.000000 0.000000 0.000000 1.000000 /end COMPU_METHOD
/* Map (1d) calibration for DDE 'ADMm_C_ExahustTemplimp_z'. */
/begin CHARACTERISTIC ADMm_C_ExahustTemplimp_z "(ret) Correction Factor for Intake Cam Angle Based on MAT z-axis" CURVE 0x81cfc RL_ADMM_C_EXAHUSTTEMPLIMP_Z 1.000000 CU_ADMM_C_EXAHUSTTEMPLIMP_Z 0.000000 1.000000
 /begin AXIS_DESCR COM_AXIS NO_INPUT_QUANTITY CU_ADMM_C_EXAHUSTTEMPLIMP_X 6 0.000000 1000.000000 AXIS_PTS_REF APD_ADMM_C_EXAHUSTTEMPLIMP_X /end AXIS_DESCR
 BYTE_ORDER MSB_FIRST /end CHARACTERISTIC
/begin RECORD_LAYOUT RL_ADMM_C_EXAHUSTTEMPLIMP_Z FNC_VALUES 1 FLOAT32_IEEE COLUMN_DIR DIRECT /end RECORD_LAYOUT
/begin COMPU_METHOD CU_ADMM_C_EXAHUSTTEMPLIMP_Z "Conversion method for ADMm_C_ExahustTemplimp_z" RAT_FUNC "%10.3" "ret" COEFFS 0.000000 1.000000 0.000000 0.000000 0.000000 1.000000 /end COMPU_METHOD
/begin AXIS_PTS APD_ADMM_C_EXAHUSTTEMPLIMP_X "(C) Correction Factor for Intake Cam Angle Based on MAT x-axis" 0x81ce4 NO_INPUT_QUANTITY RL_ADMM_C_EXAHUSTTEMPLIMP_X 1000.000000 CU_ADMM_C_EXAHUSTTEMPLIMP_X 6 0.0 1000.0 BYTE_ORDER MSB_FIRST /end AXIS_PTS
/begin RECORD_LAYOUT RL_ADMM_C_EXAHUSTTEMPLIMP_X AXIS_PTS_X 1 FLOAT32_IEEE INDEX_INCR DIRECT /end RECORD_LAYOUT
/begin COMPU_METHOD CU_ADMM_C_EXAHUSTTEMPLIMP_X "Conversion method for ADMm_C_ExahustTemplimp_x" RAT_FUNC "%10.0" "C" COEFFS 0.000000 1.000000 0.000000 0.000000 0.000000 1.000000 /end COMPU_METHOD
/* Map (2d) calibration for DDE 'ADMm_NU_BoostIGain_z'. */
/begin CHARACTERISTIC ADMm_NU_BoostIGain_z "MAF boost control feedback gain data" MAP 0x85b88 RL_ADMM_NU_BOOSTIGAIN_Z 10.000000 CU_ADMM_NU_BOOSTIGAIN_Z 0.000000 10.000000
 /begin AXIS_DESCR COM_AXIS NO_INPUT_QUANTITY CU_ADMM_NU_BOOSTIGAIN_X 6 0.000000 8000.000000 AXIS_PTS_REF APD_ADMM_NU_BOOSTIGAIN_X /end AXIS_DESCR
 /begin AXIS_DESCR COM_AXIS NO_INPUT_QUANTITY CU_ADMM_NU_BOOSTIGAIN_Y 9 0.000000 200.000000 AXIS_PTS_REF APD_ADMM_NU_BOOSTIGAIN_Y /end AXIS_DESCR
 BYTE_ORDER MSB_FIRST /end CHARACTERISTIC
/begin RECORD_LAYOUT RL_ADMM_NU_BOOSTIGAIN_Z FNC_VALUES 1 FLOAT32_IEEE COLUMN_DIR DIRECT /end RECORD_LAYOUT
/begin COMPU_METHOD CU_ADMM_NU_BOOSTIGAIN_Z "Conversion method for ADMm_NU_BoostIGain_z" RAT_FUNC "%10.4" "NU" COEFFS 0.000000 1.000000 0.000000 0.000000 0.000000 1.000000 /end COMPU_METHOD
/begin AXIS_PTS APD_ADMM_NU_BOOSTIGAIN_X "MAF boost control feedback gain engine speed axis" 0x85b4c NO_INPUT_QUANTITY RL_ADMM_NU_BOOSTIGAIN_X 8000.000000 CU_ADMM_NU_BOOSTIGAIN_X 6 0.0 8000.0 BYTE_ORDER MSB_FIRST /end AXIS_PTS
/begin RECORD_LAYOUT RL_ADMM_NU_BOOSTIGAIN_X AXIS_PTS_X 1 FLOAT32_IEEE INDEX_INCR DIRECT /end RECORD_LAYOUT
/begin COMPU_METHOD CU_ADMM_NU_BOOSTIGAIN_X "Conversion method for ADMm_NU_BoostIGain_x" RAT_FUNC "%10.0" "RPM" COEFFS 0.000000 1.000000 0.000000 0.000000 0.000000 1.000000 /end COMPU_METHOD
/begin AXIS_PTS APD_ADMM_NU_BOOSTIGAIN_Y "MAF boost control feedback gain airflow axis" 0x85b64 NO_INPUT_QUANTITY RL_ADMM_NU_BOOSTIGAIN_Y 200.000000 CU_ADMM_NU_BOOSTIGAIN_Y 9 0.0 200.0 BYTE_ORDER MSB_FIRST /end AXIS_PTS
/begin RECORD_LAYOUT RL_ADMM_NU_BOOSTIGAIN_Y AXIS_PTS_X 1 FLOAT32_IEEE INDEX_INCR DIRECT /end RECORD_LAYOUT
/begin COMPU_METHOD CU_ADMM_NU_BOOSTIGAIN_Y "Conversion method for ADMm_NU_BoostIGain_y" RAT_FUNC "%10.2" "gps" COEFFS 0.000000 1.000000 0.000000 0.000000 0.000000 1.000000 /end COMPU_METHOD
/* Map (1d) calibration for DDE 'ADMm_NU_BoostLimit_z'. */
/begin CHARACTERISTIC ADMm_NU_BoostLimit_z "Boost pressure limit table data" CURVE 0x8500c RL_ADMM_NU_BOOSTLIMIT_Z 240.000000 CU_ADMM_NU_BOOSTLIMIT_Z 0.000000 240.000000
 /begin AXIS_DESCR COM_AXIS NO_INPUT_QUANTITY CU_ADMM_NU_BOOSTLIMIT_X 9 0.000000 8000.000000 AXIS_PTS_REF APD_ADMM_NU_BOOSTLIMIT_X /end AXIS_DESCR
 BYTE_ORDER MSB_FIRST /end CHARACTERISTIC
/begin RECORD_LAYOUT RL_ADMM_NU_BOOSTLIMIT_Z FNC_VALUES 1 FLOAT32_IEEE COLUMN_DIR DIRECT /end RECORD_LAYOUT
/begin COMPU_METHOD CU_ADMM_NU_BOOSTLIMIT_Z "Conversion method for ADMm_NU_BoostLimit_z" RAT_FUNC "%10.2" "kPa" COEFFS 0.000000 1.000000 0.000000 0.000000 0.000000 1.000000 /end COMPU_METHOD
/begin AXIS_PTS APD_ADMM_NU_BOOSTLIMIT_X "Boost pressure limit table engine speed axis" 0x84fe8 NO_INPUT_QUANTITY RL_ADMM_NU_BOOSTLIMIT_X 8000.000000 CU_ADMM_NU_BOOSTLIMIT_X 9 0.0 8000.0 BYTE_ORDER MSB_FIRST /end AXIS_PTS
/begin RECORD_LAYOUT RL_ADMM_NU_BOOSTLIMIT_X AXIS_PTS_X 1 FLOAT32_IEEE INDEX_INCR DIRECT /end RECORD_LAYOUT
/begin COMPU_METHOD CU_ADMM_NU_BOOSTLIMIT_X "Conversion method for ADMm_NU_BoostLimit_x" RAT_FUNC "%10.0" "RPM" COEFFS 0.000000 1.000000 0.000000 0.000000 0.000000 1.000000 /end COMPU_METHOD
/* Map (2d) calibration for DDE 'ADMm_NU_BoostPGain_z'. */
/begin CHARACTERISTIC ADMm_NU_BoostPGain_z "MAF boost control feedback gain data" MAP 0x85a74 RL_ADMM_NU_BOOSTPGAIN_Z 10.000000 CU_ADMM_NU_BOOSTPGAIN_Z 0.000000 10.000000
 /begin AXIS_DESCR COM_AXIS NO_INPUT_QUANTITY CU_ADMM_NU_BOOSTPGAIN_X 6 0.000000 8000.000000 AXIS_PTS_REF APD_ADMM_NU_BOOSTPGAIN_X /end AXIS_DESCR
 /begin AXIS_DESCR COM_AXIS NO_INPUT_QUANTITY CU_ADMM_NU_BOOSTPGAIN_Y 9 0.000000 200.000000 AXIS_PTS_REF APD_ADMM_NU_BOOSTPGAIN_Y /end AXIS_DESCR
 BYTE_ORDER MSB_FIRST /end CHARACTERISTIC
/begin RECORD_LAYOUT RL_ADMM_NU_BOOSTPGAIN_Z FNC_VALUES 1 FLOAT32_IEEE COLUMN_DIR DIRECT /end RECORD_LAYOUT
/begin COMPU_METHOD CU_ADMM_NU_BOOSTPGAIN_Z "Conversion method for ADMm_NU_BoostPGain_z" RAT_FUNC "%10.4" "NU" COEFFS 0.000000 1.000000 0.000000 0.000000 0.000000 1.000000 /end COMPU_METHOD
/begin AXIS_PTS APD_ADMM_NU_BOOSTPGAIN_X "MAF boost control feedback gain engine speed axis" 0x85a38 NO_INPUT_QUANTITY RL_ADMM_NU_BOOSTPGAIN_X 8000.000000 CU_ADMM_NU_BOOSTPGAIN_X 6 0.0 8000.0 BYTE_ORDER MSB_FIRST /end AXIS_PTS
/begin RECORD_LAYOUT RL_ADMM_NU_BOOSTPGAIN_X AXIS_PTS_X 1 FLOAT32_IEEE INDEX_INCR DIRECT /end RECORD_LAYOUT
/begin COMPU_METHOD CU_ADMM_NU_BOOSTPGAIN_X "Conversion method for ADMm_NU_BoostPGain_x" RAT_FUNC "%10.0" "RPM" COEFFS 0.000000 1.000000 0.000000 0.000000 0.000000 1.000000 /end COMPU_METHOD
/begin AXIS_PTS APD_ADMM_NU_BOOSTPGAIN_Y "MAF boost control feedback gain airflow axis" 0x85a50 NO_INPUT_QUANTITY RL_ADMM_NU_BOOSTPGAIN_Y 200.000000 CU_ADMM_NU_BOOSTPGAIN_Y 9 0.0 200.0 BYTE_ORDER MSB_FIRST /end AXIS_PTS
/begin RECORD_LAYOUT RL_ADMM_NU_BOOSTPGAIN_Y AXIS_PTS_X 1 FLOAT32_IEEE INDEX_INCR DIRECT /end RECORD_LAYOUT
/begin COMPU_METHOD CU_ADMM_NU_BOOSTPGAIN_Y "Conversion method for ADMm_NU_BoostPGain_y" RAT_FUNC "%10.2" "gps" COEFFS 0.000000 1.000000 0.000000 0.000000 0.000000 1.000000 /end COMPU_METHOD
/* Map (2d) calibration for DDE 'ADMm_NU_BoostPressTrgtFF_z'. */
/begin CHARACTERISTIC ADMm_NU_BoostPressTrgtFF_z "Feedforward manifold pressure target table data" MAP 0x85cfc RL_ADMM_NU_BOOSTPRESSTRGTFF_Z 250.000000 CU_ADMM_NU_BOOSTPRESSTRGTFF_Z 0.000000 250.000000
 /begin AXIS_DESCR COM_AXIS NO_INPUT_QUANTITY CU_ADMM_NU_BOOSTPRESSTRGTFF_X 16 0.000000 10000.000000 AXIS_PTS_REF APD_ADMM_NU_BOOSTPRESSTRGTFF_X /end AXIS_DESCR
 /begin AXIS_DESCR COM_AXIS NO_INPUT_QUANTITY CU_ADMM_NU_BOOSTPRESSTRGTFF_Y 16 0.000000 1000.000000 AXIS_PTS_REF APD_ADMM_NU_BOOSTPRESSTRGTFF_Y /end AXIS_DESCR
 BYTE_ORDER MSB_FIRST /end CHARACTERISTIC
/begin RECORD_LAYOUT RL_ADMM_NU_BOOSTPRESSTRGTFF_Z FNC_VALUES 1 FLOAT32_IEEE COLUMN_DIR DIRECT /end RECORD_LAYOUT
/begin COMPU_METHOD CU_ADMM_NU_BOOSTPRESSTRGTFF_Z "Conversion method for ADMm_NU_BoostPressTrgtFF_z" RAT_FUNC "%10.2" "kPa" COEFFS 0.000000 1.000000 0.000000 0.000000 0.000000 1.000000 /end COMPU_METHOD
/begin AXIS_PTS APD_ADMM_NU_BOOSTPRESSTRGTFF_X "Feedforward manifold pressure target table engine speed axis" 0x85c7c NO_INPUT_QUANTITY RL_ADMM_NU_BOOSTPRESSTRGTFF_X 10000.000000 CU_ADMM_NU_BOOSTPRESSTRGTFF_X 16 0.0 10000.0 BYTE_ORDER MSB_FIRST /end AXIS_PTS
/begin RECORD_LAYOUT RL_ADMM_NU_BOOSTPRESSTRGTFF_X AXIS_PTS_X 1 FLOAT32_IEEE INDEX_INCR DIRECT /end RECORD_LAYOUT
/begin COMPU_METHOD CU_ADMM_NU_BOOSTPRESSTRGTFF_X "Conversion method for ADMm_NU_BoostPressTrgtFF_x" RAT_FUNC "%10.0" "RPM" COEFFS 0.000000 1.000000 0.000000 0.000000 0.000000 1.000000 /end COMPU_METHOD
/begin AXIS_PTS APD_ADMM_NU_BOOSTPRESSTRGTFF_Y "Feedforward manifold pressure target table airflow demand axis" 0x85cbc NO_INPUT_QUANTITY RL_ADMM_NU_BOOSTPRESSTRGTFF_Y 1000.000000 CU_ADMM_NU_BOOSTPRESSTRGTFF_Y 16 0.0 1000.0 BYTE_ORDER MSB_FIRST /end AXIS_PTS
/begin RECORD_LAYOUT RL_ADMM_NU_BOOSTPRESSTRGTFF_Y AXIS_PTS_X 1 FLOAT32_IEEE INDEX_INCR DIRECT /end RECORD_LAYOUT
/begin COMPU_METHOD CU_ADMM_NU_BOOSTPRESSTRGTFF_Y "Conversion method for ADMm_NU_BoostPressTrgtFF_y" RAT_FUNC "%10.2" "gps" COEFFS 0.000000 1.000000 0.000000 0.000000 0.000000 1.000000 /end COMPU_METHOD
/* Map (1d) calibration for DDE 'ADMm_NU_ComprSurgeMap_z'. */
/begin CHARACTERISTIC ADMm_NU_ComprSurgeMap_z "Compressor Pressure Ratio at which surge is expected" CURVE 0x84fb8 RL_ADMM_NU_COMPRSURGEMAP_Z 10.000000 CU_ADMM_NU_COMPRSURGEMAP_Z 0.000000 10.000000
 /begin AXIS_DESCR COM_AXIS ADM_gps_MAF_Corr CU_ADMM_NU_COMPRSURGEMAP_X 6 0.000000 1000.000000 AXIS_PTS_REF APD_ADMM_NU_COMPRSURGEMAP_X /end AXIS_DESCR
 BYTE_ORDER MSB_FIRST /end CHARACTERISTIC
/begin RECORD_LAYOUT RL_ADMM_NU_COMPRSURGEMAP_Z FNC_VALUES 1 FLOAT32_IEEE COLUMN_DIR DIRECT /end RECORD_LAYOUT
/begin COMPU_METHOD CU_ADMM_NU_COMPRSURGEMAP_Z "Conversion method for ADMm_NU_ComprSurgeMap_z" RAT_FUNC "%10.2" "NU" COEFFS 0.000000 1.000000 0.000000 0.000000 0.000000 1.000000 /end COMPU_METHOD
/begin AXIS_PTS APD_ADMM_NU_COMPRSURGEMAP_X "normalized MAF" 0x84fa0 ADM_gps_MAF_Corr RL_ADMM_NU_COMPRSURGEMAP_X 1000.000000 CU_ADMM_NU_COMPRSURGEMAP_X 6 0.0 1000.0 BYTE_ORDER MSB_FIRST /end AXIS_PTS
/begin RECORD_LAYOUT RL_ADMM_NU_COMPRSURGEMAP_X AXIS_PTS_X 1 FLOAT32_IEEE INDEX_INCR DIRECT /end RECORD_LAYOUT
/begin COMPU_METHOD CU_ADMM_NU_COMPRSURGEMAP_X "Conversion method for ADMm_NU_ComprSurgeMap_x" RAT_FUNC "%10.0" "gps" COEFFS 0.000000 1.000000 0.000000 0.000000 0.000000 1.000000 /end COMPU_METHOD
/* Map (1d) calibration for DDE 'ADMm_NU_CrankingVCP_z'. */
/begin CHARACTERISTIC ADMm_NU_CrankingVCP_z "(ret) Intake Cam Ang from Eng Speed and Temp z-axis" CURVE 0x86860 RL_ADMM_NU_CRANKINGVCP_Z 105.000000 CU_ADMM_NU_CRANKINGVCP_Z -5.000000 100.000000
 /begin AXIS_DESCR COM_AXIS NO_INPUT_QUANTITY CU_ADMM_NU_CRANKINGVCP_X 6 -40.000000 140.000000 AXIS_PTS_REF APD_ADMM_NU_CRANKINGVCP_X /end AXIS_DESCR
 BYTE_ORDER MSB_FIRST /end CHARACTERISTIC
/begin RECORD_LAYOUT RL_ADMM_NU_CRANKINGVCP_Z FNC_VALUES 1 FLOAT32_IEEE COLUMN_DIR DIRECT /end RECORD_LAYOUT
/begin COMPU_METHOD CU_ADMM_NU_CRANKINGVCP_Z "Conversion method for ADMm_NU_CrankingVCP_z" RAT_FUNC "%10.2" "ret" COEFFS 0.000000 1.000000 0.000000 0.000000 0.000000 1.000000 /end COMPU_METHOD
/begin AXIS_PTS APD_ADMM_NU_CRANKINGVCP_X "(C) Intake Cam Ang from Eng Speed and Temo y-axis" 0x86848 NO_INPUT_QUANTITY RL_ADMM_NU_CRANKINGVCP_X 180.000000 CU_ADMM_NU_CRANKINGVCP_X 6 -40.0 140.0 BYTE_ORDER MSB_FIRST /end AXIS_PTS
/begin RECORD_LAYOUT RL_ADMM_NU_CRANKINGVCP_X AXIS_PTS_X 1 FLOAT32_IEEE INDEX_INCR DIRECT /end RECORD_LAYOUT
/begin COMPU_METHOD CU_ADMM_NU_CRANKINGVCP_X "Conversion method for ADMm_NU_CrankingVCP_x" RAT_FUNC "%10.0" "C" COEFFS 0.000000 1.000000 0.000000 0.000000 0.000000 1.000000 /end COMPU_METHOD
/* Map (2d) calibration for DDE 'ADMm_NU_FF_ThrottleTrgt_z'. */
/begin CHARACTERISTIC ADMm_NU_FF_ThrottleTrgt_z "Feedforward target ETC flow area table data" MAP 0x86184 RL_ADMM_NU_FF_THROTTLETRGT_Z 1.000000 CU_ADMM_NU_FF_THROTTLETRGT_Z 0.000000 1.000000
 /begin AXIS_DESCR COM_AXIS NO_INPUT_QUANTITY CU_ADMM_NU_FF_THROTTLETRGT_X 16 0.000000 10000.000000 AXIS_PTS_REF APD_ADMM_NU_FF_THROTTLETRGT_X /end AXIS_DESCR
 /begin AXIS_DESCR COM_AXIS NO_INPUT_QUANTITY CU_ADMM_NU_FF_THROTTLETRGT_Y 16 0.000000 1000.000000 AXIS_PTS_REF APD_ADMM_NU_FF_THROTTLETRGT_Y /end AXIS_DESCR
 BYTE_ORDER MSB_FIRST /end CHARACTERISTIC
/begin RECORD_LAYOUT RL_ADMM_NU_FF_THROTTLETRGT_Z FNC_VALUES 1 FLOAT32_IEEE COLUMN_DIR DIRECT /end RECORD_LAYOUT
/begin COMPU_METHOD CU_ADMM_NU_FF_THROTTLETRGT_Z "Conversion method for ADMm_NU_FF_ThrottleTrgt_z" RAT_FUNC "%10.3" "pct" COEFFS 0.000000 1.000000 0.000000 0.000000 0.000000 1.000000 /end COMPU_METHOD
/begin AXIS_PTS APD_ADMM_NU_FF_THROTTLETRGT_X "Feedforward target ETC flow area table engine speed axis" 0x86104 NO_INPUT_QUANTITY RL_ADMM_NU_FF_THROTTLETRGT_X 10000.000000 CU_ADMM_NU_FF_THROTTLETRGT_X 16 0.0 10000.0 BYTE_ORDER MSB_FIRST /end AXIS_PTS
/begin RECORD_LAYOUT RL_ADMM_NU_FF_THROTTLETRGT_X AXIS_PTS_X 1 FLOAT32_IEEE INDEX_INCR DIRECT /end RECORD_LAYOUT
/begin COMPU_METHOD CU_ADMM_NU_FF_THROTTLETRGT_X "Conversion method for ADMm_NU_FF_ThrottleTrgt_x" RAT_FUNC "%10.0" "RPM" COEFFS 0.000000 1.000000 0.000000 0.000000 0.000000 1.000000 /end COMPU_METHOD
/begin AXIS_PTS APD_ADMM_NU_FF_THROTTLETRGT_Y "Feedforward target ETC flow area table MAF target axis" 0x86144 NO_INPUT_QUANTITY RL_ADMM_NU_FF_THROTTLETRGT_Y 1000.000000 CU_ADMM_NU_FF_THROTTLETRGT_Y 16 0.0 1000.0 BYTE_ORDER MSB_FIRST /end AXIS_PTS
/begin RECORD_LAYOUT RL_ADMM_NU_FF_THROTTLETRGT_Y AXIS_PTS_X 1 FLOAT32_IEEE INDEX_INCR DIRECT /end RECORD_LAYOUT
/begin COMPU_METHOD CU_ADMM_NU_FF_THROTTLETRGT_Y "Conversion method for ADMm_NU_FF_ThrottleTrgt_y" RAT_FUNC "%10.1" "gps" COEFFS 0.000000 1.000000 0.000000 0.000000 0.000000 1.000000 /end COMPU_METHOD
/* Map (2d) calibration for DDE 'ADMm_NU_ISFC_z'. */
/begin CHARACTERISTIC ADMm_NU_ISFC_z "(g/kW-hr) ISFC map" MAP 0x85624 RL_ADMM_NU_ISFC_Z 1000.000000 CU_ADMM_NU_ISFC_Z 0.000000 1000.000000
 /begin AXIS_DESCR COM_AXIS NO_INPUT_QUANTITY CU_ADMM_NU_ISFC_X 16 0.000000 10000.000000 AXIS_PTS_REF APD_ADMM_NU_ISFC_X /end AXIS_DESCR
 /begin AXIS_DESCR COM_AXIS NO_INPUT_QUANTITY CU_ADMM_NU_ISFC_Y 16 0.000000 2000.000000 AXIS_PTS_REF APD_ADMM_NU_ISFC_Y /end AXIS_DESCR
 BYTE_ORDER MSB_FIRST /end CHARACTERISTIC
/begin RECORD_LAYOUT RL_ADMM_NU_ISFC_Z FNC_VALUES 1 FLOAT32_IEEE COLUMN_DIR DIRECT /end RECORD_LAYOUT
/begin COMPU_METHOD CU_ADMM_NU_ISFC_Z "Conversion method for ADMm_NU_ISFC_z" RAT_FUNC "%10.2" "NU" COEFFS 0.000000 1.000000 0.000000 0.000000 0.000000 1.000000 /end COMPU_METHOD
/begin AXIS_PTS APD_ADMM_NU_ISFC_X "ISFC map engine speed axis" 0x855a4 NO_INPUT_QUANTITY RL_ADMM_NU_ISFC_X 10000.000000 CU_ADMM_NU_ISFC_X 16 0.0 10000.0 BYTE_ORDER MSB_FIRST /end AXIS_PTS
/begin RECORD_LAYOUT RL_ADMM_NU_ISFC_X AXIS_PTS_X 1 FLOAT32_IEEE INDEX_INCR DIRECT /end RECORD_LAYOUT
/begin COMPU_METHOD CU_ADMM_NU_ISFC_X "Conversion method for ADMm_NU_ISFC_x" RAT_FUNC "%10.0" "RPM" COEFFS 0.000000 1.000000 0.000000 0.000000 0.000000 1.000000 /end COMPU_METHOD
/begin AXIS_PTS APD_ADMM_NU_ISFC_Y "ISFC map torque demand axis" 0x855e4 NO_INPUT_QUANTITY RL_ADMM_NU_ISFC_Y 2000.000000 CU_ADMM_NU_ISFC_Y 16 0.0 2000.0 BYTE_ORDER MSB_FIRST /end AXIS_PTS
/begin RECORD_LAYOUT RL_ADMM_NU_ISFC_Y AXIS_PTS_X 1 FLOAT32_IEEE INDEX_INCR DIRECT /end RECORD_LAYOUT
/begin COMPU_METHOD CU_ADMM_NU_ISFC_Y "Conversion method for ADMm_NU_ISFC_y" RAT_FUNC "%10.2" "Nm" COEFFS 0.000000 1.000000 0.000000 0.000000 0.000000 1.000000 /end COMPU_METHOD
/* Map (2d) calibration for DDE 'ADMm_NU_LUT_ThCorr_z'. */
/begin CHARACTERISTIC ADMm_NU_LUT_ThCorr_z "(deg throttle) Throttle Angle Correction z-axis" MAP 0x86ec4 RL_ADMM_NU_LUT_THCORR_Z 200.000000 CU_ADMM_NU_LUT_THCORR_Z 0.000000 200.000000
 /begin AXIS_DESCR COM_AXIS NO_INPUT_QUANTITY CU_ADMM_NU_LUT_THCORR_X 6 0.000000 200.000000 AXIS_PTS_REF APD_ADMM_NU_LUT_THCORR_X /end AXIS_DESCR
 /begin AXIS_DESCR COM_AXIS NO_INPUT_QUANTITY CU_ADMM_NU_LUT_THCORR_Y 6 0.000000 200.000000 AXIS_PTS_REF APD_ADMM_NU_LUT_THCORR_Y /end AXIS_DESCR
 BYTE_ORDER MSB_FIRST /end CHARACTERISTIC
/begin RECORD_LAYOUT RL_ADMM_NU_LUT_THCORR_Z FNC_VALUES 1 FLOAT32_IEEE COLUMN_DIR DIRECT /end RECORD_LAYOUT
/begin COMPU_METHOD CU_ADMM_NU_LUT_THCORR_Z "Conversion method for ADMm_NU_LUT_ThCorr_z" RAT_FUNC "%10.0" "deg" COEFFS 0.000000 1.000000 0.000000 0.000000 0.000000 1.000000 /end COMPU_METHOD
/begin AXIS_PTS APD_ADMM_NU_LUT_THCORR_X "(kPa DP) Throttle Angle Correction x-axis" 0x86e94 NO_INPUT_QUANTITY RL_ADMM_NU_LUT_THCORR_X 200.000000 CU_ADMM_NU_LUT_THCORR_X 6 0.0 200.0 BYTE_ORDER MSB_FIRST /end AXIS_PTS
/begin RECORD_LAYOUT RL_ADMM_NU_LUT_THCORR_X AXIS_PTS_X 1 FLOAT32_IEEE INDEX_INCR DIRECT /end RECORD_LAYOUT
/begin COMPU_METHOD CU_ADMM_NU_LUT_THCORR_X "Conversion method for ADMm_NU_LUT_ThCorr_x" RAT_FUNC "%10.0" "kPa" COEFFS 0.000000 1.000000 0.000000 0.000000 0.000000 1.000000 /end COMPU_METHOD
/begin AXIS_PTS APD_ADMM_NU_LUT_THCORR_Y "(deg VCP) Throttle Angle Correction y-axis" 0x86eac NO_INPUT_QUANTITY RL_ADMM_NU_LUT_THCORR_Y 200.000000 CU_ADMM_NU_LUT_THCORR_Y 6 0.0 200.0 BYTE_ORDER MSB_FIRST /end AXIS_PTS
/begin RECORD_LAYOUT RL_ADMM_NU_LUT_THCORR_Y AXIS_PTS_X 1 FLOAT32_IEEE INDEX_INCR DIRECT /end RECORD_LAYOUT
/begin COMPU_METHOD CU_ADMM_NU_LUT_THCORR_Y "Conversion method for ADMm_NU_LUT_ThCorr_y" RAT_FUNC "%10.0" "adv" COEFFS 0.000000 1.000000 0.000000 0.000000 0.000000 1.000000 /end COMPU_METHOD
/* Map (2d) calibration for DDE 'ADMm_NU_NominalDP_z'. */
/begin CHARACTERISTIC ADMm_NU_NominalDP_z "Pressure drop across throttle estimate" MAP 0x86e1c RL_ADMM_NU_NOMINALDP_Z 200.000000 CU_ADMM_NU_NOMINALDP_Z 0.000000 200.000000
 /begin AXIS_DESCR COM_AXIS ADM_gps_MAF_Trgt CU_ADMM_NU_NOMINALDP_X 5 0.000000 1000.000000 AXIS_PTS_REF APD_ADMM_NU_NOMINALDP_X /end AXIS_DESCR
 /begin AXIS_DESCR COM_AXIS ADM_deg_ThrottleTrgtRaw CU_ADMM_NU_NOMINALDP_Y 6 0.000000 90.000000 AXIS_PTS_REF APD_ADMM_NU_NOMINALDP_Y /end AXIS_DESCR
 BYTE_ORDER MSB_FIRST /end CHARACTERISTIC
/begin RECORD_LAYOUT RL_ADMM_NU_NOMINALDP_Z FNC_VALUES 1 FLOAT32_IEEE COLUMN_DIR DIRECT /end RECORD_LAYOUT
/begin COMPU_METHOD CU_ADMM_NU_NOMINALDP_Z "Conversion method for ADMm_NU_NominalDP_z" RAT_FUNC "%10.0" "kPa" COEFFS 0.000000 1.000000 0.000000 0.000000 0.000000 1.000000 /end COMPU_METHOD
/begin AXIS_PTS APD_ADMM_NU_NOMINALDP_X "(gps) Pressure drop across throttle x-axis" 0x86df0 ADM_gps_MAF_Trgt RL_ADMM_NU_NOMINALDP_X 1000.000000 CU_ADMM_NU_NOMINALDP_X 5 0.0 1000.0 BYTE_ORDER MSB_FIRST /end AXIS_PTS
/begin RECORD_LAYOUT RL_ADMM_NU_NOMINALDP_X AXIS_PTS_X 1 FLOAT32_IEEE INDEX_INCR DIRECT /end RECORD_LAYOUT
/begin COMPU_METHOD CU_ADMM_NU_NOMINALDP_X "Conversion method for ADMm_NU_NominalDP_x" RAT_FUNC "%10.0" "gps" COEFFS 0.000000 1.000000 0.000000 0.000000 0.000000 1.000000 /end COMPU_METHOD
/begin AXIS_PTS APD_ADMM_NU_NOMINALDP_Y "(deg) Pressure drop across throttle y-axis" 0x86e04 ADM_deg_ThrottleTrgtRaw RL_ADMM_NU_NOMINALDP_Y 90.000000 CU_ADMM_NU_NOMINALDP_Y 6 0.0 90.0 BYTE_ORDER MSB_FIRST /end AXIS_PTS
/begin RECORD_LAYOUT RL_ADMM_NU_NOMINALDP_Y AXIS_PTS_X 1 FLOAT32_IEEE INDEX_INCR DIRECT /end RECORD_LAYOUT
/begin COMPU_METHOD CU_ADMM_NU_NOMINALDP_Y "Conversion method for ADMm_NU_NominalDP_y" RAT_FUNC "%10.0" "deg" COEFFS 0.000000 1.000000 0.000000 0.000000 0.000000 1.000000 /end COMPU_METHOD
/* Map (1d) calibration for DDE 'ADMm_NU_ThrottleFlowToAng_z'. */
/begin CHARACTERISTIC ADMm_NU_ThrottleFlowToAng_z "(deg angle) Throttle flow area to blade angle table data" CURVE 0x867f8 RL_ADMM_NU_THROTTLEFLOWTOANG_Z 100.000000 CU_ADMM_NU_THROTTLEFLOWTOANG_Z 0.000000 100.000000
 /begin AXIS_DESCR COM_AXIS ADM_pct_ThrottleEffortRaw CU_ADMM_NU_THROTTLEFLOWTOANG_X 8 0.000000 1.000000 AXIS_PTS_REF APD_ADMM_NU_THROTTLEFLOWTOANG_X /end AXIS_DESCR
 BYTE_ORDER MSB_FIRST /end CHARACTERISTIC
/begin RECORD_LAYOUT RL_ADMM_NU_THROTTLEFLOWTOANG_Z FNC_VALUES 1 FLOAT32_IEEE COLUMN_DIR DIRECT /end RECORD_LAYOUT
/begin COMPU_METHOD CU_ADMM_NU_THROTTLEFLOWTOANG_Z "Conversion method for ADMm_NU_ThrottleFlowToAng_z" RAT_FUNC "%10.1" "deg" COEFFS 0.000000 1.000000 0.000000 0.000000 0.000000 1.000000 /end COMPU_METHOD
/begin AXIS_PTS APD_ADMM_NU_THROTTLEFLOWTOANG_X "(pct flow) Throttle flow area to blade angle table" 0x867d8 ADM_pct_ThrottleEffortRaw RL_ADMM_NU_THROTTLEFLOWTOANG_X 1.000000 CU_ADMM_NU_THROTTLEFLOWTOANG_X 8 0.0 1.0 BYTE_ORDER MSB_FIRST /end AXIS_PTS
/begin RECORD_LAYOUT RL_ADMM_NU_THROTTLEFLOWTOANG_X AXIS_PTS_X 1 FLOAT32_IEEE INDEX_INCR DIRECT /end RECORD_LAYOUT
/begin COMPU_METHOD CU_ADMM_NU_THROTTLEFLOWTOANG_X "Conversion method for ADMm_NU_ThrottleFlowToAng_x" RAT_FUNC "%10.3" "pct" COEFFS 0.000000 1.000000 0.000000 0.000000 0.000000 1.000000 /end COMPU_METHOD
/* Map (2d) calibration for DDE 'ADMm_NU_ThrottleIGain_z'. */
/begin CHARACTERISTIC ADMm_NU_ThrottleIGain_z "MAF throttle control feedback gain data" MAP 0x865c0 RL_ADMM_NU_THROTTLEIGAIN_Z 10.000000 CU_ADMM_NU_THROTTLEIGAIN_Z 0.000000 10.000000
 /begin AXIS_DESCR COM_AXIS NO_INPUT_QUANTITY CU_ADMM_NU_THROTTLEIGAIN_X 6 0.000000 8000.000000 AXIS_PTS_REF APD_ADMM_NU_THROTTLEIGAIN_X /end AXIS_DESCR
 /begin AXIS_DESCR COM_AXIS NO_INPUT_QUANTITY CU_ADMM_NU_THROTTLEIGAIN_Y 9 0.000000 200.000000 AXIS_PTS_REF APD_ADMM_NU_THROTTLEIGAIN_Y /end AXIS_DESCR
 BYTE_ORDER MSB_FIRST /end CHARACTERISTIC
/begin RECORD_LAYOUT RL_ADMM_NU_THROTTLEIGAIN_Z FNC_VALUES 1 FLOAT32_IEEE COLUMN_DIR DIRECT /end RECORD_LAYOUT
/begin COMPU_METHOD CU_ADMM_NU_THROTTLEIGAIN_Z "Conversion method for ADMm_NU_ThrottleIGain_z" RAT_FUNC "%10.4" "NU" COEFFS 0.000000 1.000000 0.000000 0.000000 0.000000 1.000000 /end COMPU_METHOD
/begin AXIS_PTS APD_ADMM_NU_THROTTLEIGAIN_X "MAF throttle control feedback gain engine speed axis" 0x86584 NO_INPUT_QUANTITY RL_ADMM_NU_THROTTLEIGAIN_X 8000.000000 CU_ADMM_NU_THROTTLEIGAIN_X 6 0.0 8000.0 BYTE_ORDER MSB_FIRST /end AXIS_PTS
/begin RECORD_LAYOUT RL_ADMM_NU_THROTTLEIGAIN_X AXIS_PTS_X 1 FLOAT32_IEEE INDEX_INCR DIRECT /end RECORD_LAYOUT
/begin COMPU_METHOD CU_ADMM_NU_THROTTLEIGAIN_X "Conversion method for ADMm_NU_ThrottleIGain_x" RAT_FUNC "%10.0" "RPM" COEFFS 0.000000 1.000000 0.000000 0.000000 0.000000 1.000000 /end COMPU_METHOD
/begin AXIS_PTS APD_ADMM_NU_THROTTLEIGAIN_Y "MAF throttle control feedback gain airflow axis" 0x8659c NO_INPUT_QUANTITY RL_ADMM_NU_THROTTLEIGAIN_Y 200.000000 CU_ADMM_NU_THROTTLEIGAIN_Y 9 0.0 200.0 BYTE_ORDER MSB_FIRST /end AXIS_PTS
/begin RECORD_LAYOUT RL_ADMM_NU_THROTTLEIGAIN_Y AXIS_PTS_X 1 FLOAT32_IEEE INDEX_INCR DIRECT /end RECORD_LAYOUT
/begin COMPU_METHOD CU_ADMM_NU_THROTTLEIGAIN_Y "Conversion method for ADMm_NU_ThrottleIGain_y" RAT_FUNC "%10.2" "gps" COEFFS 0.000000 1.000000 0.000000 0.000000 0.000000 1.000000 /end COMPU_METHOD
/* Map (2d) calibration for DDE 'ADMm_NU_ThrottlePGain_z'. */
/begin CHARACTERISTIC ADMm_NU_ThrottlePGain_z "MAF throttle control feedback gain data" MAP 0x866ec RL_ADMM_NU_THROTTLEPGAIN_Z 10.000000 CU_ADMM_NU_THROTTLEPGAIN_Z 0.000000 10.000000
 /begin AXIS_DESCR COM_AXIS NO_INPUT_QUANTITY CU_ADMM_NU_THROTTLEPGAIN_X 6 0.000000 8000.000000 AXIS_PTS_REF APD_ADMM_NU_THROTTLEPGAIN_X /end AXIS_DESCR
 /begin AXIS_DESCR COM_AXIS NO_INPUT_QUANTITY CU_ADMM_NU_THROTTLEPGAIN_Y 9 0.000000 200.000000 AXIS_PTS_REF APD_ADMM_NU_THROTTLEPGAIN_Y /end AXIS_DESCR
 BYTE_ORDER MSB_FIRST /end CHARACTERISTIC
/begin RECORD_LAYOUT RL_ADMM_NU_THROTTLEPGAIN_Z FNC_VALUES 1 FLOAT32_IEEE COLUMN_DIR DIRECT /end RECORD_LAYOUT
/begin COMPU_METHOD CU_ADMM_NU_THROTTLEPGAIN_Z "Conversion method for ADMm_NU_ThrottlePGain_z" RAT_FUNC "%10.4" "NU" COEFFS 0.000000 1.000000 0.000000 0.000000 0.000000 1.000000 /end COMPU_METHOD
/begin AXIS_PTS APD_ADMM_NU_THROTTLEPGAIN_X "MAF throttle control feedback gain engine speed axis" 0x866b0 NO_INPUT_QUANTITY RL_ADMM_NU_THROTTLEPGAIN_X 8000.000000 CU_ADMM_NU_THROTTLEPGAIN_X 6 0.0 8000.0 BYTE_ORDER MSB_FIRST /end AXIS_PTS
/begin RECORD_LAYOUT RL_ADMM_NU_THROTTLEPGAIN_X AXIS_PTS_X 1 FLOAT32_IEEE INDEX_INCR DIRECT /end RECORD_LAYOUT
/begin COMPU_METHOD CU_ADMM_NU_THROTTLEPGAIN_X "Conversion method for ADMm_NU_ThrottlePGain_x" RAT_FUNC "%10.0" "RPM" COEFFS 0.000000 1.000000 0.000000 0.000000 0.000000 1.000000 /end COMPU_METHOD
/begin AXIS_PTS APD_ADMM_NU_THROTTLEPGAIN_Y "MAF throttle control feedback gain airflow axis" 0x866c8 NO_INPUT_QUANTITY RL_ADMM_NU_THROTTLEPGAIN_Y 200.000000 CU_ADMM_NU_THROTTLEPGAIN_Y 9 0.0 200.0 BYTE_ORDER MSB_FIRST /end AXIS_PTS
/begin RECORD_LAYOUT RL_ADMM_NU_THROTTLEPGAIN_Y AXIS_PTS_X 1 FLOAT32_IEEE INDEX_INCR DIRECT /end RECORD_LAYOUT
/begin COMPU_METHOD CU_ADMM_NU_THROTTLEPGAIN_Y "Conversion method for ADMm_NU_ThrottlePGain_y" RAT_FUNC "%10.2" "gps" COEFFS 0.000000 1.000000 0.000000 0.000000 0.000000 1.000000 /end COMPU_METHOD
/* Map (1d) calibration for DDE 'ADMm_NU_VCP_Temp_z'. */
/begin CHARACTERISTIC ADMm_NU_VCP_Temp_z "(ret) Correction Factor for Intake Cam Angle Based on MAT z-axis" CURVE 0x86830 RL_ADMM_NU_VCP_TEMP_Z 40.000000 CU_ADMM_NU_VCP_TEMP_Z -20.000000 20.000000
 /begin AXIS_DESCR COM_AXIS AME_C_ChargeTemp CU_ADMM_NU_VCP_TEMP_X 6 -40.000000 150.000000 AXIS_PTS_REF APD_ADMM_NU_VCP_TEMP_X /end AXIS_DESCR
 BYTE_ORDER MSB_FIRST /end CHARACTERISTIC
/begin RECORD_LAYOUT RL_ADMM_NU_VCP_TEMP_Z FNC_VALUES 1 FLOAT32_IEEE COLUMN_DIR DIRECT /end RECORD_LAYOUT
/begin COMPU_METHOD CU_ADMM_NU_VCP_TEMP_Z "Conversion method for ADMm_NU_VCP_Temp_z" RAT_FUNC "%10.0" "ret" COEFFS 0.000000 1.000000 0.000000 0.000000 0.000000 1.000000 /end COMPU_METHOD
/begin AXIS_PTS APD_ADMM_NU_VCP_TEMP_X "(C) Correction Factor for Intake Cam Angle Based on MAT x-axis" 0x86818 AME_C_ChargeTemp RL_ADMM_NU_VCP_TEMP_X 190.000000 CU_ADMM_NU_VCP_TEMP_X 6 -40.0 150.0 BYTE_ORDER MSB_FIRST /end AXIS_PTS
/begin RECORD_LAYOUT RL_ADMM_NU_VCP_TEMP_X AXIS_PTS_X 1 FLOAT32_IEEE INDEX_INCR DIRECT /end RECORD_LAYOUT
/begin COMPU_METHOD CU_ADMM_NU_VCP_TEMP_X "Conversion method for ADMm_NU_VCP_Temp_x" RAT_FUNC "%10.0" "C" COEFFS 0.000000 1.000000 0.000000 0.000000 0.000000 1.000000 /end COMPU_METHOD
/* Map (1d) calibration for DDE 'ADMm_NU_VCP_ThCorr_z'. */
/begin CHARACTERISTIC ADMm_NU_VCP_ThCorr_z "Intermediate Th Ang Corr z-axis" CURVE 0x86f88 RL_ADMM_NU_VCP_THCORR_Z 200.000000 CU_ADMM_NU_VCP_THCORR_Z 0.000000 200.000000
 /begin AXIS_DESCR COM_AXIS NO_INPUT_QUANTITY CU_ADMM_NU_VCP_THCORR_X 7 0.000000 1000.000000 AXIS_PTS_REF APD_ADMM_NU_VCP_THCORR_X /end AXIS_DESCR
 BYTE_ORDER MSB_FIRST /end CHARACTERISTIC
/begin RECORD_LAYOUT RL_ADMM_NU_VCP_THCORR_Z FNC_VALUES 1 FLOAT32_IEEE COLUMN_DIR DIRECT /end RECORD_LAYOUT
/begin COMPU_METHOD CU_ADMM_NU_VCP_THCORR_Z "Conversion method for ADMm_NU_VCP_ThCorr_z" RAT_FUNC "%10.0" "deg" COEFFS 0.000000 1.000000 0.000000 0.000000 0.000000 1.000000 /end COMPU_METHOD
/begin AXIS_PTS APD_ADMM_NU_VCP_THCORR_X "Intermediate Th Ang Corr x-axis" 0x86f6c NO_INPUT_QUANTITY RL_ADMM_NU_VCP_THCORR_X 1000.000000 CU_ADMM_NU_VCP_THCORR_X 7 0.0 1000.0 BYTE_ORDER MSB_FIRST /end AXIS_PTS
/begin RECORD_LAYOUT RL_ADMM_NU_VCP_THCORR_X AXIS_PTS_X 1 FLOAT32_IEEE INDEX_INCR DIRECT /end RECORD_LAYOUT
/begin COMPU_METHOD CU_ADMM_NU_VCP_THCORR_X "Conversion method for ADMm_NU_VCP_ThCorr_x" RAT_FUNC "%10.0" "gps" COEFFS 0.000000 1.000000 0.000000 0.000000 0.000000 1.000000 /end COMPU_METHOD
/* Map (2d) calibration for DDE 'ADMm_NU_VCP_Trgt_z'. */
/begin CHARACTERISTIC ADMm_NU_VCP_Trgt_z "(adv) Intake cam phasing command lookup" MAP 0x86910 RL_ADMM_NU_VCP_TRGT_Z 100.000000 CU_ADMM_NU_VCP_TRGT_Z 0.000000 100.000000
 /begin AXIS_DESCR COM_AXIS NO_INPUT_QUANTITY CU_ADMM_NU_VCP_TRGT_X 12 0.000000 10000.000000 AXIS_PTS_REF APD_ADMM_NU_VCP_TRGT_X /end AXIS_DESCR
 /begin AXIS_DESCR COM_AXIS NO_INPUT_QUANTITY CU_ADMM_NU_VCP_TRGT_Y 26 0.000000 3.000000 AXIS_PTS_REF APD_ADMM_NU_VCP_TRGT_Y /end AXIS_DESCR
 BYTE_ORDER MSB_FIRST /end CHARACTERISTIC
/begin RECORD_LAYOUT RL_ADMM_NU_VCP_TRGT_Z FNC_VALUES 1 FLOAT32_IEEE COLUMN_DIR DIRECT /end RECORD_LAYOUT
/begin COMPU_METHOD CU_ADMM_NU_VCP_TRGT_Z "Conversion method for ADMm_NU_VCP_Trgt_z" RAT_FUNC "%10.2" "ret" COEFFS 0.000000 1.000000 0.000000 0.000000 0.000000 1.000000 /end COMPU_METHOD
/begin AXIS_PTS APD_ADMM_NU_VCP_TRGT_X "(RPM) Intake cam phasing command lookup" 0x86878 NO_INPUT_QUANTITY RL_ADMM_NU_VCP_TRGT_X 10000.000000 CU_ADMM_NU_VCP_TRGT_X 12 0.0 10000.0 BYTE_ORDER MSB_FIRST /end AXIS_PTS
/begin RECORD_LAYOUT RL_ADMM_NU_VCP_TRGT_X AXIS_PTS_X 1 FLOAT32_IEEE INDEX_INCR DIRECT /end RECORD_LAYOUT
/begin COMPU_METHOD CU_ADMM_NU_VCP_TRGT_X "Conversion method for ADMm_NU_VCP_Trgt_x" RAT_FUNC "%10.0" "RPM" COEFFS 0.000000 1.000000 0.000000 0.000000 0.000000 1.000000 /end COMPU_METHOD
/begin AXIS_PTS APD_ADMM_NU_VCP_TRGT_Y "(pct load) Intake cam phasing command lookup" 0x868a8 NO_INPUT_QUANTITY RL_ADMM_NU_VCP_TRGT_Y 3.000000 CU_ADMM_NU_VCP_TRGT_Y 26 0.0 3.0 BYTE_ORDER MSB_FIRST /end AXIS_PTS
/begin RECORD_LAYOUT RL_ADMM_NU_VCP_TRGT_Y AXIS_PTS_X 1 FLOAT32_IEEE INDEX_INCR DIRECT /end RECORD_LAYOUT
/begin COMPU_METHOD CU_ADMM_NU_VCP_TRGT_Y "Conversion method for ADMm_NU_VCP_Trgt_y" RAT_FUNC "%10.2" "pct" COEFFS 0.000000 1.000000 0.000000 0.000000 0.000000 1.000000 /end COMPU_METHOD
/* Scalar calibration for DDE 'AFRc_lam_BaseAFR_Trim'. */
/begin CHARACTERISTIC AFRc_lam_BaseAFR_Trim "Manual Trim to adjust Base AFR during manual testing" VALUE 0x845d4 RL_AFRC_LAM_BASEAFR_TRIM 3.000000 CU_AFRC_LAM_BASEAFR_TRIM -1.000000 2.000000 BYTE_ORDER MSB_FIRST /end CHARACTERISTIC
/begin RECORD_LAYOUT RL_AFRC_LAM_BASEAFR_TRIM FNC_VALUES 1 FLOAT32_IEEE COLUMN_DIR DIRECT /end RECORD_LAYOUT
/begin COMPU_METHOD CU_AFRC_LAM_BASEAFR_TRIM "Conversion method for AFRc_lam_BaseAFR_Trim" RAT_FUNC "%10.3" "lam" COEFFS 0.000000 1.000000 0.000000 0.000000 0.000000 1.000000 /end COMPU_METHOD
/* Scalar calibration for DDE 'AFRc_lam_BaseTrgt'. */
/begin CHARACTERISTIC AFRc_lam_BaseTrgt "Override value for base AFR target" VALUE 0x845dc RL_AFRC_LAM_BASETRGT 0.600000 CU_AFRC_LAM_BASETRGT 0.600000 1.200000 BYTE_ORDER MSB_FIRST /end CHARACTERISTIC
/begin RECORD_LAYOUT RL_AFRC_LAM_BASETRGT FNC_VALUES 1 FLOAT32_IEEE COLUMN_DIR DIRECT /end RECORD_LAYOUT
/begin COMPU_METHOD CU_AFRC_LAM_BASETRGT "Conversion method for AFRc_lam_BaseTrgt" RAT_FUNC "%10.2" "lam" COEFFS 0.000000 1.000000 0.000000 0.000000 0.000000 1.000000 /end COMPU_METHOD
/* Scalar calibration for DDE 'AFRc_lam_ExitDFCEnrichment'. */
/begin CHARACTERISTIC AFRc_lam_ExitDFCEnrichment "Enrich by this amount when turbine is overtemp" VALUE 0x84054 RL_AFRC_LAM_EXITDFCENRICHMENT 1.000000 CU_AFRC_LAM_EXITDFCENRICHMENT -0.500000 0.500000 BYTE_ORDER MSB_FIRST /end CHARACTERISTIC
/begin RECORD_LAYOUT RL_AFRC_LAM_EXITDFCENRICHMENT FNC_VALUES 1 FLOAT32_IEEE COLUMN_DIR DIRECT /end RECORD_LAYOUT
/begin COMPU_METHOD CU_AFRC_LAM_EXITDFCENRICHMENT "Conversion method for AFRc_lam_ExitDFCEnrichment" RAT_FUNC "%10.2" "lam" COEFFS 0.000000 1.000000 0.000000 0.000000 0.000000 1.000000 /end COMPU_METHOD
/* Scalar calibration for DDE 'AFRc_lam_FinalTrgt1'. */
/begin CHARACTERISTIC AFRc_lam_FinalTrgt1 "Override value for final AFR target 1" VALUE 0x845e4 RL_AFRC_LAM_FINALTRGT1 0.600000 CU_AFRC_LAM_FINALTRGT1 0.600000 1.200000 BYTE_ORDER MSB_FIRST /end CHARACTERISTIC
/begin RECORD_LAYOUT RL_AFRC_LAM_FINALTRGT1 FNC_VALUES 1 FLOAT32_IEEE COLUMN_DIR DIRECT /end RECORD_LAYOUT
/begin COMPU_METHOD CU_AFRC_LAM_FINALTRGT1 "Conversion method for AFRc_lam_FinalTrgt1" RAT_FUNC "%10.2" "lam" COEFFS 0.000000 1.000000 0.000000 0.000000 0.000000 1.000000 /end COMPU_METHOD
/* Scalar calibration for DDE 'AFRc_lam_FinalTrgt2'. */
/begin CHARACTERISTIC AFRc_lam_FinalTrgt2 "Override value for final AFR target 2" VALUE 0x8be84 RL_AFRC_LAM_FINALTRGT2 0.600000 CU_AFRC_LAM_FINALTRGT2 0.600000 1.200000 BYTE_ORDER MSB_FIRST /end CHARACTERISTIC
/begin RECORD_LAYOUT RL_AFRC_LAM_FINALTRGT2 FNC_VALUES 1 FLOAT32_IEEE COLUMN_DIR DIRECT /end RECORD_LAYOUT
/begin COMPU_METHOD CU_AFRC_LAM_FINALTRGT2 "Conversion method for AFRc_lam_FinalTrgt2" RAT_FUNC "%10.2" "lam" COEFFS 0.000000 1.000000 0.000000 0.000000 0.000000 1.000000 /end COMPU_METHOD
/* Scalar calibration for DDE 'AFRc_lam_TIT_EnrichDelta'. */
/begin CHARACTERISTIC AFRc_lam_TIT_EnrichDelta "Enrich by this amount when turbine is overtemp" VALUE 0x845a8 RL_AFRC_LAM_TIT_ENRICHDELTA 0.500000 CU_AFRC_LAM_TIT_ENRICHDELTA 0.000000 0.500000 BYTE_ORDER MSB_FIRST /end CHARACTERISTIC
/begin RECORD_LAYOUT RL_AFRC_LAM_TIT_ENRICHDELTA FNC_VALUES 1 FLOAT32_IEEE COLUMN_DIR DIRECT /end RECORD_LAYOUT
/begin COMPU_METHOD CU_AFRC_LAM_TIT_ENRICHDELTA "Conversion method for AFRc_lam_TIT_EnrichDelta" RAT_FUNC "%10.2" "lam" COEFFS 0.000000 1.000000 0.000000 0.000000 0.000000 1.000000 /end COMPU_METHOD
/* Scalar calibration for DDE 'AFRc_lam_TableResult'. */
/begin CHARACTERISTIC AFRc_lam_TableResult "Override value" VALUE 0x8459c RL_AFRC_LAM_TABLERESULT 0.600000 CU_AFRC_LAM_TABLERESULT 0.600000 1.200000 BYTE_ORDER MSB_FIRST /end CHARACTERISTIC
/begin RECORD_LAYOUT RL_AFRC_LAM_TABLERESULT FNC_VALUES 1 FLOAT32_IEEE COLUMN_DIR DIRECT /end RECORD_LAYOUT
/begin COMPU_METHOD CU_AFRC_LAM_TABLERESULT "Conversion method for AFRc_lam_TableResult" RAT_FUNC "%10.2" "lam" COEFFS 0.000000 1.000000 0.000000 0.000000 0.000000 1.000000 /end COMPU_METHOD
/* Scalar calibration for DDE 'AFRc_lam_TrgtMax'. */
/begin CHARACTERISTIC AFRc_lam_TrgtMax "Maximum AFR target" VALUE 0x845e8 RL_AFRC_LAM_TRGTMAX 1.100000 CU_AFRC_LAM_TRGTMAX 0.900000 2.000000 BYTE_ORDER MSB_FIRST /end CHARACTERISTIC
/begin RECORD_LAYOUT RL_AFRC_LAM_TRGTMAX FNC_VALUES 1 FLOAT32_IEEE COLUMN_DIR DIRECT /end RECORD_LAYOUT
/begin COMPU_METHOD CU_AFRC_LAM_TRGTMAX "Conversion method for AFRc_lam_TrgtMax" RAT_FUNC "%10.2" "lam" COEFFS 0.000000 1.000000 0.000000 0.000000 0.000000 1.000000 /end COMPU_METHOD
/* Scalar calibration for DDE 'AFRc_lam_TrgtMin'. */
/begin CHARACTERISTIC AFRc_lam_TrgtMin "Minimum AFR target" VALUE 0x845ec RL_AFRC_LAM_TRGTMIN 0.400000 CU_AFRC_LAM_TRGTMIN 0.600000 1.000000 BYTE_ORDER MSB_FIRST /end CHARACTERISTIC
/begin RECORD_LAYOUT RL_AFRC_LAM_TRGTMIN FNC_VALUES 1 FLOAT32_IEEE COLUMN_DIR DIRECT /end RECORD_LAYOUT
/begin COMPU_METHOD CU_AFRC_LAM_TRGTMIN "Conversion method for AFRc_lam_TrgtMin" RAT_FUNC "%10.2" "lam" COEFFS 0.000000 1.000000 0.000000 0.000000 0.000000 1.000000 /end COMPU_METHOD
/* Scalar calibration for DDE 'AFRc_o_BaseTrgt'. */
/begin CHARACTERISTIC AFRc_o_BaseTrgt "Override flag for base AFR target" VALUE 0x845d8 RL_AFRC_O_BASETRGT 1.000000 CU_AFRC_O_BASETRGT 0.000000 1.000000 BYTE_ORDER MSB_FIRST /end CHARACTERISTIC
/begin RECORD_LAYOUT RL_AFRC_O_BASETRGT FNC_VALUES 1 UBYTE COLUMN_DIR DIRECT /end RECORD_LAYOUT
/begin COMPU_METHOD CU_AFRC_O_BASETRGT "Conversion method for AFRc_o_BaseTrgt" RAT_FUNC "%10.0" "o" COEFFS 0.000000 1.000000 0.000000 0.000000 0.000000 1.000000 /end COMPU_METHOD
/* Scalar calibration for DDE 'AFRc_o_FinalTrgt1'. */
/begin CHARACTERISTIC AFRc_o_FinalTrgt1 "Override flag for final AFR target 1" VALUE 0x845e0 RL_AFRC_O_FINALTRGT1 1.000000 CU_AFRC_O_FINALTRGT1 0.000000 1.000000 BYTE_ORDER MSB_FIRST /end CHARACTERISTIC
/begin RECORD_LAYOUT RL_AFRC_O_FINALTRGT1 FNC_VALUES 1 UBYTE COLUMN_DIR DIRECT /end RECORD_LAYOUT
/begin COMPU_METHOD CU_AFRC_O_FINALTRGT1 "Conversion method for AFRc_o_FinalTrgt1" RAT_FUNC "%10.0" "o" COEFFS 0.000000 1.000000 0.000000 0.000000 0.000000 1.000000 /end COMPU_METHOD
/* Scalar calibration for DDE 'AFRc_o_FinalTrgt2'. */
/begin CHARACTERISTIC AFRc_o_FinalTrgt2 "Override flag for final AFR target 2" VALUE 0x8be80 RL_AFRC_O_FINALTRGT2 1.000000 CU_AFRC_O_FINALTRGT2 0.000000 1.000000 BYTE_ORDER MSB_FIRST /end CHARACTERISTIC
/begin RECORD_LAYOUT RL_AFRC_O_FINALTRGT2 FNC_VALUES 1 UBYTE COLUMN_DIR DIRECT /end RECORD_LAYOUT
/begin COMPU_METHOD CU_AFRC_O_FINALTRGT2 "Conversion method for AFRc_o_FinalTrgt2" RAT_FUNC "%10.0" "o" COEFFS 0.000000 1.000000 0.000000 0.000000 0.000000 1.000000 /end COMPU_METHOD
/* Scalar calibration for DDE 'AFRc_o_TableResult'. */
/begin CHARACTERISTIC AFRc_o_TableResult "Override flag" VALUE 0x84598 RL_AFRC_O_TABLERESULT 1.000000 CU_AFRC_O_TABLERESULT 0.000000 1.000000 BYTE_ORDER MSB_FIRST /end CHARACTERISTIC
/begin RECORD_LAYOUT RL_AFRC_O_TABLERESULT FNC_VALUES 1 UBYTE COLUMN_DIR DIRECT /end RECORD_LAYOUT
/begin COMPU_METHOD CU_AFRC_O_TABLERESULT "Conversion method for AFRc_o_TableResult" RAT_FUNC "%10.0" "o" COEFFS 0.000000 1.000000 0.000000 0.000000 0.000000 1.000000 /end COMPU_METHOD
/* Scalar calibration for DDE 'AFRc_pct_EnrichLoadThresh'. */
/begin CHARACTERISTIC AFRc_pct_EnrichLoadThresh "(not defined)" VALUE 0x845a0 RL_AFRC_PCT_ENRICHLOADTHRESH 100.000000 CU_AFRC_PCT_ENRICHLOADTHRESH 0.000000 100.000000 BYTE_ORDER MSB_FIRST /end CHARACTERISTIC
/begin RECORD_LAYOUT RL_AFRC_PCT_ENRICHLOADTHRESH FNC_VALUES 1 FLOAT32_IEEE COLUMN_DIR DIRECT /end RECORD_LAYOUT
/begin COMPU_METHOD CU_AFRC_PCT_ENRICHLOADTHRESH "Conversion method for AFRc_pct_EnrichLoadThresh" RAT_FUNC "%10.2" "pct" COEFFS 0.000000 1.000000 0.000000 0.000000 0.000000 1.000000 /end COMPU_METHOD
/* Scalar calibration for DDE 'AFRc_s_DelayEnrichDelta'. */
/begin CHARACTERISTIC AFRc_s_DelayEnrichDelta "(not defined)" VALUE 0x845a4 RL_AFRC_S_DELAYENRICHDELTA 1000.000000 CU_AFRC_S_DELAYENRICHDELTA 0.000000 1000.000000 BYTE_ORDER MSB_FIRST /end CHARACTERISTIC
/begin RECORD_LAYOUT RL_AFRC_S_DELAYENRICHDELTA FNC_VALUES 1 FLOAT32_IEEE COLUMN_DIR DIRECT /end RECORD_LAYOUT
/begin COMPU_METHOD CU_AFRC_S_DELAYENRICHDELTA "Conversion method for AFRc_s_DelayEnrichDelta" RAT_FUNC "%10.2" "s" COEFFS 0.000000 1.000000 0.000000 0.000000 0.000000 1.000000 /end COMPU_METHOD
/* Scalar calibration for DDE 'AFRc_s_HoldDFCOpenLoop'. */
/begin CHARACTERISTIC AFRc_s_HoldDFCOpenLoop "Enrich by this amount when turbine is overtemp" VALUE 0x84050 RL_AFRC_S_HOLDDFCOPENLOOP 10.000000 CU_AFRC_S_HOLDDFCOPENLOOP 0.000000 10.000000 BYTE_ORDER MSB_FIRST /end CHARACTERISTIC
/begin RECORD_LAYOUT RL_AFRC_S_HOLDDFCOPENLOOP FNC_VALUES 1 FLOAT32_IEEE COLUMN_DIR DIRECT /end RECORD_LAYOUT
/begin COMPU_METHOD CU_AFRC_S_HOLDDFCOPENLOOP "Conversion method for AFRc_s_HoldDFCOpenLoop" RAT_FUNC "%10.2" "lam" COEFFS 0.000000 1.000000 0.000000 0.000000 0.000000 1.000000 /end COMPU_METHOD
/* Map (2d) calibration for DDE 'AFRm_NU_BaseTrgt_z'. */
/begin CHARACTERISTIC AFRm_NU_BaseTrgt_z "Base AFR target map data" MAP 0x84198 RL_AFRM_NU_BASETRGT_Z 2.000000 CU_AFRM_NU_BASETRGT_Z 0.000000 2.000000
 /begin AXIS_DESCR COM_AXIS NO_INPUT_QUANTITY CU_AFRM_NU_BASETRGT_X 16 0.000000 20000.000000 AXIS_PTS_REF APD_AFRM_NU_BASETRGT_X /end AXIS_DESCR
 /begin AXIS_DESCR COM_AXIS NO_INPUT_QUANTITY CU_AFRM_NU_BASETRGT_Y 16 0.000000 5.000000 AXIS_PTS_REF APD_AFRM_NU_BASETRGT_Y /end AXIS_DESCR
 BYTE_ORDER MSB_FIRST /end CHARACTERISTIC
/begin RECORD_LAYOUT RL_AFRM_NU_BASETRGT_Z FNC_VALUES 1 FLOAT32_IEEE COLUMN_DIR DIRECT /end RECORD_LAYOUT
/begin COMPU_METHOD CU_AFRM_NU_BASETRGT_Z "Conversion method for AFRm_NU_BaseTrgt_z" RAT_FUNC "%10.2" "lam" COEFFS 0.000000 1.000000 0.000000 0.000000 0.000000 1.000000 /end COMPU_METHOD
/begin AXIS_PTS APD_AFRM_NU_BASETRGT_X "Base AFR target map X axis Engine Speed" 0x84118 NO_INPUT_QUANTITY RL_AFRM_NU_BASETRGT_X 20000.000000 CU_AFRM_NU_BASETRGT_X 16 0.0 20000.0 BYTE_ORDER MSB_FIRST /end AXIS_PTS
/begin RECORD_LAYOUT RL_AFRM_NU_BASETRGT_X AXIS_PTS_X 1 FLOAT32_IEEE INDEX_INCR DIRECT /end RECORD_LAYOUT
/begin COMPU_METHOD CU_AFRM_NU_BASETRGT_X "Conversion method for AFRm_NU_BaseTrgt_x" RAT_FUNC "%10.0" "RPM" COEFFS 0.000000 1.000000 0.000000 0.000000 0.000000 1.000000 /end COMPU_METHOD
/begin AXIS_PTS APD_AFRM_NU_BASETRGT_Y "Base AFR target map Y axis Engine Load" 0x84158 NO_INPUT_QUANTITY RL_AFRM_NU_BASETRGT_Y 5.000000 CU_AFRM_NU_BASETRGT_Y 16 0.0 5.0 BYTE_ORDER MSB_FIRST /end AXIS_PTS
/begin RECORD_LAYOUT RL_AFRM_NU_BASETRGT_Y AXIS_PTS_X 1 FLOAT32_IEEE INDEX_INCR DIRECT /end RECORD_LAYOUT
/begin COMPU_METHOD CU_AFRM_NU_BASETRGT_Y "Conversion method for AFRm_NU_BaseTrgt_y" RAT_FUNC "%10.2" "pct" COEFFS 0.000000 1.000000 0.000000 0.000000 0.000000 1.000000 /end COMPU_METHOD
/* Map (2d) calibration for DDE 'AFRm_NU_CSI_Trgt_z'. */
/begin CHARACTERISTIC AFRm_NU_CSI_Trgt_z "Stratified-mode AFR target map data" MAP 0x84088 RL_AFRM_NU_CSI_TRGT_Z 2.000000 CU_AFRM_NU_CSI_TRGT_Z 0.000000 2.000000
 /begin AXIS_DESCR COM_AXIS NO_INPUT_QUANTITY CU_AFRM_NU_CSI_TRGT_X 6 0.000000 20000.000000 AXIS_PTS_REF APD_AFRM_NU_CSI_TRGT_X /end AXIS_DESCR
 /begin AXIS_DESCR COM_AXIS NO_INPUT_QUANTITY CU_AFRM_NU_CSI_TRGT_Y 6 0.000000 5.000000 AXIS_PTS_REF APD_AFRM_NU_CSI_TRGT_Y /end AXIS_DESCR
 BYTE_ORDER MSB_FIRST /end CHARACTERISTIC
/begin RECORD_LAYOUT RL_AFRM_NU_CSI_TRGT_Z FNC_VALUES 1 FLOAT32_IEEE COLUMN_DIR DIRECT /end RECORD_LAYOUT
/begin COMPU_METHOD CU_AFRM_NU_CSI_TRGT_Z "Conversion method for AFRm_NU_CSI_Trgt_z" RAT_FUNC "%10.2" "lam" COEFFS 0.000000 1.000000 0.000000 0.000000 0.000000 1.000000 /end COMPU_METHOD
/begin AXIS_PTS APD_AFRM_NU_CSI_TRGT_X "Stratified-mode AFR target map X axis Engine Speed" 0x84058 NO_INPUT_QUANTITY RL_AFRM_NU_CSI_TRGT_X 20000.000000 CU_AFRM_NU_CSI_TRGT_X 6 0.0 20000.0 BYTE_ORDER MSB_FIRST /end AXIS_PTS
/begin RECORD_LAYOUT RL_AFRM_NU_CSI_TRGT_X AXIS_PTS_X 1 FLOAT32_IEEE INDEX_INCR DIRECT /end RECORD_LAYOUT
/begin COMPU_METHOD CU_AFRM_NU_CSI_TRGT_X "Conversion method for AFRm_NU_CSI_Trgt_x" RAT_FUNC "%10.0" "RPM" COEFFS 0.000000 1.000000 0.000000 0.000000 0.000000 1.000000 /end COMPU_METHOD
/begin AXIS_PTS APD_AFRM_NU_CSI_TRGT_Y "Stratified-mode AFR target map Y axis Engine Load" 0x84070 NO_INPUT_QUANTITY RL_AFRM_NU_CSI_TRGT_Y 5.000000 CU_AFRM_NU_CSI_TRGT_Y 6 0.0 5.0 BYTE_ORDER MSB_FIRST /end AXIS_PTS
/begin RECORD_LAYOUT RL_AFRM_NU_CSI_TRGT_Y AXIS_PTS_X 1 FLOAT32_IEEE INDEX_INCR DIRECT /end RECORD_LAYOUT
/begin COMPU_METHOD CU_AFRM_NU_CSI_TRGT_Y "Conversion method for AFRm_NU_CSI_Trgt_y" RAT_FUNC "%10.2" "pct" COEFFS 0.000000 1.000000 0.000000 0.000000 0.000000 1.000000 /end COMPU_METHOD
/* Map (2d) calibration for DDE 'AFRm_NU_CrankingTrgt_z'. */
/begin CHARACTERISTIC AFRm_NU_CrankingTrgt_z "Cranking AFR target map data" MAP 0x83554 RL_AFRM_NU_CRANKINGTRGT_Z 2.000000 CU_AFRM_NU_CRANKINGTRGT_Z 0.000000 2.000000
 /begin AXIS_DESCR COM_AXIS NO_INPUT_QUANTITY CU_AFRM_NU_CRANKINGTRGT_X 6 0.000000 20000.000000 AXIS_PTS_REF APD_AFRM_NU_CRANKINGTRGT_X /end AXIS_DESCR
 /begin AXIS_DESCR COM_AXIS NO_INPUT_QUANTITY CU_AFRM_NU_CRANKINGTRGT_Y 5 -40.000000 150.000000 AXIS_PTS_REF APD_AFRM_NU_CRANKINGTRGT_Y /end AXIS_DESCR
 BYTE_ORDER MSB_FIRST /end CHARACTERISTIC
/begin RECORD_LAYOUT RL_AFRM_NU_CRANKINGTRGT_Z FNC_VALUES 1 FLOAT32_IEEE COLUMN_DIR DIRECT /end RECORD_LAYOUT
/begin COMPU_METHOD CU_AFRM_NU_CRANKINGTRGT_Z "Conversion method for AFRm_NU_CrankingTrgt_z" RAT_FUNC "%10.2" "lam" COEFFS 0.000000 1.000000 0.000000 0.000000 0.000000 1.000000 /end COMPU_METHOD
/begin AXIS_PTS APD_AFRM_NU_CRANKINGTRGT_X "Cranking AFR target map X axis Engine Speed" 0x83528 NO_INPUT_QUANTITY RL_AFRM_NU_CRANKINGTRGT_X 20000.000000 CU_AFRM_NU_CRANKINGTRGT_X 6 0.0 20000.0 BYTE_ORDER MSB_FIRST /end AXIS_PTS
/begin RECORD_LAYOUT RL_AFRM_NU_CRANKINGTRGT_X AXIS_PTS_X 1 FLOAT32_IEEE INDEX_INCR DIRECT /end RECORD_LAYOUT
/begin COMPU_METHOD CU_AFRM_NU_CRANKINGTRGT_X "Conversion method for AFRm_NU_CrankingTrgt_x" RAT_FUNC "%10.0" "RPM" COEFFS 0.000000 1.000000 0.000000 0.000000 0.000000 1.000000 /end COMPU_METHOD
/begin AXIS_PTS APD_AFRM_NU_CRANKINGTRGT_Y "Cranking AFR target map Y axis ECT" 0x83540 NO_INPUT_QUANTITY RL_AFRM_NU_CRANKINGTRGT_Y 190.000000 CU_AFRM_NU_CRANKINGTRGT_Y 5 -40.0 150.0 BYTE_ORDER MSB_FIRST /end AXIS_PTS
/begin RECORD_LAYOUT RL_AFRM_NU_CRANKINGTRGT_Y AXIS_PTS_X 1 FLOAT32_IEEE INDEX_INCR DIRECT /end RECORD_LAYOUT
/begin COMPU_METHOD CU_AFRM_NU_CRANKINGTRGT_Y "Conversion method for AFRm_NU_CrankingTrgt_y" RAT_FUNC "%10.0" "C" COEFFS 0.000000 1.000000 0.000000 0.000000 0.000000 1.000000 /end COMPU_METHOD
/* Map (1d) calibration for DDE 'AFRm_NU_RampRate_z'. */
/begin CHARACTERISTIC AFRm_NU_RampRate_z "Cranking AFR ramp rate map data" CURVE 0x845c0 RL_AFRM_NU_RAMPRATE_Z 1.000000 CU_AFRM_NU_RAMPRATE_Z 0.000000 1.000000
 /begin AXIS_DESCR COM_AXIS NO_INPUT_QUANTITY CU_AFRM_NU_RAMPRATE_X 5 -40.000000 150.000000 AXIS_PTS_REF APD_AFRM_NU_RAMPRATE_X /end AXIS_DESCR
 BYTE_ORDER MSB_FIRST /end CHARACTERISTIC
/begin RECORD_LAYOUT RL_AFRM_NU_RAMPRATE_Z FNC_VALUES 1 FLOAT32_IEEE COLUMN_DIR DIRECT /end RECORD_LAYOUT
/begin COMPU_METHOD CU_AFRM_NU_RAMPRATE_Z "Conversion method for AFRm_NU_RampRate_z" RAT_FUNC "%10.3" "NU" COEFFS 0.000000 1.000000 0.000000 0.000000 0.000000 1.000000 /end COMPU_METHOD
/begin AXIS_PTS APD_AFRM_NU_RAMPRATE_X "Cranking AFR ramp rate map X axis ECT" 0x845ac NO_INPUT_QUANTITY RL_AFRM_NU_RAMPRATE_X 190.000000 CU_AFRM_NU_RAMPRATE_X 5 -40.0 150.0 BYTE_ORDER MSB_FIRST /end AXIS_PTS
/begin RECORD_LAYOUT RL_AFRM_NU_RAMPRATE_X AXIS_PTS_X 1 FLOAT32_IEEE INDEX_INCR DIRECT /end RECORD_LAYOUT
/begin COMPU_METHOD CU_AFRM_NU_RAMPRATE_X "Conversion method for AFRm_NU_RampRate_x" RAT_FUNC "%10.0" "C" COEFFS 0.000000 1.000000 0.000000 0.000000 0.000000 1.000000 /end COMPU_METHOD
/* Scalar calibration for DDE 'AINc_A_HighsideCurrentMonOfst'. */
/begin CHARACTERISTIC AINc_A_HighsideCurrentMonOfst "(not defined)" VALUE 0x8cd1c RL_AINC_A_HIGHSIDECURRENTMONOF0 0.000000 CU_AINC_A_HIGHSIDECURRENTMONOF0 0.022000 0.022000 BYTE_ORDER MSB_FIRST /end CHARACTERISTIC
/begin RECORD_LAYOUT RL_AINC_A_HIGHSIDECURRENTMONOF0 FNC_VALUES 1 FLOAT32_IEEE COLUMN_DIR DIRECT /end RECORD_LAYOUT
/begin COMPU_METHOD CU_AINC_A_HIGHSIDECURRENTMONOF0 "Conversion method for AINc_A_HighsideCurrentMonOfst" RAT_FUNC "%10.3" "A" COEFFS 0.000000 1.000000 0.000000 0.000000 0.000000 1.000000 /end COMPU_METHOD
/* Scalar calibration for DDE 'AINc_C_AmbientTemp'. */
/begin CHARACTERISTIC AINc_C_AmbientTemp "Override value" VALUE 0x8c3f0 RL_AINC_C_AMBIENTTEMP 0.000000 CU_AINC_C_AMBIENTTEMP 0.000000 0.000000 BYTE_ORDER MSB_FIRST /end CHARACTERISTIC
/begin RECORD_LAYOUT RL_AINC_C_AMBIENTTEMP FNC_VALUES 1 FLOAT32_IEEE COLUMN_DIR DIRECT /end RECORD_LAYOUT
/begin COMPU_METHOD CU_AINC_C_AMBIENTTEMP "Conversion method for AINc_C_AmbientTemp" RAT_FUNC "%10.2" "C" COEFFS 0.000000 1.000000 0.000000 0.000000 0.000000 1.000000 /end COMPU_METHOD
/* Scalar calibration for DDE 'AINc_C_AmbientTemp_Dflt'. */
/begin CHARACTERISTIC AINc_C_AmbientTemp_Dflt "This default is only applied once the leaky bucket is full" VALUE 0x8c3f4 RL_AINC_C_AMBIENTTEMP_DFLT 240.000000 CU_AINC_C_AMBIENTTEMP_DFLT -40.000000 200.000000 BYTE_ORDER MSB_FIRST /end CHARACTERISTIC
/begin RECORD_LAYOUT RL_AINC_C_AMBIENTTEMP_DFLT FNC_VALUES 1 FLOAT32_IEEE COLUMN_DIR DIRECT /end RECORD_LAYOUT
/begin COMPU_METHOD CU_AINC_C_AMBIENTTEMP_DFLT "Conversion method for AINc_C_AmbientTemp_Dflt" RAT_FUNC "%10.1" "C" COEFFS 0.000000 1.000000 0.000000 0.000000 0.000000 1.000000 /end COMPU_METHOD
/* Scalar calibration for DDE 'AINc_C_AmbientTemp_Max'. */
/begin CHARACTERISTIC AINc_C_AmbientTemp_Max "AIN output will be bounded by this range" VALUE 0x8ddec RL_AINC_C_AMBIENTTEMP_MAX 0.000000 CU_AINC_C_AMBIENTTEMP_MAX 80.000000 80.000000 BYTE_ORDER MSB_FIRST /end CHARACTERISTIC
/begin RECORD_LAYOUT RL_AINC_C_AMBIENTTEMP_MAX FNC_VALUES 1 FLOAT32_IEEE COLUMN_DIR DIRECT /end RECORD_LAYOUT
/begin COMPU_METHOD CU_AINC_C_AMBIENTTEMP_MAX "Conversion method for AINc_C_AmbientTemp_Max" RAT_FUNC "%10.1" "C" COEFFS 0.000000 1.000000 0.000000 0.000000 0.000000 1.000000 /end COMPU_METHOD
/* Scalar calibration for DDE 'AINc_C_AmbientTemp_Min'. */
/begin CHARACTERISTIC AINc_C_AmbientTemp_Min "AIN output will be bounded by this range" VALUE 0x8dde8 RL_AINC_C_AMBIENTTEMP_MIN 0.000000 CU_AINC_C_AMBIENTTEMP_MIN -40.000000 -40.000000 BYTE_ORDER MSB_FIRST /end CHARACTERISTIC
/begin RECORD_LAYOUT RL_AINC_C_AMBIENTTEMP_MIN FNC_VALUES 1 FLOAT32_IEEE COLUMN_DIR DIRECT /end RECORD_LAYOUT
/begin COMPU_METHOD CU_AINC_C_AMBIENTTEMP_MIN "Conversion method for AINc_C_AmbientTemp_Min" RAT_FUNC "%10.1" "C" COEFFS 0.000000 1.000000 0.000000 0.000000 0.000000 1.000000 /end COMPU_METHOD
/* Scalar calibration for DDE 'AINc_C_CompOutTemp'. */
/begin CHARACTERISTIC AINc_C_CompOutTemp "Override value" VALUE 0x8c434 RL_AINC_C_COMPOUTTEMP 160.000000 CU_AINC_C_COMPOUTTEMP -40.000000 120.000000 BYTE_ORDER MSB_FIRST /end CHARACTERISTIC
/begin RECORD_LAYOUT RL_AINC_C_COMPOUTTEMP FNC_VALUES 1 FLOAT32_IEEE COLUMN_DIR DIRECT /end RECORD_LAYOUT
/begin COMPU_METHOD CU_AINC_C_COMPOUTTEMP "Conversion method for AINc_C_CompOutTemp" RAT_FUNC "%10.2" "C" COEFFS 0.000000 1.000000 0.000000 0.000000 0.000000 1.000000 /end COMPU_METHOD
/* Scalar calibration for DDE 'AINc_C_CoolantTemp'. */
/begin CHARACTERISTIC AINc_C_CoolantTemp "Override value" VALUE 0x8c45c RL_AINC_C_COOLANTTEMP 160.000000 CU_AINC_C_COOLANTTEMP -40.000000 120.000000 BYTE_ORDER MSB_FIRST /end CHARACTERISTIC
/begin RECORD_LAYOUT RL_AINC_C_COOLANTTEMP FNC_VALUES 1 FLOAT32_IEEE COLUMN_DIR DIRECT /end RECORD_LAYOUT
/begin COMPU_METHOD CU_AINC_C_COOLANTTEMP "Conversion method for AINc_C_CoolantTemp" RAT_FUNC "%10.0" "C" COEFFS 0.000000 1.000000 0.000000 0.000000 0.000000 1.000000 /end COMPU_METHOD
/* Scalar calibration for DDE 'AINc_C_CoolantTemp_Dflt'. */
/begin CHARACTERISTIC AINc_C_CoolantTemp_Dflt "This default is only applied once the leaky bucket is full" VALUE 0x8c460 RL_AINC_C_COOLANTTEMP_DFLT 1.100000 CU_AINC_C_COOLANTTEMP_DFLT -0.100000 1.000000 BYTE_ORDER MSB_FIRST /end CHARACTERISTIC
/begin RECORD_LAYOUT RL_AINC_C_COOLANTTEMP_DFLT FNC_VALUES 1 FLOAT32_IEEE COLUMN_DIR DIRECT /end RECORD_LAYOUT
/begin COMPU_METHOD CU_AINC_C_COOLANTTEMP_DFLT "Conversion method for AINc_C_CoolantTemp_Dflt" RAT_FUNC "%10.1" "C" COEFFS 0.000000 1.000000 0.000000 0.000000 0.000000 1.000000 /end COMPU_METHOD
/* Scalar calibration for DDE 'AINc_C_CoolantTemp_Max'. */
/begin CHARACTERISTIC AINc_C_CoolantTemp_Max "AIN output will be bounded by this range" VALUE 0x8dde4 RL_AINC_C_COOLANTTEMP_MAX 200.000000 CU_AINC_C_COOLANTTEMP_MAX 0.000000 200.000000 BYTE_ORDER MSB_FIRST /end CHARACTERISTIC
/begin RECORD_LAYOUT RL_AINC_C_COOLANTTEMP_MAX FNC_VALUES 1 FLOAT32_IEEE COLUMN_DIR DIRECT /end RECORD_LAYOUT
/begin COMPU_METHOD CU_AINC_C_COOLANTTEMP_MAX "Conversion method for AINc_C_CoolantTemp_Max" RAT_FUNC "%10.1" "C" COEFFS 0.000000 1.000000 0.000000 0.000000 0.000000 1.000000 /end COMPU_METHOD
/* Scalar calibration for DDE 'AINc_C_CoolantTemp_Max_Begas'. */
/begin CHARACTERISTIC AINc_C_CoolantTemp_Max_Begas "AIN output will be bounded by this range" VALUE 0x8c104 RL_AINC_C_COOLANTTEMP_MAX_BEGAS 200.000000 CU_AINC_C_COOLANTTEMP_MAX_BEGAS 0.000000 200.000000 BYTE_ORDER MSB_FIRST /end CHARACTERISTIC
/begin RECORD_LAYOUT RL_AINC_C_COOLANTTEMP_MAX_BEGAS FNC_VALUES 1 FLOAT32_IEEE COLUMN_DIR DIRECT /end RECORD_LAYOUT
/begin COMPU_METHOD CU_AINC_C_COOLANTTEMP_MAX_BEGAS "Conversion method for AINc_C_CoolantTemp_Max_Begas" RAT_FUNC "%10.1" "C" COEFFS 0.000000 1.000000 0.000000 0.000000 0.000000 1.000000 /end COMPU_METHOD
/* Scalar calibration for DDE 'AINc_C_CoolantTemp_Min'. */
/begin CHARACTERISTIC AINc_C_CoolantTemp_Min "AIN output will be bounded by this range" VALUE 0x8dde0 RL_AINC_C_COOLANTTEMP_MIN 40.000000 CU_AINC_C_COOLANTTEMP_MIN -40.000000 0.000000 BYTE_ORDER MSB_FIRST /end CHARACTERISTIC
/begin RECORD_LAYOUT RL_AINC_C_COOLANTTEMP_MIN FNC_VALUES 1 FLOAT32_IEEE COLUMN_DIR DIRECT /end RECORD_LAYOUT
/begin COMPU_METHOD CU_AINC_C_COOLANTTEMP_MIN "Conversion method for AINc_C_CoolantTemp_Min" RAT_FUNC "%10.1" "C" COEFFS 0.000000 1.000000 0.000000 0.000000 0.000000 1.000000 /end COMPU_METHOD
/* Scalar calibration for DDE 'AINc_C_CoolantTemp_Min_Begas'. */
/begin CHARACTERISTIC AINc_C_CoolantTemp_Min_Begas "AIN output will be bounded by this range" VALUE 0x8c10c RL_AINC_C_COOLANTTEMP_MIN_BEGAS 300.000000 CU_AINC_C_COOLANTTEMP_MIN_BEGAS -100.000000 200.000000 BYTE_ORDER MSB_FIRST /end CHARACTERISTIC
/begin RECORD_LAYOUT RL_AINC_C_COOLANTTEMP_MIN_BEGAS FNC_VALUES 1 FLOAT32_IEEE COLUMN_DIR DIRECT /end RECORD_LAYOUT
/begin COMPU_METHOD CU_AINC_C_COOLANTTEMP_MIN_BEGAS "Conversion method for AINc_C_CoolantTemp_Min_Begas" RAT_FUNC "%10.1" "C" COEFFS 0.000000 1.000000 0.000000 0.000000 0.000000 1.000000 /end COMPU_METHOD
/* Scalar calibration for DDE 'AINc_C_ExTemp_Dflt'. */
/begin CHARACTERISTIC AINc_C_ExTemp_Dflt "This default is only applied once the leaky bucket is full" VALUE 0x8dddc RL_AINC_C_EXTEMP_DFLT 1.100000 CU_AINC_C_EXTEMP_DFLT -0.100000 1.000000 BYTE_ORDER MSB_FIRST /end CHARACTERISTIC
/begin RECORD_LAYOUT RL_AINC_C_EXTEMP_DFLT FNC_VALUES 1 FLOAT32_IEEE COLUMN_DIR DIRECT /end RECORD_LAYOUT
/begin COMPU_METHOD CU_AINC_C_EXTEMP_DFLT "Conversion method for AINc_C_ExTemp_Dflt" RAT_FUNC "%10.1" "C" COEFFS 0.000000 1.000000 0.000000 0.000000 0.000000 1.000000 /end COMPU_METHOD
/* Scalar calibration for DDE 'AINc_C_ExTemp_Max'. */
/begin CHARACTERISTIC AINc_C_ExTemp_Max "AIN output will be bounded by this range" VALUE 0x8ddd8 RL_AINC_C_EXTEMP_MAX 2000.000000 CU_AINC_C_EXTEMP_MAX 0.000000 2000.000000 BYTE_ORDER MSB_FIRST /end CHARACTERISTIC
/begin RECORD_LAYOUT RL_AINC_C_EXTEMP_MAX FNC_VALUES 1 FLOAT32_IEEE COLUMN_DIR DIRECT /end RECORD_LAYOUT
/begin COMPU_METHOD CU_AINC_C_EXTEMP_MAX "Conversion method for AINc_C_ExTemp_Max" RAT_FUNC "%10.0" "C" COEFFS 0.000000 1.000000 0.000000 0.000000 0.000000 1.000000 /end COMPU_METHOD
/* Scalar calibration for DDE 'AINc_C_ExTemp_Min'. */
/begin CHARACTERISTIC AINc_C_ExTemp_Min "AIN output will be bounded by this range" VALUE 0x8ddd4 RL_AINC_C_EXTEMP_MIN 0.000000 CU_AINC_C_EXTEMP_MIN -40.000000 -40.000000 BYTE_ORDER MSB_FIRST /end CHARACTERISTIC
/begin RECORD_LAYOUT RL_AINC_C_EXTEMP_MIN FNC_VALUES 1 FLOAT32_IEEE COLUMN_DIR DIRECT /end RECORD_LAYOUT
/begin COMPU_METHOD CU_AINC_C_EXTEMP_MIN "Conversion method for AINc_C_ExTemp_Min" RAT_FUNC "%10.1" "C" COEFFS 0.000000 1.000000 0.000000 0.000000 0.000000 1.000000 /end COMPU_METHOD
/* Scalar calibration for DDE 'AINc_C_ExhaustTemp'. */
/begin CHARACTERISTIC AINc_C_ExhaustTemp "Override value" VALUE 0x8c0d0 RL_AINC_C_EXHAUSTTEMP 0.000000 CU_AINC_C_EXHAUSTTEMP 0.000000 0.000000 BYTE_ORDER MSB_FIRST /end CHARACTERISTIC
/begin RECORD_LAYOUT RL_AINC_C_EXHAUSTTEMP FNC_VALUES 1 FLOAT32_IEEE COLUMN_DIR DIRECT /end RECORD_LAYOUT
/begin COMPU_METHOD CU_AINC_C_EXHAUSTTEMP "Conversion method for AINc_C_ExhaustTemp" RAT_FUNC "%10.2" "C" COEFFS 0.000000 1.000000 0.000000 0.000000 0.000000 1.000000 /end COMPU_METHOD
/* Scalar calibration for DDE 'AINc_C_FuelTemp'. */
/begin CHARACTERISTIC AINc_C_FuelTemp "Override value" VALUE 0x8c43c RL_AINC_C_FUELTEMP 0.000000 CU_AINC_C_FUELTEMP 0.000000 0.000000 BYTE_ORDER MSB_FIRST /end CHARACTERISTIC
/begin RECORD_LAYOUT RL_AINC_C_FUELTEMP FNC_VALUES 1 FLOAT32_IEEE COLUMN_DIR DIRECT /end RECORD_LAYOUT
/begin COMPU_METHOD CU_AINC_C_FUELTEMP "Conversion method for AINc_C_FuelTemp" RAT_FUNC "%10.2" "C" COEFFS 0.000000 1.000000 0.000000 0.000000 0.000000 1.000000 /end COMPU_METHOD
/* Scalar calibration for DDE 'AINc_C_FuelTemp_Dflt'. */
/begin CHARACTERISTIC AINc_C_FuelTemp_Dflt "This default is only applied once the leaky bucket is full" VALUE 0x8ddd0 RL_AINC_C_FUELTEMP_DFLT 200.000000 CU_AINC_C_FUELTEMP_DFLT -50.000000 150.000000 BYTE_ORDER MSB_FIRST /end CHARACTERISTIC
/begin RECORD_LAYOUT RL_AINC_C_FUELTEMP_DFLT FNC_VALUES 1 FLOAT32_IEEE COLUMN_DIR DIRECT /end RECORD_LAYOUT
/begin COMPU_METHOD CU_AINC_C_FUELTEMP_DFLT "Conversion method for AINc_C_FuelTemp_Dflt" RAT_FUNC "%10.1" "C" COEFFS 0.000000 1.000000 0.000000 0.000000 0.000000 1.000000 /end COMPU_METHOD
/* Scalar calibration for DDE 'AINc_C_FuelTemp_Max'. */
/begin CHARACTERISTIC AINc_C_FuelTemp_Max "AIN Volts will be bounded by this range" VALUE 0x8ddcc RL_AINC_C_FUELTEMP_MAX 200.000000 CU_AINC_C_FUELTEMP_MAX -50.000000 150.000000 BYTE_ORDER MSB_FIRST /end CHARACTERISTIC
/begin RECORD_LAYOUT RL_AINC_C_FUELTEMP_MAX FNC_VALUES 1 FLOAT32_IEEE COLUMN_DIR DIRECT /end RECORD_LAYOUT
/begin COMPU_METHOD CU_AINC_C_FUELTEMP_MAX "Conversion method for AINc_C_FuelTemp_Max" RAT_FUNC "%10.1" "C" COEFFS 0.000000 1.000000 0.000000 0.000000 0.000000 1.000000 /end COMPU_METHOD
/* Scalar calibration for DDE 'AINc_C_FuelTemp_Min'. */
/begin CHARACTERISTIC AINc_C_FuelTemp_Min "AIN Volts will be bounded by this range" VALUE 0x8ddc8 RL_AINC_C_FUELTEMP_MIN 200.000000 CU_AINC_C_FUELTEMP_MIN -50.000000 150.000000 BYTE_ORDER MSB_FIRST /end CHARACTERISTIC
/begin RECORD_LAYOUT RL_AINC_C_FUELTEMP_MIN FNC_VALUES 1 FLOAT32_IEEE COLUMN_DIR DIRECT /end RECORD_LAYOUT
/begin COMPU_METHOD CU_AINC_C_FUELTEMP_MIN "Conversion method for AINc_C_FuelTemp_Min" RAT_FUNC "%10.1" "C" COEFFS 0.000000 1.000000 0.000000 0.000000 0.000000 1.000000 /end COMPU_METHOD
/* Scalar calibration for DDE 'AINc_C_GLPTemp_Dflt'. */
/begin CHARACTERISTIC AINc_C_GLPTemp_Dflt "This default is only applied once the leaky bucket is full" VALUE 0x8c440 RL_AINC_C_GLPTEMP_DFLT 120.100000 CU_AINC_C_GLPTEMP_DFLT -0.100000 120.000000 BYTE_ORDER MSB_FIRST /end CHARACTERISTIC
/begin RECORD_LAYOUT RL_AINC_C_GLPTEMP_DFLT FNC_VALUES 1 FLOAT32_IEEE COLUMN_DIR DIRECT /end RECORD_LAYOUT
/begin COMPU_METHOD CU_AINC_C_GLPTEMP_DFLT "Conversion method for AINc_C_GLPTemp_Dflt" RAT_FUNC "%10.1" "C" COEFFS 0.000000 1.000000 0.000000 0.000000 0.000000 1.000000 /end COMPU_METHOD
/* Scalar calibration for DDE 'AINc_C_ManifoldTemp'. */
/begin CHARACTERISTIC AINc_C_ManifoldTemp "Override value" VALUE 0x8c448 RL_AINC_C_MANIFOLDTEMP 160.000000 CU_AINC_C_MANIFOLDTEMP -40.000000 120.000000 BYTE_ORDER MSB_FIRST /end CHARACTERISTIC
/begin RECORD_LAYOUT RL_AINC_C_MANIFOLDTEMP FNC_VALUES 1 FLOAT32_IEEE COLUMN_DIR DIRECT /end RECORD_LAYOUT
/begin COMPU_METHOD CU_AINC_C_MANIFOLDTEMP "Conversion method for AINc_C_ManifoldTemp" RAT_FUNC "%10.1" "C" COEFFS 0.000000 1.000000 0.000000 0.000000 0.000000 1.000000 /end COMPU_METHOD
/* Scalar calibration for DDE 'AINc_C_ManifoldTemp_Dflt'. */
/begin CHARACTERISTIC AINc_C_ManifoldTemp_Dflt "This default is only applied once the leaky bucket is full" VALUE 0x8c44c RL_AINC_C_MANIFOLDTEMP_DFLT 240.000000 CU_AINC_C_MANIFOLDTEMP_DFLT -40.000000 200.000000 BYTE_ORDER MSB_FIRST /end CHARACTERISTIC
/begin RECORD_LAYOUT RL_AINC_C_MANIFOLDTEMP_DFLT FNC_VALUES 1 FLOAT32_IEEE COLUMN_DIR DIRECT /end RECORD_LAYOUT
/begin COMPU_METHOD CU_AINC_C_MANIFOLDTEMP_DFLT "Conversion method for AINc_C_ManifoldTemp_Dflt" RAT_FUNC "%10.1" "C" COEFFS 0.000000 1.000000 0.000000 0.000000 0.000000 1.000000 /end COMPU_METHOD
/* Scalar calibration for DDE 'AINc_C_ManifoldTemp_Max'. */
/begin CHARACTERISTIC AINc_C_ManifoldTemp_Max "AIN output will be bounded by this range" VALUE 0x8ddc4 RL_AINC_C_MANIFOLDTEMP_MAX 150.000000 CU_AINC_C_MANIFOLDTEMP_MAX 0.000000 150.000000 BYTE_ORDER MSB_FIRST /end CHARACTERISTIC
/begin RECORD_LAYOUT RL_AINC_C_MANIFOLDTEMP_MAX FNC_VALUES 1 FLOAT32_IEEE COLUMN_DIR DIRECT /end RECORD_LAYOUT
/begin COMPU_METHOD CU_AINC_C_MANIFOLDTEMP_MAX "Conversion method for AINc_C_ManifoldTemp_Max" RAT_FUNC "%10.1" "C" COEFFS 0.000000 1.000000 0.000000 0.000000 0.000000 1.000000 /end COMPU_METHOD
/* Scalar calibration for DDE 'AINc_C_ManifoldTemp_Min'. */
/begin CHARACTERISTIC AINc_C_ManifoldTemp_Min "AIN output will be bounded by this range" VALUE 0x8ddc0 RL_AINC_C_MANIFOLDTEMP_MIN 40.000000 CU_AINC_C_MANIFOLDTEMP_MIN -40.000000 0.000000 BYTE_ORDER MSB_FIRST /end CHARACTERISTIC
/begin RECORD_LAYOUT RL_AINC_C_MANIFOLDTEMP_MIN FNC_VALUES 1 FLOAT32_IEEE COLUMN_DIR DIRECT /end RECORD_LAYOUT
/begin COMPU_METHOD CU_AINC_C_MANIFOLDTEMP_MIN "Conversion method for AINc_C_ManifoldTemp_Min" RAT_FUNC "%10.1" "C" COEFFS 0.000000 1.000000 0.000000 0.000000 0.000000 1.000000 /end COMPU_METHOD
/* Scalar calibration for DDE 'AINc_C_OilTemp'. */
/begin CHARACTERISTIC AINc_C_OilTemp "Override value" VALUE 0x8c40c RL_AINC_C_OILTEMP 160.000000 CU_AINC_C_OILTEMP -40.000000 120.000000 BYTE_ORDER MSB_FIRST /end CHARACTERISTIC
/begin RECORD_LAYOUT RL_AINC_C_OILTEMP FNC_VALUES 1 FLOAT32_IEEE COLUMN_DIR DIRECT /end RECORD_LAYOUT
/begin COMPU_METHOD CU_AINC_C_OILTEMP "Conversion method for AINc_C_OilTemp" RAT_FUNC "%10.2" "C" COEFFS 0.000000 1.000000 0.000000 0.000000 0.000000 1.000000 /end COMPU_METHOD
/* Scalar calibration for DDE 'AINc_HZ_acel_pdl2_dat_nok_FR'. */
/begin CHARACTERISTIC AINc_HZ_acel_pdl2_dat_nok_FR "(not defined)" VALUE 0x8bfd4 RL_AINC_HZ_ACEL_PDL2_DAT_NOK_FR 100.000000 CU_AINC_HZ_ACEL_PDL2_DAT_NOK_FR 0.000000 100.000000 BYTE_ORDER MSB_FIRST /end CHARACTERISTIC
/begin RECORD_LAYOUT RL_AINC_HZ_ACEL_PDL2_DAT_NOK_FR FNC_VALUES 1 FLOAT32_IEEE COLUMN_DIR DIRECT /end RECORD_LAYOUT
/begin COMPU_METHOD CU_AINC_HZ_ACEL_PDL2_DAT_NOK_FR "Conversion method for AINc_HZ_acel_pdl2_dat_nok_FR" RAT_FUNC "%10.3" "Hz" COEFFS 0.000000 1.000000 0.000000 0.000000 0.000000 1.000000 /end COMPU_METHOD
/* Scalar calibration for DDE 'AINc_HZ_acel_pdl2_dat_nok_RR'. */
/begin CHARACTERISTIC AINc_HZ_acel_pdl2_dat_nok_RR "(not defined)" VALUE 0x8bfd8 RL_AINC_HZ_ACEL_PDL2_DAT_NOK_RR 100.000000 CU_AINC_HZ_ACEL_PDL2_DAT_NOK_RR 0.000000 100.000000 BYTE_ORDER MSB_FIRST /end CHARACTERISTIC
/begin RECORD_LAYOUT RL_AINC_HZ_ACEL_PDL2_DAT_NOK_RR FNC_VALUES 1 FLOAT32_IEEE COLUMN_DIR DIRECT /end RECORD_LAYOUT
/begin COMPU_METHOD CU_AINC_HZ_ACEL_PDL2_DAT_NOK_RR "Conversion method for AINc_HZ_acel_pdl2_dat_nok_RR" RAT_FUNC "%10.3" "Hz" COEFFS 0.000000 1.000000 0.000000 0.000000 0.000000 1.000000 /end COMPU_METHOD
/* Scalar calibration for DDE 'AINc_HZ_pdl1_dat_nok_FR'. */
/begin CHARACTERISTIC AINc_HZ_pdl1_dat_nok_FR "(not defined)" VALUE 0x8bfc0 RL_AINC_HZ_PDL1_DAT_NOK_FR 100.000000 CU_AINC_HZ_PDL1_DAT_NOK_FR 0.000000 100.000000 BYTE_ORDER MSB_FIRST /end CHARACTERISTIC
/begin RECORD_LAYOUT RL_AINC_HZ_PDL1_DAT_NOK_FR FNC_VALUES 1 FLOAT32_IEEE COLUMN_DIR DIRECT /end RECORD_LAYOUT
/begin COMPU_METHOD CU_AINC_HZ_PDL1_DAT_NOK_FR "Conversion method for AINc_HZ_pdl1_dat_nok_FR" RAT_FUNC "%10.3" "Hz" COEFFS 0.000000 1.000000 0.000000 0.000000 0.000000 1.000000 /end COMPU_METHOD
/* Scalar calibration for DDE 'AINc_HZ_pdl1_dat_nok_RR'. */
/begin CHARACTERISTIC AINc_HZ_pdl1_dat_nok_RR "(not defined)" VALUE 0x8bfc4 RL_AINC_HZ_PDL1_DAT_NOK_RR 100.000000 CU_AINC_HZ_PDL1_DAT_NOK_RR 0.000000 100.000000 BYTE_ORDER MSB_FIRST /end CHARACTERISTIC
/begin RECORD_LAYOUT RL_AINC_HZ_PDL1_DAT_NOK_RR FNC_VALUES 1 FLOAT32_IEEE COLUMN_DIR DIRECT /end RECORD_LAYOUT
/begin COMPU_METHOD CU_AINC_HZ_PDL1_DAT_NOK_RR "Conversion method for AINc_HZ_pdl1_dat_nok_RR" RAT_FUNC "%10.3" "Hz" COEFFS 0.000000 1.000000 0.000000 0.000000 0.000000 1.000000 /end COMPU_METHOD
/* Scalar calibration for DDE 'AINc_Hz_AmbientTemp_BktFR'. */
/begin CHARACTERISTIC AINc_Hz_AmbientTemp_BktFR "(not defined)" VALUE 0x8ddbc RL_AINC_HZ_AMBIENTTEMP_BKTFR 100.000000 CU_AINC_HZ_AMBIENTTEMP_BKTFR 0.000000 100.000000 BYTE_ORDER MSB_FIRST /end CHARACTERISTIC
/begin RECORD_LAYOUT RL_AINC_HZ_AMBIENTTEMP_BKTFR FNC_VALUES 1 FLOAT32_IEEE COLUMN_DIR DIRECT /end RECORD_LAYOUT
/begin COMPU_METHOD CU_AINC_HZ_AMBIENTTEMP_BKTFR "Conversion method for AINc_Hz_AmbientTemp_BktFR" RAT_FUNC "%10.3" "Hz" COEFFS 0.000000 1.000000 0.000000 0.000000 0.000000 1.000000 /end COMPU_METHOD
/* Scalar calibration for DDE 'AINc_Hz_AmbientTemp_BktRR'. */
/begin CHARACTERISTIC AINc_Hz_AmbientTemp_BktRR "(not defined)" VALUE 0x8ddb8 RL_AINC_HZ_AMBIENTTEMP_BKTRR 100.000000 CU_AINC_HZ_AMBIENTTEMP_BKTRR 0.000000 100.000000 BYTE_ORDER MSB_FIRST /end CHARACTERISTIC
/begin RECORD_LAYOUT RL_AINC_HZ_AMBIENTTEMP_BKTRR FNC_VALUES 1 FLOAT32_IEEE COLUMN_DIR DIRECT /end RECORD_LAYOUT
/begin COMPU_METHOD CU_AINC_HZ_AMBIENTTEMP_BKTRR "Conversion method for AINc_Hz_AmbientTemp_BktRR" RAT_FUNC "%10.3" "Hz" COEFFS 0.000000 1.000000 0.000000 0.000000 0.000000 1.000000 /end COMPU_METHOD
/* Scalar calibration for DDE 'AINc_Hz_Baro_BktFR'. */
/begin CHARACTERISTIC AINc_Hz_Baro_BktFR "(not defined)" VALUE 0x8ddb4 RL_AINC_HZ_BARO_BKTFR 100.000000 CU_AINC_HZ_BARO_BKTFR 0.000000 100.000000 BYTE_ORDER MSB_FIRST /end CHARACTERISTIC
/begin RECORD_LAYOUT RL_AINC_HZ_BARO_BKTFR FNC_VALUES 1 FLOAT32_IEEE COLUMN_DIR DIRECT /end RECORD_LAYOUT
/begin COMPU_METHOD CU_AINC_HZ_BARO_BKTFR "Conversion method for AINc_Hz_Baro_BktFR" RAT_FUNC "%10.3" "Hz" COEFFS 0.000000 1.000000 0.000000 0.000000 0.000000 1.000000 /end COMPU_METHOD
/* Scalar calibration for DDE 'AINc_Hz_Baro_BktRR'. */
/begin CHARACTERISTIC AINc_Hz_Baro_BktRR "(not defined)" VALUE 0x8ddb0 RL_AINC_HZ_BARO_BKTRR 100.000000 CU_AINC_HZ_BARO_BKTRR 0.000000 100.000000 BYTE_ORDER MSB_FIRST /end CHARACTERISTIC
/begin RECORD_LAYOUT RL_AINC_HZ_BARO_BKTRR FNC_VALUES 1 FLOAT32_IEEE COLUMN_DIR DIRECT /end RECORD_LAYOUT
/begin COMPU_METHOD CU_AINC_HZ_BARO_BKTRR "Conversion method for AINc_Hz_Baro_BktRR" RAT_FUNC "%10.3" "Hz" COEFFS 0.000000 1.000000 0.000000 0.000000 0.000000 1.000000 /end COMPU_METHOD
/* Scalar calibration for DDE 'AINc_Hz_CompOutPress_BktFR'. */
/begin CHARACTERISTIC AINc_Hz_CompOutPress_BktFR "(pct/s) rate at which OOR bucket falls (always applies) ie: 0.50 implies fault will clear after 2 seconds." VALUE 0x8ddac RL_AINC_HZ_COMPOUTPRESS_BKTFR 1000.000000 CU_AINC_HZ_COMPOUTPRESS_BKTFR 0.000000 1000.000000 BYTE_ORDER MSB_FIRST /end CHARACTERISTIC
/begin RECORD_LAYOUT RL_AINC_HZ_COMPOUTPRESS_BKTFR FNC_VALUES 1 FLOAT32_IEEE COLUMN_DIR DIRECT /end RECORD_LAYOUT
/begin COMPU_METHOD CU_AINC_HZ_COMPOUTPRESS_BKTFR "Conversion method for AINc_Hz_CompOutPress_BktFR" RAT_FUNC "%10.2" "NU" COEFFS 0.000000 1.000000 0.000000 0.000000 0.000000 1.000000 /end COMPU_METHOD
/* Scalar calibration for DDE 'AINc_Hz_CompOutPress_BktRR'. */
/begin CHARACTERISTIC AINc_Hz_CompOutPress_BktRR "(pct/s) rate at which OOR bucket rises when an OOR condition is present (Note: must be > fall rate for bucket to work)" VALUE 0x8dda8 RL_AINC_HZ_COMPOUTPRESS_BKTRR 1000.000000 CU_AINC_HZ_COMPOUTPRESS_BKTRR 0.000000 1000.000000 BYTE_ORDER MSB_FIRST /end CHARACTERISTIC
/begin RECORD_LAYOUT RL_AINC_HZ_COMPOUTPRESS_BKTRR FNC_VALUES 1 FLOAT32_IEEE COLUMN_DIR DIRECT /end RECORD_LAYOUT
/begin COMPU_METHOD CU_AINC_HZ_COMPOUTPRESS_BKTRR "Conversion method for AINc_Hz_CompOutPress_BktRR" RAT_FUNC "%10.2" "NU" COEFFS 0.000000 1.000000 0.000000 0.000000 0.000000 1.000000 /end COMPU_METHOD
/* Scalar calibration for DDE 'AINc_Hz_CoolantTemp_BktFR'. */
/begin CHARACTERISTIC AINc_Hz_CoolantTemp_BktFR "(not defined)" VALUE 0x8dda4 RL_AINC_HZ_COOLANTTEMP_BKTFR 100.000000 CU_AINC_HZ_COOLANTTEMP_BKTFR 0.000000 100.000000 BYTE_ORDER MSB_FIRST /end CHARACTERISTIC
/begin RECORD_LAYOUT RL_AINC_HZ_COOLANTTEMP_BKTFR FNC_VALUES 1 FLOAT32_IEEE COLUMN_DIR DIRECT /end RECORD_LAYOUT
/begin COMPU_METHOD CU_AINC_HZ_COOLANTTEMP_BKTFR "Conversion method for AINc_Hz_CoolantTemp_BktFR" RAT_FUNC "%10.3" "Hz" COEFFS 0.000000 1.000000 0.000000 0.000000 0.000000 1.000000 /end COMPU_METHOD
/* Scalar calibration for DDE 'AINc_Hz_CoolantTemp_BktRR'. */
/begin CHARACTERISTIC AINc_Hz_CoolantTemp_BktRR "(not defined)" VALUE 0x8dda0 RL_AINC_HZ_COOLANTTEMP_BKTRR 100.000000 CU_AINC_HZ_COOLANTTEMP_BKTRR 0.000000 100.000000 BYTE_ORDER MSB_FIRST /end CHARACTERISTIC
/begin RECORD_LAYOUT RL_AINC_HZ_COOLANTTEMP_BKTRR FNC_VALUES 1 FLOAT32_IEEE COLUMN_DIR DIRECT /end RECORD_LAYOUT
/begin COMPU_METHOD CU_AINC_HZ_COOLANTTEMP_BKTRR "Conversion method for AINc_Hz_CoolantTemp_BktRR" RAT_FUNC "%10.3" "Hz" COEFFS 0.000000 1.000000 0.000000 0.000000 0.000000 1.000000 /end COMPU_METHOD
/* Scalar calibration for DDE 'AINc_Hz_ETC_fail_FR'. */
/begin CHARACTERISTIC AINc_Hz_ETC_fail_FR "(not defined)" VALUE 0x879ec RL_AINC_HZ_ETC_FAIL_FR 100.000000 CU_AINC_HZ_ETC_FAIL_FR 0.000000 100.000000 BYTE_ORDER MSB_FIRST /end CHARACTERISTIC
/begin RECORD_LAYOUT RL_AINC_HZ_ETC_FAIL_FR FNC_VALUES 1 FLOAT32_IEEE COLUMN_DIR DIRECT /end RECORD_LAYOUT
/begin COMPU_METHOD CU_AINC_HZ_ETC_FAIL_FR "Conversion method for AINc_Hz_ETC_fail_FR" RAT_FUNC "%10.3" "Hz" COEFFS 0.000000 1.000000 0.000000 0.000000 0.000000 1.000000 /end COMPU_METHOD
/* Scalar calibration for DDE 'AINc_Hz_ETC_fail_RR'. */
/begin CHARACTERISTIC AINc_Hz_ETC_fail_RR "(not defined)" VALUE 0x879f0 RL_AINC_HZ_ETC_FAIL_RR 100.000000 CU_AINC_HZ_ETC_FAIL_RR 0.000000 100.000000 BYTE_ORDER MSB_FIRST /end CHARACTERISTIC
/begin RECORD_LAYOUT RL_AINC_HZ_ETC_FAIL_RR FNC_VALUES 1 FLOAT32_IEEE COLUMN_DIR DIRECT /end RECORD_LAYOUT
/begin COMPU_METHOD CU_AINC_HZ_ETC_FAIL_RR "Conversion method for AINc_Hz_ETC_fail_RR" RAT_FUNC "%10.3" "Hz" COEFFS 0.000000 1.000000 0.000000 0.000000 0.000000 1.000000 /end COMPU_METHOD
/* Scalar calibration for DDE 'AINc_Hz_ExTemp_BktFR'. */
/begin CHARACTERISTIC AINc_Hz_ExTemp_BktFR "(pct/s) rate at which OOR bucket falls (always applies) ie: 0.50 implies fault will clear after 2 seconds." VALUE 0x8dd9c RL_AINC_HZ_EXTEMP_BKTFR 1000.000000 CU_AINC_HZ_EXTEMP_BKTFR 0.000000 1000.000000 BYTE_ORDER MSB_FIRST /end CHARACTERISTIC
/begin RECORD_LAYOUT RL_AINC_HZ_EXTEMP_BKTFR FNC_VALUES 1 FLOAT32_IEEE COLUMN_DIR DIRECT /end RECORD_LAYOUT
/begin COMPU_METHOD CU_AINC_HZ_EXTEMP_BKTFR "Conversion method for AINc_Hz_ExTemp_BktFR" RAT_FUNC "%10.2" "NU" COEFFS 0.000000 1.000000 0.000000 0.000000 0.000000 1.000000 /end COMPU_METHOD
/* Scalar calibration for DDE 'AINc_Hz_ExTemp_BktRR'. */
/begin CHARACTERISTIC AINc_Hz_ExTemp_BktRR "(pct/s) rate at which OOR bucket rises when an OOR condition is present (Note: must be > fall rate for bucket to work)" VALUE 0x8dd98 RL_AINC_HZ_EXTEMP_BKTRR 1000.000000 CU_AINC_HZ_EXTEMP_BKTRR 0.000000 1000.000000 BYTE_ORDER MSB_FIRST /end CHARACTERISTIC
/begin RECORD_LAYOUT RL_AINC_HZ_EXTEMP_BKTRR FNC_VALUES 1 FLOAT32_IEEE COLUMN_DIR DIRECT /end RECORD_LAYOUT
/begin COMPU_METHOD CU_AINC_HZ_EXTEMP_BKTRR "Conversion method for AINc_Hz_ExTemp_BktRR" RAT_FUNC "%10.2" "NU" COEFFS 0.000000 1.000000 0.000000 0.000000 0.000000 1.000000 /end COMPU_METHOD
/* Scalar calibration for DDE 'AINc_Hz_FAPPress_BktFR'. */
/begin CHARACTERISTIC AINc_Hz_FAPPress_BktFR "(not defined)" VALUE 0x8dd94 RL_AINC_HZ_FAPPRESS_BKTFR 100.000000 CU_AINC_HZ_FAPPRESS_BKTFR 0.000000 100.000000 BYTE_ORDER MSB_FIRST /end CHARACTERISTIC
/begin RECORD_LAYOUT RL_AINC_HZ_FAPPRESS_BKTFR FNC_VALUES 1 FLOAT32_IEEE COLUMN_DIR DIRECT /end RECORD_LAYOUT
/begin COMPU_METHOD CU_AINC_HZ_FAPPRESS_BKTFR "Conversion method for AINc_Hz_FAPPress_BktFR" RAT_FUNC "%10.3" "Hz" COEFFS 0.000000 1.000000 0.000000 0.000000 0.000000 1.000000 /end COMPU_METHOD
/* Scalar calibration for DDE 'AINc_Hz_FAPPress_BktRR'. */
/begin CHARACTERISTIC AINc_Hz_FAPPress_BktRR "(not defined)" VALUE 0x8dd90 RL_AINC_HZ_FAPPRESS_BKTRR 100.000000 CU_AINC_HZ_FAPPRESS_BKTRR 0.000000 100.000000 BYTE_ORDER MSB_FIRST /end CHARACTERISTIC
/begin RECORD_LAYOUT RL_AINC_HZ_FAPPRESS_BKTRR FNC_VALUES 1 FLOAT32_IEEE COLUMN_DIR DIRECT /end RECORD_LAYOUT
/begin COMPU_METHOD CU_AINC_HZ_FAPPRESS_BKTRR "Conversion method for AINc_Hz_FAPPress_BktRR" RAT_FUNC "%10.3" "Hz" COEFFS 0.000000 1.000000 0.000000 0.000000 0.000000 1.000000 /end COMPU_METHOD
/* Scalar calibration for DDE 'AINc_Hz_FR_TurboErr'. */
/begin CHARACTERISTIC AINc_Hz_FR_TurboErr "(not defined)" VALUE 0x8b870 RL_AINC_HZ_FR_TURBOERR 100.000000 CU_AINC_HZ_FR_TURBOERR 0.000000 100.000000 BYTE_ORDER MSB_FIRST /end CHARACTERISTIC
/begin RECORD_LAYOUT RL_AINC_HZ_FR_TURBOERR FNC_VALUES 1 FLOAT32_IEEE COLUMN_DIR DIRECT /end RECORD_LAYOUT
/begin COMPU_METHOD CU_AINC_HZ_FR_TURBOERR "Conversion method for AINc_Hz_FR_TurboErr" RAT_FUNC "%10.3" "Hz" COEFFS 0.000000 1.000000 0.000000 0.000000 0.000000 1.000000 /end COMPU_METHOD
/* Scalar calibration for DDE 'AINc_Hz_FuelLevel1_LPF'. */
/begin CHARACTERISTIC AINc_Hz_FuelLevel1_LPF "Lowpass filter cutoff freq. calibration" VALUE 0x8c17c RL_AINC_HZ_FUELLEVEL1_LPF 50.000000 CU_AINC_HZ_FUELLEVEL1_LPF 0.000000 50.000000 BYTE_ORDER MSB_FIRST /end CHARACTERISTIC
/begin RECORD_LAYOUT RL_AINC_HZ_FUELLEVEL1_LPF FNC_VALUES 1 FLOAT32_IEEE COLUMN_DIR DIRECT /end RECORD_LAYOUT
/begin COMPU_METHOD CU_AINC_HZ_FUELLEVEL1_LPF "Conversion method for AINc_Hz_FuelLevel1_LPF" RAT_FUNC "%10.3" "Hz" COEFFS 0.000000 1.000000 0.000000 0.000000 0.000000 1.000000 /end COMPU_METHOD
/* Scalar calibration for DDE 'AINc_Hz_FuelLevel2_LPF'. */
/begin CHARACTERISTIC AINc_Hz_FuelLevel2_LPF "Lowpass filter cutoff freq. calibration" VALUE 0x8c168 RL_AINC_HZ_FUELLEVEL2_LPF 50.000000 CU_AINC_HZ_FUELLEVEL2_LPF 0.000000 50.000000 BYTE_ORDER MSB_FIRST /end CHARACTERISTIC
/begin RECORD_LAYOUT RL_AINC_HZ_FUELLEVEL2_LPF FNC_VALUES 1 FLOAT32_IEEE COLUMN_DIR DIRECT /end RECORD_LAYOUT
/begin COMPU_METHOD CU_AINC_HZ_FUELLEVEL2_LPF "Conversion method for AINc_Hz_FuelLevel2_LPF" RAT_FUNC "%10.3" "Hz" COEFFS 0.000000 1.000000 0.000000 0.000000 0.000000 1.000000 /end COMPU_METHOD
/* Scalar calibration for DDE 'AINc_Hz_FuelPress_BktFR'. */
/begin CHARACTERISTIC AINc_Hz_FuelPress_BktFR "(not defined)" VALUE 0x8dd8c RL_AINC_HZ_FUELPRESS_BKTFR 100.000000 CU_AINC_HZ_FUELPRESS_BKTFR 0.000000 100.000000 BYTE_ORDER MSB_FIRST /end CHARACTERISTIC
/begin RECORD_LAYOUT RL_AINC_HZ_FUELPRESS_BKTFR FNC_VALUES 1 FLOAT32_IEEE COLUMN_DIR DIRECT /end RECORD_LAYOUT
/begin COMPU_METHOD CU_AINC_HZ_FUELPRESS_BKTFR "Conversion method for AINc_Hz_FuelPress_BktFR" RAT_FUNC "%10.3" "Hz" COEFFS 0.000000 1.000000 0.000000 0.000000 0.000000 1.000000 /end COMPU_METHOD
/* Scalar calibration for DDE 'AINc_Hz_FuelPress_BktRR'. */
/begin CHARACTERISTIC AINc_Hz_FuelPress_BktRR "(not defined)" VALUE 0x8dd88 RL_AINC_HZ_FUELPRESS_BKTRR 100.000000 CU_AINC_HZ_FUELPRESS_BKTRR 0.000000 100.000000 BYTE_ORDER MSB_FIRST /end CHARACTERISTIC
/begin RECORD_LAYOUT RL_AINC_HZ_FUELPRESS_BKTRR FNC_VALUES 1 FLOAT32_IEEE COLUMN_DIR DIRECT /end RECORD_LAYOUT
/begin COMPU_METHOD CU_AINC_HZ_FUELPRESS_BKTRR "Conversion method for AINc_Hz_FuelPress_BktRR" RAT_FUNC "%10.3" "Hz" COEFFS 0.000000 1.000000 0.000000 0.000000 0.000000 1.000000 /end COMPU_METHOD
/* Scalar calibration for DDE 'AINc_Hz_FuelPress_LPF'. */
/begin CHARACTERISTIC AINc_Hz_FuelPress_LPF "Lowpass filter cutoff freq. calibration" VALUE 0x8c12c RL_AINC_HZ_FUELPRESS_LPF 50.000000 CU_AINC_HZ_FUELPRESS_LPF 0.000000 50.000000 BYTE_ORDER MSB_FIRST /end CHARACTERISTIC
/begin RECORD_LAYOUT RL_AINC_HZ_FUELPRESS_LPF FNC_VALUES 1 FLOAT32_IEEE COLUMN_DIR DIRECT /end RECORD_LAYOUT
/begin COMPU_METHOD CU_AINC_HZ_FUELPRESS_LPF "Conversion method for AINc_Hz_FuelPress_LPF" RAT_FUNC "%10.2" "Hz" COEFFS 0.000000 1.000000 0.000000 0.000000 0.000000 1.000000 /end COMPU_METHOD
/* Scalar calibration for DDE 'AINc_Hz_FuelTemp_BktFR'. */
/begin CHARACTERISTIC AINc_Hz_FuelTemp_BktFR "(pct/s) rate at which OOR bucket falls (always applies) ie: 0.50 implies fault will clear after 2 seconds." VALUE 0x8dd84 RL_AINC_HZ_FUELTEMP_BKTFR 1000.000000 CU_AINC_HZ_FUELTEMP_BKTFR 0.000000 1000.000000 BYTE_ORDER MSB_FIRST /end CHARACTERISTIC
/begin RECORD_LAYOUT RL_AINC_HZ_FUELTEMP_BKTFR FNC_VALUES 1 FLOAT32_IEEE COLUMN_DIR DIRECT /end RECORD_LAYOUT
/begin COMPU_METHOD CU_AINC_HZ_FUELTEMP_BKTFR "Conversion method for AINc_Hz_FuelTemp_BktFR" RAT_FUNC "%10.2" "NU" COEFFS 0.000000 1.000000 0.000000 0.000000 0.000000 1.000000 /end COMPU_METHOD
/* Scalar calibration for DDE 'AINc_Hz_FuelTemp_BktRR'. */
/begin CHARACTERISTIC AINc_Hz_FuelTemp_BktRR "(pct/s) rate at which OOR bucket rises when an OOR condition is present (Note: must be > fall rate for bucket to work)" VALUE 0x8dd80 RL_AINC_HZ_FUELTEMP_BKTRR 1000.000000 CU_AINC_HZ_FUELTEMP_BKTRR 0.000000 1000.000000 BYTE_ORDER MSB_FIRST /end CHARACTERISTIC
/begin RECORD_LAYOUT RL_AINC_HZ_FUELTEMP_BKTRR FNC_VALUES 1 FLOAT32_IEEE COLUMN_DIR DIRECT /end RECORD_LAYOUT
/begin COMPU_METHOD CU_AINC_HZ_FUELTEMP_BKTRR "Conversion method for AINc_Hz_FuelTemp_BktRR" RAT_FUNC "%10.2" "NU" COEFFS 0.000000 1.000000 0.000000 0.000000 0.000000 1.000000 /end COMPU_METHOD
/* Scalar calibration for DDE 'AINc_Hz_LB12_fail_FR'. */
/begin CHARACTERISTIC AINc_Hz_LB12_fail_FR "(not defined)" VALUE 0x8c0a8 RL_AINC_HZ_LB12_FAIL_FR 100.000000 CU_AINC_HZ_LB12_FAIL_FR 0.000000 100.000000 BYTE_ORDER MSB_FIRST /end CHARACTERISTIC
/begin RECORD_LAYOUT RL_AINC_HZ_LB12_FAIL_FR FNC_VALUES 1 FLOAT32_IEEE COLUMN_DIR DIRECT /end RECORD_LAYOUT
/begin COMPU_METHOD CU_AINC_HZ_LB12_FAIL_FR "Conversion method for AINc_Hz_LB12_fail_FR" RAT_FUNC "%10.3" "Hz" COEFFS 0.000000 1.000000 0.000000 0.000000 0.000000 1.000000 /end COMPU_METHOD
/* Scalar calibration for DDE 'AINc_Hz_LB12_fail_RR'. */
/begin CHARACTERISTIC AINc_Hz_LB12_fail_RR "(not defined)" VALUE 0x8c0ac RL_AINC_HZ_LB12_FAIL_RR 100.000000 CU_AINC_HZ_LB12_FAIL_RR 0.000000 100.000000 BYTE_ORDER MSB_FIRST /end CHARACTERISTIC
/begin RECORD_LAYOUT RL_AINC_HZ_LB12_FAIL_RR FNC_VALUES 1 FLOAT32_IEEE COLUMN_DIR DIRECT /end RECORD_LAYOUT
/begin COMPU_METHOD CU_AINC_HZ_LB12_FAIL_RR "Conversion method for AINc_Hz_LB12_fail_RR" RAT_FUNC "%10.3" "Hz" COEFFS 0.000000 1.000000 0.000000 0.000000 0.000000 1.000000 /end COMPU_METHOD
/* Scalar calibration for DDE 'AINc_Hz_LB12_vl_FR'. */
/begin CHARACTERISTIC AINc_Hz_LB12_vl_FR "(not defined)" VALUE 0x8c0bc RL_AINC_HZ_LB12_VL_FR 100.000000 CU_AINC_HZ_LB12_VL_FR 0.000000 100.000000 BYTE_ORDER MSB_FIRST /end CHARACTERISTIC
/begin RECORD_LAYOUT RL_AINC_HZ_LB12_VL_FR FNC_VALUES 1 FLOAT32_IEEE COLUMN_DIR DIRECT /end RECORD_LAYOUT
/begin COMPU_METHOD CU_AINC_HZ_LB12_VL_FR "Conversion method for AINc_Hz_LB12_vl_FR" RAT_FUNC "%10.3" "Hz" COEFFS 0.000000 1.000000 0.000000 0.000000 0.000000 1.000000 /end COMPU_METHOD
/* Scalar calibration for DDE 'AINc_Hz_LB12_vl_RR'. */
/begin CHARACTERISTIC AINc_Hz_LB12_vl_RR "(not defined)" VALUE 0x8c0c0 RL_AINC_HZ_LB12_VL_RR 100.000000 CU_AINC_HZ_LB12_VL_RR 0.000000 100.000000 BYTE_ORDER MSB_FIRST /end CHARACTERISTIC
/begin RECORD_LAYOUT RL_AINC_HZ_LB12_VL_RR FNC_VALUES 1 FLOAT32_IEEE COLUMN_DIR DIRECT /end RECORD_LAYOUT
/begin COMPU_METHOD CU_AINC_HZ_LB12_VL_RR "Conversion method for AINc_Hz_LB12_vl_RR" RAT_FUNC "%10.3" "Hz" COEFFS 0.000000 1.000000 0.000000 0.000000 0.000000 1.000000 /end COMPU_METHOD
/* Scalar calibration for DDE 'AINc_Hz_ManifoldTemp_BktFR'. */
/begin CHARACTERISTIC AINc_Hz_ManifoldTemp_BktFR "(pct/s) rate at which OOR bucket falls (always applies) ie: 0.50 implies fault will clear after 2 seconds." VALUE 0x8dd7c RL_AINC_HZ_MANIFOLDTEMP_BKTFR 1000.000000 CU_AINC_HZ_MANIFOLDTEMP_BKTFR 0.000000 1000.000000 BYTE_ORDER MSB_FIRST /end CHARACTERISTIC
/begin RECORD_LAYOUT RL_AINC_HZ_MANIFOLDTEMP_BKTFR FNC_VALUES 1 FLOAT32_IEEE COLUMN_DIR DIRECT /end RECORD_LAYOUT
/begin COMPU_METHOD CU_AINC_HZ_MANIFOLDTEMP_BKTFR "Conversion method for AINc_Hz_ManifoldTemp_BktFR" RAT_FUNC "%10.2" "NU" COEFFS 0.000000 1.000000 0.000000 0.000000 0.000000 1.000000 /end COMPU_METHOD
/* Scalar calibration for DDE 'AINc_Hz_ManifoldTemp_BktRR'. */
/begin CHARACTERISTIC AINc_Hz_ManifoldTemp_BktRR "(pct/s) rate at which OOR bucket rises when an OOR condition is present (Note: must be > fall rate for bucket to work)" VALUE 0x8dd78 RL_AINC_HZ_MANIFOLDTEMP_BKTRR 1000.000000 CU_AINC_HZ_MANIFOLDTEMP_BKTRR 0.000000 1000.000000 BYTE_ORDER MSB_FIRST /end CHARACTERISTIC
/begin RECORD_LAYOUT RL_AINC_HZ_MANIFOLDTEMP_BKTRR FNC_VALUES 1 FLOAT32_IEEE COLUMN_DIR DIRECT /end RECORD_LAYOUT
/begin COMPU_METHOD CU_AINC_HZ_MANIFOLDTEMP_BKTRR "Conversion method for AINc_Hz_ManifoldTemp_BktRR" RAT_FUNC "%10.2" "NU" COEFFS 0.000000 1.000000 0.000000 0.000000 0.000000 1.000000 /end COMPU_METHOD
/* Scalar calibration for DDE 'AINc_Hz_RT_TurboErr'. */
/begin CHARACTERISTIC AINc_Hz_RT_TurboErr "(not defined)" VALUE 0x8b874 RL_AINC_HZ_RT_TURBOERR 100.000000 CU_AINC_HZ_RT_TURBOERR 0.000000 100.000000 BYTE_ORDER MSB_FIRST /end CHARACTERISTIC
/begin RECORD_LAYOUT RL_AINC_HZ_RT_TURBOERR FNC_VALUES 1 FLOAT32_IEEE COLUMN_DIR DIRECT /end RECORD_LAYOUT
/begin COMPU_METHOD CU_AINC_HZ_RT_TURBOERR "Conversion method for AINc_Hz_RT_TurboErr" RAT_FUNC "%10.3" "Hz" COEFFS 0.000000 1.000000 0.000000 0.000000 0.000000 1.000000 /end COMPU_METHOD
/* Scalar calibration for DDE 'AINc_Hz_TP1_BktFR'. */
/begin CHARACTERISTIC AINc_Hz_TP1_BktFR "(pct/s) rate at which OOR bucket falls (always applies) ie: 0.50 implies fault will clear after 2 seconds." VALUE 0x8dd74 RL_AINC_HZ_TP1_BKTFR 1000.000000 CU_AINC_HZ_TP1_BKTFR 0.000000 1000.000000 BYTE_ORDER MSB_FIRST /end CHARACTERISTIC
/begin RECORD_LAYOUT RL_AINC_HZ_TP1_BKTFR FNC_VALUES 1 FLOAT32_IEEE COLUMN_DIR DIRECT /end RECORD_LAYOUT
/begin COMPU_METHOD CU_AINC_HZ_TP1_BKTFR "Conversion method for AINc_Hz_TP1_BktFR" RAT_FUNC "%10.2" "NU" COEFFS 0.000000 1.000000 0.000000 0.000000 0.000000 1.000000 /end COMPU_METHOD
/* Scalar calibration for DDE 'AINc_Hz_TP1_BktRR'. */
/begin CHARACTERISTIC AINc_Hz_TP1_BktRR "(pct/s) rate at which OOR bucket rises when an OOR condition is present (Note: must be > fall rate for bucket to work)" VALUE 0x8dd70 RL_AINC_HZ_TP1_BKTRR 1000.000000 CU_AINC_HZ_TP1_BKTRR 0.000000 1000.000000 BYTE_ORDER MSB_FIRST /end CHARACTERISTIC
/begin RECORD_LAYOUT RL_AINC_HZ_TP1_BKTRR FNC_VALUES 1 FLOAT32_IEEE COLUMN_DIR DIRECT /end RECORD_LAYOUT
/begin COMPU_METHOD CU_AINC_HZ_TP1_BKTRR "Conversion method for AINc_Hz_TP1_BktRR" RAT_FUNC "%10.2" "NU" COEFFS 0.000000 1.000000 0.000000 0.000000 0.000000 1.000000 /end COMPU_METHOD
/* Scalar calibration for DDE 'AINc_Hz_TP2_BktFR'. */
/begin CHARACTERISTIC AINc_Hz_TP2_BktFR "(pct/s) rate at which OOR bucket falls (always applies) ie: 0.50 implies fault will clear after 2 seconds." VALUE 0x8dd6c RL_AINC_HZ_TP2_BKTFR 1000.000000 CU_AINC_HZ_TP2_BKTFR 0.000000 1000.000000 BYTE_ORDER MSB_FIRST /end CHARACTERISTIC
/begin RECORD_LAYOUT RL_AINC_HZ_TP2_BKTFR FNC_VALUES 1 FLOAT32_IEEE COLUMN_DIR DIRECT /end RECORD_LAYOUT
/begin COMPU_METHOD CU_AINC_HZ_TP2_BKTFR "Conversion method for AINc_Hz_TP2_BktFR" RAT_FUNC "%10.2" "NU" COEFFS 0.000000 1.000000 0.000000 0.000000 0.000000 1.000000 /end COMPU_METHOD
/* Scalar calibration for DDE 'AINc_Hz_TP2_BktRR'. */
/begin CHARACTERISTIC AINc_Hz_TP2_BktRR "(pct/s) rate at which OOR bucket rises when an OOR condition is present (Note: must be > fall rate for bucket to work)" VALUE 0x8dd68 RL_AINC_HZ_TP2_BKTRR 1000.000000 CU_AINC_HZ_TP2_BKTRR 0.000000 1000.000000 BYTE_ORDER MSB_FIRST /end CHARACTERISTIC
/begin RECORD_LAYOUT RL_AINC_HZ_TP2_BKTRR FNC_VALUES 1 FLOAT32_IEEE COLUMN_DIR DIRECT /end RECORD_LAYOUT
/begin COMPU_METHOD CU_AINC_HZ_TP2_BKTRR "Conversion method for AINc_Hz_TP2_BktRR" RAT_FUNC "%10.2" "NU" COEFFS 0.000000 1.000000 0.000000 0.000000 0.000000 1.000000 /end COMPU_METHOD
/* Scalar calibration for DDE 'AINc_Hz_bat_dat_nok_FR'. */
/begin CHARACTERISTIC AINc_Hz_bat_dat_nok_FR "(not defined)" VALUE 0x8c388 RL_AINC_HZ_BAT_DAT_NOK_FR 100.000000 CU_AINC_HZ_BAT_DAT_NOK_FR 0.000000 100.000000 BYTE_ORDER MSB_FIRST /end CHARACTERISTIC
/begin RECORD_LAYOUT RL_AINC_HZ_BAT_DAT_NOK_FR FNC_VALUES 1 FLOAT32_IEEE COLUMN_DIR DIRECT /end RECORD_LAYOUT
/begin COMPU_METHOD CU_AINC_HZ_BAT_DAT_NOK_FR "Conversion method for AINc_Hz_bat_dat_nok_FR" RAT_FUNC "%10.3" "Hz" COEFFS 0.000000 1.000000 0.000000 0.000000 0.000000 1.000000 /end COMPU_METHOD
/* Scalar calibration for DDE 'AINc_Hz_bat_dat_nok_RR'. */
/begin CHARACTERISTIC AINc_Hz_bat_dat_nok_RR "(not defined)" VALUE 0x8c38c RL_AINC_HZ_BAT_DAT_NOK_RR 100.000000 CU_AINC_HZ_BAT_DAT_NOK_RR 0.000000 100.000000 BYTE_ORDER MSB_FIRST /end CHARACTERISTIC
/begin RECORD_LAYOUT RL_AINC_HZ_BAT_DAT_NOK_RR FNC_VALUES 1 FLOAT32_IEEE COLUMN_DIR DIRECT /end RECORD_LAYOUT
/begin COMPU_METHOD CU_AINC_HZ_BAT_DAT_NOK_RR "Conversion method for AINc_Hz_bat_dat_nok_RR" RAT_FUNC "%10.3" "Hz" COEFFS 0.000000 1.000000 0.000000 0.000000 0.000000 1.000000 /end COMPU_METHOD
/* Scalar calibration for DDE 'AINc_Hz_eng_oil_pres_dat_l3_FR'. */
/begin CHARACTERISTIC AINc_Hz_eng_oil_pres_dat_l3_FR "(not defined)" VALUE 0x8c858 RL_AINC_HZ_ENG_OIL_PRES_DAT_L30 100.000000 CU_AINC_HZ_ENG_OIL_PRES_DAT_L30 0.000000 100.000000 BYTE_ORDER MSB_FIRST /end CHARACTERISTIC
/begin RECORD_LAYOUT RL_AINC_HZ_ENG_OIL_PRES_DAT_L30 FNC_VALUES 1 FLOAT32_IEEE COLUMN_DIR DIRECT /end RECORD_LAYOUT
/begin COMPU_METHOD CU_AINC_HZ_ENG_OIL_PRES_DAT_L30 "Conversion method for AINc_Hz_eng_oil_pres_dat_l3_FR" RAT_FUNC "%10.3" "Hz" COEFFS 0.000000 1.000000 0.000000 0.000000 0.000000 1.000000 /end COMPU_METHOD
/* Scalar calibration for DDE 'AINc_Hz_eng_oil_pres_dat_l3_RR'. */
/begin CHARACTERISTIC AINc_Hz_eng_oil_pres_dat_l3_RR "(not defined)" VALUE 0x8c85c RL_AINC_HZ_ENG_OIL_PRES_DAT_L31 100.000000 CU_AINC_HZ_ENG_OIL_PRES_DAT_L31 0.000000 100.000000 BYTE_ORDER MSB_FIRST /end CHARACTERISTIC
/begin RECORD_LAYOUT RL_AINC_HZ_ENG_OIL_PRES_DAT_L31 FNC_VALUES 1 FLOAT32_IEEE COLUMN_DIR DIRECT /end RECORD_LAYOUT
/begin COMPU_METHOD CU_AINC_HZ_ENG_OIL_PRES_DAT_L31 "Conversion method for AINc_Hz_eng_oil_pres_dat_l3_RR" RAT_FUNC "%10.3" "Hz" COEFFS 0.000000 1.000000 0.000000 0.000000 0.000000 1.000000 /end COMPU_METHOD
/* Scalar calibration for DDE 'AINc_Hz_eng_oil_pres_oc_FR'. */
/begin CHARACTERISTIC AINc_Hz_eng_oil_pres_oc_FR "(not defined)" VALUE 0x8c84c RL_AINC_HZ_ENG_OIL_PRES_OC_FR 100.000000 CU_AINC_HZ_ENG_OIL_PRES_OC_FR 0.000000 100.000000 BYTE_ORDER MSB_FIRST /end CHARACTERISTIC
/begin RECORD_LAYOUT RL_AINC_HZ_ENG_OIL_PRES_OC_FR FNC_VALUES 1 FLOAT32_IEEE COLUMN_DIR DIRECT /end RECORD_LAYOUT
/begin COMPU_METHOD CU_AINC_HZ_ENG_OIL_PRES_OC_FR "Conversion method for AINc_Hz_eng_oil_pres_oc_FR" RAT_FUNC "%10.3" "Hz" COEFFS 0.000000 1.000000 0.000000 0.000000 0.000000 1.000000 /end COMPU_METHOD
/* Scalar calibration for DDE 'AINc_Hz_eng_oil_pres_oc_RR'. */
/begin CHARACTERISTIC AINc_Hz_eng_oil_pres_oc_RR "(not defined)" VALUE 0x8c850 RL_AINC_HZ_ENG_OIL_PRES_OC_RR 100.000000 CU_AINC_HZ_ENG_OIL_PRES_OC_RR 0.000000 100.000000 BYTE_ORDER MSB_FIRST /end CHARACTERISTIC
/begin RECORD_LAYOUT RL_AINC_HZ_ENG_OIL_PRES_OC_RR FNC_VALUES 1 FLOAT32_IEEE COLUMN_DIR DIRECT /end RECORD_LAYOUT
/begin COMPU_METHOD CU_AINC_HZ_ENG_OIL_PRES_OC_RR "Conversion method for AINc_Hz_eng_oil_pres_oc_RR" RAT_FUNC "%10.3" "Hz" COEFFS 0.000000 1.000000 0.000000 0.000000 0.000000 1.000000 /end COMPU_METHOD
/* Scalar calibration for DDE 'AINc_Hz_fuel_lvl_dat_FR'. */
/begin CHARACTERISTIC AINc_Hz_fuel_lvl_dat_FR "(not defined)" VALUE 0x8c150 RL_AINC_HZ_FUEL_LVL_DAT_FR 100.000000 CU_AINC_HZ_FUEL_LVL_DAT_FR 0.000000 100.000000 BYTE_ORDER MSB_FIRST /end CHARACTERISTIC
/begin RECORD_LAYOUT RL_AINC_HZ_FUEL_LVL_DAT_FR FNC_VALUES 1 FLOAT32_IEEE COLUMN_DIR DIRECT /end RECORD_LAYOUT
/begin COMPU_METHOD CU_AINC_HZ_FUEL_LVL_DAT_FR "Conversion method for AINc_Hz_fuel_lvl_dat_FR" RAT_FUNC "%10.3" "Hz" COEFFS 0.000000 1.000000 0.000000 0.000000 0.000000 1.000000 /end COMPU_METHOD
/* Scalar calibration for DDE 'AINc_Hz_fuel_lvl_dat_RR'. */
/begin CHARACTERISTIC AINc_Hz_fuel_lvl_dat_RR "(not defined)" VALUE 0x8c154 RL_AINC_HZ_FUEL_LVL_DAT_RR 100.000000 CU_AINC_HZ_FUEL_LVL_DAT_RR 0.000000 100.000000 BYTE_ORDER MSB_FIRST /end CHARACTERISTIC
/begin RECORD_LAYOUT RL_AINC_HZ_FUEL_LVL_DAT_RR FNC_VALUES 1 FLOAT32_IEEE COLUMN_DIR DIRECT /end RECORD_LAYOUT
/begin COMPU_METHOD CU_AINC_HZ_FUEL_LVL_DAT_RR "Conversion method for AINc_Hz_fuel_lvl_dat_RR" RAT_FUNC "%10.3" "Hz" COEFFS 0.000000 1.000000 0.000000 0.000000 0.000000 1.000000 /end COMPU_METHOD
/* Scalar calibration for DDE 'AINc_Hz_map_dath_FR'. */
/begin CHARACTERISTIC AINc_Hz_map_dath_FR "(not defined)" VALUE 0x8c058 RL_AINC_HZ_MAP_DATH_FR 100.000000 CU_AINC_HZ_MAP_DATH_FR 0.000000 100.000000 BYTE_ORDER MSB_FIRST /end CHARACTERISTIC
/begin RECORD_LAYOUT RL_AINC_HZ_MAP_DATH_FR FNC_VALUES 1 FLOAT32_IEEE COLUMN_DIR DIRECT /end RECORD_LAYOUT
/begin COMPU_METHOD CU_AINC_HZ_MAP_DATH_FR "Conversion method for AINc_Hz_map_dath_FR" RAT_FUNC "%10.3" "Hz" COEFFS 0.000000 1.000000 0.000000 0.000000 0.000000 1.000000 /end COMPU_METHOD
/* Scalar calibration for DDE 'AINc_Hz_map_dath_RR'. */
/begin CHARACTERISTIC AINc_Hz_map_dath_RR "(not defined)" VALUE 0x8c05c RL_AINC_HZ_MAP_DATH_RR 100.000000 CU_AINC_HZ_MAP_DATH_RR 0.000000 100.000000 BYTE_ORDER MSB_FIRST /end CHARACTERISTIC
/begin RECORD_LAYOUT RL_AINC_HZ_MAP_DATH_RR FNC_VALUES 1 FLOAT32_IEEE COLUMN_DIR DIRECT /end RECORD_LAYOUT
/begin COMPU_METHOD CU_AINC_HZ_MAP_DATH_RR "Conversion method for AINc_Hz_map_dath_RR" RAT_FUNC "%10.3" "Hz" COEFFS 0.000000 1.000000 0.000000 0.000000 0.000000 1.000000 /end COMPU_METHOD
/* Scalar calibration for DDE 'AINc_Hz_map_datl_FR'. */
/begin CHARACTERISTIC AINc_Hz_map_datl_FR "(not defined)" VALUE 0x8c068 RL_AINC_HZ_MAP_DATL_FR 100.000000 CU_AINC_HZ_MAP_DATL_FR 0.000000 100.000000 BYTE_ORDER MSB_FIRST /end CHARACTERISTIC
/begin RECORD_LAYOUT RL_AINC_HZ_MAP_DATL_FR FNC_VALUES 1 FLOAT32_IEEE COLUMN_DIR DIRECT /end RECORD_LAYOUT
/begin COMPU_METHOD CU_AINC_HZ_MAP_DATL_FR "Conversion method for AINc_Hz_map_datl_FR" RAT_FUNC "%10.3" "Hz" COEFFS 0.000000 1.000000 0.000000 0.000000 0.000000 1.000000 /end COMPU_METHOD
/* Scalar calibration for DDE 'AINc_Hz_map_datl_RR'. */
/begin CHARACTERISTIC AINc_Hz_map_datl_RR "(not defined)" VALUE 0x8c06c RL_AINC_HZ_MAP_DATL_RR 100.000000 CU_AINC_HZ_MAP_DATL_RR 0.000000 100.000000 BYTE_ORDER MSB_FIRST /end CHARACTERISTIC
/begin RECORD_LAYOUT RL_AINC_HZ_MAP_DATL_RR FNC_VALUES 1 FLOAT32_IEEE COLUMN_DIR DIRECT /end RECORD_LAYOUT
/begin COMPU_METHOD CU_AINC_HZ_MAP_DATL_RR "Conversion method for AINc_Hz_map_datl_RR" RAT_FUNC "%10.3" "Hz" COEFFS 0.000000 1.000000 0.000000 0.000000 0.000000 1.000000 /end COMPU_METHOD
/* Scalar calibration for DDE 'AINc_Hz_map_lh_FR'. */
/begin CHARACTERISTIC AINc_Hz_map_lh_FR "(not defined)" VALUE 0x8c038 RL_AINC_HZ_MAP_LH_FR 100.000000 CU_AINC_HZ_MAP_LH_FR 0.000000 100.000000 BYTE_ORDER MSB_FIRST /end CHARACTERISTIC
/begin RECORD_LAYOUT RL_AINC_HZ_MAP_LH_FR FNC_VALUES 1 FLOAT32_IEEE COLUMN_DIR DIRECT /end RECORD_LAYOUT
/begin COMPU_METHOD CU_AINC_HZ_MAP_LH_FR "Conversion method for AINc_Hz_map_lh_FR" RAT_FUNC "%10.3" "Hz" COEFFS 0.000000 1.000000 0.000000 0.000000 0.000000 1.000000 /end COMPU_METHOD
/* Scalar calibration for DDE 'AINc_Hz_map_lh_RR'. */
/begin CHARACTERISTIC AINc_Hz_map_lh_RR "(not defined)" VALUE 0x8c03c RL_AINC_HZ_MAP_LH_RR 100.000000 CU_AINC_HZ_MAP_LH_RR 0.000000 100.000000 BYTE_ORDER MSB_FIRST /end CHARACTERISTIC
/begin RECORD_LAYOUT RL_AINC_HZ_MAP_LH_RR FNC_VALUES 1 FLOAT32_IEEE COLUMN_DIR DIRECT /end RECORD_LAYOUT
/begin COMPU_METHOD CU_AINC_HZ_MAP_LH_RR "Conversion method for AINc_Hz_map_lh_RR" RAT_FUNC "%10.3" "Hz" COEFFS 0.000000 1.000000 0.000000 0.000000 0.000000 1.000000 /end COMPU_METHOD
/* Scalar calibration for DDE 'AINc_Hz_map_vh_FR'. */
/begin CHARACTERISTIC AINc_Hz_map_vh_FR "(not defined)" VALUE 0x8c028 RL_AINC_HZ_MAP_VH_FR 100.000000 CU_AINC_HZ_MAP_VH_FR 0.000000 100.000000 BYTE_ORDER MSB_FIRST /end CHARACTERISTIC
/begin RECORD_LAYOUT RL_AINC_HZ_MAP_VH_FR FNC_VALUES 1 FLOAT32_IEEE COLUMN_DIR DIRECT /end RECORD_LAYOUT
/begin COMPU_METHOD CU_AINC_HZ_MAP_VH_FR "Conversion method for AINc_Hz_map_vh_FR" RAT_FUNC "%10.3" "Hz" COEFFS 0.000000 1.000000 0.000000 0.000000 0.000000 1.000000 /end COMPU_METHOD
/* Scalar calibration for DDE 'AINc_Hz_map_vh_RR'. */
/begin CHARACTERISTIC AINc_Hz_map_vh_RR "(not defined)" VALUE 0x8c02c RL_AINC_HZ_MAP_VH_RR 100.000000 CU_AINC_HZ_MAP_VH_RR 0.000000 100.000000 BYTE_ORDER MSB_FIRST /end CHARACTERISTIC
/begin RECORD_LAYOUT RL_AINC_HZ_MAP_VH_RR FNC_VALUES 1 FLOAT32_IEEE COLUMN_DIR DIRECT /end RECORD_LAYOUT
/begin COMPU_METHOD CU_AINC_HZ_MAP_VH_RR "Conversion method for AINc_Hz_map_vh_RR" RAT_FUNC "%10.3" "Hz" COEFFS 0.000000 1.000000 0.000000 0.000000 0.000000 1.000000 /end COMPU_METHOD
/* Scalar calibration for DDE 'AINc_Hz_vsup_nok_FR'. */
/begin CHARACTERISTIC AINc_Hz_vsup_nok_FR "(not defined)" VALUE 0x8ccd8 RL_AINC_HZ_VSUP_NOK_FR 100.000000 CU_AINC_HZ_VSUP_NOK_FR 0.000000 100.000000 BYTE_ORDER MSB_FIRST /end CHARACTERISTIC
/begin RECORD_LAYOUT RL_AINC_HZ_VSUP_NOK_FR FNC_VALUES 1 FLOAT32_IEEE COLUMN_DIR DIRECT /end RECORD_LAYOUT
/begin COMPU_METHOD CU_AINC_HZ_VSUP_NOK_FR "Conversion method for AINc_Hz_vsup_nok_FR" RAT_FUNC "%10.3" "Hz" COEFFS 0.000000 1.000000 0.000000 0.000000 0.000000 1.000000 /end COMPU_METHOD
/* Scalar calibration for DDE 'AINc_Hz_vsup_nok_RR'. */
/begin CHARACTERISTIC AINc_Hz_vsup_nok_RR "(not defined)" VALUE 0x8ccdc RL_AINC_HZ_VSUP_NOK_RR 100.000000 CU_AINC_HZ_VSUP_NOK_RR 0.000000 100.000000 BYTE_ORDER MSB_FIRST /end CHARACTERISTIC
/begin RECORD_LAYOUT RL_AINC_HZ_VSUP_NOK_RR FNC_VALUES 1 FLOAT32_IEEE COLUMN_DIR DIRECT /end RECORD_LAYOUT
/begin COMPU_METHOD CU_AINC_HZ_VSUP_NOK_RR "Conversion method for AINc_Hz_vsup_nok_RR" RAT_FUNC "%10.3" "Hz" COEFFS 0.000000 1.000000 0.000000 0.000000 0.000000 1.000000 /end COMPU_METHOD
/* Scalar calibration for DDE 'AINc_NU_APP1_Raw'. */
/begin CHARACTERISTIC AINc_NU_APP1_Raw "Override value" VALUE 0x8c414 RL_AINC_NU_APP1_RAW 2.000000 CU_AINC_NU_APP1_RAW 0.000000 2.000000 BYTE_ORDER MSB_FIRST /end CHARACTERISTIC
/begin RECORD_LAYOUT RL_AINC_NU_APP1_RAW FNC_VALUES 1 FLOAT32_IEEE COLUMN_DIR DIRECT /end RECORD_LAYOUT
/begin COMPU_METHOD CU_AINC_NU_APP1_RAW "Conversion method for AINc_NU_APP1_Raw" RAT_FUNC "%10.2" "NU" COEFFS 0.000000 1.000000 0.000000 0.000000 0.000000 1.000000 /end COMPU_METHOD
/* Scalar calibration for DDE 'AINc_NU_APP2_Raw'. */
/begin CHARACTERISTIC AINc_NU_APP2_Raw "Override value" VALUE 0x8c41c RL_AINC_NU_APP2_RAW 2.000000 CU_AINC_NU_APP2_RAW 0.000000 2.000000 BYTE_ORDER MSB_FIRST /end CHARACTERISTIC
/begin RECORD_LAYOUT RL_AINC_NU_APP2_RAW FNC_VALUES 1 FLOAT32_IEEE COLUMN_DIR DIRECT /end RECORD_LAYOUT
/begin COMPU_METHOD CU_AINC_NU_APP2_RAW "Conversion method for AINc_NU_APP2_Raw" RAT_FUNC "%10.2" "NU" COEFFS 0.000000 1.000000 0.000000 0.000000 0.000000 1.000000 /end COMPU_METHOD
/* Scalar calibration for DDE 'AINc_NU_AmbientTemp_BktHys'. */
/begin CHARACTERISTIC AINc_NU_AmbientTemp_BktHys "This is the bucket value where the fault clears. (Fault will always set when bucket value = 1.0 which cannot be adjusted.)" VALUE 0x8dd64 RL_AINC_NU_AMBIENTTEMP_BKTHYS 1.100000 CU_AINC_NU_AMBIENTTEMP_BKTHYS -0.100000 1.000000 BYTE_ORDER MSB_FIRST /end CHARACTERISTIC
/begin RECORD_LAYOUT RL_AINC_NU_AMBIENTTEMP_BKTHYS FNC_VALUES 1 FLOAT32_IEEE COLUMN_DIR DIRECT /end RECORD_LAYOUT
/begin COMPU_METHOD CU_AINC_NU_AMBIENTTEMP_BKTHYS "Conversion method for AINc_NU_AmbientTemp_BktHys" RAT_FUNC "%10.1" "NU" COEFFS 0.000000 1.000000 0.000000 0.000000 0.000000 1.000000 /end COMPU_METHOD
/* Scalar calibration for DDE 'AINc_NU_AmbientTemp_SlewLim'. */
/begin CHARACTERISTIC AINc_NU_AmbientTemp_SlewLim "(pct/s) set to 9s to disable check" VALUE 0x8dd60 RL_AINC_NU_AMBIENTTEMP_SLEWLIM 0.000000 CU_AINC_NU_AMBIENTTEMP_SLEWLIM 999999.000000 999999.000000 BYTE_ORDER MSB_FIRST /end CHARACTERISTIC
/begin RECORD_LAYOUT RL_AINC_NU_AMBIENTTEMP_SLEWLIM FNC_VALUES 1 FLOAT32_IEEE COLUMN_DIR DIRECT /end RECORD_LAYOUT
/begin COMPU_METHOD CU_AINC_NU_AMBIENTTEMP_SLEWLIM "Conversion method for AINc_NU_AmbientTemp_SlewLim" RAT_FUNC "%10.0" "NU" COEFFS 0.000000 1.000000 0.000000 0.000000 0.000000 1.000000 /end COMPU_METHOD
/* Scalar calibration for DDE 'AINc_NU_Baro_BktHys'. */
/begin CHARACTERISTIC AINc_NU_Baro_BktHys "This is the bucket value where the fault clears. (Fault will always set when bucket value = 1.0 which cannot be adjusted.)" VALUE 0x8dd5c RL_AINC_NU_BARO_BKTHYS 1.100000 CU_AINC_NU_BARO_BKTHYS -0.100000 1.000000 BYTE_ORDER MSB_FIRST /end CHARACTERISTIC
/begin RECORD_LAYOUT RL_AINC_NU_BARO_BKTHYS FNC_VALUES 1 FLOAT32_IEEE COLUMN_DIR DIRECT /end RECORD_LAYOUT
/begin COMPU_METHOD CU_AINC_NU_BARO_BKTHYS "Conversion method for AINc_NU_Baro_BktHys" RAT_FUNC "%10.1" "NU" COEFFS 0.000000 1.000000 0.000000 0.000000 0.000000 1.000000 /end COMPU_METHOD
/* Scalar calibration for DDE 'AINc_NU_Baro_Gain'. */
/begin CHARACTERISTIC AINc_NU_Baro_Gain "(pct/V) Sensor transfer function" VALUE 0x8c074 RL_AINC_NU_BARO_GAIN 100.000000 CU_AINC_NU_BARO_GAIN 0.000000 100.000000 BYTE_ORDER MSB_FIRST /end CHARACTERISTIC
/begin RECORD_LAYOUT RL_AINC_NU_BARO_GAIN FNC_VALUES 1 FLOAT32_IEEE COLUMN_DIR DIRECT /end RECORD_LAYOUT
/begin COMPU_METHOD CU_AINC_NU_BARO_GAIN "Conversion method for AINc_NU_Baro_Gain" RAT_FUNC "%10.3" "NU" COEFFS 0.000000 1.000000 0.000000 0.000000 0.000000 1.000000 /end COMPU_METHOD
/* Scalar calibration for DDE 'AINc_NU_Baro_SlewLim'. */
/begin CHARACTERISTIC AINc_NU_Baro_SlewLim "(pct/s) set to 9s to disable check" VALUE 0x8dd58 RL_AINC_NU_BARO_SLEWLIM 0.000000 CU_AINC_NU_BARO_SLEWLIM 999999.000000 999999.000000 BYTE_ORDER MSB_FIRST /end CHARACTERISTIC
/begin RECORD_LAYOUT RL_AINC_NU_BARO_SLEWLIM FNC_VALUES 1 FLOAT32_IEEE COLUMN_DIR DIRECT /end RECORD_LAYOUT
/begin COMPU_METHOD CU_AINC_NU_BARO_SLEWLIM "Conversion method for AINc_NU_Baro_SlewLim" RAT_FUNC "%10.0" "NU" COEFFS 0.000000 1.000000 0.000000 0.000000 0.000000 1.000000 /end COMPU_METHOD
/* Scalar calibration for DDE 'AINc_NU_CompOutPress_BktHys'. */
/begin CHARACTERISTIC AINc_NU_CompOutPress_BktHys "This is the bucket value where the fault clears. (Fault will always set when bucket value = 1.0 which cannot be adjusted.)" VALUE 0x8dd54 RL_AINC_NU_COMPOUTPRESS_BKTHYS 1.100000 CU_AINC_NU_COMPOUTPRESS_BKTHYS -0.100000 1.000000 BYTE_ORDER MSB_FIRST /end CHARACTERISTIC
/begin RECORD_LAYOUT RL_AINC_NU_COMPOUTPRESS_BKTHYS FNC_VALUES 1 FLOAT32_IEEE COLUMN_DIR DIRECT /end RECORD_LAYOUT
/begin COMPU_METHOD CU_AINC_NU_COMPOUTPRESS_BKTHYS "Conversion method for AINc_NU_CompOutPress_BktHys" RAT_FUNC "%10.1" "NU" COEFFS 0.000000 1.000000 0.000000 0.000000 0.000000 1.000000 /end COMPU_METHOD
/* Scalar calibration for DDE 'AINc_NU_CompOutPress_Gain'. */
/begin CHARACTERISTIC AINc_NU_CompOutPress_Gain "(pct/V) Sensor transfer function" VALUE 0x8c394 RL_AINC_NU_COMPOUTPRESS_GAIN 100.000000 CU_AINC_NU_COMPOUTPRESS_GAIN 0.000000 100.000000 BYTE_ORDER MSB_FIRST /end CHARACTERISTIC
/begin RECORD_LAYOUT RL_AINC_NU_COMPOUTPRESS_GAIN FNC_VALUES 1 FLOAT32_IEEE COLUMN_DIR DIRECT /end RECORD_LAYOUT
/begin COMPU_METHOD CU_AINC_NU_COMPOUTPRESS_GAIN "Conversion method for AINc_NU_CompOutPress_Gain" RAT_FUNC "%10.3" "NU" COEFFS 0.000000 1.000000 0.000000 0.000000 0.000000 1.000000 /end COMPU_METHOD
/* Scalar calibration for DDE 'AINc_NU_CompOutPress_SlewLim'. */
/begin CHARACTERISTIC AINc_NU_CompOutPress_SlewLim "(pct/s) set to 9s to disable check" VALUE 0x8dd50 RL_AINC_NU_COMPOUTPRESS_SLEWLIM 0.000000 CU_AINC_NU_COMPOUTPRESS_SLEWLIM 999999.000000 999999.000000 BYTE_ORDER MSB_FIRST /end CHARACTERISTIC
/begin RECORD_LAYOUT RL_AINC_NU_COMPOUTPRESS_SLEWLIM FNC_VALUES 1 FLOAT32_IEEE COLUMN_DIR DIRECT /end RECORD_LAYOUT
/begin COMPU_METHOD CU_AINC_NU_COMPOUTPRESS_SLEWLIM "Conversion method for AINc_NU_CompOutPress_SlewLim" RAT_FUNC "%10.0" "NU" COEFFS 0.000000 1.000000 0.000000 0.000000 0.000000 1.000000 /end COMPU_METHOD
/* Scalar calibration for DDE 'AINc_NU_CoolantTemp_BktHys'. */
/begin CHARACTERISTIC AINc_NU_CoolantTemp_BktHys "This is the bucket value where the fault clears. (Fault will always set when bucket value = 1.0  which cannot be adjusted.)" VALUE 0x8dd4c RL_AINC_NU_COOLANTTEMP_BKTHYS 1.100000 CU_AINC_NU_COOLANTTEMP_BKTHYS -0.100000 1.000000 BYTE_ORDER MSB_FIRST /end CHARACTERISTIC
/begin RECORD_LAYOUT RL_AINC_NU_COOLANTTEMP_BKTHYS FNC_VALUES 1 FLOAT32_IEEE COLUMN_DIR DIRECT /end RECORD_LAYOUT
/begin COMPU_METHOD CU_AINC_NU_COOLANTTEMP_BKTHYS "Conversion method for AINc_NU_CoolantTemp_BktHys" RAT_FUNC "%10.1" "NU" COEFFS 0.000000 1.000000 0.000000 0.000000 0.000000 1.000000 /end COMPU_METHOD
/* Scalar calibration for DDE 'AINc_NU_CoolantTemp_SlewLim'. */
/begin CHARACTERISTIC AINc_NU_CoolantTemp_SlewLim "(pct/s) set to 9s to disable check" VALUE 0x8dd48 RL_AINC_NU_COOLANTTEMP_SLEWLIM 0.000000 CU_AINC_NU_COOLANTTEMP_SLEWLIM 999999.000000 999999.000000 BYTE_ORDER MSB_FIRST /end CHARACTERISTIC
/begin RECORD_LAYOUT RL_AINC_NU_COOLANTTEMP_SLEWLIM FNC_VALUES 1 FLOAT32_IEEE COLUMN_DIR DIRECT /end RECORD_LAYOUT
/begin COMPU_METHOD CU_AINC_NU_COOLANTTEMP_SLEWLIM "Conversion method for AINc_NU_CoolantTemp_SlewLim" RAT_FUNC "%10.0" "NU" COEFFS 0.000000 1.000000 0.000000 0.000000 0.000000 1.000000 /end COMPU_METHOD
/* Scalar calibration for DDE 'AINc_NU_DOT_VMonGain'. */
/begin CHARACTERISTIC AINc_NU_DOT_VMonGain "Voltage divider gain: M670 uses 1556/203" VALUE 0x8c094 RL_AINC_NU_DOT_VMONGAIN 0.000000 CU_AINC_NU_DOT_VMONGAIN 7.665000 7.665000 BYTE_ORDER MSB_FIRST /end CHARACTERISTIC
/begin RECORD_LAYOUT RL_AINC_NU_DOT_VMONGAIN FNC_VALUES 1 FLOAT32_IEEE COLUMN_DIR DIRECT /end RECORD_LAYOUT
/begin COMPU_METHOD CU_AINC_NU_DOT_VMONGAIN "Conversion method for AINc_NU_DOT_VMonGain" RAT_FUNC "%10.3" "NU" COEFFS 0.000000 1.000000 0.000000 0.000000 0.000000 1.000000 /end COMPU_METHOD
/* Scalar calibration for DDE 'AINc_NU_EngPower'. */
/begin CHARACTERISTIC AINc_NU_EngPower "(not defined)" VALUE 0x8d5f4 RL_AINC_NU_ENGPOWER 10000.000000 CU_AINC_NU_ENGPOWER 0.000000 10000.000000 BYTE_ORDER MSB_FIRST /end CHARACTERISTIC
/begin RECORD_LAYOUT RL_AINC_NU_ENGPOWER FNC_VALUES 1 FLOAT32_IEEE COLUMN_DIR DIRECT /end RECORD_LAYOUT
/begin COMPU_METHOD CU_AINC_NU_ENGPOWER "Conversion method for AINc_NU_EngPower" RAT_FUNC "%10.1" "NU" COEFFS 0.000000 1.000000 0.000000 0.000000 0.000000 1.000000 /end COMPU_METHOD
/* Scalar calibration for DDE 'AINc_NU_ExTemp_BktHys'. */
/begin CHARACTERISTIC AINc_NU_ExTemp_BktHys "This is the bucket value where the fault clears. (Fault will always set when bucket value = 1.0 which cannot be adjusted.)" VALUE 0x8dd44 RL_AINC_NU_EXTEMP_BKTHYS 1.100000 CU_AINC_NU_EXTEMP_BKTHYS -0.100000 1.000000 BYTE_ORDER MSB_FIRST /end CHARACTERISTIC
/begin RECORD_LAYOUT RL_AINC_NU_EXTEMP_BKTHYS FNC_VALUES 1 FLOAT32_IEEE COLUMN_DIR DIRECT /end RECORD_LAYOUT
/begin COMPU_METHOD CU_AINC_NU_EXTEMP_BKTHYS "Conversion method for AINc_NU_ExTemp_BktHys" RAT_FUNC "%10.1" "NU" COEFFS 0.000000 1.000000 0.000000 0.000000 0.000000 1.000000 /end COMPU_METHOD
/* Scalar calibration for DDE 'AINc_NU_ExTemp_SlewLim'. */
/begin CHARACTERISTIC AINc_NU_ExTemp_SlewLim "(pct/s) set to 9s to disable check" VALUE 0x8dd40 RL_AINC_NU_EXTEMP_SLEWLIM 0.000000 CU_AINC_NU_EXTEMP_SLEWLIM 999999.000000 999999.000000 BYTE_ORDER MSB_FIRST /end CHARACTERISTIC
/begin RECORD_LAYOUT RL_AINC_NU_EXTEMP_SLEWLIM FNC_VALUES 1 FLOAT32_IEEE COLUMN_DIR DIRECT /end RECORD_LAYOUT
/begin COMPU_METHOD CU_AINC_NU_EXTEMP_SLEWLIM "Conversion method for AINc_NU_ExTemp_SlewLim" RAT_FUNC "%10.0" "NU" COEFFS 0.000000 1.000000 0.000000 0.000000 0.000000 1.000000 /end COMPU_METHOD
/* Scalar calibration for DDE 'AINc_NU_FAPPress_BktHys'. */
/begin CHARACTERISTIC AINc_NU_FAPPress_BktHys "This is the bucket value where the fault clears. (Fault will always set when bucket value = 1" VALUE 0x8dd3c RL_AINC_NU_FAPPRESS_BKTHYS 1.100000 CU_AINC_NU_FAPPRESS_BKTHYS -0.100000 1.000000 BYTE_ORDER MSB_FIRST /end CHARACTERISTIC
/begin RECORD_LAYOUT RL_AINC_NU_FAPPRESS_BKTHYS FNC_VALUES 1 FLOAT32_IEEE COLUMN_DIR DIRECT /end RECORD_LAYOUT
/begin COMPU_METHOD CU_AINC_NU_FAPPRESS_BKTHYS "Conversion method for AINc_NU_FAPPress_BktHys" RAT_FUNC "%10.1" "NU" COEFFS 0.000000 1.000000 0.000000 0.000000 0.000000 1.000000 /end COMPU_METHOD
/* Scalar calibration for DDE 'AINc_NU_FAPPress_Gain'. */
/begin CHARACTERISTIC AINc_NU_FAPPress_Gain "(kPa/V) Sensor transfer function" VALUE 0x8c118 RL_AINC_NU_FAPPRESS_GAIN 500.000000 CU_AINC_NU_FAPPRESS_GAIN 0.000000 500.000000 BYTE_ORDER MSB_FIRST /end CHARACTERISTIC
/begin RECORD_LAYOUT RL_AINC_NU_FAPPRESS_GAIN FNC_VALUES 1 FLOAT32_IEEE COLUMN_DIR DIRECT /end RECORD_LAYOUT
/begin COMPU_METHOD CU_AINC_NU_FAPPRESS_GAIN "Conversion method for AINc_NU_FAPPress_Gain" RAT_FUNC "%10.3" "NU" COEFFS 0.000000 1.000000 0.000000 0.000000 0.000000 1.000000 /end COMPU_METHOD
/* Scalar calibration for DDE 'AINc_NU_FAPPress_SlewLim'. */
/begin CHARACTERISTIC AINc_NU_FAPPress_SlewLim "(pct/s) set to 9s to disable check" VALUE 0x8dd38 RL_AINC_NU_FAPPRESS_SLEWLIM 0.000000 CU_AINC_NU_FAPPRESS_SLEWLIM 999999.000000 999999.000000 BYTE_ORDER MSB_FIRST /end CHARACTERISTIC
/begin RECORD_LAYOUT RL_AINC_NU_FAPPRESS_SLEWLIM FNC_VALUES 1 FLOAT32_IEEE COLUMN_DIR DIRECT /end RECORD_LAYOUT
/begin COMPU_METHOD CU_AINC_NU_FAPPRESS_SLEWLIM "Conversion method for AINc_NU_FAPPress_SlewLim" RAT_FUNC "%10.0" "NU" COEFFS 0.000000 1.000000 0.000000 0.000000 0.000000 1.000000 /end COMPU_METHOD
/* Scalar calibration for DDE 'AINc_NU_FuelLevel1_Gain_PctToL'. */
/begin CHARACTERISTIC AINc_NU_FuelLevel1_Gain_PctToL "(L/%) Sensor transfer function" VALUE 0x8c180 RL_AINC_NU_FUELLEVEL1_GAIN_PCT0 500.000000 CU_AINC_NU_FUELLEVEL1_GAIN_PCT0 0.000000 500.000000 BYTE_ORDER MSB_FIRST /end CHARACTERISTIC
/begin RECORD_LAYOUT RL_AINC_NU_FUELLEVEL1_GAIN_PCT0 FNC_VALUES 1 FLOAT32_IEEE COLUMN_DIR DIRECT /end RECORD_LAYOUT
/begin COMPU_METHOD CU_AINC_NU_FUELLEVEL1_GAIN_PCT0 "Conversion method for AINc_NU_FuelLevel1_Gain_PctToL" RAT_FUNC "%10.3" "NU" COEFFS 0.000000 1.000000 0.000000 0.000000 0.000000 1.000000 /end COMPU_METHOD
/* Scalar calibration for DDE 'AINc_NU_FuelLevel1_Gain_VToPct'. */
/begin CHARACTERISTIC AINc_NU_FuelLevel1_Gain_VToPct "(%/V) Sensor transfer function" VALUE 0x8c174 RL_AINC_NU_FUELLEVEL1_GAIN_VTO0 500.000000 CU_AINC_NU_FUELLEVEL1_GAIN_VTO0 0.000000 500.000000 BYTE_ORDER MSB_FIRST /end CHARACTERISTIC
/begin RECORD_LAYOUT RL_AINC_NU_FUELLEVEL1_GAIN_VTO0 FNC_VALUES 1 FLOAT32_IEEE COLUMN_DIR DIRECT /end RECORD_LAYOUT
/begin COMPU_METHOD CU_AINC_NU_FUELLEVEL1_GAIN_VTO0 "Conversion method for AINc_NU_FuelLevel1_Gain_VToPct" RAT_FUNC "%10.3" "NU" COEFFS 0.000000 1.000000 0.000000 0.000000 0.000000 1.000000 /end COMPU_METHOD
/* Scalar calibration for DDE 'AINc_NU_FuelLevel2_Gain_PctToL'. */
/begin CHARACTERISTIC AINc_NU_FuelLevel2_Gain_PctToL "(L/%) Sensor transfer function" VALUE 0x8c188 RL_AINC_NU_FUELLEVEL2_GAIN_PCT0 500.000000 CU_AINC_NU_FUELLEVEL2_GAIN_PCT0 0.000000 500.000000 BYTE_ORDER MSB_FIRST /end CHARACTERISTIC
/begin RECORD_LAYOUT RL_AINC_NU_FUELLEVEL2_GAIN_PCT0 FNC_VALUES 1 FLOAT32_IEEE COLUMN_DIR DIRECT /end RECORD_LAYOUT
/begin COMPU_METHOD CU_AINC_NU_FUELLEVEL2_GAIN_PCT0 "Conversion method for AINc_NU_FuelLevel2_Gain_PctToL" RAT_FUNC "%10.3" "NU" COEFFS 0.000000 1.000000 0.000000 0.000000 0.000000 1.000000 /end COMPU_METHOD
/* Scalar calibration for DDE 'AINc_NU_FuelLevel2_Gain_VToPct'. */
/begin CHARACTERISTIC AINc_NU_FuelLevel2_Gain_VToPct "(%/V) Sensor transfer function" VALUE 0x8c160 RL_AINC_NU_FUELLEVEL2_GAIN_VTO0 500.000000 CU_AINC_NU_FUELLEVEL2_GAIN_VTO0 0.000000 500.000000 BYTE_ORDER MSB_FIRST /end CHARACTERISTIC
/begin RECORD_LAYOUT RL_AINC_NU_FUELLEVEL2_GAIN_VTO0 FNC_VALUES 1 FLOAT32_IEEE COLUMN_DIR DIRECT /end RECORD_LAYOUT
/begin COMPU_METHOD CU_AINC_NU_FUELLEVEL2_GAIN_VTO0 "Conversion method for AINc_NU_FuelLevel2_Gain_VToPct" RAT_FUNC "%10.3" "NU" COEFFS 0.000000 1.000000 0.000000 0.000000 0.000000 1.000000 /end COMPU_METHOD
/* Scalar calibration for DDE 'AINc_NU_FuelPress_BktHys'. */
/begin CHARACTERISTIC AINc_NU_FuelPress_BktHys "This is the bucket value where the fault clears. (Fault will always set when bucket value = 1.0 which cannot be adjusted.)" VALUE 0x8dd34 RL_AINC_NU_FUELPRESS_BKTHYS 1.100000 CU_AINC_NU_FUELPRESS_BKTHYS -0.100000 1.000000 BYTE_ORDER MSB_FIRST /end CHARACTERISTIC
/begin RECORD_LAYOUT RL_AINC_NU_FUELPRESS_BKTHYS FNC_VALUES 1 FLOAT32_IEEE COLUMN_DIR DIRECT /end RECORD_LAYOUT
/begin COMPU_METHOD CU_AINC_NU_FUELPRESS_BKTHYS "Conversion method for AINc_NU_FuelPress_BktHys" RAT_FUNC "%10.1" "NU" COEFFS 0.000000 1.000000 0.000000 0.000000 0.000000 1.000000 /end COMPU_METHOD
/* Scalar calibration for DDE 'AINc_NU_FuelPress_SlewLim'. */
/begin CHARACTERISTIC AINc_NU_FuelPress_SlewLim "(pct/s) set to 9s to disable check" VALUE 0x8dd30 RL_AINC_NU_FUELPRESS_SLEWLIM 0.000000 CU_AINC_NU_FUELPRESS_SLEWLIM 999999.000000 999999.000000 BYTE_ORDER MSB_FIRST /end CHARACTERISTIC
/begin RECORD_LAYOUT RL_AINC_NU_FUELPRESS_SLEWLIM FNC_VALUES 1 FLOAT32_IEEE COLUMN_DIR DIRECT /end RECORD_LAYOUT
/begin COMPU_METHOD CU_AINC_NU_FUELPRESS_SLEWLIM "Conversion method for AINc_NU_FuelPress_SlewLim" RAT_FUNC "%10.0" "NU" COEFFS 0.000000 1.000000 0.000000 0.000000 0.000000 1.000000 /end COMPU_METHOD
/* Scalar calibration for DDE 'AINc_NU_FuelTemp_BktHys'. */
/begin CHARACTERISTIC AINc_NU_FuelTemp_BktHys "This is the bucket value where the fault clears. (Fault will always set when bucket value = 1.0 which cannot be adjusted.)" VALUE 0x8dd2c RL_AINC_NU_FUELTEMP_BKTHYS 1.100000 CU_AINC_NU_FUELTEMP_BKTHYS -0.100000 1.000000 BYTE_ORDER MSB_FIRST /end CHARACTERISTIC
/begin RECORD_LAYOUT RL_AINC_NU_FUELTEMP_BKTHYS FNC_VALUES 1 FLOAT32_IEEE COLUMN_DIR DIRECT /end RECORD_LAYOUT
/begin COMPU_METHOD CU_AINC_NU_FUELTEMP_BKTHYS "Conversion method for AINc_NU_FuelTemp_BktHys" RAT_FUNC "%10.1" "NU" COEFFS 0.000000 1.000000 0.000000 0.000000 0.000000 1.000000 /end COMPU_METHOD
/* Scalar calibration for DDE 'AINc_NU_FuelTemp_SlewLim'. */
/begin CHARACTERISTIC AINc_NU_FuelTemp_SlewLim "(pct/s) set to 9s to disable check" VALUE 0x8dd28 RL_AINC_NU_FUELTEMP_SLEWLIM 0.000000 CU_AINC_NU_FUELTEMP_SLEWLIM 999999.000000 999999.000000 BYTE_ORDER MSB_FIRST /end CHARACTERISTIC
/begin RECORD_LAYOUT RL_AINC_NU_FUELTEMP_SLEWLIM FNC_VALUES 1 FLOAT32_IEEE COLUMN_DIR DIRECT /end RECORD_LAYOUT
/begin COMPU_METHOD CU_AINC_NU_FUELTEMP_SLEWLIM "Conversion method for AINc_NU_FuelTemp_SlewLim" RAT_FUNC "%10.0" "NU" COEFFS 0.000000 1.000000 0.000000 0.000000 0.000000 1.000000 /end COMPU_METHOD
/* Scalar calibration for DDE 'AINc_NU_HBridgeCurrentMonGain'. */
/begin CHARACTERISTIC AINc_NU_HBridgeCurrentMonGain "(not defined)" VALUE 0x8cd14 RL_AINC_NU_HBRIDGECURRENTMONGA0 0.000000 CU_AINC_NU_HBRIDGECURRENTMONGA0 10.000000 10.000000 BYTE_ORDER MSB_FIRST /end CHARACTERISTIC
/begin RECORD_LAYOUT RL_AINC_NU_HBRIDGECURRENTMONGA0 FNC_VALUES 1 FLOAT32_IEEE COLUMN_DIR DIRECT /end RECORD_LAYOUT
/begin COMPU_METHOD CU_AINC_NU_HBRIDGECURRENTMONGA0 "Conversion method for AINc_NU_HBridgeCurrentMonGain" RAT_FUNC "%10.2" "NU" COEFFS 0.000000 1.000000 0.000000 0.000000 0.000000 1.000000 /end COMPU_METHOD
/* Scalar calibration for DDE 'AINc_NU_HighsideCurrentMonGain'. */
/begin CHARACTERISTIC AINc_NU_HighsideCurrentMonGain "(not defined)" VALUE 0x8cd18 RL_AINC_NU_HIGHSIDECURRENTMONG0 0.000000 CU_AINC_NU_HIGHSIDECURRENTMONG0 5.000000 5.000000 BYTE_ORDER MSB_FIRST /end CHARACTERISTIC
/begin RECORD_LAYOUT RL_AINC_NU_HIGHSIDECURRENTMONG0 FNC_VALUES 1 FLOAT32_IEEE COLUMN_DIR DIRECT /end RECORD_LAYOUT
/begin COMPU_METHOD CU_AINC_NU_HIGHSIDECURRENTMONG0 "Conversion method for AINc_NU_HighsideCurrentMonGain" RAT_FUNC "%10.2" "NU" COEFFS 0.000000 1.000000 0.000000 0.000000 0.000000 1.000000 /end COMPU_METHOD
/* Scalar calibration for DDE 'AINc_NU_HighsideGain'. */
/begin CHARACTERISTIC AINc_NU_HighsideGain "Monitor circuit gain 56K / 10K voltage divider" VALUE 0x8cd20 RL_AINC_NU_HIGHSIDEGAIN 0.000000 CU_AINC_NU_HIGHSIDEGAIN 6.600000 6.600000 BYTE_ORDER MSB_FIRST /end CHARACTERISTIC
/begin RECORD_LAYOUT RL_AINC_NU_HIGHSIDEGAIN FNC_VALUES 1 FLOAT32_IEEE COLUMN_DIR DIRECT /end RECORD_LAYOUT
/begin COMPU_METHOD CU_AINC_NU_HIGHSIDEGAIN "Conversion method for AINc_NU_HighsideGain" RAT_FUNC "%10.3" "NU" COEFFS 0.000000 1.000000 0.000000 0.000000 0.000000 1.000000 /end COMPU_METHOD
/* Scalar calibration for DDE 'AINc_NU_MAP_Gain'. */
/begin CHARACTERISTIC AINc_NU_MAP_Gain "(kPa/V) Sensor transfer function" VALUE 0x8c04c RL_AINC_NU_MAP_GAIN 10000.000000 CU_AINC_NU_MAP_GAIN 0.000000 10000.000000 BYTE_ORDER MSB_FIRST /end CHARACTERISTIC
/begin RECORD_LAYOUT RL_AINC_NU_MAP_GAIN FNC_VALUES 1 FLOAT32_IEEE COLUMN_DIR DIRECT /end RECORD_LAYOUT
/begin COMPU_METHOD CU_AINC_NU_MAP_GAIN "Conversion method for AINc_NU_MAP_Gain" RAT_FUNC "%10.3" "NU" COEFFS 0.000000 1.000000 0.000000 0.000000 0.000000 1.000000 /end COMPU_METHOD
/* Scalar calibration for DDE 'AINc_NU_MIL_Status'. */
/begin CHARACTERISTIC AINc_NU_MIL_Status "(not defined)" VALUE 0x80410 RL_AINC_NU_MIL_STATUS 10.000000 CU_AINC_NU_MIL_STATUS 0.000000 10.000000 BYTE_ORDER MSB_FIRST /end CHARACTERISTIC
/begin RECORD_LAYOUT RL_AINC_NU_MIL_STATUS FNC_VALUES 1 FLOAT32_IEEE COLUMN_DIR DIRECT /end RECORD_LAYOUT
/begin COMPU_METHOD CU_AINC_NU_MIL_STATUS "Conversion method for AINc_NU_MIL_Status" RAT_FUNC "%10.0" "NU" COEFFS 0.000000 1.000000 0.000000 0.000000 0.000000 1.000000 /end COMPU_METHOD
/* Scalar calibration for DDE 'AINc_NU_ManifoldTemp_BktHys'. */
/begin CHARACTERISTIC AINc_NU_ManifoldTemp_BktHys "This is the bucket value where the fault clears. (Fault will always set when bucket value = 1.0 which cannot be adjusted.)" VALUE 0x8dd24 RL_AINC_NU_MANIFOLDTEMP_BKTHYS 1.100000 CU_AINC_NU_MANIFOLDTEMP_BKTHYS -0.100000 1.000000 BYTE_ORDER MSB_FIRST /end CHARACTERISTIC
/begin RECORD_LAYOUT RL_AINC_NU_MANIFOLDTEMP_BKTHYS FNC_VALUES 1 FLOAT32_IEEE COLUMN_DIR DIRECT /end RECORD_LAYOUT
/begin COMPU_METHOD CU_AINC_NU_MANIFOLDTEMP_BKTHYS "Conversion method for AINc_NU_ManifoldTemp_BktHys" RAT_FUNC "%10.1" "NU" COEFFS 0.000000 1.000000 0.000000 0.000000 0.000000 1.000000 /end COMPU_METHOD
/* Scalar calibration for DDE 'AINc_NU_ManifoldTemp_SlewLim'. */
/begin CHARACTERISTIC AINc_NU_ManifoldTemp_SlewLim "(pct/s) set to 9s to disable check" VALUE 0x8dd20 RL_AINC_NU_MANIFOLDTEMP_SLEWLIM 0.000000 CU_AINC_NU_MANIFOLDTEMP_SLEWLIM 999999.000000 999999.000000 BYTE_ORDER MSB_FIRST /end CHARACTERISTIC
/begin RECORD_LAYOUT RL_AINC_NU_MANIFOLDTEMP_SLEWLIM FNC_VALUES 1 FLOAT32_IEEE COLUMN_DIR DIRECT /end RECORD_LAYOUT
/begin COMPU_METHOD CU_AINC_NU_MANIFOLDTEMP_SLEWLIM "Conversion method for AINc_NU_ManifoldTemp_SlewLim" RAT_FUNC "%10.0" "NU" COEFFS 0.000000 1.000000 0.000000 0.000000 0.000000 1.000000 /end COMPU_METHOD
/* Scalar calibration for DDE 'AINc_NU_MinRPMCaCr'. */
/begin CHARACTERISTIC AINc_NU_MinRPMCaCr "Valor minimo test cam y crank" VALUE 0x8c4f4 RL_AINC_NU_MINRPMCACR 3000.000000 CU_AINC_NU_MINRPMCACR 0.000000 3000.000000 BYTE_ORDER MSB_FIRST /end CHARACTERISTIC
/begin RECORD_LAYOUT RL_AINC_NU_MINRPMCACR FNC_VALUES 1 FLOAT32_IEEE COLUMN_DIR DIRECT /end RECORD_LAYOUT
/begin COMPU_METHOD CU_AINC_NU_MINRPMCACR "Conversion method for AINc_NU_MinRPMCaCr" RAT_FUNC "%10.0" "NU" COEFFS 0.000000 1.000000 0.000000 0.000000 0.000000 1.000000 /end COMPU_METHOD
/* Scalar calibration for DDE 'AINc_NU_TP1_BktHys'. */
/begin CHARACTERISTIC AINc_NU_TP1_BktHys "This is the bucket value where the fault clears. (Fault will always set when bucket value = 1.0 which cannot be adjusted.)" VALUE 0x8dd1c RL_AINC_NU_TP1_BKTHYS 1.100000 CU_AINC_NU_TP1_BKTHYS -0.100000 1.000000 BYTE_ORDER MSB_FIRST /end CHARACTERISTIC
/begin RECORD_LAYOUT RL_AINC_NU_TP1_BKTHYS FNC_VALUES 1 FLOAT32_IEEE COLUMN_DIR DIRECT /end RECORD_LAYOUT
/begin COMPU_METHOD CU_AINC_NU_TP1_BKTHYS "Conversion method for AINc_NU_TP1_BktHys" RAT_FUNC "%10.1" "NU" COEFFS 0.000000 1.000000 0.000000 0.000000 0.000000 1.000000 /end COMPU_METHOD
/* Scalar calibration for DDE 'AINc_NU_TP1_Dflt'. */
/begin CHARACTERISTIC AINc_NU_TP1_Dflt "This default is only applied once the leaky bucket is full" VALUE 0x8dd18 RL_AINC_NU_TP1_DFLT 0.000000 CU_AINC_NU_TP1_DFLT 4.500000 4.500000 BYTE_ORDER MSB_FIRST /end CHARACTERISTIC
/begin RECORD_LAYOUT RL_AINC_NU_TP1_DFLT FNC_VALUES 1 FLOAT32_IEEE COLUMN_DIR DIRECT /end RECORD_LAYOUT
/begin COMPU_METHOD CU_AINC_NU_TP1_DFLT "Conversion method for AINc_NU_TP1_Dflt" RAT_FUNC "%10.1" "V" COEFFS 0.000000 1.000000 0.000000 0.000000 0.000000 1.000000 /end COMPU_METHOD
/* Scalar calibration for DDE 'AINc_NU_TP1_Gain'. */
/begin CHARACTERISTIC AINc_NU_TP1_Gain "(deg/V) Sensor transfer function" VALUE 0x8c35c RL_AINC_NU_TP1_GAIN 10000.000000 CU_AINC_NU_TP1_GAIN 0.000000 10000.000000 BYTE_ORDER MSB_FIRST /end CHARACTERISTIC
/begin RECORD_LAYOUT RL_AINC_NU_TP1_GAIN FNC_VALUES 1 FLOAT32_IEEE COLUMN_DIR DIRECT /end RECORD_LAYOUT
/begin COMPU_METHOD CU_AINC_NU_TP1_GAIN "Conversion method for AINc_NU_TP1_Gain" RAT_FUNC "%10.1" "NU" COEFFS 0.000000 1.000000 0.000000 0.000000 0.000000 1.000000 /end COMPU_METHOD
/* Scalar calibration for DDE 'AINc_NU_TP1_Raw'. */
/begin CHARACTERISTIC AINc_NU_TP1_Raw "Override value" VALUE 0x8c3b8 RL_AINC_NU_TP1_RAW 90.000000 CU_AINC_NU_TP1_RAW 0.000000 90.000000 BYTE_ORDER MSB_FIRST /end CHARACTERISTIC
/begin RECORD_LAYOUT RL_AINC_NU_TP1_RAW FNC_VALUES 1 FLOAT32_IEEE COLUMN_DIR DIRECT /end RECORD_LAYOUT
/begin COMPU_METHOD CU_AINC_NU_TP1_RAW "Conversion method for AINc_NU_TP1_Raw" RAT_FUNC "%10.1" "NU" COEFFS 0.000000 1.000000 0.000000 0.000000 0.000000 1.000000 /end COMPU_METHOD
/* Scalar calibration for DDE 'AINc_NU_TP1_SlewLim'. */
/begin CHARACTERISTIC AINc_NU_TP1_SlewLim "(pct/s) set to 9s to disable check" VALUE 0x8dd14 RL_AINC_NU_TP1_SLEWLIM 0.000000 CU_AINC_NU_TP1_SLEWLIM 999999.000000 999999.000000 BYTE_ORDER MSB_FIRST /end CHARACTERISTIC
/begin RECORD_LAYOUT RL_AINC_NU_TP1_SLEWLIM FNC_VALUES 1 FLOAT32_IEEE COLUMN_DIR DIRECT /end RECORD_LAYOUT
/begin COMPU_METHOD CU_AINC_NU_TP1_SLEWLIM "Conversion method for AINc_NU_TP1_SlewLim" RAT_FUNC "%10.0" "NU" COEFFS 0.000000 1.000000 0.000000 0.000000 0.000000 1.000000 /end COMPU_METHOD
/* Scalar calibration for DDE 'AINc_NU_TP2_BktHys'. */
/begin CHARACTERISTIC AINc_NU_TP2_BktHys "This is the bucket value where the fault clears. (Fault will always set when bucket value = 1.0 which cannot be adjusted.)" VALUE 0x8dd10 RL_AINC_NU_TP2_BKTHYS 1.100000 CU_AINC_NU_TP2_BKTHYS -0.100000 1.000000 BYTE_ORDER MSB_FIRST /end CHARACTERISTIC
/begin RECORD_LAYOUT RL_AINC_NU_TP2_BKTHYS FNC_VALUES 1 FLOAT32_IEEE COLUMN_DIR DIRECT /end RECORD_LAYOUT
/begin COMPU_METHOD CU_AINC_NU_TP2_BKTHYS "Conversion method for AINc_NU_TP2_BktHys" RAT_FUNC "%10.1" "NU" COEFFS 0.000000 1.000000 0.000000 0.000000 0.000000 1.000000 /end COMPU_METHOD
/* Scalar calibration for DDE 'AINc_NU_TP2_Dflt'. */
/begin CHARACTERISTIC AINc_NU_TP2_Dflt "This default is only applied once the leaky bucket is full" VALUE 0x8dd0c RL_AINC_NU_TP2_DFLT 0.000000 CU_AINC_NU_TP2_DFLT 4.500000 4.500000 BYTE_ORDER MSB_FIRST /end CHARACTERISTIC
/begin RECORD_LAYOUT RL_AINC_NU_TP2_DFLT FNC_VALUES 1 FLOAT32_IEEE COLUMN_DIR DIRECT /end RECORD_LAYOUT
/begin COMPU_METHOD CU_AINC_NU_TP2_DFLT "Conversion method for AINc_NU_TP2_Dflt" RAT_FUNC "%10.1" "V" COEFFS 0.000000 1.000000 0.000000 0.000000 0.000000 1.000000 /end COMPU_METHOD
/* Scalar calibration for DDE 'AINc_NU_TP2_Gain'. */
/begin CHARACTERISTIC AINc_NU_TP2_Gain "(deg/V) Sensor transfer function" VALUE 0x8c374 RL_AINC_NU_TP2_GAIN 10000.000000 CU_AINC_NU_TP2_GAIN 0.000000 10000.000000 BYTE_ORDER MSB_FIRST /end CHARACTERISTIC
/begin RECORD_LAYOUT RL_AINC_NU_TP2_GAIN FNC_VALUES 1 FLOAT32_IEEE COLUMN_DIR DIRECT /end RECORD_LAYOUT
/begin COMPU_METHOD CU_AINC_NU_TP2_GAIN "Conversion method for AINc_NU_TP2_Gain" RAT_FUNC "%10.1" "NU" COEFFS 0.000000 1.000000 0.000000 0.000000 0.000000 1.000000 /end COMPU_METHOD
/* Scalar calibration for DDE 'AINc_NU_TP2_Raw'. */
/begin CHARACTERISTIC AINc_NU_TP2_Raw "Override value" VALUE 0x8c3c0 RL_AINC_NU_TP2_RAW 90.000000 CU_AINC_NU_TP2_RAW 0.000000 90.000000 BYTE_ORDER MSB_FIRST /end CHARACTERISTIC
/begin RECORD_LAYOUT RL_AINC_NU_TP2_RAW FNC_VALUES 1 FLOAT32_IEEE COLUMN_DIR DIRECT /end RECORD_LAYOUT
/begin COMPU_METHOD CU_AINC_NU_TP2_RAW "Conversion method for AINc_NU_TP2_Raw" RAT_FUNC "%10.1" "NU" COEFFS 0.000000 1.000000 0.000000 0.000000 0.000000 1.000000 /end COMPU_METHOD
/* Scalar calibration for DDE 'AINc_NU_TP2_SlewLim'. */
/begin CHARACTERISTIC AINc_NU_TP2_SlewLim "(pct/s) set to 9s to disable check" VALUE 0x8dd08 RL_AINC_NU_TP2_SLEWLIM 0.000000 CU_AINC_NU_TP2_SLEWLIM 999999.000000 999999.000000 BYTE_ORDER MSB_FIRST /end CHARACTERISTIC
/begin RECORD_LAYOUT RL_AINC_NU_TP2_SLEWLIM FNC_VALUES 1 FLOAT32_IEEE COLUMN_DIR DIRECT /end RECORD_LAYOUT
/begin COMPU_METHOD CU_AINC_NU_TP2_SLEWLIM "Conversion method for AINc_NU_TP2_SlewLim" RAT_FUNC "%10.0" "NU" COEFFS 0.000000 1.000000 0.000000 0.000000 0.000000 1.000000 /end COMPU_METHOD
/* Scalar calibration for DDE 'AINc_NU_VBattGain'. */
/begin CHARACTERISTIC AINc_NU_VBattGain "Battery power monitor circuit gain: M670 uses 111/11" VALUE 0x8c084 RL_AINC_NU_VBATTGAIN 0.000000 CU_AINC_NU_VBATTGAIN 10.091000 10.091000 BYTE_ORDER MSB_FIRST /end CHARACTERISTIC
/begin RECORD_LAYOUT RL_AINC_NU_VBATTGAIN FNC_VALUES 1 FLOAT32_IEEE COLUMN_DIR DIRECT /end RECORD_LAYOUT
/begin COMPU_METHOD CU_AINC_NU_VBATTGAIN "Conversion method for AINc_NU_VBattGain" RAT_FUNC "%10.3" "NU" COEFFS 0.000000 1.000000 0.000000 0.000000 0.000000 1.000000 /end COMPU_METHOD
/* Scalar calibration for DDE 'AINc_NU_VRefMonGain'. */
/begin CHARACTERISTIC AINc_NU_VRefMonGain "Monitor circuit gain: M670 uses 465/407" VALUE 0x8ccd0 RL_AINC_NU_VREFMONGAIN 0.000000 CU_AINC_NU_VREFMONGAIN 1.142500 1.142500 BYTE_ORDER MSB_FIRST /end CHARACTERISTIC
/begin RECORD_LAYOUT RL_AINC_NU_VREFMONGAIN FNC_VALUES 1 FLOAT32_IEEE COLUMN_DIR DIRECT /end RECORD_LAYOUT
/begin COMPU_METHOD CU_AINC_NU_VREFMONGAIN "Conversion method for AINc_NU_VRefMonGain" RAT_FUNC "%10.3" "NU" COEFFS 0.000000 1.000000 0.000000 0.000000 0.000000 1.000000 /end COMPU_METHOD
/* Scalar calibration for DDE 'AINc_Nm_EngTor'. */
/begin CHARACTERISTIC AINc_Nm_EngTor "(not defined)" VALUE 0x8d5f0 RL_AINC_NM_ENGTOR 10000.000000 CU_AINC_NM_ENGTOR 0.000000 10000.000000 BYTE_ORDER MSB_FIRST /end CHARACTERISTIC
/begin RECORD_LAYOUT RL_AINC_NM_ENGTOR FNC_VALUES 1 FLOAT32_IEEE COLUMN_DIR DIRECT /end RECORD_LAYOUT
/begin COMPU_METHOD CU_AINC_NM_ENGTOR "Conversion method for AINc_Nm_EngTor" RAT_FUNC "%10.1" "Nm" COEFFS 0.000000 1.000000 0.000000 0.000000 0.000000 1.000000 /end COMPU_METHOD
/* Scalar calibration for DDE 'AINc_V_APP1_Max'. */
/begin CHARACTERISTIC AINc_V_APP1_Max "AIN Volts will be bounded by this range" VALUE 0x8bfb8 RL_AINC_V_APP1_MAX 10.000000 CU_AINC_V_APP1_MAX 0.000000 10.000000 BYTE_ORDER MSB_FIRST /end CHARACTERISTIC
/begin RECORD_LAYOUT RL_AINC_V_APP1_MAX FNC_VALUES 1 FLOAT32_IEEE COLUMN_DIR DIRECT /end RECORD_LAYOUT
/begin COMPU_METHOD CU_AINC_V_APP1_MAX "Conversion method for AINc_V_APP1_Max" RAT_FUNC "%10.3" "V" COEFFS 0.000000 1.000000 0.000000 0.000000 0.000000 1.000000 /end COMPU_METHOD
/* Scalar calibration for DDE 'AINc_V_APP1_Min'. */
/begin CHARACTERISTIC AINc_V_APP1_Min "AIN Volts will be bounded by this range" VALUE 0x8bfb4 RL_AINC_V_APP1_MIN 10.000000 CU_AINC_V_APP1_MIN 0.000000 10.000000 BYTE_ORDER MSB_FIRST /end CHARACTERISTIC
/begin RECORD_LAYOUT RL_AINC_V_APP1_MIN FNC_VALUES 1 FLOAT32_IEEE COLUMN_DIR DIRECT /end RECORD_LAYOUT
/begin COMPU_METHOD CU_AINC_V_APP1_MIN "Conversion method for AINc_V_APP1_Min" RAT_FUNC "%10.3" "V" COEFFS 0.000000 1.000000 0.000000 0.000000 0.000000 1.000000 /end COMPU_METHOD
/* Scalar calibration for DDE 'AINc_V_APP2_Max'. */
/begin CHARACTERISTIC AINc_V_APP2_Max "AIN Volts will be bounded by this range" VALUE 0x8bfcc RL_AINC_V_APP2_MAX 10.000000 CU_AINC_V_APP2_MAX 0.000000 10.000000 BYTE_ORDER MSB_FIRST /end CHARACTERISTIC
/begin RECORD_LAYOUT RL_AINC_V_APP2_MAX FNC_VALUES 1 FLOAT32_IEEE COLUMN_DIR DIRECT /end RECORD_LAYOUT
/begin COMPU_METHOD CU_AINC_V_APP2_MAX "Conversion method for AINc_V_APP2_Max" RAT_FUNC "%10.3" "V" COEFFS 0.000000 1.000000 0.000000 0.000000 0.000000 1.000000 /end COMPU_METHOD
/* Scalar calibration for DDE 'AINc_V_APP2_Min'. */
/begin CHARACTERISTIC AINc_V_APP2_Min "AIN Volts will be bounded by this range" VALUE 0x8bfc8 RL_AINC_V_APP2_MIN 10.000000 CU_AINC_V_APP2_MIN 0.000000 10.000000 BYTE_ORDER MSB_FIRST /end CHARACTERISTIC
/begin RECORD_LAYOUT RL_AINC_V_APP2_MIN FNC_VALUES 1 FLOAT32_IEEE COLUMN_DIR DIRECT /end RECORD_LAYOUT
/begin COMPU_METHOD CU_AINC_V_APP2_MIN "Conversion method for AINc_V_APP2_Min" RAT_FUNC "%10.3" "V" COEFFS 0.000000 1.000000 0.000000 0.000000 0.000000 1.000000 /end COMPU_METHOD
/* Scalar calibration for DDE 'AINc_V_AmbientTemp_Max'. */
/begin CHARACTERISTIC AINc_V_AmbientTemp_Max "AIN Volts will be bounded by this range" VALUE 0x8dd04 RL_AINC_V_AMBIENTTEMP_MAX 10.000000 CU_AINC_V_AMBIENTTEMP_MAX 0.000000 10.000000 BYTE_ORDER MSB_FIRST /end CHARACTERISTIC
/begin RECORD_LAYOUT RL_AINC_V_AMBIENTTEMP_MAX FNC_VALUES 1 FLOAT32_IEEE COLUMN_DIR DIRECT /end RECORD_LAYOUT
/begin COMPU_METHOD CU_AINC_V_AMBIENTTEMP_MAX "Conversion method for AINc_V_AmbientTemp_Max" RAT_FUNC "%10.3" "V" COEFFS 0.000000 1.000000 0.000000 0.000000 0.000000 1.000000 /end COMPU_METHOD
/* Scalar calibration for DDE 'AINc_V_AmbientTemp_Min'. */
/begin CHARACTERISTIC AINc_V_AmbientTemp_Min "AIN Volts will be bounded by this range" VALUE 0x8dd00 RL_AINC_V_AMBIENTTEMP_MIN 10.000000 CU_AINC_V_AMBIENTTEMP_MIN 0.000000 10.000000 BYTE_ORDER MSB_FIRST /end CHARACTERISTIC
/begin RECORD_LAYOUT RL_AINC_V_AMBIENTTEMP_MIN FNC_VALUES 1 FLOAT32_IEEE COLUMN_DIR DIRECT /end RECORD_LAYOUT
/begin COMPU_METHOD CU_AINC_V_AMBIENTTEMP_MIN "Conversion method for AINc_V_AmbientTemp_Min" RAT_FUNC "%10.3" "V" COEFFS 0.000000 1.000000 0.000000 0.000000 0.000000 1.000000 /end COMPU_METHOD
/* Scalar calibration for DDE 'AINc_V_Baro_Max'. */
/begin CHARACTERISTIC AINc_V_Baro_Max "AIN Volts will be bounded by this range" VALUE 0x8dcfc RL_AINC_V_BARO_MAX 10.000000 CU_AINC_V_BARO_MAX 0.000000 10.000000 BYTE_ORDER MSB_FIRST /end CHARACTERISTIC
/begin RECORD_LAYOUT RL_AINC_V_BARO_MAX FNC_VALUES 1 FLOAT32_IEEE COLUMN_DIR DIRECT /end RECORD_LAYOUT
/begin COMPU_METHOD CU_AINC_V_BARO_MAX "Conversion method for AINc_V_Baro_Max" RAT_FUNC "%10.3" "V" COEFFS 0.000000 1.000000 0.000000 0.000000 0.000000 1.000000 /end COMPU_METHOD
/* Scalar calibration for DDE 'AINc_V_Baro_Min'. */
/begin CHARACTERISTIC AINc_V_Baro_Min "AIN Volts will be bounded by this range" VALUE 0x8dcf8 RL_AINC_V_BARO_MIN 10.000000 CU_AINC_V_BARO_MIN 0.000000 10.000000 BYTE_ORDER MSB_FIRST /end CHARACTERISTIC
/begin RECORD_LAYOUT RL_AINC_V_BARO_MIN FNC_VALUES 1 FLOAT32_IEEE COLUMN_DIR DIRECT /end RECORD_LAYOUT
/begin COMPU_METHOD CU_AINC_V_BARO_MIN "Conversion method for AINc_V_Baro_Min" RAT_FUNC "%10.3" "V" COEFFS 0.000000 1.000000 0.000000 0.000000 0.000000 1.000000 /end COMPU_METHOD
/* Scalar calibration for DDE 'AINc_V_Baro_Ofst'. */
/begin CHARACTERISTIC AINc_V_Baro_Ofst "Sensor transfer function" VALUE 0x8c070 RL_AINC_V_BARO_OFST 5.000000 CU_AINC_V_BARO_OFST -5.000000 0.000000 BYTE_ORDER MSB_FIRST /end CHARACTERISTIC
/begin RECORD_LAYOUT RL_AINC_V_BARO_OFST FNC_VALUES 1 FLOAT32_IEEE COLUMN_DIR DIRECT /end RECORD_LAYOUT
/begin COMPU_METHOD CU_AINC_V_BARO_OFST "Conversion method for AINc_V_Baro_Ofst" RAT_FUNC "%10.2" "V" COEFFS 0.000000 1.000000 0.000000 0.000000 0.000000 1.000000 /end COMPU_METHOD
/* Scalar calibration for DDE 'AINc_V_CompOutPress_Max'. */
/begin CHARACTERISTIC AINc_V_CompOutPress_Max "AIN Volts will be bounded by this range" VALUE 0x8dcf4 RL_AINC_V_COMPOUTPRESS_MAX 10.000000 CU_AINC_V_COMPOUTPRESS_MAX 0.000000 10.000000 BYTE_ORDER MSB_FIRST /end CHARACTERISTIC
/begin RECORD_LAYOUT RL_AINC_V_COMPOUTPRESS_MAX FNC_VALUES 1 FLOAT32_IEEE COLUMN_DIR DIRECT /end RECORD_LAYOUT
/begin COMPU_METHOD CU_AINC_V_COMPOUTPRESS_MAX "Conversion method for AINc_V_CompOutPress_Max" RAT_FUNC "%10.3" "V" COEFFS 0.000000 1.000000 0.000000 0.000000 0.000000 1.000000 /end COMPU_METHOD
/* Scalar calibration for DDE 'AINc_V_CompOutPress_Min'. */
/begin CHARACTERISTIC AINc_V_CompOutPress_Min "AIN Volts will be bounded by this range" VALUE 0x8dcf0 RL_AINC_V_COMPOUTPRESS_MIN 10.000000 CU_AINC_V_COMPOUTPRESS_MIN 0.000000 10.000000 BYTE_ORDER MSB_FIRST /end CHARACTERISTIC
/begin RECORD_LAYOUT RL_AINC_V_COMPOUTPRESS_MIN FNC_VALUES 1 FLOAT32_IEEE COLUMN_DIR DIRECT /end RECORD_LAYOUT
/begin COMPU_METHOD CU_AINC_V_COMPOUTPRESS_MIN "Conversion method for AINc_V_CompOutPress_Min" RAT_FUNC "%10.3" "V" COEFFS 0.000000 1.000000 0.000000 0.000000 0.000000 1.000000 /end COMPU_METHOD
/* Scalar calibration for DDE 'AINc_V_CompOutPress_Ofst'. */
/begin CHARACTERISTIC AINc_V_CompOutPress_Ofst "Sensor transfer function" VALUE 0x8c390 RL_AINC_V_COMPOUTPRESS_OFST 5.000000 CU_AINC_V_COMPOUTPRESS_OFST -5.000000 0.000000 BYTE_ORDER MSB_FIRST /end CHARACTERISTIC
/begin RECORD_LAYOUT RL_AINC_V_COMPOUTPRESS_OFST FNC_VALUES 1 FLOAT32_IEEE COLUMN_DIR DIRECT /end RECORD_LAYOUT
/begin COMPU_METHOD CU_AINC_V_COMPOUTPRESS_OFST "Conversion method for AINc_V_CompOutPress_Ofst" RAT_FUNC "%10.2" "V" COEFFS 0.000000 1.000000 0.000000 0.000000 0.000000 1.000000 /end COMPU_METHOD
/* Scalar calibration for DDE 'AINc_V_CoolantTemp_Max'. */
/begin CHARACTERISTIC AINc_V_CoolantTemp_Max "AIN Volts will be bounded by this range" VALUE 0x8dcec RL_AINC_V_COOLANTTEMP_MAX 10.000000 CU_AINC_V_COOLANTTEMP_MAX 0.000000 10.000000 BYTE_ORDER MSB_FIRST /end CHARACTERISTIC
/begin RECORD_LAYOUT RL_AINC_V_COOLANTTEMP_MAX FNC_VALUES 1 FLOAT32_IEEE COLUMN_DIR DIRECT /end RECORD_LAYOUT
/begin COMPU_METHOD CU_AINC_V_COOLANTTEMP_MAX "Conversion method for AINc_V_CoolantTemp_Max" RAT_FUNC "%10.3" "V" COEFFS 0.000000 1.000000 0.000000 0.000000 0.000000 1.000000 /end COMPU_METHOD
/* Scalar calibration for DDE 'AINc_V_CoolantTemp_Min'. */
/begin CHARACTERISTIC AINc_V_CoolantTemp_Min "AIN Volts will be bounded by this range" VALUE 0x8dce8 RL_AINC_V_COOLANTTEMP_MIN 10.000000 CU_AINC_V_COOLANTTEMP_MIN 0.000000 10.000000 BYTE_ORDER MSB_FIRST /end CHARACTERISTIC
/begin RECORD_LAYOUT RL_AINC_V_COOLANTTEMP_MIN FNC_VALUES 1 FLOAT32_IEEE COLUMN_DIR DIRECT /end RECORD_LAYOUT
/begin COMPU_METHOD CU_AINC_V_COOLANTTEMP_MIN "Conversion method for AINc_V_CoolantTemp_Min" RAT_FUNC "%10.3" "V" COEFFS 0.000000 1.000000 0.000000 0.000000 0.000000 1.000000 /end COMPU_METHOD
/* Scalar calibration for DDE 'AINc_V_EGO11'. */
/begin CHARACTERISTIC AINc_V_EGO11 "Override value" VALUE 0x8c404 RL_AINC_V_EGO11 2.000000 CU_AINC_V_EGO11 0.000000 2.000000 BYTE_ORDER MSB_FIRST /end CHARACTERISTIC
/begin RECORD_LAYOUT RL_AINC_V_EGO11 FNC_VALUES 1 FLOAT32_IEEE COLUMN_DIR DIRECT /end RECORD_LAYOUT
/begin COMPU_METHOD CU_AINC_V_EGO11 "Conversion method for AINc_V_EGO11" RAT_FUNC "%10.2" "V" COEFFS 0.000000 1.000000 0.000000 0.000000 0.000000 1.000000 /end COMPU_METHOD
/* Scalar calibration for DDE 'AINc_V_EGO12'. */
/begin CHARACTERISTIC AINc_V_EGO12 "Override value" VALUE 0x8c0f0 RL_AINC_V_EGO12 2.000000 CU_AINC_V_EGO12 0.000000 2.000000 BYTE_ORDER MSB_FIRST /end CHARACTERISTIC
/begin RECORD_LAYOUT RL_AINC_V_EGO12 FNC_VALUES 1 FLOAT32_IEEE COLUMN_DIR DIRECT /end RECORD_LAYOUT
/begin COMPU_METHOD CU_AINC_V_EGO12 "Conversion method for AINc_V_EGO12" RAT_FUNC "%10.2" "V" COEFFS 0.000000 1.000000 0.000000 0.000000 0.000000 1.000000 /end COMPU_METHOD
/* Scalar calibration for DDE 'AINc_V_EGO21'. */
/begin CHARACTERISTIC AINc_V_EGO21 "Override value" VALUE 0x8c3b0 RL_AINC_V_EGO21 2.000000 CU_AINC_V_EGO21 0.000000 2.000000 BYTE_ORDER MSB_FIRST /end CHARACTERISTIC
/begin RECORD_LAYOUT RL_AINC_V_EGO21 FNC_VALUES 1 FLOAT32_IEEE COLUMN_DIR DIRECT /end RECORD_LAYOUT
/begin COMPU_METHOD CU_AINC_V_EGO21 "Conversion method for AINc_V_EGO21" RAT_FUNC "%10.2" "V" COEFFS 0.000000 1.000000 0.000000 0.000000 0.000000 1.000000 /end COMPU_METHOD
/* Scalar calibration for DDE 'AINc_V_ExTemp_Max'. */
/begin CHARACTERISTIC AINc_V_ExTemp_Max "AIN Volts will be bounded by this range" VALUE 0x8dce4 RL_AINC_V_EXTEMP_MAX 10.000000 CU_AINC_V_EXTEMP_MAX 0.000000 10.000000 BYTE_ORDER MSB_FIRST /end CHARACTERISTIC
/begin RECORD_LAYOUT RL_AINC_V_EXTEMP_MAX FNC_VALUES 1 FLOAT32_IEEE COLUMN_DIR DIRECT /end RECORD_LAYOUT
/begin COMPU_METHOD CU_AINC_V_EXTEMP_MAX "Conversion method for AINc_V_ExTemp_Max" RAT_FUNC "%10.3" "V" COEFFS 0.000000 1.000000 0.000000 0.000000 0.000000 1.000000 /end COMPU_METHOD
/* Scalar calibration for DDE 'AINc_V_ExTemp_Min'. */
/begin CHARACTERISTIC AINc_V_ExTemp_Min "AIN Volts will be bounded by this range" VALUE 0x8dce0 RL_AINC_V_EXTEMP_MIN 10.000000 CU_AINC_V_EXTEMP_MIN 0.000000 10.000000 BYTE_ORDER MSB_FIRST /end CHARACTERISTIC
/begin RECORD_LAYOUT RL_AINC_V_EXTEMP_MIN FNC_VALUES 1 FLOAT32_IEEE COLUMN_DIR DIRECT /end RECORD_LAYOUT
/begin COMPU_METHOD CU_AINC_V_EXTEMP_MIN "Conversion method for AINc_V_ExTemp_Min" RAT_FUNC "%10.3" "V" COEFFS 0.000000 1.000000 0.000000 0.000000 0.000000 1.000000 /end COMPU_METHOD
/* Scalar calibration for DDE 'AINc_V_FAPPress_Max'. */
/begin CHARACTERISTIC AINc_V_FAPPress_Max "AIN Volts will be bounded by this range" VALUE 0x8dcdc RL_AINC_V_FAPPRESS_MAX 10.000000 CU_AINC_V_FAPPRESS_MAX 0.000000 10.000000 BYTE_ORDER MSB_FIRST /end CHARACTERISTIC
/begin RECORD_LAYOUT RL_AINC_V_FAPPRESS_MAX FNC_VALUES 1 FLOAT32_IEEE COLUMN_DIR DIRECT /end RECORD_LAYOUT
/begin COMPU_METHOD CU_AINC_V_FAPPRESS_MAX "Conversion method for AINc_V_FAPPress_Max" RAT_FUNC "%10.3" "V" COEFFS 0.000000 1.000000 0.000000 0.000000 0.000000 1.000000 /end COMPU_METHOD
/* Scalar calibration for DDE 'AINc_V_FAPPress_Min'. */
/begin CHARACTERISTIC AINc_V_FAPPress_Min "AIN Volts will be bounded by this range" VALUE 0x8dcd8 RL_AINC_V_FAPPRESS_MIN 10.000000 CU_AINC_V_FAPPRESS_MIN 0.000000 10.000000 BYTE_ORDER MSB_FIRST /end CHARACTERISTIC
/begin RECORD_LAYOUT RL_AINC_V_FAPPRESS_MIN FNC_VALUES 1 FLOAT32_IEEE COLUMN_DIR DIRECT /end RECORD_LAYOUT
/begin COMPU_METHOD CU_AINC_V_FAPPRESS_MIN "Conversion method for AINc_V_FAPPress_Min" RAT_FUNC "%10.3" "V" COEFFS 0.000000 1.000000 0.000000 0.000000 0.000000 1.000000 /end COMPU_METHOD
/* Scalar calibration for DDE 'AINc_V_FAPPress_Ofst'. */
/begin CHARACTERISTIC AINc_V_FAPPress_Ofst "Sensor transfer function" VALUE 0x8c11c RL_AINC_V_FAPPRESS_OFST 50.000000 CU_AINC_V_FAPPRESS_OFST -50.000000 0.000000 BYTE_ORDER MSB_FIRST /end CHARACTERISTIC
/begin RECORD_LAYOUT RL_AINC_V_FAPPRESS_OFST FNC_VALUES 1 FLOAT32_IEEE COLUMN_DIR DIRECT /end RECORD_LAYOUT
/begin COMPU_METHOD CU_AINC_V_FAPPRESS_OFST "Conversion method for AINc_V_FAPPress_Ofst" RAT_FUNC "%10.2" "V" COEFFS 0.000000 1.000000 0.000000 0.000000 0.000000 1.000000 /end COMPU_METHOD
/* Scalar calibration for DDE 'AINc_V_FuelLevel1_Ofst_PctToL'. */
/begin CHARACTERISTIC AINc_V_FuelLevel1_Ofst_PctToL "Sensor transfer function" VALUE 0x8c184 RL_AINC_V_FUELLEVEL1_OFST_PCTT0 505.000000 CU_AINC_V_FUELLEVEL1_OFST_PCTT0 -5.000000 500.000000 BYTE_ORDER MSB_FIRST /end CHARACTERISTIC
/begin RECORD_LAYOUT RL_AINC_V_FUELLEVEL1_OFST_PCTT0 FNC_VALUES 1 FLOAT32_IEEE COLUMN_DIR DIRECT /end RECORD_LAYOUT
/begin COMPU_METHOD CU_AINC_V_FUELLEVEL1_OFST_PCTT0 "Conversion method for AINc_V_FuelLevel1_Ofst_PctToL" RAT_FUNC "%10.3" "V" COEFFS 0.000000 1.000000 0.000000 0.000000 0.000000 1.000000 /end COMPU_METHOD
/* Scalar calibration for DDE 'AINc_V_FuelLevel1_Ofst_VToPct'. */
/begin CHARACTERISTIC AINc_V_FuelLevel1_Ofst_VToPct "Sensor transfer function" VALUE 0x8c178 RL_AINC_V_FUELLEVEL1_OFST_VTOP0 505.000000 CU_AINC_V_FUELLEVEL1_OFST_VTOP0 -5.000000 500.000000 BYTE_ORDER MSB_FIRST /end CHARACTERISTIC
/begin RECORD_LAYOUT RL_AINC_V_FUELLEVEL1_OFST_VTOP0 FNC_VALUES 1 FLOAT32_IEEE COLUMN_DIR DIRECT /end RECORD_LAYOUT
/begin COMPU_METHOD CU_AINC_V_FUELLEVEL1_OFST_VTOP0 "Conversion method for AINc_V_FuelLevel1_Ofst_VToPct" RAT_FUNC "%10.3" "V" COEFFS 0.000000 1.000000 0.000000 0.000000 0.000000 1.000000 /end COMPU_METHOD
/* Scalar calibration for DDE 'AINc_V_FuelLevel2_Ofst_PctToL'. */
/begin CHARACTERISTIC AINc_V_FuelLevel2_Ofst_PctToL "Sensor transfer function" VALUE 0x8c18c RL_AINC_V_FUELLEVEL2_OFST_PCTT0 505.000000 CU_AINC_V_FUELLEVEL2_OFST_PCTT0 -5.000000 500.000000 BYTE_ORDER MSB_FIRST /end CHARACTERISTIC
/begin RECORD_LAYOUT RL_AINC_V_FUELLEVEL2_OFST_PCTT0 FNC_VALUES 1 FLOAT32_IEEE COLUMN_DIR DIRECT /end RECORD_LAYOUT
/begin COMPU_METHOD CU_AINC_V_FUELLEVEL2_OFST_PCTT0 "Conversion method for AINc_V_FuelLevel2_Ofst_PctToL" RAT_FUNC "%10.3" "V" COEFFS 0.000000 1.000000 0.000000 0.000000 0.000000 1.000000 /end COMPU_METHOD
/* Scalar calibration for DDE 'AINc_V_FuelLevel2_Ofst_VToPct'. */
/begin CHARACTERISTIC AINc_V_FuelLevel2_Ofst_VToPct "Sensor transfer function" VALUE 0x8c164 RL_AINC_V_FUELLEVEL2_OFST_VTOP0 505.000000 CU_AINC_V_FUELLEVEL2_OFST_VTOP0 -5.000000 500.000000 BYTE_ORDER MSB_FIRST /end CHARACTERISTIC
/begin RECORD_LAYOUT RL_AINC_V_FUELLEVEL2_OFST_VTOP0 FNC_VALUES 1 FLOAT32_IEEE COLUMN_DIR DIRECT /end RECORD_LAYOUT
/begin COMPU_METHOD CU_AINC_V_FUELLEVEL2_OFST_VTOP0 "Conversion method for AINc_V_FuelLevel2_Ofst_VToPct" RAT_FUNC "%10.3" "V" COEFFS 0.000000 1.000000 0.000000 0.000000 0.000000 1.000000 /end COMPU_METHOD
/* Scalar calibration for DDE 'AINc_V_FuelPress_Max'. */
/begin CHARACTERISTIC AINc_V_FuelPress_Max "AIN Volts will be bounded by this range" VALUE 0x8d2e8 RL_AINC_V_FUELPRESS_MAX 10.000000 CU_AINC_V_FUELPRESS_MAX 0.000000 10.000000 BYTE_ORDER MSB_FIRST /end CHARACTERISTIC
/begin RECORD_LAYOUT RL_AINC_V_FUELPRESS_MAX FNC_VALUES 1 FLOAT32_IEEE COLUMN_DIR DIRECT /end RECORD_LAYOUT
/begin COMPU_METHOD CU_AINC_V_FUELPRESS_MAX "Conversion method for AINc_V_FuelPress_Max" RAT_FUNC "%10.3" "V" COEFFS 0.000000 1.000000 0.000000 0.000000 0.000000 1.000000 /end COMPU_METHOD
/* Scalar calibration for DDE 'AINc_V_FuelPress_Min'. */
/begin CHARACTERISTIC AINc_V_FuelPress_Min "AIN Volts will be bounded by this range" VALUE 0x8dcd4 RL_AINC_V_FUELPRESS_MIN 10.000000 CU_AINC_V_FUELPRESS_MIN 0.000000 10.000000 BYTE_ORDER MSB_FIRST /end CHARACTERISTIC
/begin RECORD_LAYOUT RL_AINC_V_FUELPRESS_MIN FNC_VALUES 1 FLOAT32_IEEE COLUMN_DIR DIRECT /end RECORD_LAYOUT
/begin COMPU_METHOD CU_AINC_V_FUELPRESS_MIN "Conversion method for AINc_V_FuelPress_Min" RAT_FUNC "%10.3" "V" COEFFS 0.000000 1.000000 0.000000 0.000000 0.000000 1.000000 /end COMPU_METHOD
/* Scalar calibration for DDE 'AINc_V_FuelTemp_Max'. */
/begin CHARACTERISTIC AINc_V_FuelTemp_Max "AIN Volts will be bounded by this range" VALUE 0x8dcd0 RL_AINC_V_FUELTEMP_MAX 10.000000 CU_AINC_V_FUELTEMP_MAX 0.000000 10.000000 BYTE_ORDER MSB_FIRST /end CHARACTERISTIC
/begin RECORD_LAYOUT RL_AINC_V_FUELTEMP_MAX FNC_VALUES 1 FLOAT32_IEEE COLUMN_DIR DIRECT /end RECORD_LAYOUT
/begin COMPU_METHOD CU_AINC_V_FUELTEMP_MAX "Conversion method for AINc_V_FuelTemp_Max" RAT_FUNC "%10.3" "V" COEFFS 0.000000 1.000000 0.000000 0.000000 0.000000 1.000000 /end COMPU_METHOD
/* Scalar calibration for DDE 'AINc_V_FuelTemp_Min'. */
/begin CHARACTERISTIC AINc_V_FuelTemp_Min "AIN Volts will be bounded by this range" VALUE 0x8dccc RL_AINC_V_FUELTEMP_MIN 10.000000 CU_AINC_V_FUELTEMP_MIN 0.000000 10.000000 BYTE_ORDER MSB_FIRST /end CHARACTERISTIC
/begin RECORD_LAYOUT RL_AINC_V_FUELTEMP_MIN FNC_VALUES 1 FLOAT32_IEEE COLUMN_DIR DIRECT /end RECORD_LAYOUT
/begin COMPU_METHOD CU_AINC_V_FUELTEMP_MIN "Conversion method for AINc_V_FuelTemp_Min" RAT_FUNC "%10.3" "V" COEFFS 0.000000 1.000000 0.000000 0.000000 0.000000 1.000000 /end COMPU_METHOD
/* Scalar calibration for DDE 'AINc_V_GLPHV'. */
/begin CHARACTERISTIC AINc_V_GLPHV "AIN Volts will be bounded by this range" VALUE 0x8c14c RL_AINC_V_GLPHV 10.000000 CU_AINC_V_GLPHV 0.000000 10.000000 BYTE_ORDER MSB_FIRST /end CHARACTERISTIC
/begin RECORD_LAYOUT RL_AINC_V_GLPHV FNC_VALUES 1 FLOAT32_IEEE COLUMN_DIR DIRECT /end RECORD_LAYOUT
/begin COMPU_METHOD CU_AINC_V_GLPHV "Conversion method for AINc_V_GLPHV" RAT_FUNC "%10.3" "V" COEFFS 0.000000 1.000000 0.000000 0.000000 0.000000 1.000000 /end COMPU_METHOD
/* Scalar calibration for DDE 'AINc_V_HBridgeCurrentMonOfst'. */
/begin CHARACTERISTIC AINc_V_HBridgeCurrentMonOfst "(not defined)" VALUE 0x8cd10 RL_AINC_V_HBRIDGECURRENTMONOFST 0.000000 CU_AINC_V_HBRIDGECURRENTMONOFST 0.200000 0.200000 BYTE_ORDER MSB_FIRST /end CHARACTERISTIC
/begin RECORD_LAYOUT RL_AINC_V_HBRIDGECURRENTMONOFST FNC_VALUES 1 FLOAT32_IEEE COLUMN_DIR DIRECT /end RECORD_LAYOUT
/begin COMPU_METHOD CU_AINC_V_HBRIDGECURRENTMONOFST "Conversion method for AINc_V_HBridgeCurrentMonOfst" RAT_FUNC "%10.2" "V" COEFFS 0.000000 1.000000 0.000000 0.000000 0.000000 1.000000 /end COMPU_METHOD
/* Scalar calibration for DDE 'AINc_V_LambErrorThres'. */
/begin CHARACTERISTIC AINc_V_LambErrorThres "Voltage divider gain: M670 uses 1556/203" VALUE 0x8c0a4 RL_AINC_V_LAMBERRORTHRES 20.000000 CU_AINC_V_LAMBERRORTHRES 0.000000 20.000000 BYTE_ORDER MSB_FIRST /end CHARACTERISTIC
/begin RECORD_LAYOUT RL_AINC_V_LAMBERRORTHRES FNC_VALUES 1 FLOAT32_IEEE COLUMN_DIR DIRECT /end RECORD_LAYOUT
/begin COMPU_METHOD CU_AINC_V_LAMBERRORTHRES "Conversion method for AINc_V_LambErrorThres" RAT_FUNC "%10.3" "NU" COEFFS 0.000000 1.000000 0.000000 0.000000 0.000000 1.000000 /end COMPU_METHOD
/* Scalar calibration for DDE 'AINc_V_MAP_Dft'. */
/begin CHARACTERISTIC AINc_V_MAP_Dft "Sensor transfer function" VALUE 0x8c044 RL_AINC_V_MAP_DFT 5.000000 CU_AINC_V_MAP_DFT 0.000000 5.000000 BYTE_ORDER MSB_FIRST /end CHARACTERISTIC
/begin RECORD_LAYOUT RL_AINC_V_MAP_DFT FNC_VALUES 1 FLOAT32_IEEE COLUMN_DIR DIRECT /end RECORD_LAYOUT
/begin COMPU_METHOD CU_AINC_V_MAP_DFT "Conversion method for AINc_V_MAP_Dft" RAT_FUNC "%10.3" "V" COEFFS 0.000000 1.000000 0.000000 0.000000 0.000000 1.000000 /end COMPU_METHOD
/* Scalar calibration for DDE 'AINc_V_MAP_OV'. */
/begin CHARACTERISTIC AINc_V_MAP_OV "Sensor transfer function" VALUE 0x8c024 RL_AINC_V_MAP_OV 5.000000 CU_AINC_V_MAP_OV 0.000000 5.000000 BYTE_ORDER MSB_FIRST /end CHARACTERISTIC
/begin RECORD_LAYOUT RL_AINC_V_MAP_OV FNC_VALUES 1 FLOAT32_IEEE COLUMN_DIR DIRECT /end RECORD_LAYOUT
/begin COMPU_METHOD CU_AINC_V_MAP_OV "Conversion method for AINc_V_MAP_OV" RAT_FUNC "%10.3" "V" COEFFS 0.000000 1.000000 0.000000 0.000000 0.000000 1.000000 /end COMPU_METHOD
/* Scalar calibration for DDE 'AINc_V_MAP_Ofst'. */
/begin CHARACTERISTIC AINc_V_MAP_Ofst "Sensor transfer function" VALUE 0x8c048 RL_AINC_V_MAP_OFST 10.000000 CU_AINC_V_MAP_OFST -5.000000 5.000000 BYTE_ORDER MSB_FIRST /end CHARACTERISTIC
/begin RECORD_LAYOUT RL_AINC_V_MAP_OFST FNC_VALUES 1 FLOAT32_IEEE COLUMN_DIR DIRECT /end RECORD_LAYOUT
/begin COMPU_METHOD CU_AINC_V_MAP_OFST "Conversion method for AINc_V_MAP_Ofst" RAT_FUNC "%10.3" "V" COEFFS 0.000000 1.000000 0.000000 0.000000 0.000000 1.000000 /end COMPU_METHOD
/* Scalar calibration for DDE 'AINc_V_MAP_UV'. */
/begin CHARACTERISTIC AINc_V_MAP_UV "Sensor transfer function" VALUE 0x8c034 RL_AINC_V_MAP_UV 5.000000 CU_AINC_V_MAP_UV 0.000000 5.000000 BYTE_ORDER MSB_FIRST /end CHARACTERISTIC
/begin RECORD_LAYOUT RL_AINC_V_MAP_UV FNC_VALUES 1 FLOAT32_IEEE COLUMN_DIR DIRECT /end RECORD_LAYOUT
/begin COMPU_METHOD CU_AINC_V_MAP_UV "Conversion method for AINc_V_MAP_UV" RAT_FUNC "%10.3" "V" COEFFS 0.000000 1.000000 0.000000 0.000000 0.000000 1.000000 /end COMPU_METHOD
/* Scalar calibration for DDE 'AINc_V_ManifoldTemp_Max'. */
/begin CHARACTERISTIC AINc_V_ManifoldTemp_Max "AIN Volts will be bounded by this range" VALUE 0x8dcc8 RL_AINC_V_MANIFOLDTEMP_MAX 10.000000 CU_AINC_V_MANIFOLDTEMP_MAX 0.000000 10.000000 BYTE_ORDER MSB_FIRST /end CHARACTERISTIC
/begin RECORD_LAYOUT RL_AINC_V_MANIFOLDTEMP_MAX FNC_VALUES 1 FLOAT32_IEEE COLUMN_DIR DIRECT /end RECORD_LAYOUT
/begin COMPU_METHOD CU_AINC_V_MANIFOLDTEMP_MAX "Conversion method for AINc_V_ManifoldTemp_Max" RAT_FUNC "%10.3" "V" COEFFS 0.000000 1.000000 0.000000 0.000000 0.000000 1.000000 /end COMPU_METHOD
/* Scalar calibration for DDE 'AINc_V_ManifoldTemp_Min'. */
/begin CHARACTERISTIC AINc_V_ManifoldTemp_Min "AIN Volts will be bounded by this range" VALUE 0x8dcc4 RL_AINC_V_MANIFOLDTEMP_MIN 10.000000 CU_AINC_V_MANIFOLDTEMP_MIN 0.000000 10.000000 BYTE_ORDER MSB_FIRST /end CHARACTERISTIC
/begin RECORD_LAYOUT RL_AINC_V_MANIFOLDTEMP_MIN FNC_VALUES 1 FLOAT32_IEEE COLUMN_DIR DIRECT /end RECORD_LAYOUT
/begin COMPU_METHOD CU_AINC_V_MANIFOLDTEMP_MIN "Conversion method for AINc_V_ManifoldTemp_Min" RAT_FUNC "%10.3" "V" COEFFS 0.000000 1.000000 0.000000 0.000000 0.000000 1.000000 /end COMPU_METHOD
/* Scalar calibration for DDE 'AINc_V_TP1_Max'. */
/begin CHARACTERISTIC AINc_V_TP1_Max "AIN Volts will be bounded by this range" VALUE 0x8dcc0 RL_AINC_V_TP1_MAX 10.000000 CU_AINC_V_TP1_MAX 0.000000 10.000000 BYTE_ORDER MSB_FIRST /end CHARACTERISTIC
/begin RECORD_LAYOUT RL_AINC_V_TP1_MAX FNC_VALUES 1 FLOAT32_IEEE COLUMN_DIR DIRECT /end RECORD_LAYOUT
/begin COMPU_METHOD CU_AINC_V_TP1_MAX "Conversion method for AINc_V_TP1_Max" RAT_FUNC "%10.3" "V" COEFFS 0.000000 1.000000 0.000000 0.000000 0.000000 1.000000 /end COMPU_METHOD
/* Scalar calibration for DDE 'AINc_V_TP1_Min'. */
/begin CHARACTERISTIC AINc_V_TP1_Min "AIN Volts will be bounded by this range" VALUE 0x8dcbc RL_AINC_V_TP1_MIN 10.000000 CU_AINC_V_TP1_MIN 0.000000 10.000000 BYTE_ORDER MSB_FIRST /end CHARACTERISTIC
/begin RECORD_LAYOUT RL_AINC_V_TP1_MIN FNC_VALUES 1 FLOAT32_IEEE COLUMN_DIR DIRECT /end RECORD_LAYOUT
/begin COMPU_METHOD CU_AINC_V_TP1_MIN "Conversion method for AINc_V_TP1_Min" RAT_FUNC "%10.3" "V" COEFFS 0.000000 1.000000 0.000000 0.000000 0.000000 1.000000 /end COMPU_METHOD
/* Scalar calibration for DDE 'AINc_V_TP1_Ofst'. */
/begin CHARACTERISTIC AINc_V_TP1_Ofst "Sensor transfer function" VALUE 0x8c358 RL_AINC_V_TP1_OFST 5.000000 CU_AINC_V_TP1_OFST -5.000000 0.000000 BYTE_ORDER MSB_FIRST /end CHARACTERISTIC
/begin RECORD_LAYOUT RL_AINC_V_TP1_OFST FNC_VALUES 1 FLOAT32_IEEE COLUMN_DIR DIRECT /end RECORD_LAYOUT
/begin COMPU_METHOD CU_AINC_V_TP1_OFST "Conversion method for AINc_V_TP1_Ofst" RAT_FUNC "%10.2" "V" COEFFS 0.000000 1.000000 0.000000 0.000000 0.000000 1.000000 /end COMPU_METHOD
/* Scalar calibration for DDE 'AINc_V_TP2_Max'. */
/begin CHARACTERISTIC AINc_V_TP2_Max "AIN Volts will be bounded by this range" VALUE 0x8dcb8 RL_AINC_V_TP2_MAX 10.000000 CU_AINC_V_TP2_MAX 0.000000 10.000000 BYTE_ORDER MSB_FIRST /end CHARACTERISTIC
/begin RECORD_LAYOUT RL_AINC_V_TP2_MAX FNC_VALUES 1 FLOAT32_IEEE COLUMN_DIR DIRECT /end RECORD_LAYOUT
/begin COMPU_METHOD CU_AINC_V_TP2_MAX "Conversion method for AINc_V_TP2_Max" RAT_FUNC "%10.3" "V" COEFFS 0.000000 1.000000 0.000000 0.000000 0.000000 1.000000 /end COMPU_METHOD
/* Scalar calibration for DDE 'AINc_V_TP2_Min'. */
/begin CHARACTERISTIC AINc_V_TP2_Min "AIN Volts will be bounded by this range" VALUE 0x8dcb4 RL_AINC_V_TP2_MIN 10.000000 CU_AINC_V_TP2_MIN 0.000000 10.000000 BYTE_ORDER MSB_FIRST /end CHARACTERISTIC
/begin RECORD_LAYOUT RL_AINC_V_TP2_MIN FNC_VALUES 1 FLOAT32_IEEE COLUMN_DIR DIRECT /end RECORD_LAYOUT
/begin COMPU_METHOD CU_AINC_V_TP2_MIN "Conversion method for AINc_V_TP2_Min" RAT_FUNC "%10.3" "V" COEFFS 0.000000 1.000000 0.000000 0.000000 0.000000 1.000000 /end COMPU_METHOD
/* Scalar calibration for DDE 'AINc_V_TP2_Ofst'. */
/begin CHARACTERISTIC AINc_V_TP2_Ofst "Sensor transfer function" VALUE 0x8c370 RL_AINC_V_TP2_OFST 5.000000 CU_AINC_V_TP2_OFST -5.000000 0.000000 BYTE_ORDER MSB_FIRST /end CHARACTERISTIC
/begin RECORD_LAYOUT RL_AINC_V_TP2_OFST FNC_VALUES 1 FLOAT32_IEEE COLUMN_DIR DIRECT /end RECORD_LAYOUT
/begin COMPU_METHOD CU_AINC_V_TP2_OFST "Conversion method for AINc_V_TP2_Ofst" RAT_FUNC "%10.2" "V" COEFFS 0.000000 1.000000 0.000000 0.000000 0.000000 1.000000 /end COMPU_METHOD
/* Scalar measurable for DDE 'TUR_NU_BoostPressErrROC'. */
/begin MEASUREMENT TUR_NU_BoostPressErrROC "Rate of change of manifold pressure error" FLOAT32_IEEE CU_TUR_NU_BOOSTPRESSERRROC 1 100 0.0 0.0 ECU_ADDRESS 0x40003284 BYTE_ORDER MSB_FIRST /end MEASUREMENT
/begin COMPU_METHOD CU_TUR_NU_BOOSTPRESSERRROC "Conversion method for TUR_NU_BoostPressErrROC" RAT_FUNC "%10.2" "NU" COEFFS 0.000000 1.000000 0.000000 0.000000 0.000000 1.000000 /end COMPU_METHOD
/* Scalar measurable for DDE 'TUR_NU_FB_DC'. */
/begin MEASUREMENT TUR_NU_FB_DC "Tubo Feedback DC" FLOAT32_IEEE CU_TUR_NU_FB_DC 1 100 0.0 0.0 ECU_ADDRESS 0x40003264 BYTE_ORDER MSB_FIRST /end MEASUREMENT
/begin COMPU_METHOD CU_TUR_NU_FB_DC "Conversion method for TUR_NU_FB_DC" RAT_FUNC "%10.3" "pct" COEFFS 0.000000 1.000000 0.000000 0.000000 0.000000 1.000000 /end COMPU_METHOD
/* Scalar measurable for DDE 'TUR_NU_FF_DC'. */
/begin MEASUREMENT TUR_NU_FF_DC "Tubo Feedback DC" FLOAT32_IEEE CU_TUR_NU_FF_DC 1 100 0.0 0.0 ECU_ADDRESS 0x40003260 BYTE_ORDER MSB_FIRST /end MEASUREMENT
/begin COMPU_METHOD CU_TUR_NU_FF_DC "Conversion method for TUR_NU_FF_DC" RAT_FUNC "%10.3" "pct" COEFFS 0.000000 1.000000 0.000000 0.000000 0.000000 1.000000 /end COMPU_METHOD
/* Scalar measurable for DDE 'TUR_NU_PressRatioTrgt'. */
/begin MEASUREMENT TUR_NU_PressRatioTrgt "Target boost pressure ratio" FLOAT32_IEEE CU_TUR_NU_PRESSRATIOTRGT 1 100 0.0 0.0 ECU_ADDRESS 0x40003274 BYTE_ORDER MSB_FIRST /end MEASUREMENT
/begin COMPU_METHOD CU_TUR_NU_PRESSRATIOTRGT "Conversion method for TUR_NU_PressRatioTrgt" RAT_FUNC "%10.2" "NU" COEFFS 0.000000 1.000000 0.000000 0.000000 0.000000 1.000000 /end COMPU_METHOD
/* Scalar measurable for DDE 'TUR_b_AtMaxBoost'. */
/begin MEASUREMENT TUR_b_AtMaxBoost "Indicates actuator is at its limit of authority" UBYTE CU_TUR_B_ATMAXBOOST 1 100 0.0 1.0 ECU_ADDRESS 0x40002e82 BYTE_ORDER MSB_FIRST /end MEASUREMENT
/begin COMPU_METHOD CU_TUR_B_ATMAXBOOST "Conversion method for TUR_b_AtMaxBoost" RAT_FUNC "%10.0" "b" COEFFS 0.000000 1.000000 0.000000 0.000000 0.000000 1.000000 /end COMPU_METHOD
/* Scalar measurable for DDE 'TUR_b_AtMinBoost'. */
/begin MEASUREMENT TUR_b_AtMinBoost "Indicates actuator is at its limit of authority" UBYTE CU_TUR_B_ATMINBOOST 1 100 0.0 1.0 ECU_ADDRESS 0x40002e83 BYTE_ORDER MSB_FIRST /end MEASUREMENT
/begin COMPU_METHOD CU_TUR_B_ATMINBOOST "Conversion method for TUR_b_AtMinBoost" RAT_FUNC "%10.0" "b" COEFFS 0.000000 1.000000 0.000000 0.000000 0.000000 1.000000 /end COMPU_METHOD
/* Scalar measurable for DDE 'TUR_b_CompBypassValve'. */
/begin MEASUREMENT TUR_b_CompBypassValve "Compressor bypass valve command" UBYTE CU_TUR_B_COMPBYPASSVALVE 1 100 0.0 1.0 ECU_ADDRESS 0x40002e7f BYTE_ORDER MSB_FIRST /end MEASUREMENT
/begin COMPU_METHOD CU_TUR_B_COMPBYPASSVALVE "Conversion method for TUR_b_CompBypassValve" RAT_FUNC "%10.0" "b" COEFFS 0.000000 1.000000 0.000000 0.000000 0.000000 1.000000 /end COMPU_METHOD
/* Scalar measurable for DDE 'TUR_kPa_BoostPressErr'. */
/begin MEASUREMENT TUR_kPa_BoostPressErr "Manifold pressure error" FLOAT32_IEEE CU_TUR_KPA_BOOSTPRESSERR 1 100 0.0 0.0 ECU_ADDRESS 0x40003290 BYTE_ORDER MSB_FIRST /end MEASUREMENT
/begin COMPU_METHOD CU_TUR_KPA_BOOSTPRESSERR "Conversion method for TUR_kPa_BoostPressErr" RAT_FUNC "%10.2" "kPa" COEFFS 0.000000 1.000000 0.000000 0.000000 0.000000 1.000000 /end COMPU_METHOD
/* Scalar measurable for DDE 'TUR_pct_DTerm'. */
/begin MEASUREMENT TUR_pct_DTerm "Derivative effort term for turbo actuator control" FLOAT32_IEEE CU_TUR_PCT_DTERM 1 100 0.0 0.0 ECU_ADDRESS 0x40003280 BYTE_ORDER MSB_FIRST /end MEASUREMENT
/begin COMPU_METHOD CU_TUR_PCT_DTERM "Conversion method for TUR_pct_DTerm" RAT_FUNC "%10.3" "pct" COEFFS 0.000000 1.000000 0.000000 0.000000 0.000000 1.000000 /end COMPU_METHOD
/* Scalar measurable for DDE 'TUR_pct_FB_Effort'. */
/begin MEASUREMENT TUR_pct_FB_Effort "Final PID effort for turbo boost control" FLOAT32_IEEE CU_TUR_PCT_FB_EFFORT 1 100 0.0 0.0 ECU_ADDRESS 0x40003278 BYTE_ORDER MSB_FIRST /end MEASUREMENT
/begin COMPU_METHOD CU_TUR_PCT_FB_EFFORT "Conversion method for TUR_pct_FB_Effort" RAT_FUNC "%10.3" "pct" COEFFS 0.000000 1.000000 0.000000 0.000000 0.000000 1.000000 /end COMPU_METHOD
/* Scalar measurable for DDE 'TUR_pct_FB_EffortRaw'. */
/begin MEASUREMENT TUR_pct_FB_EffortRaw "Raw PID effort for turbo boost control" FLOAT32_IEEE CU_TUR_PCT_FB_EFFORTRAW 1 100 0.0 0.0 ECU_ADDRESS 0x4000327c BYTE_ORDER MSB_FIRST /end MEASUREMENT
/begin COMPU_METHOD CU_TUR_PCT_FB_EFFORTRAW "Conversion method for TUR_pct_FB_EffortRaw" RAT_FUNC "%10.3" "pct" COEFFS 0.000000 1.000000 0.000000 0.000000 0.000000 1.000000 /end COMPU_METHOD
/* Scalar measurable for DDE 'TUR_pct_FF_Effort'. */
/begin MEASUREMENT TUR_pct_FF_Effort "Turbo feedforward effort" FLOAT32_IEEE CU_TUR_PCT_FF_EFFORT 1 100 0.0 0.0 ECU_ADDRESS 0x40003270 BYTE_ORDER MSB_FIRST /end MEASUREMENT
/begin COMPU_METHOD CU_TUR_PCT_FF_EFFORT "Conversion method for TUR_pct_FF_Effort" RAT_FUNC "%10.3" "pct" COEFFS 0.000000 1.000000 0.000000 0.000000 0.000000 1.000000 /end COMPU_METHOD
/* Scalar measurable for DDE 'TUR_pct_ITerm'. */
/begin MEASUREMENT TUR_pct_ITerm "Integral effort term in turbo actuator control" FLOAT32_IEEE CU_TUR_PCT_ITERM 1 100 0.0 0.0 ECU_ADDRESS 0x40003288 BYTE_ORDER MSB_FIRST /end MEASUREMENT
/begin COMPU_METHOD CU_TUR_PCT_ITERM "Conversion method for TUR_pct_ITerm" RAT_FUNC "%10.4" "pct" COEFFS 0.000000 1.000000 0.000000 0.000000 0.000000 1.000000 /end COMPU_METHOD
/* Scalar measurable for DDE 'TUR_pct_PTerm'. */
/begin MEASUREMENT TUR_pct_PTerm "Proportional effort term in turbo actuator control" FLOAT32_IEEE CU_TUR_PCT_PTERM 1 100 0.0 0.0 ECU_ADDRESS 0x4000328c BYTE_ORDER MSB_FIRST /end MEASUREMENT
/begin COMPU_METHOD CU_TUR_PCT_PTERM "Conversion method for TUR_pct_PTerm" RAT_FUNC "%10.4" "pct" COEFFS 0.000000 1.000000 0.000000 0.000000 0.000000 1.000000 /end COMPU_METHOD
/* Scalar measurable for DDE 'TUR_pct_TotalEffort'. */
/begin MEASUREMENT TUR_pct_TotalEffort "Final total turbo control effort" FLOAT32_IEEE CU_TUR_PCT_TOTALEFFORT 1 100 0.0 0.0 ECU_ADDRESS 0x40003268 BYTE_ORDER MSB_FIRST /end MEASUREMENT
/begin COMPU_METHOD CU_TUR_PCT_TOTALEFFORT "Conversion method for TUR_pct_TotalEffort" RAT_FUNC "%10.3" "pct" COEFFS 0.000000 1.000000 0.000000 0.000000 0.000000 1.000000 /end COMPU_METHOD
/* Scalar measurable for DDE 'TUR_pct_TotalEffortRaw'. */
/begin MEASUREMENT TUR_pct_TotalEffortRaw "Raw total turbo control effort" FLOAT32_IEEE CU_TUR_PCT_TOTALEFFORTRAW 1 100 0.0 0.0 ECU_ADDRESS 0x4000326c BYTE_ORDER MSB_FIRST /end MEASUREMENT
/begin COMPU_METHOD CU_TUR_PCT_TOTALEFFORTRAW "Conversion method for TUR_pct_TotalEffortRaw" RAT_FUNC "%10.3" "pct" COEFFS 0.000000 1.000000 0.000000 0.000000 0.000000 1.000000 /end COMPU_METHOD
/* Scalar measurable for DDE 'TUR_pct_TurCtrlDC'. */
/begin MEASUREMENT TUR_pct_TurCtrlDC "Final value of turbo control actuator duty cycle" FLOAT32_IEEE CU_TUR_PCT_TURCTRLDC 1 100 0.0 0.0 ECU_ADDRESS 0x40003234 BYTE_ORDER MSB_FIRST /end MEASUREMENT
/begin COMPU_METHOD CU_TUR_PCT_TURCTRLDC "Conversion method for TUR_pct_TurCtrlDC" RAT_FUNC "%10.3" "pct" COEFFS 0.000000 1.000000 0.000000 0.000000 0.000000 1.000000 /end COMPU_METHOD
/* Scalar measurable for DDE 'VCP_NU_CamErrROC'. */
/begin MEASUREMENT VCP_NU_CamErrROC "(deg/s) Time derivative of position error" FLOAT32_IEEE CU_VCP_NU_CAMERRROC 1 100 -100.0 100.0 ECU_ADDRESS 0x40003244 BYTE_ORDER MSB_FIRST /end MEASUREMENT
/begin COMPU_METHOD CU_VCP_NU_CAMERRROC "Conversion method for VCP_NU_CamErrROC" RAT_FUNC "%10.3" "NU" COEFFS 0.000000 1.000000 0.000000 0.000000 0.000000 1.000000 /end COMPU_METHOD
/* Scalar measurable for DDE 'VCP_adv_CamTrgt'. */
/begin MEASUREMENT VCP_adv_CamTrgt "Rate limited  cam phasing target" FLOAT32_IEEE CU_VCP_ADV_CAMTRGT 1 100 -5.0 100.0 ECU_ADDRESS 0x40003258 BYTE_ORDER MSB_FIRST /end MEASUREMENT
/begin COMPU_METHOD CU_VCP_ADV_CAMTRGT "Conversion method for VCP_adv_CamTrgt" RAT_FUNC "%10.1" "adv" COEFFS 0.000000 1.000000 0.000000 0.000000 0.000000 1.000000 /end COMPU_METHOD
/* Scalar measurable for DDE 'VCP_deg_CamErr'. */
/begin MEASUREMENT VCP_deg_CamErr "VVT error" FLOAT32_IEEE CU_VCP_DEG_CAMERR 1 100 -100.0 100.0 ECU_ADDRESS 0x40003250 BYTE_ORDER MSB_FIRST /end MEASUREMENT
/begin COMPU_METHOD CU_VCP_DEG_CAMERR "Conversion method for VCP_deg_CamErr" RAT_FUNC "%10.3" "NU" COEFFS 0.000000 1.000000 0.000000 0.000000 0.000000 1.000000 /end COMPU_METHOD
/* Scalar measurable for DDE 'VCP_pct_CamDC'. */
/begin MEASUREMENT VCP_pct_CamDC "PWM Signal percentage for Monitoring" FLOAT32_IEEE CU_VCP_PCT_CAMDC 1 100 0.0 1.0 ECU_ADDRESS 0x40003204 BYTE_ORDER MSB_FIRST /end MEASUREMENT
/begin COMPU_METHOD CU_VCP_PCT_CAMDC "Conversion method for VCP_pct_CamDC" RAT_FUNC "%10.2" "pct" COEFFS 0.000000 1.000000 0.000000 0.000000 0.000000 1.000000 /end COMPU_METHOD
/* Scalar measurable for DDE 'VCP_pct_CamDC_FF'. */
/begin MEASUREMENT VCP_pct_CamDC_FF "Feed-forward control effort for  cam phasing" FLOAT32_IEEE CU_VCP_PCT_CAMDC_FF 1 100 0.0 1.0 ECU_ADDRESS 0x40003254 BYTE_ORDER MSB_FIRST /end MEASUREMENT
/begin COMPU_METHOD CU_VCP_PCT_CAMDC_FF "Conversion method for VCP_pct_CamDC_FF" RAT_FUNC "%10.3" "NU" COEFFS 0.000000 1.000000 0.000000 0.000000 0.000000 1.000000 /end COMPU_METHOD
/* Scalar measurable for DDE 'VCP_pct_CamDC_PID'. */
/begin MEASUREMENT VCP_pct_CamDC_PID "Feedback control effort for  cam phasing" FLOAT32_IEEE CU_VCP_PCT_CAMDC_PID 1 100 0.0 1.0 ECU_ADDRESS 0x40003238 BYTE_ORDER MSB_FIRST /end MEASUREMENT
/begin COMPU_METHOD CU_VCP_PCT_CAMDC_PID "Conversion method for VCP_pct_CamDC_PID" RAT_FUNC "%10.3" "NU" COEFFS 0.000000 1.000000 0.000000 0.000000 0.000000 1.000000 /end COMPU_METHOD
/* Scalar measurable for DDE 'VCP_pct_CamDTerm'. */
/begin MEASUREMENT VCP_pct_CamDTerm "Derivative effort for  cam" FLOAT32_IEEE CU_VCP_PCT_CAMDTERM 1 100 -1.0 1.0 ECU_ADDRESS 0x40003240 BYTE_ORDER MSB_FIRST /end MEASUREMENT
/begin COMPU_METHOD CU_VCP_PCT_CAMDTERM "Conversion method for VCP_pct_CamDTerm" RAT_FUNC "%10.3" "NU" COEFFS 0.000000 1.000000 0.000000 0.000000 0.000000 1.000000 /end COMPU_METHOD
/* Scalar measurable for DDE 'VCP_pct_CamITerm'. */
/begin MEASUREMENT VCP_pct_CamITerm "Integral effort for  cam" FLOAT32_IEEE CU_VCP_PCT_CAMITERM 1 100 -1.0 1.0 ECU_ADDRESS 0x40003248 BYTE_ORDER MSB_FIRST /end MEASUREMENT
/begin COMPU_METHOD CU_VCP_PCT_CAMITERM "Conversion method for VCP_pct_CamITerm" RAT_FUNC "%10.3" "NU" COEFFS 0.000000 1.000000 0.000000 0.000000 0.000000 1.000000 /end COMPU_METHOD
/* Scalar measurable for DDE 'VCP_pct_CamPIDRaw'. */
/begin MEASUREMENT VCP_pct_CamPIDRaw "Cam PID effort raw" FLOAT32_IEEE CU_VCP_PCT_CAMPIDRAW 1 100 -1.0 1.0 ECU_ADDRESS 0x4000323c BYTE_ORDER MSB_FIRST /end MEASUREMENT
/begin COMPU_METHOD CU_VCP_PCT_CAMPIDRAW "Conversion method for VCP_pct_CamPIDRaw" RAT_FUNC "%10.3" "NU" COEFFS 0.000000 1.000000 0.000000 0.000000 0.000000 1.000000 /end COMPU_METHOD
/* Scalar measurable for DDE 'VCP_pct_CamPTerm'. */
/begin MEASUREMENT VCP_pct_CamPTerm "Proportional effort" FLOAT32_IEEE CU_VCP_PCT_CAMPTERM 1 100 0.0 1.0 ECU_ADDRESS 0x4000324c BYTE_ORDER MSB_FIRST /end MEASUREMENT
/begin COMPU_METHOD CU_VCP_PCT_CAMPTERM "Conversion method for VCP_pct_CamPTerm" RAT_FUNC "%10.3" "NU" COEFFS 0.000000 1.000000 0.000000 0.000000 0.000000 1.000000 /end COMPU_METHOD
/* Scalar measurable for DDE 'exd_NU_awlstatus'. */
/begin MEASUREMENT exd_NU_awlstatus "(not defined)" FLOAT32_IEEE CU_EXD_NU_AWLSTATUS 1 100 0.0 3.0 ECU_ADDRESS 0x40003680 BYTE_ORDER MSB_FIRST /end MEASUREMENT
/begin COMPU_METHOD CU_EXD_NU_AWLSTATUS "Conversion method for exd_NU_awlstatus" RAT_FUNC "%10.0" "NU" COEFFS 0.000000 1.000000 0.000000 0.000000 0.000000 1.000000 /end COMPU_METHOD
/* Scalar measurable for DDE 'exd_NU_milstatus'. */
/begin MEASUREMENT exd_NU_milstatus "(not defined)" FLOAT32_IEEE CU_EXD_NU_MILSTATUS 1 100 0.0 3.0 ECU_ADDRESS 0x40003688 BYTE_ORDER MSB_FIRST /end MEASUREMENT
/begin COMPU_METHOD CU_EXD_NU_MILSTATUS "Conversion method for exd_NU_milstatus" RAT_FUNC "%10.0" "NU" COEFFS 0.000000 1.000000 0.000000 0.000000 0.000000 1.000000 /end COMPU_METHOD
/* Scalar measurable for DDE 'exd_NU_prlstatus'. */
/begin MEASUREMENT exd_NU_prlstatus "(not defined)" FLOAT32_IEEE CU_EXD_NU_PRLSTATUS 1 100 0.0 3.0 ECU_ADDRESS 0x4000367c BYTE_ORDER MSB_FIRST /end MEASUREMENT
/begin COMPU_METHOD CU_EXD_NU_PRLSTATUS "Conversion method for exd_NU_prlstatus" RAT_FUNC "%10.0" "NU" COEFFS 0.000000 1.000000 0.000000 0.000000 0.000000 1.000000 /end COMPU_METHOD
/* Scalar measurable for DDE 'exd_NU_rslstatus'. */
/begin MEASUREMENT exd_NU_rslstatus "(not defined)" FLOAT32_IEEE CU_EXD_NU_RSLSTATUS 1 100 0.0 3.0 ECU_ADDRESS 0x40003684 BYTE_ORDER MSB_FIRST /end MEASUREMENT
/begin COMPU_METHOD CU_EXD_NU_RSLSTATUS "Conversion method for exd_NU_rslstatus" RAT_FUNC "%10.0" "NU" COEFFS 0.000000 1.000000 0.000000 0.000000 0.000000 1.000000 /end COMPU_METHOD
/* Scalar measurable for DDE 'exd_b_DM11cleared'. */
/begin MEASUREMENT exd_b_DM11cleared "Override flag" UBYTE CU_EXD_B_DM11CLEARED 1 100 0.0 1.0 ECU_ADDRESS 0x40002f2d BYTE_ORDER MSB_FIRST /end MEASUREMENT
/begin COMPU_METHOD CU_EXD_B_DM11CLEARED "Conversion method for exd_b_DM11cleared" RAT_FUNC "%10.0" "b" COEFFS 0.000000 1.000000 0.000000 0.000000 0.000000 1.000000 /end COMPU_METHOD
/* Scalar measurable for DDE 'exd_b_DTCscleared'. */
/begin MEASUREMENT exd_b_DTCscleared "Override flag" UBYTE CU_EXD_B_DTCSCLEARED 1 100 0.0 1.0 ECU_ADDRESS 0x4000368c BYTE_ORDER MSB_FIRST /end MEASUREMENT
/begin COMPU_METHOD CU_EXD_B_DTCSCLEARED "Conversion method for exd_b_DTCscleared" RAT_FUNC "%10.0" "b" COEFFS 0.000000 1.000000 0.000000 0.000000 0.000000 1.000000 /end COMPU_METHOD
/* Scalar measurable for DDE 'ext_NU_activmode'. */
/begin MEASUREMENT ext_NU_activmode "(not defined)" FLOAT32_IEEE CU_EXT_NU_ACTIVMODE 1 100 0.0 3.0 ECU_ADDRESS 0x40003012 BYTE_ORDER MSB_FIRST /end MEASUREMENT
/begin COMPU_METHOD CU_EXT_NU_ACTIVMODE "Conversion method for ext_NU_activmode" RAT_FUNC "%10.0" "NU" COEFFS 0.000000 1.000000 0.000000 0.000000 0.000000 1.000000 /end COMPU_METHOD
/* Scalar measurable for DDE 'ext_NU_b1constinuous'. */
/begin MEASUREMENT ext_NU_b1constinuous "(not defined)" FLOAT32_IEEE CU_EXT_NU_B1CONSTINUOUS 1 100 0.0 4294967295.0 ECU_ADDRESS 0x40003048 BYTE_ORDER MSB_FIRST /end MEASUREMENT
/begin COMPU_METHOD CU_EXT_NU_B1CONSTINUOUS "Conversion method for ext_NU_b1constinuous" RAT_FUNC "%10.1" "NU" COEFFS 0.000000 1.000000 0.000000 0.000000 0.000000 1.000000 /end COMPU_METHOD
/* Scalar measurable for DDE 'ext_NU_b1cumulative'. */
/begin MEASUREMENT ext_NU_b1cumulative "(not defined)" FLOAT32_IEEE CU_EXT_NU_B1CUMULATIVE 1 100 0.0 4294967295.0 ECU_ADDRESS 0x4000304c BYTE_ORDER MSB_FIRST /end MEASUREMENT
/begin COMPU_METHOD CU_EXT_NU_B1CUMULATIVE "Conversion method for ext_NU_b1cumulative" RAT_FUNC "%10.1" "NU" COEFFS 0.000000 1.000000 0.000000 0.000000 0.000000 1.000000 /end COMPU_METHOD
/* Scalar measurable for DDE 'ext_NU_milcumulative'. */
/begin MEASUREMENT ext_NU_milcumulative "(not defined)" FLOAT32_IEEE CU_EXT_NU_MILCUMULATIVE 1 100 0.0 4294967295.0 ECU_ADDRESS 0x40003050 BYTE_ORDER MSB_FIRST /end MEASUREMENT
/begin COMPU_METHOD CU_EXT_NU_MILCUMULATIVE "Conversion method for ext_NU_milcumulative" RAT_FUNC "%10.1" "NU" COEFFS 0.000000 1.000000 0.000000 0.000000 0.000000 1.000000 /end COMPU_METHOD
/* Scalar measurable for DDE 'sys_app_code_day'. */
/begin MEASUREMENT sys_app_code_day "Day the application code was built." UWORD CU_SYS_APP_CODE_DAY 1 100 0.0 0.0 ECU_ADDRESS 0x4000314c BYTE_ORDER MSB_FIRST /end MEASUREMENT
/begin COMPU_METHOD CU_SYS_APP_CODE_DAY "Conversion method for sys_app_code_day" RAT_FUNC "%10.0" "(not defined)" COEFFS 0.000000 1.000000 0.000000 0.000000 0.000000 1.000000 /end COMPU_METHOD
/* Scalar measurable for DDE 'sys_app_code_major_ver'. */
/begin MEASUREMENT sys_app_code_major_ver "Major version of the application code." UWORD CU_SYS_APP_CODE_MAJOR_VER 1 100 0.0 0.0 ECU_ADDRESS 0x40003148 BYTE_ORDER MSB_FIRST /end MEASUREMENT
/begin COMPU_METHOD CU_SYS_APP_CODE_MAJOR_VER "Conversion method for sys_app_code_major_ver" RAT_FUNC "%10.0" "(not defined)" COEFFS 0.000000 1.000000 0.000000 0.000000 0.000000 1.000000 /end COMPU_METHOD
/* Scalar measurable for DDE 'sys_app_code_minor_ver'. */
/begin MEASUREMENT sys_app_code_minor_ver "Minor version of the application code." UWORD CU_SYS_APP_CODE_MINOR_VER 1 100 0.0 0.0 ECU_ADDRESS 0x40003144 BYTE_ORDER MSB_FIRST /end MEASUREMENT
/begin COMPU_METHOD CU_SYS_APP_CODE_MINOR_VER "Conversion method for sys_app_code_minor_ver" RAT_FUNC "%10.0" "(not defined)" COEFFS 0.000000 1.000000 0.000000 0.000000 0.000000 1.000000 /end COMPU_METHOD
/* Scalar measurable for DDE 'sys_app_code_month'. */
/begin MEASUREMENT sys_app_code_month "Month the application code was built." UWORD CU_SYS_APP_CODE_MONTH 1 100 0.0 0.0 ECU_ADDRESS 0x40003150 BYTE_ORDER MSB_FIRST /end MEASUREMENT
/begin COMPU_METHOD CU_SYS_APP_CODE_MONTH "Conversion method for sys_app_code_month" RAT_FUNC "%10.0" "(not defined)" COEFFS 0.000000 1.000000 0.000000 0.000000 0.000000 1.000000 /end COMPU_METHOD
/* Scalar measurable for DDE 'sys_app_code_subminor_ver'. */
/begin MEASUREMENT sys_app_code_subminor_ver "Sub-minor version of the application code." UWORD CU_SYS_APP_CODE_SUBMINOR_VER 1 100 0.0 0.0 ECU_ADDRESS 0x40003140 BYTE_ORDER MSB_FIRST /end MEASUREMENT
/begin COMPU_METHOD CU_SYS_APP_CODE_SUBMINOR_VER "Conversion method for sys_app_code_subminor_ver" RAT_FUNC "%10.0" "(not defined)" COEFFS 0.000000 1.000000 0.000000 0.000000 0.000000 1.000000 /end COMPU_METHOD
/* Scalar measurable for DDE 'sys_app_code_year'. */
/begin MEASUREMENT sys_app_code_year "Year the application code was built." UWORD CU_SYS_APP_CODE_YEAR 1 100 0.0 0.0 ECU_ADDRESS 0x40003154 BYTE_ORDER MSB_FIRST /end MEASUREMENT
/begin COMPU_METHOD CU_SYS_APP_CODE_YEAR "Conversion method for sys_app_code_year" RAT_FUNC "%10.0" "(not defined)" COEFFS 0.000000 1.000000 0.000000 0.000000 0.000000 1.000000 /end COMPU_METHOD
/* Scalar measurable for DDE 'sys_cpu_loading'. */
/begin MEASUREMENT sys_cpu_loading "CPU loading seen in last 50ms" UBYTE CU_SYS_CPU_LOADING 1 100 0.0 0.0 ECU_ADDRESS 0x40003018 BYTE_ORDER MSB_FIRST /end MEASUREMENT
/begin COMPU_METHOD CU_SYS_CPU_LOADING "Conversion method for sys_cpu_loading" RAT_FUNC "%10.0" "%" COEFFS 0.000000 1.000000 0.000000 0.000000 0.000000 1.000000 /end COMPU_METHOD
/* Scalar measurable for DDE 'sys_cpu_loading_max'. */
/begin MEASUREMENT sys_cpu_loading_max "Maximum CPU loading seen in any 50ms period" UBYTE CU_SYS_CPU_LOADING_MAX 1 100 0.0 0.0 ECU_ADDRESS 0x40003017 BYTE_ORDER MSB_FIRST /end MEASUREMENT
/begin COMPU_METHOD CU_SYS_CPU_LOADING_MAX "Conversion method for sys_cpu_loading_max" RAT_FUNC "%10.0" "%" COEFFS 0.000000 1.000000 0.000000 0.000000 0.000000 1.000000 /end COMPU_METHOD
/* Scalar measurable for DDE 'sys_stack_used'. */
/begin MEASUREMENT sys_stack_used "Amount of used stack" ULONG CU_SYS_STACK_USED 1 100 0.0 0.0 ECU_ADDRESS 0x40003060 BYTE_ORDER MSB_FIRST /end MEASUREMENT
/begin COMPU_METHOD CU_SYS_STACK_USED "Conversion method for sys_stack_used" RAT_FUNC "%10.0" "B" COEFFS 0.000000 1.000000 0.000000 0.000000 0.000000 1.000000 /end COMPU_METHOD
/begin FUNCTION Signals "Group /ByType/Signals"
 /begin LOC_MEASUREMENT TUR_NU_BoostPressErrROC TUR_NU_FB_DC TUR_NU_FF_DC TUR_NU_PressRatioTrgt TUR_b_AtMaxBoost TUR_b_AtMinBoost TUR_b_CompBypassValve TUR_kPa_BoostPressErr TUR_pct_DTerm TUR_pct_FB_Effort TUR_pct_FB_EffortRaw TUR_pct_FF_Effort TUR_pct_ITerm TUR_pct_PTerm TUR_pct_TotalEffort TUR_pct_TotalEffortRaw TUR_pct_TurCtrlDC VCP_NU_CamErrROC VCP_adv_CamTrgt VCP_deg_CamErr VCP_pct_CamDC VCP_pct_CamDC_FF VCP_pct_CamDC_PID VCP_pct_CamDTerm VCP_pct_CamITerm VCP_pct_CamPIDRaw VCP_pct_CamPTerm exd_NU_awlstatus exd_NU_milstatus exd_NU_prlstatus exd_NU_rslstatus exd_b_DM11cleared exd_b_DTCscleared ext_NU_activmode ext_NU_b1constinuous ext_NU_b1cumulative ext_NU_milcumulative sys_app_code_day sys_app_code_major_ver sys_app_code_minor_ver sys_app_code_month sys_app_code_subminor_ver sys_app_code_year sys_cpu_loading sys_cpu_loading_max sys_stack_used /end LOC_MEASUREMENT
/end FUNCTION
/begin FUNCTION ByType "Group /ByType" /begin SUB_FUNCTION Adaptives Arrays Automatic Maps Scalars Signals /end SUB_FUNCTION /end FUNCTION
/begin FUNCTION Others "Group /Others"
 /begin REF_CHARACTERISTIC AINc_kPa_Baro_Ofst MaxCruiseTorque_Nm MinCruiseTorque_Nm mplc_fi_config_din_pin_y21 mplc_fi_count_din_pin_y21 pioc_inj_diag_blank pioc_inj_t6_max pioc_inj_t7 pioc_inj_t7_on_time pioc_rate_pot_max_hz /end REF_CHARACTERISTIC
/end FUNCTION
/end MODULE
/end PROJECT
