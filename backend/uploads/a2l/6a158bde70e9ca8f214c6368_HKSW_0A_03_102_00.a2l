ASAP2_VERSION 1 31
/begin PROJECT M670_Engine_Control_1.2.0_M670_000 "BeGas B430LG Turbocharged engine"
/begin HEADER "Begas Motor 2017-2022 (c)" VERSION "1_2_0" /end HEADER
/begin MODULE OpenECU_M670_000 ""
/* Scalar calibration for DDE 'OUTc_b_MIL_LED'. */
/begin CHARACTERISTIC OUTc_b_MIL_LED "MIL Led" VALUE 0x8ce72 RL_OUTC_B_MIL_LED 1.000000 CU_OUTC_B_MIL_LED 0.000000 1.000000 BYTE_ORDER MSB_FIRST /end CHARACTERISTIC
/begin RECORD_LAYOUT RL_OUTC_B_MIL_LED FNC_VALUES 1 UBYTE COLUMN_DIR DIRECT /end RECORD_LAYOUT
/begin COMPU_METHOD CU_OUTC_B_MIL_LED "Conversion method for OUTc_b_MIL_LED" RAT_FUNC "%10.0" "b" COEFFS 0.000000 1.000000 0.000000 0.000000 0.000000 1.000000 /end COMPU_METHOD
/* Scalar calibration for DDE 'OUTc_b_ManualFuelCut1'. */
/begin CHARACTERISTIC OUTc_b_ManualFuelCut1 "Disable fuel for cylinder 1" VALUE 0x8d28a RL_OUTC_B_MANUALFUELCUT1 1.000000 CU_OUTC_B_MANUALFUELCUT1 0.000000 1.000000 BYTE_ORDER MSB_FIRST /end CHARACTERISTIC
/begin RECORD_LAYOUT RL_OUTC_B_MANUALFUELCUT1 FNC_VALUES 1 UBYTE COLUMN_DIR DIRECT /end RECORD_LAYOUT
/begin COMPU_METHOD CU_OUTC_B_MANUALFUELCUT1 "Conversion method for OUTc_b_ManualFuelCut1" RAT_FUNC "%10.0" "b" COEFFS 0.000000 1.000000 0.000000 0.000000 0.000000 1.000000 /end COMPU_METHOD
/* Scalar calibration for DDE 'OUTc_b_ManualFuelCut2'. */
/begin CHARACTERISTIC OUTc_b_ManualFuelCut2 "Disable fuel for cylinder 2" VALUE 0x8d28b RL_OUTC_B_MANUALFUELCUT2 1.000000 CU_OUTC_B_MANUALFUELCUT2 0.000000 1.000000 BYTE_ORDER MSB_FIRST /end CHARACTERISTIC
/begin RECORD_LAYOUT RL_OUTC_B_MANUALFUELCUT2 FNC_VALUES 1 UBYTE COLUMN_DIR DIRECT /end RECORD_LAYOUT
/begin COMPU_METHOD CU_OUTC_B_MANUALFUELCUT2 "Conversion method for OUTc_b_ManualFuelCut2" RAT_FUNC "%10.0" "b" COEFFS 0.000000 1.000000 0.000000 0.000000 0.000000 1.000000 /end COMPU_METHOD
/* Scalar calibration for DDE 'OUTc_b_ManualFuelCut3'. */
/begin CHARACTERISTIC OUTc_b_ManualFuelCut3 "Disable fuel for cylinder 3" VALUE 0x8d28c RL_OUTC_B_MANUALFUELCUT3 1.000000 CU_OUTC_B_MANUALFUELCUT3 0.000000 1.000000 BYTE_ORDER MSB_FIRST /end CHARACTERISTIC
/begin RECORD_LAYOUT RL_OUTC_B_MANUALFUELCUT3 FNC_VALUES 1 UBYTE COLUMN_DIR DIRECT /end RECORD_LAYOUT
/begin COMPU_METHOD CU_OUTC_B_MANUALFUELCUT3 "Conversion method for OUTc_b_ManualFuelCut3" RAT_FUNC "%10.0" "b" COEFFS 0.000000 1.000000 0.000000 0.000000 0.000000 1.000000 /end COMPU_METHOD
/* Scalar calibration for DDE 'OUTc_b_ManualFuelCut4'. */
/begin CHARACTERISTIC OUTc_b_ManualFuelCut4 "Disable fuel for cylinder 4" VALUE 0x8d28d RL_OUTC_B_MANUALFUELCUT4 1.000000 CU_OUTC_B_MANUALFUELCUT4 0.000000 1.000000 BYTE_ORDER MSB_FIRST /end CHARACTERISTIC
/begin RECORD_LAYOUT RL_OUTC_B_MANUALFUELCUT4 FNC_VALUES 1 UBYTE COLUMN_DIR DIRECT /end RECORD_LAYOUT
/begin COMPU_METHOD CU_OUTC_B_MANUALFUELCUT4 "Conversion method for OUTc_b_ManualFuelCut4" RAT_FUNC "%10.0" "b" COEFFS 0.000000 1.000000 0.000000 0.000000 0.000000 1.000000 /end COMPU_METHOD
/* Scalar calibration for DDE 'OUTc_b_ManualSparkCut1'. */
/begin CHARACTERISTIC OUTc_b_ManualSparkCut1 "Disable spark for cylinder 1" VALUE 0x8d284 RL_OUTC_B_MANUALSPARKCUT1 1.000000 CU_OUTC_B_MANUALSPARKCUT1 0.000000 1.000000 BYTE_ORDER MSB_FIRST /end CHARACTERISTIC
/begin RECORD_LAYOUT RL_OUTC_B_MANUALSPARKCUT1 FNC_VALUES 1 UBYTE COLUMN_DIR DIRECT /end RECORD_LAYOUT
/begin COMPU_METHOD CU_OUTC_B_MANUALSPARKCUT1 "Conversion method for OUTc_b_ManualSparkCut1" RAT_FUNC "%10.0" "b" COEFFS 0.000000 1.000000 0.000000 0.000000 0.000000 1.000000 /end COMPU_METHOD
/* Scalar calibration for DDE 'OUTc_b_ManualSparkCut2'. */
/begin CHARACTERISTIC OUTc_b_ManualSparkCut2 "Disable spark for cylinder 2" VALUE 0x8d285 RL_OUTC_B_MANUALSPARKCUT2 1.000000 CU_OUTC_B_MANUALSPARKCUT2 0.000000 1.000000 BYTE_ORDER MSB_FIRST /end CHARACTERISTIC
/begin RECORD_LAYOUT RL_OUTC_B_MANUALSPARKCUT2 FNC_VALUES 1 UBYTE COLUMN_DIR DIRECT /end RECORD_LAYOUT
/begin COMPU_METHOD CU_OUTC_B_MANUALSPARKCUT2 "Conversion method for OUTc_b_ManualSparkCut2" RAT_FUNC "%10.0" "b" COEFFS 0.000000 1.000000 0.000000 0.000000 0.000000 1.000000 /end COMPU_METHOD
/* Scalar calibration for DDE 'OUTc_b_ManualSparkCut3'. */
/begin CHARACTERISTIC OUTc_b_ManualSparkCut3 "Disable spark for cylinder 3" VALUE 0x8d286 RL_OUTC_B_MANUALSPARKCUT3 1.000000 CU_OUTC_B_MANUALSPARKCUT3 0.000000 1.000000 BYTE_ORDER MSB_FIRST /end CHARACTERISTIC
/begin RECORD_LAYOUT RL_OUTC_B_MANUALSPARKCUT3 FNC_VALUES 1 UBYTE COLUMN_DIR DIRECT /end RECORD_LAYOUT
/begin COMPU_METHOD CU_OUTC_B_MANUALSPARKCUT3 "Conversion method for OUTc_b_ManualSparkCut3" RAT_FUNC "%10.0" "b" COEFFS 0.000000 1.000000 0.000000 0.000000 0.000000 1.000000 /end COMPU_METHOD
/* Scalar calibration for DDE 'OUTc_b_ManualSparkCut4'. */
/begin CHARACTERISTIC OUTc_b_ManualSparkCut4 "Disable spark for cylinder 4" VALUE 0x8d287 RL_OUTC_B_MANUALSPARKCUT4 1.000000 CU_OUTC_B_MANUALSPARKCUT4 0.000000 1.000000 BYTE_ORDER MSB_FIRST /end CHARACTERISTIC
/begin RECORD_LAYOUT RL_OUTC_B_MANUALSPARKCUT4 FNC_VALUES 1 UBYTE COLUMN_DIR DIRECT /end RECORD_LAYOUT
/begin COMPU_METHOD CU_OUTC_B_MANUALSPARKCUT4 "Conversion method for OUTc_b_ManualSparkCut4" RAT_FUNC "%10.0" "b" COEFFS 0.000000 1.000000 0.000000 0.000000 0.000000 1.000000 /end COMPU_METHOD
/* Scalar calibration for DDE 'OUTc_b_ManualSparkCut5'. */
/begin CHARACTERISTIC OUTc_b_ManualSparkCut5 "Disable spark for cylinder 5" VALUE 0x8d291 RL_OUTC_B_MANUALSPARKCUT5 1.000000 CU_OUTC_B_MANUALSPARKCUT5 0.000000 1.000000 BYTE_ORDER MSB_FIRST /end CHARACTERISTIC
/begin RECORD_LAYOUT RL_OUTC_B_MANUALSPARKCUT5 FNC_VALUES 1 UBYTE COLUMN_DIR DIRECT /end RECORD_LAYOUT
/begin COMPU_METHOD CU_OUTC_B_MANUALSPARKCUT5 "Conversion method for OUTc_b_ManualSparkCut5" RAT_FUNC "%10.0" "b" COEFFS 0.000000 1.000000 0.000000 0.000000 0.000000 1.000000 /end COMPU_METHOD
/* Scalar calibration for DDE 'OUTc_b_ManualSparkCut6'. */
/begin CHARACTERISTIC OUTc_b_ManualSparkCut6 "Disable spark for cylinder 6" VALUE 0x8d292 RL_OUTC_B_MANUALSPARKCUT6 1.000000 CU_OUTC_B_MANUALSPARKCUT6 0.000000 1.000000 BYTE_ORDER MSB_FIRST /end CHARACTERISTIC
/begin RECORD_LAYOUT RL_OUTC_B_MANUALSPARKCUT6 FNC_VALUES 1 UBYTE COLUMN_DIR DIRECT /end RECORD_LAYOUT
/begin COMPU_METHOD CU_OUTC_B_MANUALSPARKCUT6 "Conversion method for OUTc_b_ManualSparkCut6" RAT_FUNC "%10.0" "b" COEFFS 0.000000 1.000000 0.000000 0.000000 0.000000 1.000000 /end COMPU_METHOD
/* Scalar calibration for DDE 'OUTc_b_ManualSparkCut7'. */
/begin CHARACTERISTIC OUTc_b_ManualSparkCut7 "Disable spark for cylinder 7" VALUE 0x8d293 RL_OUTC_B_MANUALSPARKCUT7 1.000000 CU_OUTC_B_MANUALSPARKCUT7 0.000000 1.000000 BYTE_ORDER MSB_FIRST /end CHARACTERISTIC
/begin RECORD_LAYOUT RL_OUTC_B_MANUALSPARKCUT7 FNC_VALUES 1 UBYTE COLUMN_DIR DIRECT /end RECORD_LAYOUT
/begin COMPU_METHOD CU_OUTC_B_MANUALSPARKCUT7 "Conversion method for OUTc_b_ManualSparkCut7" RAT_FUNC "%10.0" "b" COEFFS 0.000000 1.000000 0.000000 0.000000 0.000000 1.000000 /end COMPU_METHOD
/* Scalar calibration for DDE 'OUTc_b_ManualSparkCut8'. */
/begin CHARACTERISTIC OUTc_b_ManualSparkCut8 "Disable spark for cylinder 8" VALUE 0x8d294 RL_OUTC_B_MANUALSPARKCUT8 1.000000 CU_OUTC_B_MANUALSPARKCUT8 0.000000 1.000000 BYTE_ORDER MSB_FIRST /end CHARACTERISTIC
/begin RECORD_LAYOUT RL_OUTC_B_MANUALSPARKCUT8 FNC_VALUES 1 UBYTE COLUMN_DIR DIRECT /end RECORD_LAYOUT
/begin COMPU_METHOD CU_OUTC_B_MANUALSPARKCUT8 "Conversion method for OUTc_b_ManualSparkCut8" RAT_FUNC "%10.0" "b" COEFFS 0.000000 1.000000 0.000000 0.000000 0.000000 1.000000 /end COMPU_METHOD
/* Scalar calibration for DDE 'OUTc_b_PT_RelayEnergized'. */
/begin CHARACTERISTIC OUTc_b_PT_RelayEnergized "Override value" VALUE 0x8d296 RL_OUTC_B_PT_RELAYENERGIZED 1.000000 CU_OUTC_B_PT_RELAYENERGIZED 0.000000 1.000000 BYTE_ORDER MSB_FIRST /end CHARACTERISTIC
/begin RECORD_LAYOUT RL_OUTC_B_PT_RELAYENERGIZED FNC_VALUES 1 UBYTE COLUMN_DIR DIRECT /end RECORD_LAYOUT
/begin COMPU_METHOD CU_OUTC_B_PT_RELAYENERGIZED "Conversion method for OUTc_b_PT_RelayEnergized" RAT_FUNC "%10.0" "b" COEFFS 0.000000 1.000000 0.000000 0.000000 0.000000 1.000000 /end COMPU_METHOD
/* Scalar calibration for DDE 'OUTc_b_PowerRelayIgnoreSync'. */
/begin CHARACTERISTIC OUTc_b_PowerRelayIgnoreSync "Calibratable" VALUE 0x8d28e RL_OUTC_B_POWERRELAYIGNORESYNC 1.000000 CU_OUTC_B_POWERRELAYIGNORESYNC 0.000000 1.000000 BYTE_ORDER MSB_FIRST /end CHARACTERISTIC
/begin RECORD_LAYOUT RL_OUTC_B_POWERRELAYIGNORESYNC FNC_VALUES 1 UBYTE COLUMN_DIR DIRECT /end RECORD_LAYOUT
/begin COMPU_METHOD CU_OUTC_B_POWERRELAYIGNORESYNC "Conversion method for OUTc_b_PowerRelayIgnoreSync" RAT_FUNC "%10.0" "b" COEFFS 0.000000 1.000000 0.000000 0.000000 0.000000 1.000000 /end COMPU_METHOD
/* Scalar calibration for DDE 'OUTc_b_ResetFltBankA'. */
/begin CHARACTERISTIC OUTc_b_ResetFltBankA "Flag to reset any current trip present for the spark coil power source" VALUE 0x8d0ac RL_OUTC_B_RESETFLTBANKA 1.000000 CU_OUTC_B_RESETFLTBANKA 0.000000 1.000000 BYTE_ORDER MSB_FIRST /end CHARACTERISTIC
/begin RECORD_LAYOUT RL_OUTC_B_RESETFLTBANKA FNC_VALUES 1 UBYTE COLUMN_DIR DIRECT /end RECORD_LAYOUT
/begin COMPU_METHOD CU_OUTC_B_RESETFLTBANKA "Conversion method for OUTc_b_ResetFltBankA" RAT_FUNC "%10.0" "b" COEFFS 0.000000 1.000000 0.000000 0.000000 0.000000 1.000000 /end COMPU_METHOD
/* Scalar calibration for DDE 'OUTc_b_ResetFltBankB'. */
/begin CHARACTERISTIC OUTc_b_ResetFltBankB "Flag to reset any current trip present for the spark coil power source" VALUE 0x8d0ad RL_OUTC_B_RESETFLTBANKB 1.000000 CU_OUTC_B_RESETFLTBANKB 0.000000 1.000000 BYTE_ORDER MSB_FIRST /end CHARACTERISTIC
/begin RECORD_LAYOUT RL_OUTC_B_RESETFLTBANKB FNC_VALUES 1 UBYTE COLUMN_DIR DIRECT /end RECORD_LAYOUT
/begin COMPU_METHOD CU_OUTC_B_RESETFLTBANKB "Conversion method for OUTc_b_ResetFltBankB" RAT_FUNC "%10.0" "b" COEFFS 0.000000 1.000000 0.000000 0.000000 0.000000 1.000000 /end COMPU_METHOD
/* Scalar calibration for DDE 'OUTc_b_ResetHighsideTrip'. */
/begin CHARACTERISTIC OUTc_b_ResetHighsideTrip "Flag to reset highsides Y1+Y5 (must be held >350ms)" VALUE 0x8d0b5 RL_OUTC_B_RESETHIGHSIDETRIP 1.000000 CU_OUTC_B_RESETHIGHSIDETRIP 0.000000 1.000000 BYTE_ORDER MSB_FIRST /end CHARACTERISTIC
/begin RECORD_LAYOUT RL_OUTC_B_RESETHIGHSIDETRIP FNC_VALUES 1 UBYTE COLUMN_DIR DIRECT /end RECORD_LAYOUT
/begin COMPU_METHOD CU_OUTC_B_RESETHIGHSIDETRIP "Conversion method for OUTc_b_ResetHighsideTrip" RAT_FUNC "%10.0" "b" COEFFS 0.000000 1.000000 0.000000 0.000000 0.000000 1.000000 /end COMPU_METHOD
/* Scalar calibration for DDE 'OUTc_b_ResetOC_Trip'. */
/begin CHARACTERISTIC OUTc_b_ResetOC_Trip "Flag to reset any current trip present for non-current-limited outputs" VALUE 0x8d2af RL_OUTC_B_RESETOC_TRIP 1.000000 CU_OUTC_B_RESETOC_TRIP 0.000000 1.000000 BYTE_ORDER MSB_FIRST /end CHARACTERISTIC
/begin RECORD_LAYOUT RL_OUTC_B_RESETOC_TRIP FNC_VALUES 1 UBYTE COLUMN_DIR DIRECT /end RECORD_LAYOUT
/begin COMPU_METHOD CU_OUTC_B_RESETOC_TRIP "Conversion method for OUTc_b_ResetOC_Trip" RAT_FUNC "%10.0" "b" COEFFS 0.000000 1.000000 0.000000 0.000000 0.000000 1.000000 /end COMPU_METHOD
/* Scalar calibration for DDE 'OUTc_b_SpkEnIgnoreSync'. */
/begin CHARACTERISTIC OUTc_b_SpkEnIgnoreSync "If True, allow spark whether syncd or not." VALUE 0x8d282 RL_OUTC_B_SPKENIGNORESYNC 1.000000 CU_OUTC_B_SPKENIGNORESYNC 0.000000 1.000000 BYTE_ORDER MSB_FIRST /end CHARACTERISTIC
/begin RECORD_LAYOUT RL_OUTC_B_SPKENIGNORESYNC FNC_VALUES 1 UBYTE COLUMN_DIR DIRECT /end RECORD_LAYOUT
/begin COMPU_METHOD CU_OUTC_B_SPKENIGNORESYNC "Conversion method for OUTc_b_SpkEnIgnoreSync" RAT_FUNC "%10.0" "b" COEFFS 0.000000 1.000000 0.000000 0.000000 0.000000 1.000000 /end COMPU_METHOD
/* Scalar calibration for DDE 'OUTc_b_TCO'. */
/begin CHARACTERISTIC OUTc_b_TCO "Enable TCO" VALUE 0x8bdea RL_OUTC_B_TCO 1.000000 CU_OUTC_B_TCO 0.000000 1.000000 BYTE_ORDER MSB_FIRST /end CHARACTERISTIC
/begin RECORD_LAYOUT RL_OUTC_B_TCO FNC_VALUES 1 UBYTE COLUMN_DIR DIRECT /end RECORD_LAYOUT
/begin COMPU_METHOD CU_OUTC_B_TCO "Conversion method for OUTc_b_TCO" RAT_FUNC "%10.0" "NU" COEFFS 0.000000 1.000000 0.000000 0.000000 0.000000 1.000000 /end COMPU_METHOD
/* Scalar calibration for DDE 'OUTc_b_TCO_ena'. */
/begin CHARACTERISTIC OUTc_b_TCO_ena "Override TCO" VALUE 0x8bde9 RL_OUTC_B_TCO_ENA 1.000000 CU_OUTC_B_TCO_ENA 0.000000 1.000000 BYTE_ORDER MSB_FIRST /end CHARACTERISTIC
/begin RECORD_LAYOUT RL_OUTC_B_TCO_ENA FNC_VALUES 1 UBYTE COLUMN_DIR DIRECT /end RECORD_LAYOUT
/begin COMPU_METHOD CU_OUTC_B_TCO_ENA "Conversion method for OUTc_b_TCO_ena" RAT_FUNC "%10.0" "NU" COEFFS 0.000000 1.000000 0.000000 0.000000 0.000000 1.000000 /end COMPU_METHOD
/* Scalar calibration for DDE 'OUTc_b_VISCO_1st'. */
/begin CHARACTERISTIC OUTc_b_VISCO_1st "(not defined)" VALUE 0x8d0f9 RL_OUTC_B_VISCO_1ST 1.000000 CU_OUTC_B_VISCO_1ST 0.000000 1.000000 BYTE_ORDER MSB_FIRST /end CHARACTERISTIC
/begin RECORD_LAYOUT RL_OUTC_B_VISCO_1ST FNC_VALUES 1 UBYTE COLUMN_DIR DIRECT /end RECORD_LAYOUT
/begin COMPU_METHOD CU_OUTC_B_VISCO_1ST "Conversion method for OUTc_b_VISCO_1st" RAT_FUNC "%10.0" "b" COEFFS 0.000000 1.000000 0.000000 0.000000 0.000000 1.000000 /end COMPU_METHOD
/* Scalar calibration for DDE 'OUTc_b_VISCO_2nd'. */
/begin CHARACTERISTIC OUTc_b_VISCO_2nd "(not defined)" VALUE 0x8d0fb RL_OUTC_B_VISCO_2ND 1.000000 CU_OUTC_B_VISCO_2ND 0.000000 1.000000 BYTE_ORDER MSB_FIRST /end CHARACTERISTIC
/begin RECORD_LAYOUT RL_OUTC_B_VISCO_2ND FNC_VALUES 1 UBYTE COLUMN_DIR DIRECT /end RECORD_LAYOUT
/begin COMPU_METHOD CU_OUTC_B_VISCO_2ND "Conversion method for OUTc_b_VISCO_2nd" RAT_FUNC "%10.0" "b" COEFFS 0.000000 1.000000 0.000000 0.000000 0.000000 1.000000 /end COMPU_METHOD
/* Scalar calibration for DDE 'OUTc_b_VRefA_Enbl'. */
/begin CHARACTERISTIC OUTc_b_VRefA_Enbl "5V supply en" VALUE 0x8d0b6 RL_OUTC_B_VREFA_ENBL 1.000000 CU_OUTC_B_VREFA_ENBL 0.000000 1.000000 BYTE_ORDER MSB_FIRST /end CHARACTERISTIC
/begin RECORD_LAYOUT RL_OUTC_B_VREFA_ENBL FNC_VALUES 1 UBYTE COLUMN_DIR DIRECT /end RECORD_LAYOUT
/begin COMPU_METHOD CU_OUTC_B_VREFA_ENBL "Conversion method for OUTc_b_VRefA_Enbl" RAT_FUNC "%10.0" "b" COEFFS 0.000000 1.000000 0.000000 0.000000 0.000000 1.000000 /end COMPU_METHOD
/* Scalar calibration for DDE 'OUTc_b_VRefB_Enbl'. */
/begin CHARACTERISTIC OUTc_b_VRefB_Enbl "5V supply en" VALUE 0x8d0b7 RL_OUTC_B_VREFB_ENBL 1.000000 CU_OUTC_B_VREFB_ENBL 0.000000 1.000000 BYTE_ORDER MSB_FIRST /end CHARACTERISTIC
/begin RECORD_LAYOUT RL_OUTC_B_VREFB_ENBL FNC_VALUES 1 UBYTE COLUMN_DIR DIRECT /end RECORD_LAYOUT
/begin COMPU_METHOD CU_OUTC_B_VREFB_ENBL "Conversion method for OUTc_b_VRefB_Enbl" RAT_FUNC "%10.0" "b" COEFFS 0.000000 1.000000 0.000000 0.000000 0.000000 1.000000 /end COMPU_METHOD
/* Scalar calibration for DDE 'OUTc_b_VRefC_Enbl'. */
/begin CHARACTERISTIC OUTc_b_VRefC_Enbl "5V supply en" VALUE 0x8d0b8 RL_OUTC_B_VREFC_ENBL 1.000000 CU_OUTC_B_VREFC_ENBL 0.000000 1.000000 BYTE_ORDER MSB_FIRST /end CHARACTERISTIC
/begin RECORD_LAYOUT RL_OUTC_B_VREFC_ENBL FNC_VALUES 1 UBYTE COLUMN_DIR DIRECT /end RECORD_LAYOUT
/begin COMPU_METHOD CU_OUTC_B_VREFC_ENBL "Conversion method for OUTc_b_VRefC_Enbl" RAT_FUNC "%10.0" "b" COEFFS 0.000000 1.000000 0.000000 0.000000 0.000000 1.000000 /end COMPU_METHOD
/* Scalar calibration for DDE 'OUTc_b_VRefD_Enbl'. */
/begin CHARACTERISTIC OUTc_b_VRefD_Enbl "5V supply en" VALUE 0x8d0b9 RL_OUTC_B_VREFD_ENBL 1.000000 CU_OUTC_B_VREFD_ENBL 0.000000 1.000000 BYTE_ORDER MSB_FIRST /end CHARACTERISTIC
/begin RECORD_LAYOUT RL_OUTC_B_VREFD_ENBL FNC_VALUES 1 UBYTE COLUMN_DIR DIRECT /end RECORD_LAYOUT
/begin COMPU_METHOD CU_OUTC_B_VREFD_ENBL "Conversion method for OUTc_b_VRefD_Enbl" RAT_FUNC "%10.0" "b" COEFFS 0.000000 1.000000 0.000000 0.000000 0.000000 1.000000 /end COMPU_METHOD
/* Scalar calibration for DDE 'OUTc_b_VentiladorZF'. */
/begin CHARACTERISTIC OUTc_b_VentiladorZF "ZF Fan" VALUE 0x83440 RL_OUTC_B_VENTILADORZF 1.000000 CU_OUTC_B_VENTILADORZF 0.000000 1.000000 BYTE_ORDER MSB_FIRST /end CHARACTERISTIC
/begin RECORD_LAYOUT RL_OUTC_B_VENTILADORZF FNC_VALUES 1 UBYTE COLUMN_DIR DIRECT /end RECORD_LAYOUT
/begin COMPU_METHOD CU_OUTC_B_VENTILADORZF "Conversion method for OUTc_b_VentiladorZF" RAT_FUNC "%10.0" "b" COEFFS 0.000000 1.000000 0.000000 0.000000 0.000000 1.000000 /end COMPU_METHOD
/* Scalar calibration for DDE 'OUTc_km_Totaldistance'. */
/begin CHARACTERISTIC OUTc_km_Totaldistance "Total Distance km" VALUE 0x8bdfc RL_OUTC_KM_TOTALDISTANCE 1000000.000000 CU_OUTC_KM_TOTALDISTANCE 0.000000 1000000.000000 BYTE_ORDER MSB_FIRST /end CHARACTERISTIC
/begin RECORD_LAYOUT RL_OUTC_KM_TOTALDISTANCE FNC_VALUES 1 FLOAT32_IEEE COLUMN_DIR DIRECT /end RECORD_LAYOUT
/begin COMPU_METHOD CU_OUTC_KM_TOTALDISTANCE "Conversion method for OUTc_km_Totaldistance" RAT_FUNC "%10.0" "km" COEFFS 0.000000 1.000000 0.000000 0.000000 0.000000 1.000000 /end COMPU_METHOD
/* Scalar calibration for DDE 'OUTc_o_18F00000_ena'. */
/begin CHARACTERISTIC OUTc_o_18F00000_ena "Override enable ERC1 msg @ 250ms" VALUE 0x8bdee RL_OUTC_O_18F00000_ENA 1.000000 CU_OUTC_O_18F00000_ENA 0.000000 1.000000 BYTE_ORDER MSB_FIRST /end CHARACTERISTIC
/begin RECORD_LAYOUT RL_OUTC_O_18F00000_ENA FNC_VALUES 1 UBYTE COLUMN_DIR DIRECT /end RECORD_LAYOUT
/begin COMPU_METHOD CU_OUTC_O_18F00000_ENA "Conversion method for OUTc_o_18F00000_ena" RAT_FUNC "%10.0" "NU" COEFFS 0.000000 1.000000 0.000000 0.000000 0.000000 1.000000 /end COMPU_METHOD
/* Scalar calibration for DDE 'OUTc_o_18F0010B_ena'. */
/begin CHARACTERISTIC OUTc_o_18F0010B_ena "Override enable EBC1 msg" VALUE 0x8bdc8 RL_OUTC_O_18F0010B_ENA 1.000000 CU_OUTC_O_18F0010B_ENA 0.000000 1.000000 BYTE_ORDER MSB_FIRST /end CHARACTERISTIC
/begin RECORD_LAYOUT RL_OUTC_O_18F0010B_ENA FNC_VALUES 1 UBYTE COLUMN_DIR DIRECT /end RECORD_LAYOUT
/begin COMPU_METHOD CU_OUTC_O_18F0010B_ENA "Conversion method for OUTc_o_18F0010B_ena" RAT_FUNC "%10.0" "NU" COEFFS 0.000000 1.000000 0.000000 0.000000 0.000000 1.000000 /end COMPU_METHOD
/* Scalar calibration for DDE 'OUTc_o_18FDC40B_ena'. */
/begin CHARACTERISTIC OUTc_o_18FDC40B_ena "Override enable EBC5 msg @ 100ms" VALUE 0x8bdcb RL_OUTC_O_18FDC40B_ENA 1.000000 CU_OUTC_O_18FDC40B_ENA 0.000000 1.000000 BYTE_ORDER MSB_FIRST /end CHARACTERISTIC
/begin RECORD_LAYOUT RL_OUTC_O_18FDC40B_ENA FNC_VALUES 1 UBYTE COLUMN_DIR DIRECT /end RECORD_LAYOUT
/begin COMPU_METHOD CU_OUTC_O_18FDC40B_ENA "Conversion method for OUTc_o_18FDC40B_ena" RAT_FUNC "%10.0" "NU" COEFFS 0.000000 1.000000 0.000000 0.000000 0.000000 1.000000 /end COMPU_METHOD
/* Scalar calibration for DDE 'OUTc_o_18FE6E00_ena'. */
/begin CHARACTERISTIC OUTc_o_18FE6E00_ena "Override value of HRW msg @ 20ms" VALUE 0x8bddc RL_OUTC_O_18FE6E00_ENA 1.000000 CU_OUTC_O_18FE6E00_ENA 0.000000 1.000000 BYTE_ORDER MSB_FIRST /end CHARACTERISTIC
/begin RECORD_LAYOUT RL_OUTC_O_18FE6E00_ENA FNC_VALUES 1 UBYTE COLUMN_DIR DIRECT /end RECORD_LAYOUT
/begin COMPU_METHOD CU_OUTC_O_18FE6E00_ENA "Conversion method for OUTc_o_18FE6E00_ena" RAT_FUNC "%10.0" "NU" COEFFS 0.000000 1.000000 0.000000 0.000000 0.000000 1.000000 /end COMPU_METHOD
/* Scalar calibration for DDE 'OUTc_o_18FEE100_ena'. */
/begin CHARACTERISTIC OUTc_o_18FEE100_ena "Override FEE1 msg @ 250ms" VALUE 0x8bdf1 RL_OUTC_O_18FEE100_ENA 1.000000 CU_OUTC_O_18FEE100_ENA 0.000000 1.000000 BYTE_ORDER MSB_FIRST /end CHARACTERISTIC
/begin RECORD_LAYOUT RL_OUTC_O_18FEE100_ENA FNC_VALUES 1 UBYTE COLUMN_DIR DIRECT /end RECORD_LAYOUT
/begin COMPU_METHOD CU_OUTC_O_18FEE100_ENA "Conversion method for OUTc_o_18FEE100_ena" RAT_FUNC "%10.0" "NU" COEFFS 0.000000 1.000000 0.000000 0.000000 0.000000 1.000000 /end COMPU_METHOD
/* Scalar calibration for DDE 'OUTc_o_18FEE600_ena'. */
/begin CHARACTERISTIC OUTc_o_18FEE600_ena "Override FEE6 msg @ 1000ms" VALUE 0x8bdeb RL_OUTC_O_18FEE600_ENA 1.000000 CU_OUTC_O_18FEE600_ENA 0.000000 1.000000 BYTE_ORDER MSB_FIRST /end CHARACTERISTIC
/begin RECORD_LAYOUT RL_OUTC_O_18FEE600_ENA FNC_VALUES 1 UBYTE COLUMN_DIR DIRECT /end RECORD_LAYOUT
/begin COMPU_METHOD CU_OUTC_O_18FEE600_ENA "Conversion method for OUTc_o_18FEE600_ena" RAT_FUNC "%10.0" "NU" COEFFS 0.000000 1.000000 0.000000 0.000000 0.000000 1.000000 /end COMPU_METHOD
/* Scalar calibration for DDE 'OUTc_o_18FEEE00_ena'. */
/begin CHARACTERISTIC OUTc_o_18FEEE00_ena "Override FEEE msg @ 1000ms" VALUE 0x8bdce RL_OUTC_O_18FEEE00_ENA 1.000000 CU_OUTC_O_18FEEE00_ENA 0.000000 1.000000 BYTE_ORDER MSB_FIRST /end CHARACTERISTIC
/begin RECORD_LAYOUT RL_OUTC_O_18FEEE00_ENA FNC_VALUES 1 UBYTE COLUMN_DIR DIRECT /end RECORD_LAYOUT
/begin COMPU_METHOD CU_OUTC_O_18FEEE00_ENA "Conversion method for OUTc_o_18FEEE00_ena" RAT_FUNC "%10.0" "NU" COEFFS 0.000000 1.000000 0.000000 0.000000 0.000000 1.000000 /end COMPU_METHOD
/* Scalar calibration for DDE 'OUTc_o_BCM_ZF_ena'. */
/begin CHARACTERISTIC OUTc_o_BCM_ZF_ena "Override value of BCM" VALUE 0x8bd8e RL_OUTC_O_BCM_ZF_ENA 1.000000 CU_OUTC_O_BCM_ZF_ENA 0.000000 1.000000 BYTE_ORDER MSB_FIRST /end CHARACTERISTIC
/begin RECORD_LAYOUT RL_OUTC_O_BCM_ZF_ENA FNC_VALUES 1 UBYTE COLUMN_DIR DIRECT /end RECORD_LAYOUT
/begin COMPU_METHOD CU_OUTC_O_BCM_ZF_ENA "Conversion method for OUTc_o_BCM_ZF_ena" RAT_FUNC "%10.0" "NU" COEFFS 0.000000 1.000000 0.000000 0.000000 0.000000 1.000000 /end COMPU_METHOD
/* Scalar calibration for DDE 'OUTc_o_BCM_ena'. */
/begin CHARACTERISTIC OUTc_o_BCM_ena "Override value of BCM" VALUE 0x8bd8b RL_OUTC_O_BCM_ENA 1.000000 CU_OUTC_O_BCM_ENA 0.000000 1.000000 BYTE_ORDER MSB_FIRST /end CHARACTERISTIC
/begin RECORD_LAYOUT RL_OUTC_O_BCM_ENA FNC_VALUES 1 UBYTE COLUMN_DIR DIRECT /end RECORD_LAYOUT
/begin COMPU_METHOD CU_OUTC_O_BCM_ENA "Conversion method for OUTc_o_BCM_ena" RAT_FUNC "%10.0" "NU" COEFFS 0.000000 1.000000 0.000000 0.000000 0.000000 1.000000 /end COMPU_METHOD
/* Scalar calibration for DDE 'OUTc_o_CombustionAllCyls'. */
/begin CHARACTERISTIC OUTc_o_CombustionAllCyls "Override flag" VALUE 0x8d297 RL_OUTC_O_COMBUSTIONALLCYLS 1.000000 CU_OUTC_O_COMBUSTIONALLCYLS 0.000000 1.000000 BYTE_ORDER MSB_FIRST /end CHARACTERISTIC
/begin RECORD_LAYOUT RL_OUTC_O_COMBUSTIONALLCYLS FNC_VALUES 1 UBYTE COLUMN_DIR DIRECT /end RECORD_LAYOUT
/begin COMPU_METHOD CU_OUTC_O_COMBUSTIONALLCYLS "Conversion method for OUTc_o_CombustionAllCyls" RAT_FUNC "%10.0" "o" COEFFS 0.000000 1.000000 0.000000 0.000000 0.000000 1.000000 /end COMPU_METHOD
/* Scalar calibration for DDE 'OUTc_o_DM19CVN'. */
/begin CHARACTERISTIC OUTc_o_DM19CVN "shutoff valve frequency" VALUE 0x80400 RL_OUTC_O_DM19CVN 1.000000 CU_OUTC_O_DM19CVN 0.000000 1.000000 BYTE_ORDER MSB_FIRST /end CHARACTERISTIC
/begin RECORD_LAYOUT RL_OUTC_O_DM19CVN FNC_VALUES 1 UBYTE COLUMN_DIR DIRECT /end RECORD_LAYOUT
/begin COMPU_METHOD CU_OUTC_O_DM19CVN "Conversion method for OUTc_o_DM19CVN" RAT_FUNC "%10.0" "NU" COEFFS 0.000000 1.000000 0.000000 0.000000 0.000000 1.000000 /end COMPU_METHOD
/* Scalar calibration for DDE 'OUTc_o_DM19Request'. */
/begin CHARACTERISTIC OUTc_o_DM19Request "ZF Fan" VALUE 0x80408 RL_OUTC_O_DM19REQUEST 1.000000 CU_OUTC_O_DM19REQUEST 0.000000 1.000000 BYTE_ORDER MSB_FIRST /end CHARACTERISTIC
/begin RECORD_LAYOUT RL_OUTC_O_DM19REQUEST FNC_VALUES 1 UBYTE COLUMN_DIR DIRECT /end RECORD_LAYOUT
/begin COMPU_METHOD CU_OUTC_O_DM19REQUEST "Conversion method for OUTc_o_DM19Request" RAT_FUNC "%10.0" "b" COEFFS 0.000000 1.000000 0.000000 0.000000 0.000000 1.000000 /end COMPU_METHOD
/* Scalar calibration for DDE 'OUTc_o_EngSpd'. */
/begin CHARACTERISTIC OUTc_o_EngSpd "(not defined)" VALUE 0x8d250 RL_OUTC_O_ENGSPD 1.000000 CU_OUTC_O_ENGSPD 0.000000 1.000000 BYTE_ORDER MSB_FIRST /end CHARACTERISTIC
/begin RECORD_LAYOUT RL_OUTC_O_ENGSPD FNC_VALUES 1 UBYTE COLUMN_DIR DIRECT /end RECORD_LAYOUT
/begin COMPU_METHOD CU_OUTC_O_ENGSPD "Conversion method for OUTc_o_EngSpd" RAT_FUNC "%10.0" "o" COEFFS 0.000000 1.000000 0.000000 0.000000 0.000000 1.000000 /end COMPU_METHOD
/* Scalar calibration for DDE 'OUTc_o_FAN_ZF'. */
/begin CHARACTERISTIC OUTc_o_FAN_ZF "Override flag" VALUE 0x83430 RL_OUTC_O_FAN_ZF 1.000000 CU_OUTC_O_FAN_ZF 0.000000 1.000000 BYTE_ORDER MSB_FIRST /end CHARACTERISTIC
/begin RECORD_LAYOUT RL_OUTC_O_FAN_ZF FNC_VALUES 1 UBYTE COLUMN_DIR DIRECT /end RECORD_LAYOUT
/begin COMPU_METHOD CU_OUTC_O_FAN_ZF "Conversion method for OUTc_o_FAN_ZF" RAT_FUNC "%10.0" "o" COEFFS 0.000000 1.000000 0.000000 0.000000 0.000000 1.000000 /end COMPU_METHOD
/* Scalar calibration for DDE 'OUTc_o_FreqUEGOA'. */
/begin CHARACTERISTIC OUTc_o_FreqUEGOA "Override flag" VALUE 0x8c33c RL_OUTC_O_FREQUEGOA 1.000000 CU_OUTC_O_FREQUEGOA 0.000000 1.000000 BYTE_ORDER MSB_FIRST /end CHARACTERISTIC
/begin RECORD_LAYOUT RL_OUTC_O_FREQUEGOA FNC_VALUES 1 UBYTE COLUMN_DIR DIRECT /end RECORD_LAYOUT
/begin COMPU_METHOD CU_OUTC_O_FREQUEGOA "Conversion method for OUTc_o_FreqUEGOA" RAT_FUNC "%10.0" "o" COEFFS 0.000000 1.000000 0.000000 0.000000 0.000000 1.000000 /end COMPU_METHOD
/* Scalar calibration for DDE 'OUTc_o_MIL_LED'. */
/begin CHARACTERISTIC OUTc_o_MIL_LED "MIL Led" VALUE 0x8ce71 RL_OUTC_O_MIL_LED 1.000000 CU_OUTC_O_MIL_LED 0.000000 1.000000 BYTE_ORDER MSB_FIRST /end CHARACTERISTIC
/begin RECORD_LAYOUT RL_OUTC_O_MIL_LED FNC_VALUES 1 UBYTE COLUMN_DIR DIRECT /end RECORD_LAYOUT
/begin COMPU_METHOD CU_OUTC_O_MIL_LED "Conversion method for OUTc_o_MIL_LED" RAT_FUNC "%10.0" "b" COEFFS 0.000000 1.000000 0.000000 0.000000 0.000000 1.000000 /end COMPU_METHOD
/* Scalar calibration for DDE 'OUTc_o_PT_RelayEnergized'. */
/begin CHARACTERISTIC OUTc_o_PT_RelayEnergized "Override flag" VALUE 0x8d295 RL_OUTC_O_PT_RELAYENERGIZED 1.000000 CU_OUTC_O_PT_RELAYENERGIZED 0.000000 1.000000 BYTE_ORDER MSB_FIRST /end CHARACTERISTIC
/begin RECORD_LAYOUT RL_OUTC_O_PT_RELAYENERGIZED FNC_VALUES 1 UBYTE COLUMN_DIR DIRECT /end RECORD_LAYOUT
/begin COMPU_METHOD CU_OUTC_O_PT_RELAYENERGIZED "Conversion method for OUTc_o_PT_RelayEnergized" RAT_FUNC "%10.0" "o" COEFFS 0.000000 1.000000 0.000000 0.000000 0.000000 1.000000 /end COMPU_METHOD
/* Scalar calibration for DDE 'OUTc_o_TCO_ena'. */
/begin CHARACTERISTIC OUTc_o_TCO_ena "Override value of TCO" VALUE 0x8bde8 RL_OUTC_O_TCO_ENA 1.000000 CU_OUTC_O_TCO_ENA 0.000000 1.000000 BYTE_ORDER MSB_FIRST /end CHARACTERISTIC
/begin RECORD_LAYOUT RL_OUTC_O_TCO_ENA FNC_VALUES 1 UBYTE COLUMN_DIR DIRECT /end RECORD_LAYOUT
/begin COMPU_METHOD CU_OUTC_O_TCO_ENA "Conversion method for OUTc_o_TCO_ena" RAT_FUNC "%10.0" "NU" COEFFS 0.000000 1.000000 0.000000 0.000000 0.000000 1.000000 /end COMPU_METHOD
/* Scalar calibration for DDE 'OUTc_o_UEGO_HTR_DC_A'. */
/begin CHARACTERISTIC OUTc_o_UEGO_HTR_DC_A "UEGO HTR DC value override" VALUE 0x8d2a8 RL_OUTC_O_UEGO_HTR_DC_A 1.000000 CU_OUTC_O_UEGO_HTR_DC_A 0.000000 1.000000 BYTE_ORDER MSB_FIRST /end CHARACTERISTIC
/begin RECORD_LAYOUT RL_OUTC_O_UEGO_HTR_DC_A FNC_VALUES 1 UBYTE COLUMN_DIR DIRECT /end RECORD_LAYOUT
/begin COMPU_METHOD CU_OUTC_O_UEGO_HTR_DC_A "Conversion method for OUTc_o_UEGO_HTR_DC_A" RAT_FUNC "%10.0" "o" COEFFS 0.000000 1.000000 0.000000 0.000000 0.000000 1.000000 /end COMPU_METHOD
/* Scalar calibration for DDE 'OUTc_o_VISCO_1st'. */
/begin CHARACTERISTIC OUTc_o_VISCO_1st "(not defined)" VALUE 0x8d0f8 RL_OUTC_O_VISCO_1ST 1.000000 CU_OUTC_O_VISCO_1ST 0.000000 1.000000 BYTE_ORDER MSB_FIRST /end CHARACTERISTIC
/begin RECORD_LAYOUT RL_OUTC_O_VISCO_1ST FNC_VALUES 1 UBYTE COLUMN_DIR DIRECT /end RECORD_LAYOUT
/begin COMPU_METHOD CU_OUTC_O_VISCO_1ST "Conversion method for OUTc_o_VISCO_1st" RAT_FUNC "%10.0" "o" COEFFS 0.000000 1.000000 0.000000 0.000000 0.000000 1.000000 /end COMPU_METHOD
/* Scalar calibration for DDE 'OUTc_o_VISCO_2nd'. */
/begin CHARACTERISTIC OUTc_o_VISCO_2nd "(not defined)" VALUE 0x8d0fa RL_OUTC_O_VISCO_2ND 1.000000 CU_OUTC_O_VISCO_2ND 0.000000 1.000000 BYTE_ORDER MSB_FIRST /end CHARACTERISTIC
/begin RECORD_LAYOUT RL_OUTC_O_VISCO_2ND FNC_VALUES 1 UBYTE COLUMN_DIR DIRECT /end RECORD_LAYOUT
/begin COMPU_METHOD CU_OUTC_O_VISCO_2ND "Conversion method for OUTc_o_VISCO_2nd" RAT_FUNC "%10.0" "o" COEFFS 0.000000 1.000000 0.000000 0.000000 0.000000 1.000000 /end COMPU_METHOD
/* Scalar calibration for DDE 'OUTc_o_VentiladorZF'. */
/begin CHARACTERISTIC OUTc_o_VentiladorZF "ZF Fan" VALUE 0x8bea0 RL_OUTC_O_VENTILADORZF 1.000000 CU_OUTC_O_VENTILADORZF 0.000000 1.000000 BYTE_ORDER MSB_FIRST /end CHARACTERISTIC
/begin RECORD_LAYOUT RL_OUTC_O_VENTILADORZF FNC_VALUES 1 UBYTE COLUMN_DIR DIRECT /end RECORD_LAYOUT
/begin COMPU_METHOD CU_OUTC_O_VENTILADORZF "Conversion method for OUTc_o_VentiladorZF" RAT_FUNC "%10.0" "b" COEFFS 0.000000 1.000000 0.000000 0.000000 0.000000 1.000000 /end COMPU_METHOD
/* Scalar calibration for DDE 'OUTc_o_VhSpd'. */
/begin CHARACTERISTIC OUTc_o_VhSpd "(not defined)" VALUE 0x8d1a0 RL_OUTC_O_VHSPD 1.000000 CU_OUTC_O_VHSPD 0.000000 1.000000 BYTE_ORDER MSB_FIRST /end CHARACTERISTIC
/begin RECORD_LAYOUT RL_OUTC_O_VHSPD FNC_VALUES 1 UBYTE COLUMN_DIR DIRECT /end RECORD_LAYOUT
/begin COMPU_METHOD CU_OUTC_O_VHSPD "Conversion method for OUTc_o_VhSpd" RAT_FUNC "%10.0" "o" COEFFS 0.000000 1.000000 0.000000 0.000000 0.000000 1.000000 /end COMPU_METHOD
/* Scalar calibration for DDE 'OUTc_pct_ActvLoadPumpThrs'. */
/begin CHARACTERISTIC OUTc_pct_ActvLoadPumpThrs "Engine load threshold for pump PWM" VALUE 0x8d25c RL_OUTC_PCT_ACTVLOADPUMPTHRS 5.000000 CU_OUTC_PCT_ACTVLOADPUMPTHRS 0.000000 5.000000 BYTE_ORDER MSB_FIRST /end CHARACTERISTIC
/begin RECORD_LAYOUT RL_OUTC_PCT_ACTVLOADPUMPTHRS FNC_VALUES 1 FLOAT32_IEEE COLUMN_DIR DIRECT /end RECORD_LAYOUT
/begin COMPU_METHOD CU_OUTC_PCT_ACTVLOADPUMPTHRS "Conversion method for OUTc_pct_ActvLoadPumpThrs" RAT_FUNC "%10.3" "pct" COEFFS 0.000000 1.000000 0.000000 0.000000 0.000000 1.000000 /end COMPU_METHOD
/* Scalar calibration for DDE 'OUTc_pct_DC_StepsUEGOA'. */
/begin CHARACTERISTIC OUTc_pct_DC_StepsUEGOA "24V warmup" VALUE 0x8c2ec RL_OUTC_PCT_DC_STEPSUEGOA 10000.000000 CU_OUTC_PCT_DC_STEPSUEGOA 0.000000 10000.000000 BYTE_ORDER MSB_FIRST /end CHARACTERISTIC
/begin RECORD_LAYOUT RL_OUTC_PCT_DC_STEPSUEGOA FNC_VALUES 1 FLOAT32_IEEE COLUMN_DIR DIRECT /end RECORD_LAYOUT
/begin COMPU_METHOD CU_OUTC_PCT_DC_STEPSUEGOA "Conversion method for OUTc_pct_DC_StepsUEGOA" RAT_FUNC "%10.3" "pct" COEFFS 0.000000 1.000000 0.000000 0.000000 0.000000 1.000000 /end COMPU_METHOD
/* Scalar calibration for DDE 'OUTc_pct_DC_UEGO_A'. */
/begin CHARACTERISTIC OUTc_pct_DC_UEGO_A "24V warmup" VALUE 0x8d500 RL_OUTC_PCT_DC_UEGO_A 10000.000000 CU_OUTC_PCT_DC_UEGO_A 0.000000 10000.000000 BYTE_ORDER MSB_FIRST /end CHARACTERISTIC
/begin RECORD_LAYOUT RL_OUTC_PCT_DC_UEGO_A FNC_VALUES 1 FLOAT32_IEEE COLUMN_DIR DIRECT /end RECORD_LAYOUT
/begin COMPU_METHOD CU_OUTC_PCT_DC_UEGO_A "Conversion method for OUTc_pct_DC_UEGO_A" RAT_FUNC "%10.3" "pct" COEFFS 0.000000 1.000000 0.000000 0.000000 0.000000 1.000000 /end COMPU_METHOD
/* Scalar calibration for DDE 'OUTc_pct_DeactvLoadPumpThrs'. */
/begin CHARACTERISTIC OUTc_pct_DeactvLoadPumpThrs "Engine load threshold for pump PWM" VALUE 0x8d260 RL_OUTC_PCT_DEACTVLOADPUMPTHRS 5.000000 CU_OUTC_PCT_DEACTVLOADPUMPTHRS 0.000000 5.000000 BYTE_ORDER MSB_FIRST /end CHARACTERISTIC
/begin RECORD_LAYOUT RL_OUTC_PCT_DEACTVLOADPUMPTHRS FNC_VALUES 1 FLOAT32_IEEE COLUMN_DIR DIRECT /end RECORD_LAYOUT
/begin COMPU_METHOD CU_OUTC_PCT_DEACTVLOADPUMPTHRS "Conversion method for OUTc_pct_DeactvLoadPumpThrs" RAT_FUNC "%10.3" "pct" COEFFS 0.000000 1.000000 0.000000 0.000000 0.000000 1.000000 /end COMPU_METHOD
/* Scalar calibration for DDE 'OUTc_pct_EngSpd_Fq'. */
/begin CHARACTERISTIC OUTc_pct_EngSpd_Fq "R" VALUE 0x8d258 RL_OUTC_PCT_ENGSPD_FQ 1.000000 CU_OUTC_PCT_ENGSPD_FQ 0.000000 1.000000 BYTE_ORDER MSB_FIRST /end CHARACTERISTIC
/begin RECORD_LAYOUT RL_OUTC_PCT_ENGSPD_FQ FNC_VALUES 1 FLOAT32_IEEE COLUMN_DIR DIRECT /end RECORD_LAYOUT
/begin COMPU_METHOD CU_OUTC_PCT_ENGSPD_FQ "Conversion method for OUTc_pct_EngSpd_Fq" RAT_FUNC "%10.2" "pct" COEFFS 0.000000 1.000000 0.000000 0.000000 0.000000 1.000000 /end COMPU_METHOD
/* Scalar calibration for DDE 'OUTc_pct_FuelMinLevel'. */
/begin CHARACTERISTIC OUTc_pct_FuelMinLevel "Minimum fuel level for the pump to get fuel" VALUE 0x8d0d0 RL_OUTC_PCT_FUELMINLEVEL 100.000000 CU_OUTC_PCT_FUELMINLEVEL 0.000000 100.000000 BYTE_ORDER MSB_FIRST /end CHARACTERISTIC
/begin RECORD_LAYOUT RL_OUTC_PCT_FUELMINLEVEL FNC_VALUES 1 FLOAT32_IEEE COLUMN_DIR DIRECT /end RECORD_LAYOUT
/begin COMPU_METHOD CU_OUTC_PCT_FUELMINLEVEL "Conversion method for OUTc_pct_FuelMinLevel" RAT_FUNC "%10.3" "pct" COEFFS 0.000000 1.000000 0.000000 0.000000 0.000000 1.000000 /end COMPU_METHOD
/* Scalar calibration for DDE 'OUTc_pct_FuelReserve_1Tank'. */
/begin CHARACTERISTIC OUTc_pct_FuelReserve_1Tank "Fuel Level value (%) for the reserve with 1 tanks" VALUE 0x8bdac RL_OUTC_PCT_FUELRESERVE_1TANK 100.000000 CU_OUTC_PCT_FUELRESERVE_1TANK 0.000000 100.000000 BYTE_ORDER MSB_FIRST /end CHARACTERISTIC
/begin RECORD_LAYOUT RL_OUTC_PCT_FUELRESERVE_1TANK FNC_VALUES 1 FLOAT32_IEEE COLUMN_DIR DIRECT /end RECORD_LAYOUT
/begin COMPU_METHOD CU_OUTC_PCT_FUELRESERVE_1TANK "Conversion method for OUTc_pct_FuelReserve_1Tank" RAT_FUNC "%10.3" "pct" COEFFS 0.000000 1.000000 0.000000 0.000000 0.000000 1.000000 /end COMPU_METHOD
/* Scalar calibration for DDE 'OUTc_pct_FuelReserve_2Tank'. */
/begin CHARACTERISTIC OUTc_pct_FuelReserve_2Tank "Fuel Level value (%) for the reserve with 2 tanks" VALUE 0x8bda8 RL_OUTC_PCT_FUELRESERVE_2TANK 100.000000 CU_OUTC_PCT_FUELRESERVE_2TANK 0.000000 100.000000 BYTE_ORDER MSB_FIRST /end CHARACTERISTIC
/begin RECORD_LAYOUT RL_OUTC_PCT_FUELRESERVE_2TANK FNC_VALUES 1 FLOAT32_IEEE COLUMN_DIR DIRECT /end RECORD_LAYOUT
/begin COMPU_METHOD CU_OUTC_PCT_FUELRESERVE_2TANK "Conversion method for OUTc_pct_FuelReserve_2Tank" RAT_FUNC "%10.3" "pct" COEFFS 0.000000 1.000000 0.000000 0.000000 0.000000 1.000000 /end COMPU_METHOD
/* Scalar calibration for DDE 'OUTc_pct_HiThrshUEGOA'. */
/begin CHARACTERISTIC OUTc_pct_HiThrshUEGOA "24V warmup" VALUE 0x8c2f8 RL_OUTC_PCT_HITHRSHUEGOA 10000.000000 CU_OUTC_PCT_HITHRSHUEGOA 0.000000 10000.000000 BYTE_ORDER MSB_FIRST /end CHARACTERISTIC
/begin RECORD_LAYOUT RL_OUTC_PCT_HITHRSHUEGOA FNC_VALUES 1 FLOAT32_IEEE COLUMN_DIR DIRECT /end RECORD_LAYOUT
/begin COMPU_METHOD CU_OUTC_PCT_HITHRSHUEGOA "Conversion method for OUTc_pct_HiThrshUEGOA" RAT_FUNC "%10.3" "pct" COEFFS 0.000000 1.000000 0.000000 0.000000 0.000000 1.000000 /end COMPU_METHOD
/* Scalar calibration for DDE 'OUTc_pct_RampDC_A'. */
/begin CHARACTERISTIC OUTc_pct_RampDC_A "24V warmup" VALUE 0x8c2e0 RL_OUTC_PCT_RAMPDC_A 10000.000000 CU_OUTC_PCT_RAMPDC_A 0.000000 10000.000000 BYTE_ORDER MSB_FIRST /end CHARACTERISTIC
/begin RECORD_LAYOUT RL_OUTC_PCT_RAMPDC_A FNC_VALUES 1 FLOAT32_IEEE COLUMN_DIR DIRECT /end RECORD_LAYOUT
/begin COMPU_METHOD CU_OUTC_PCT_RAMPDC_A "Conversion method for OUTc_pct_RampDC_A" RAT_FUNC "%10.3" "pct" COEFFS 0.000000 1.000000 0.000000 0.000000 0.000000 1.000000 /end COMPU_METHOD
/* Scalar calibration for DDE 'OUTc_pct_UEGO_HTR_DC_A'. */
/begin CHARACTERISTIC OUTc_pct_UEGO_HTR_DC_A "UEGO HTR DC value" VALUE 0x8c2f4 RL_OUTC_PCT_UEGO_HTR_DC_A 1.000000 CU_OUTC_PCT_UEGO_HTR_DC_A 0.000000 1.000000 BYTE_ORDER MSB_FIRST /end CHARACTERISTIC
/begin RECORD_LAYOUT RL_OUTC_PCT_UEGO_HTR_DC_A FNC_VALUES 1 FLOAT32_IEEE COLUMN_DIR DIRECT /end RECORD_LAYOUT
/begin COMPU_METHOD CU_OUTC_PCT_UEGO_HTR_DC_A "Conversion method for OUTc_pct_UEGO_HTR_DC_A" RAT_FUNC "%10.2" "pct" COEFFS 0.000000 1.000000 0.000000 0.000000 0.000000 1.000000 /end COMPU_METHOD
/* Scalar calibration for DDE 'OUTc_pct_VhSpd_Fq'. */
/begin CHARACTERISTIC OUTc_pct_VhSpd_Fq "R" VALUE 0x8d1a8 RL_OUTC_PCT_VHSPD_FQ 1.000000 CU_OUTC_PCT_VHSPD_FQ 0.000000 1.000000 BYTE_ORDER MSB_FIRST /end CHARACTERISTIC
/begin RECORD_LAYOUT RL_OUTC_PCT_VHSPD_FQ FNC_VALUES 1 FLOAT32_IEEE COLUMN_DIR DIRECT /end RECORD_LAYOUT
/begin COMPU_METHOD CU_OUTC_PCT_VHSPD_FQ "Conversion method for OUTc_pct_VhSpd_Fq" RAT_FUNC "%10.2" "pct" COEFFS 0.000000 1.000000 0.000000 0.000000 0.000000 1.000000 /end COMPU_METHOD
/* Scalar calibration for DDE 'OUTc_s_ChangeTanksDelay'. */
/begin CHARACTERISTIC OUTc_s_ChangeTanksDelay "Time to go under the Min Level to switch tanks" VALUE 0x8d0cc RL_OUTC_S_CHANGETANKSDELAY 10.000000 CU_OUTC_S_CHANGETANKSDELAY 0.000000 10.000000 BYTE_ORDER MSB_FIRST /end CHARACTERISTIC
/begin RECORD_LAYOUT RL_OUTC_S_CHANGETANKSDELAY FNC_VALUES 1 FLOAT32_IEEE COLUMN_DIR DIRECT /end RECORD_LAYOUT
/begin COMPU_METHOD CU_OUTC_S_CHANGETANKSDELAY "Conversion method for OUTc_s_ChangeTanksDelay" RAT_FUNC "%10.3" "s" COEFFS 0.000000 1.000000 0.000000 0.000000 0.000000 1.000000 /end COMPU_METHOD
/* Scalar calibration for DDE 'OUTc_s_DbncStepsDC_UEGOA'. */
/begin CHARACTERISTIC OUTc_s_DbncStepsDC_UEGOA "24V warmup" VALUE 0x8c2e4 RL_OUTC_S_DBNCSTEPSDC_UEGOA 10000.000000 CU_OUTC_S_DBNCSTEPSDC_UEGOA 0.000000 10000.000000 BYTE_ORDER MSB_FIRST /end CHARACTERISTIC
/begin RECORD_LAYOUT RL_OUTC_S_DBNCSTEPSDC_UEGOA FNC_VALUES 1 FLOAT32_IEEE COLUMN_DIR DIRECT /end RECORD_LAYOUT
/begin COMPU_METHOD CU_OUTC_S_DBNCSTEPSDC_UEGOA "Conversion method for OUTc_s_DbncStepsDC_UEGOA" RAT_FUNC "%10.0" "s" COEFFS 0.000000 1.000000 0.000000 0.000000 0.000000 1.000000 /end COMPU_METHOD
/* Scalar calibration for DDE 'OUTc_s_DbncStepsDC_UEGOA2'. */
/begin CHARACTERISTIC OUTc_s_DbncStepsDC_UEGOA2 "24V warmup" VALUE 0x8c2e8 RL_OUTC_S_DBNCSTEPSDC_UEGOA2 10000.000000 CU_OUTC_S_DBNCSTEPSDC_UEGOA2 0.000000 10000.000000 BYTE_ORDER MSB_FIRST /end CHARACTERISTIC
/begin RECORD_LAYOUT RL_OUTC_S_DBNCSTEPSDC_UEGOA2 FNC_VALUES 1 FLOAT32_IEEE COLUMN_DIR DIRECT /end RECORD_LAYOUT
/begin COMPU_METHOD CU_OUTC_S_DBNCSTEPSDC_UEGOA2 "Conversion method for OUTc_s_DbncStepsDC_UEGOA2" RAT_FUNC "%10.0" "s" COEFFS 0.000000 1.000000 0.000000 0.000000 0.000000 1.000000 /end COMPU_METHOD
/* Scalar calibration for DDE 'OUTc_s_DbncStepsFreqUEGOA'. */
/begin CHARACTERISTIC OUTc_s_DbncStepsFreqUEGOA "24V warmup" VALUE 0x8c300 RL_OUTC_S_DBNCSTEPSFREQUEGOA 10000.000000 CU_OUTC_S_DBNCSTEPSFREQUEGOA 0.000000 10000.000000 BYTE_ORDER MSB_FIRST /end CHARACTERISTIC
/begin RECORD_LAYOUT RL_OUTC_S_DBNCSTEPSFREQUEGOA FNC_VALUES 1 FLOAT32_IEEE COLUMN_DIR DIRECT /end RECORD_LAYOUT
/begin COMPU_METHOD CU_OUTC_S_DBNCSTEPSFREQUEGOA "Conversion method for OUTc_s_DbncStepsFreqUEGOA" RAT_FUNC "%10.0" "s" COEFFS 0.000000 1.000000 0.000000 0.000000 0.000000 1.000000 /end COMPU_METHOD
/* Scalar calibration for DDE 'OUTc_s_DbncStepsFreqUEGOA2'. */
/begin CHARACTERISTIC OUTc_s_DbncStepsFreqUEGOA2 "24V warmup" VALUE 0x8c304 RL_OUTC_S_DBNCSTEPSFREQUEGOA2 10000.000000 CU_OUTC_S_DBNCSTEPSFREQUEGOA2 0.000000 10000.000000 BYTE_ORDER MSB_FIRST /end CHARACTERISTIC
/begin RECORD_LAYOUT RL_OUTC_S_DBNCSTEPSFREQUEGOA2 FNC_VALUES 1 FLOAT32_IEEE COLUMN_DIR DIRECT /end RECORD_LAYOUT
/begin COMPU_METHOD CU_OUTC_S_DBNCSTEPSFREQUEGOA2 "Conversion method for OUTc_s_DbncStepsFreqUEGOA2" RAT_FUNC "%10.0" "s" COEFFS 0.000000 1.000000 0.000000 0.000000 0.000000 1.000000 /end COMPU_METHOD
/* Scalar calibration for DDE 'OUTc_s_DynoMsg1_Period'. */
/begin CHARACTERISTIC OUTc_s_DynoMsg1_Period "Message transmit rate for DynoMessage1" VALUE 0x8bdb0 RL_OUTC_S_DYNOMSG1_PERIOD 10.000000 CU_OUTC_S_DYNOMSG1_PERIOD 0.000000 10.000000 BYTE_ORDER MSB_FIRST /end CHARACTERISTIC
/begin RECORD_LAYOUT RL_OUTC_S_DYNOMSG1_PERIOD FNC_VALUES 1 FLOAT32_IEEE COLUMN_DIR DIRECT /end RECORD_LAYOUT
/begin COMPU_METHOD CU_OUTC_S_DYNOMSG1_PERIOD "Conversion method for OUTc_s_DynoMsg1_Period" RAT_FUNC "%10.3" "s" COEFFS 0.000000 1.000000 0.000000 0.000000 0.000000 1.000000 /end COMPU_METHOD
/* Scalar calibration for DDE 'OUTc_s_DynoMsg2_Period'. */
/begin CHARACTERISTIC OUTc_s_DynoMsg2_Period "Message transmit rate for DynoMessage2" VALUE 0x8bdbc RL_OUTC_S_DYNOMSG2_PERIOD 10.000000 CU_OUTC_S_DYNOMSG2_PERIOD 0.000000 10.000000 BYTE_ORDER MSB_FIRST /end CHARACTERISTIC
/begin RECORD_LAYOUT RL_OUTC_S_DYNOMSG2_PERIOD FNC_VALUES 1 FLOAT32_IEEE COLUMN_DIR DIRECT /end RECORD_LAYOUT
/begin COMPU_METHOD CU_OUTC_S_DYNOMSG2_PERIOD "Conversion method for OUTc_s_DynoMsg2_Period" RAT_FUNC "%10.3" "s" COEFFS 0.000000 1.000000 0.000000 0.000000 0.000000 1.000000 /end COMPU_METHOD
/* Scalar calibration for DDE 'OUTc_s_FuelLevelLimDelay'. */
/begin CHARACTERISTIC OUTc_s_FuelLevelLimDelay "Time to go under the Min Level to switch tanks" VALUE 0x8d0d4 RL_OUTC_S_FUELLEVELLIMDELAY 10.000000 CU_OUTC_S_FUELLEVELLIMDELAY 0.000000 10.000000 BYTE_ORDER MSB_FIRST /end CHARACTERISTIC
/begin RECORD_LAYOUT RL_OUTC_S_FUELLEVELLIMDELAY FNC_VALUES 1 FLOAT32_IEEE COLUMN_DIR DIRECT /end RECORD_LAYOUT
/begin COMPU_METHOD CU_OUTC_S_FUELLEVELLIMDELAY "Conversion method for OUTc_s_FuelLevelLimDelay" RAT_FUNC "%10.3" "s" COEFFS 0.000000 1.000000 0.000000 0.000000 0.000000 1.000000 /end COMPU_METHOD
/* Scalar calibration for DDE 'OUTc_s_ShutdownDelay'. */
/begin CHARACTERISTIC OUTc_s_ShutdownDelay "ECU will stop executing the application after this duration following ign-off" VALUE 0x8d0b0 RL_OUTC_S_SHUTDOWNDELAY 10000.000000 CU_OUTC_S_SHUTDOWNDELAY 0.000000 10000.000000 BYTE_ORDER MSB_FIRST /end CHARACTERISTIC
/begin RECORD_LAYOUT RL_OUTC_S_SHUTDOWNDELAY FNC_VALUES 1 FLOAT32_IEEE COLUMN_DIR DIRECT /end RECORD_LAYOUT
/begin COMPU_METHOD CU_OUTC_S_SHUTDOWNDELAY "Conversion method for OUTc_s_ShutdownDelay" RAT_FUNC "%10.0" "s" COEFFS 0.000000 1.000000 0.000000 0.000000 0.000000 1.000000 /end COMPU_METHOD
/* Scalar calibration for DDE 'OUTc_s_SwichTankHold'. */
/begin CHARACTERISTIC OUTc_s_SwichTankHold "Fuel Tank will keep working during this time after being unselected" VALUE 0x8d0d8 RL_OUTC_S_SWICHTANKHOLD 10000.000000 CU_OUTC_S_SWICHTANKHOLD 0.000000 10000.000000 BYTE_ORDER MSB_FIRST /end CHARACTERISTIC
/begin RECORD_LAYOUT RL_OUTC_S_SWICHTANKHOLD FNC_VALUES 1 FLOAT32_IEEE COLUMN_DIR DIRECT /end RECORD_LAYOUT
/begin COMPU_METHOD CU_OUTC_S_SWICHTANKHOLD "Conversion method for OUTc_s_SwichTankHold" RAT_FUNC "%10.1" "s" COEFFS 0.000000 1.000000 0.000000 0.000000 0.000000 1.000000 /end COMPU_METHOD
/* Scalar calibration for DDE 'OUTc_s_ViscoOFFPulse'. */
/begin CHARACTERISTIC OUTc_s_ViscoOFFPulse "Duración pico visco" VALUE 0x8d0f4 RL_OUTC_S_VISCOOFFPULSE 10.000000 CU_OUTC_S_VISCOOFFPULSE 0.000000 10.000000 BYTE_ORDER MSB_FIRST /end CHARACTERISTIC
/begin RECORD_LAYOUT RL_OUTC_S_VISCOOFFPULSE FNC_VALUES 1 FLOAT32_IEEE COLUMN_DIR DIRECT /end RECORD_LAYOUT
/begin COMPU_METHOD CU_OUTC_S_VISCOOFFPULSE "Conversion method for OUTc_s_ViscoOFFPulse" RAT_FUNC "%10.3" "s" COEFFS 0.000000 1.000000 0.000000 0.000000 0.000000 1.000000 /end COMPU_METHOD
/* Scalar calibration for DDE 'OUTc_s_ViscoPeakPulse'. */
/begin CHARACTERISTIC OUTc_s_ViscoPeakPulse "Duración pico visco" VALUE 0x8d0e8 RL_OUTC_S_VISCOPEAKPULSE 5.000000 CU_OUTC_S_VISCOPEAKPULSE 0.000000 5.000000 BYTE_ORDER MSB_FIRST /end CHARACTERISTIC
/begin RECORD_LAYOUT RL_OUTC_S_VISCOPEAKPULSE FNC_VALUES 1 FLOAT32_IEEE COLUMN_DIR DIRECT /end RECORD_LAYOUT
/begin COMPU_METHOD CU_OUTC_S_VISCOPEAKPULSE "Conversion method for OUTc_s_ViscoPeakPulse" RAT_FUNC "%10.3" "s" COEFFS 0.000000 1.000000 0.000000 0.000000 0.000000 1.000000 /end COMPU_METHOD
/* Scalar calibration for DDE 'OUTc_us_CurrentLimitDither1'. */
/begin CHARACTERISTIC OUTc_us_CurrentLimitDither1 "After the injector output reaches a current limit, it will be disabled for this duration before re-enabling" VALUE 0x8d4e8 RL_OUTC_US_CURRENTLIMITDITHER1 200.000000 CU_OUTC_US_CURRENTLIMITDITHER1 0.000000 200.000000 BYTE_ORDER MSB_FIRST /end CHARACTERISTIC
/begin RECORD_LAYOUT RL_OUTC_US_CURRENTLIMITDITHER1 FNC_VALUES 1 FLOAT32_IEEE COLUMN_DIR DIRECT /end RECORD_LAYOUT
/begin COMPU_METHOD CU_OUTC_US_CURRENTLIMITDITHER1 "Conversion method for OUTc_us_CurrentLimitDither1" RAT_FUNC "%10.0" "us" COEFFS 0.000000 1.000000 0.000000 0.000000 0.000000 1.000000 /end COMPU_METHOD
/* Scalar calibration for DDE 'OUTc_us_CurrentLimitDither3'. */
/begin CHARACTERISTIC OUTc_us_CurrentLimitDither3 "After the injector output reaches a current limit, it will be disabled for this duration before re-enabling" VALUE 0x8d4f0 RL_OUTC_US_CURRENTLIMITDITHER3 200.000000 CU_OUTC_US_CURRENTLIMITDITHER3 0.000000 200.000000 BYTE_ORDER MSB_FIRST /end CHARACTERISTIC
/begin RECORD_LAYOUT RL_OUTC_US_CURRENTLIMITDITHER3 FNC_VALUES 1 FLOAT32_IEEE COLUMN_DIR DIRECT /end RECORD_LAYOUT
/begin COMPU_METHOD CU_OUTC_US_CURRENTLIMITDITHER3 "Conversion method for OUTc_us_CurrentLimitDither3" RAT_FUNC "%10.0" "us" COEFFS 0.000000 1.000000 0.000000 0.000000 0.000000 1.000000 /end COMPU_METHOD
/* Scalar calibration for DDE 'OUTc_us_InjPeakDuration'. */
/begin CHARACTERISTIC OUTc_us_InjPeakDuration "The _peak_ current limit will apply for this duration, then the output will switch to the _hold_ current limit" VALUE 0x8d4e4 RL_OUTC_US_INJPEAKDURATION 10000.000000 CU_OUTC_US_INJPEAKDURATION 0.000000 10000.000000 BYTE_ORDER MSB_FIRST /end CHARACTERISTIC
/begin RECORD_LAYOUT RL_OUTC_US_INJPEAKDURATION FNC_VALUES 1 FLOAT32_IEEE COLUMN_DIR DIRECT /end RECORD_LAYOUT
/begin COMPU_METHOD CU_OUTC_US_INJPEAKDURATION "Conversion method for OUTc_us_InjPeakDuration" RAT_FUNC "%10.0" "us" COEFFS 0.000000 1.000000 0.000000 0.000000 0.000000 1.000000 /end COMPU_METHOD
/* Map (1d) calibration for DDE 'OUTm_Hz_FreqUEGO_z'. */
/begin CHARACTERISTIC OUTm_Hz_FreqUEGO_z "(not defined)" CURVE 0x8c324 RL_OUTM_HZ_FREQUEGO_Z 10000.000000 CU_OUTM_HZ_FREQUEGO_Z 0.000000 10000.000000
 /begin AXIS_DESCR COM_AXIS NO_INPUT_QUANTITY CU_OUTM_HZ_FREQUEGO_X 6 0.000000 10000.000000 AXIS_PTS_REF APD_OUTM_HZ_FREQUEGO_X /end AXIS_DESCR
 BYTE_ORDER MSB_FIRST /end CHARACTERISTIC
/begin RECORD_LAYOUT RL_OUTM_HZ_FREQUEGO_Z FNC_VALUES 1 FLOAT32_IEEE COLUMN_DIR DIRECT /end RECORD_LAYOUT
/begin COMPU_METHOD CU_OUTM_HZ_FREQUEGO_Z "Conversion method for OUTm_Hz_FreqUEGO_z" RAT_FUNC "%10.3" "V" COEFFS 0.000000 1.000000 0.000000 0.000000 0.000000 1.000000 /end COMPU_METHOD
/begin AXIS_PTS APD_OUTM_HZ_FREQUEGO_X "(not defined)" 0x8c30c NO_INPUT_QUANTITY RL_OUTM_HZ_FREQUEGO_X 10000.000000 CU_OUTM_HZ_FREQUEGO_X 6 0.0 10000.0 BYTE_ORDER MSB_FIRST /end AXIS_PTS
/begin RECORD_LAYOUT RL_OUTM_HZ_FREQUEGO_X AXIS_PTS_X 1 FLOAT32_IEEE INDEX_INCR DIRECT /end RECORD_LAYOUT
/begin COMPU_METHOD CU_OUTM_HZ_FREQUEGO_X "Conversion method for OUTm_Hz_FreqUEGO_x" RAT_FUNC "%10.3" "V" COEFFS 0.000000 1.000000 0.000000 0.000000 0.000000 1.000000 /end COMPU_METHOD
/* Map (1d) calibration for DDE 'OUTm_NU_EngSpd_z'. */
/begin CHARACTERISTIC OUTm_NU_EngSpd_z "Engine speed axis Z (Hz) for dashboard control" CURVE 0x8d200 RL_OUTM_NU_ENGSPD_Z 10000.000000 CU_OUTM_NU_ENGSPD_Z 0.000000 10000.000000
 /begin AXIS_DESCR COM_AXIS NO_INPUT_QUANTITY CU_OUTM_NU_ENGSPD_X 20 0.000000 8000.000000 AXIS_PTS_REF APD_OUTM_NU_ENGSPD_X /end AXIS_DESCR
 BYTE_ORDER MSB_FIRST /end CHARACTERISTIC
/begin RECORD_LAYOUT RL_OUTM_NU_ENGSPD_Z FNC_VALUES 1 FLOAT32_IEEE COLUMN_DIR DIRECT /end RECORD_LAYOUT
/begin COMPU_METHOD CU_OUTM_NU_ENGSPD_Z "Conversion method for OUTm_NU_EngSpd_z" RAT_FUNC "%10.0" "Hz" COEFFS 0.000000 1.000000 0.000000 0.000000 0.000000 1.000000 /end COMPU_METHOD
/begin AXIS_PTS APD_OUTM_NU_ENGSPD_X "Engine speed axis X (RPM) for dashboard control" 0x8d1b0 NO_INPUT_QUANTITY RL_OUTM_NU_ENGSPD_X 8000.000000 CU_OUTM_NU_ENGSPD_X 20 0.0 8000.0 BYTE_ORDER MSB_FIRST /end AXIS_PTS
/begin RECORD_LAYOUT RL_OUTM_NU_ENGSPD_X AXIS_PTS_X 1 FLOAT32_IEEE INDEX_INCR DIRECT /end RECORD_LAYOUT
/begin COMPU_METHOD CU_OUTM_NU_ENGSPD_X "Conversion method for OUTm_NU_EngSpd_x" RAT_FUNC "%10.0" "RPM" COEFFS 0.000000 1.000000 0.000000 0.000000 0.000000 1.000000 /end COMPU_METHOD
/* Map (1d) calibration for DDE 'OUTm_NU_VhSpd_z'. */
/begin CHARACTERISTIC OUTm_NU_VhSpd_z "Engine speed axis Z (Hz) for dashboard control" CURVE 0x8d150 RL_OUTM_NU_VHSPD_Z 10000.000000 CU_OUTM_NU_VHSPD_Z 0.000000 10000.000000
 /begin AXIS_DESCR COM_AXIS NO_INPUT_QUANTITY CU_OUTM_NU_VHSPD_X 20 0.000000 8000.000000 AXIS_PTS_REF APD_OUTM_NU_VHSPD_X /end AXIS_DESCR
 BYTE_ORDER MSB_FIRST /end CHARACTERISTIC
/begin RECORD_LAYOUT RL_OUTM_NU_VHSPD_Z FNC_VALUES 1 FLOAT32_IEEE COLUMN_DIR DIRECT /end RECORD_LAYOUT
/begin COMPU_METHOD CU_OUTM_NU_VHSPD_Z "Conversion method for OUTm_NU_VhSpd_z" RAT_FUNC "%10.0" "Hz" COEFFS 0.000000 1.000000 0.000000 0.000000 0.000000 1.000000 /end COMPU_METHOD
/begin AXIS_PTS APD_OUTM_NU_VHSPD_X "Engine speed axis X (RPM) for dashboard control" 0x8d100 NO_INPUT_QUANTITY RL_OUTM_NU_VHSPD_X 8000.000000 CU_OUTM_NU_VHSPD_X 20 0.0 8000.0 BYTE_ORDER MSB_FIRST /end AXIS_PTS
/begin RECORD_LAYOUT RL_OUTM_NU_VHSPD_X AXIS_PTS_X 1 FLOAT32_IEEE INDEX_INCR DIRECT /end RECORD_LAYOUT
/begin COMPU_METHOD CU_OUTM_NU_VHSPD_X "Conversion method for OUTm_NU_VhSpd_x" RAT_FUNC "%10.0" "RPM" COEFFS 0.000000 1.000000 0.000000 0.000000 0.000000 1.000000 /end COMPU_METHOD
/* Scalar calibration for DDE 'REMc_C_OvertempThrsh'. */
/begin CHARACTERISTIC REMc_C_OvertempThrsh "Throttle will be limited when EngineTemp exceeds this value" VALUE 0x8cea0 RL_REMC_C_OVERTEMPTHRSH 500.000000 CU_REMC_C_OVERTEMPTHRSH 0.000000 500.000000 BYTE_ORDER MSB_FIRST /end CHARACTERISTIC
/begin RECORD_LAYOUT RL_REMC_C_OVERTEMPTHRSH FNC_VALUES 1 FLOAT32_IEEE COLUMN_DIR DIRECT /end RECORD_LAYOUT
/begin COMPU_METHOD CU_REMC_C_OVERTEMPTHRSH "Conversion method for REMc_C_OvertempThrsh" RAT_FUNC "%10.0" "C" COEFFS 0.000000 1.000000 0.000000 0.000000 0.000000 1.000000 /end COMPU_METHOD
/* Scalar calibration for DDE 'REMc_C_TurbineShutdownThrsh'. */
/begin CHARACTERISTIC REMc_C_TurbineShutdownThrsh "Stop combustion after this temperature" VALUE 0x8ce8c RL_REMC_C_TURBINESHUTDOWNTHRSH 300.000000 CU_REMC_C_TURBINESHUTDOWNTHRSH 700.000000 1000.000000 BYTE_ORDER MSB_FIRST /end CHARACTERISTIC
/begin RECORD_LAYOUT RL_REMC_C_TURBINESHUTDOWNTHRSH FNC_VALUES 1 FLOAT32_IEEE COLUMN_DIR DIRECT /end RECORD_LAYOUT
/begin COMPU_METHOD CU_REMC_C_TURBINESHUTDOWNTHRSH "Conversion method for REMc_C_TurbineShutdownThrsh" RAT_FUNC "%10.0" "C" COEFFS 0.000000 1.000000 0.000000 0.000000 0.000000 1.000000 /end COMPU_METHOD
/* Scalar calibration for DDE 'REMc_C_TurbineWarningThrsh'. */
/begin CHARACTERISTIC REMc_C_TurbineWarningThrsh "Set turbine overtemp warning after this temperature" VALUE 0x8ce98 RL_REMC_C_TURBINEWARNINGTHRSH 300.000000 CU_REMC_C_TURBINEWARNINGTHRSH 700.000000 1000.000000 BYTE_ORDER MSB_FIRST /end CHARACTERISTIC
/begin RECORD_LAYOUT RL_REMC_C_TURBINEWARNINGTHRSH FNC_VALUES 1 FLOAT32_IEEE COLUMN_DIR DIRECT /end RECORD_LAYOUT
/begin COMPU_METHOD CU_REMC_C_TURBINEWARNINGTHRSH "Conversion method for REMc_C_TurbineWarningThrsh" RAT_FUNC "%10.0" "C" COEFFS 0.000000 1.000000 0.000000 0.000000 0.000000 1.000000 /end COMPU_METHOD
/* Scalar calibration for DDE 'REMc_Nm_OvertempTqLimit'. */
/begin CHARACTERISTIC REMc_Nm_OvertempTqLimit "Limit the indicated torque request to this magnitude during an engine overheat" VALUE 0x8cea8 RL_REMC_NM_OVERTEMPTQLIMIT 300.000000 CU_REMC_NM_OVERTEMPTQLIMIT 0.000000 300.000000 BYTE_ORDER MSB_FIRST /end CHARACTERISTIC
/begin RECORD_LAYOUT RL_REMC_NM_OVERTEMPTQLIMIT FNC_VALUES 1 FLOAT32_IEEE COLUMN_DIR DIRECT /end RECORD_LAYOUT
/begin COMPU_METHOD CU_REMC_NM_OVERTEMPTQLIMIT "Conversion method for REMc_Nm_OvertempTqLimit" RAT_FUNC "%10.0" "Nm" COEFFS 0.000000 1.000000 0.000000 0.000000 0.000000 1.000000 /end COMPU_METHOD
/* Scalar calibration for DDE 'REMc_Nm_TqLimit'. */
/begin CHARACTERISTIC REMc_Nm_TqLimit "Override value" VALUE 0x8cea4 RL_REMC_NM_TQLIMIT 500.000000 CU_REMC_NM_TQLIMIT 0.000000 500.000000 BYTE_ORDER MSB_FIRST /end CHARACTERISTIC
/begin RECORD_LAYOUT RL_REMC_NM_TQLIMIT FNC_VALUES 1 FLOAT32_IEEE COLUMN_DIR DIRECT /end RECORD_LAYOUT
/begin COMPU_METHOD CU_REMC_NM_TQLIMIT "Conversion method for REMc_Nm_TqLimit" RAT_FUNC "%10.0" "Nm" COEFFS 0.000000 1.000000 0.000000 0.000000 0.000000 1.000000 /end COMPU_METHOD
/* Scalar calibration for DDE 'REMc_b_EnblCombustion'. */
/begin CHARACTERISTIC REMc_b_EnblCombustion "Manual key cal" VALUE 0x8ce95 RL_REMC_B_ENBLCOMBUSTION 1.000000 CU_REMC_B_ENBLCOMBUSTION 0.000000 1.000000 BYTE_ORDER MSB_FIRST /end CHARACTERISTIC
/begin RECORD_LAYOUT RL_REMC_B_ENBLCOMBUSTION FNC_VALUES 1 UBYTE COLUMN_DIR DIRECT /end RECORD_LAYOUT
/begin COMPU_METHOD CU_REMC_B_ENBLCOMBUSTION "Conversion method for REMc_b_EnblCombustion" RAT_FUNC "%10.0" "b" COEFFS 0.000000 1.000000 0.000000 0.000000 0.000000 1.000000 /end COMPU_METHOD
/* Scalar calibration for DDE 'REMc_b_PreventRunningReboot'. */
/begin CHARACTERISTIC REMc_b_PreventRunningReboot "Enables logic to stop combustion in the case the ECU reboots while the engine is still spinning (leave enabled during calibration)" VALUE 0x8ce84 RL_REMC_B_PREVENTRUNNINGREBOOT 1.000000 CU_REMC_B_PREVENTRUNNINGREBOOT 0.000000 1.000000 BYTE_ORDER MSB_FIRST /end CHARACTERISTIC
/begin RECORD_LAYOUT RL_REMC_B_PREVENTRUNNINGREBOOT FNC_VALUES 1 UBYTE COLUMN_DIR DIRECT /end RECORD_LAYOUT
/begin COMPU_METHOD CU_REMC_B_PREVENTRUNNINGREBOOT "Conversion method for REMc_b_PreventRunningReboot" RAT_FUNC "%10.0" "b" COEFFS 0.000000 1.000000 0.000000 0.000000 0.000000 1.000000 /end COMPU_METHOD
/* Scalar calibration for DDE 'REMc_b_ResetTurbineShutdown'. */
/begin CHARACTERISTIC REMc_b_ResetTurbineShutdown "Allows combustion to resume after a turbo overtemp shutdown" VALUE 0x8ce94 RL_REMC_B_RESETTURBINESHUTDOWN 1.000000 CU_REMC_B_RESETTURBINESHUTDOWN 0.000000 1.000000 BYTE_ORDER MSB_FIRST /end CHARACTERISTIC
/begin RECORD_LAYOUT RL_REMC_B_RESETTURBINESHUTDOWN FNC_VALUES 1 UBYTE COLUMN_DIR DIRECT /end RECORD_LAYOUT
/begin COMPU_METHOD CU_REMC_B_RESETTURBINESHUTDOWN "Conversion method for REMc_b_ResetTurbineShutdown" RAT_FUNC "%10.0" "b" COEFFS 0.000000 1.000000 0.000000 0.000000 0.000000 1.000000 /end COMPU_METHOD
/* Scalar calibration for DDE 'REMc_b_StopCombustion'. */
/begin CHARACTERISTIC REMc_b_StopCombustion "Override value" VALUE 0x8ce97 RL_REMC_B_STOPCOMBUSTION 1.000000 CU_REMC_B_STOPCOMBUSTION 0.000000 1.000000 BYTE_ORDER MSB_FIRST /end CHARACTERISTIC
/begin RECORD_LAYOUT RL_REMC_B_STOPCOMBUSTION FNC_VALUES 1 UBYTE COLUMN_DIR DIRECT /end RECORD_LAYOUT
/begin COMPU_METHOD CU_REMC_B_STOPCOMBUSTION "Conversion method for REMc_b_StopCombustion" RAT_FUNC "%10.0" "b" COEFFS 0.000000 1.000000 0.000000 0.000000 0.000000 1.000000 /end COMPU_METHOD
/* Scalar calibration for DDE 'REMc_e_TurbineState'. */
/begin CHARACTERISTIC REMc_e_TurbineState "Override value" VALUE 0x8ce9d RL_REMC_E_TURBINESTATE 2.000000 CU_REMC_E_TURBINESTATE 0.000000 2.000000 BYTE_ORDER MSB_FIRST /end CHARACTERISTIC
/begin RECORD_LAYOUT RL_REMC_E_TURBINESTATE FNC_VALUES 1 UBYTE COLUMN_DIR DIRECT /end RECORD_LAYOUT
/begin COMPU_METHOD CU_REMC_E_TURBINESTATE "Conversion method for REMc_e_TurbineState" RAT_FUNC "%10.0" "e" COEFFS 0.000000 1.000000 0.000000 0.000000 0.000000 1.000000 /end COMPU_METHOD
/* Scalar calibration for DDE 'REMc_o_OvertempThrottleLimit'. */
/begin CHARACTERISTIC REMc_o_OvertempThrottleLimit "Override flag" VALUE 0x8d299 RL_REMC_O_OVERTEMPTHROTTLELIMIT 1.000000 CU_REMC_O_OVERTEMPTHROTTLELIMIT 0.000000 1.000000 BYTE_ORDER MSB_FIRST /end CHARACTERISTIC
/begin RECORD_LAYOUT RL_REMC_O_OVERTEMPTHROTTLELIMIT FNC_VALUES 1 UBYTE COLUMN_DIR DIRECT /end RECORD_LAYOUT
/begin COMPU_METHOD CU_REMC_O_OVERTEMPTHROTTLELIMIT "Conversion method for REMc_o_OvertempThrottleLimit" RAT_FUNC "%10.0" "b" COEFFS 0.000000 1.000000 0.000000 0.000000 0.000000 1.000000 /end COMPU_METHOD
/* Scalar calibration for DDE 'REMc_o_StopCombustion'. */
/begin CHARACTERISTIC REMc_o_StopCombustion "Override flag" VALUE 0x8ce96 RL_REMC_O_STOPCOMBUSTION 1.000000 CU_REMC_O_STOPCOMBUSTION 0.000000 1.000000 BYTE_ORDER MSB_FIRST /end CHARACTERISTIC
/begin RECORD_LAYOUT RL_REMC_O_STOPCOMBUSTION FNC_VALUES 1 UBYTE COLUMN_DIR DIRECT /end RECORD_LAYOUT
/begin COMPU_METHOD CU_REMC_O_STOPCOMBUSTION "Conversion method for REMc_o_StopCombustion" RAT_FUNC "%10.0" "o" COEFFS 0.000000 1.000000 0.000000 0.000000 0.000000 1.000000 /end COMPU_METHOD
/* Scalar calibration for DDE 'REMc_o_TqLimit'. */
/begin CHARACTERISTIC REMc_o_TqLimit "Override flag" VALUE 0x8d2aa RL_REMC_O_TQLIMIT 1.000000 CU_REMC_O_TQLIMIT 0.000000 1.000000 BYTE_ORDER MSB_FIRST /end CHARACTERISTIC
/begin RECORD_LAYOUT RL_REMC_O_TQLIMIT FNC_VALUES 1 UBYTE COLUMN_DIR DIRECT /end RECORD_LAYOUT
/begin COMPU_METHOD CU_REMC_O_TQLIMIT "Conversion method for REMc_o_TqLimit" RAT_FUNC "%10.0" "b" COEFFS 0.000000 1.000000 0.000000 0.000000 0.000000 1.000000 /end COMPU_METHOD
/* Scalar calibration for DDE 'REMc_o_TurbineState'. */
/begin CHARACTERISTIC REMc_o_TurbineState "Override flag" VALUE 0x8ce9c RL_REMC_O_TURBINESTATE 1.000000 CU_REMC_O_TURBINESTATE 0.000000 1.000000 BYTE_ORDER MSB_FIRST /end CHARACTERISTIC
/begin RECORD_LAYOUT RL_REMC_O_TURBINESTATE FNC_VALUES 1 UBYTE COLUMN_DIR DIRECT /end RECORD_LAYOUT
/begin COMPU_METHOD CU_REMC_O_TURBINESTATE "Conversion method for REMc_o_TurbineState" RAT_FUNC "%10.0" "o" COEFFS 0.000000 1.000000 0.000000 0.000000 0.000000 1.000000 /end COMPU_METHOD
/* Scalar calibration for DDE 'REMc_pct_OvertempThrottleLimit'. */
/begin CHARACTERISTIC REMc_pct_OvertempThrottleLimit "Throttle maximum when overtemp logic is active" VALUE 0x8d29c RL_REMC_PCT_OVERTEMPTHROTTLELI0 1.000000 CU_REMC_PCT_OVERTEMPTHROTTLELI0 0.000000 1.000000 BYTE_ORDER MSB_FIRST /end CHARACTERISTIC
/begin RECORD_LAYOUT RL_REMC_PCT_OVERTEMPTHROTTLELI0 FNC_VALUES 1 FLOAT32_IEEE COLUMN_DIR DIRECT /end RECORD_LAYOUT
/begin COMPU_METHOD CU_REMC_PCT_OVERTEMPTHROTTLELI0 "Conversion method for REMc_pct_OvertempThrottleLimit" RAT_FUNC "%10.2" "pct" COEFFS 0.000000 1.000000 0.000000 0.000000 0.000000 1.000000 /end COMPU_METHOD
/* Scalar calibration for DDE 'REMc_s_PowerupDelay'. */
/begin CHARACTERISTIC REMc_s_PowerupDelay "StopCombustion flag will remain set for this duration after ECU powerup" VALUE 0x8ce88 RL_REMC_S_POWERUPDELAY 5.000000 CU_REMC_S_POWERUPDELAY 0.000000 5.000000 BYTE_ORDER MSB_FIRST /end CHARACTERISTIC
/begin RECORD_LAYOUT RL_REMC_S_POWERUPDELAY FNC_VALUES 1 FLOAT32_IEEE COLUMN_DIR DIRECT /end RECORD_LAYOUT
/begin COMPU_METHOD CU_REMC_S_POWERUPDELAY "Conversion method for REMc_s_PowerupDelay" RAT_FUNC "%10.2" "s" COEFFS 0.000000 1.000000 0.000000 0.000000 0.000000 1.000000 /end COMPU_METHOD
/* Scalar calibration for DDE 'REMc_s_RunningRebootWindow'. */
/begin CHARACTERISTIC REMc_s_RunningRebootWindow "If we see engine speed during this duration after reboot prevent combustion" VALUE 0x8ce80 RL_REMC_S_RUNNINGREBOOTWINDOW 5.000000 CU_REMC_S_RUNNINGREBOOTWINDOW 0.000000 5.000000 BYTE_ORDER MSB_FIRST /end CHARACTERISTIC
/begin RECORD_LAYOUT RL_REMC_S_RUNNINGREBOOTWINDOW FNC_VALUES 1 FLOAT32_IEEE COLUMN_DIR DIRECT /end RECORD_LAYOUT
/begin COMPU_METHOD CU_REMC_S_RUNNINGREBOOTWINDOW "Conversion method for REMc_s_RunningRebootWindow" RAT_FUNC "%10.2" "s" COEFFS 0.000000 1.000000 0.000000 0.000000 0.000000 1.000000 /end COMPU_METHOD
/* Scalar calibration for DDE 'REMc_s_TurbineTempDbnc'. */
/begin CHARACTERISTIC REMc_s_TurbineTempDbnc "Delay time before updating TurbineState" VALUE 0x8ce90 RL_REMC_S_TURBINETEMPDBNC 10.000000 CU_REMC_S_TURBINETEMPDBNC 0.000000 10.000000 BYTE_ORDER MSB_FIRST /end CHARACTERISTIC
/begin RECORD_LAYOUT RL_REMC_S_TURBINETEMPDBNC FNC_VALUES 1 FLOAT32_IEEE COLUMN_DIR DIRECT /end RECORD_LAYOUT
/begin COMPU_METHOD CU_REMC_S_TURBINETEMPDBNC "Conversion method for REMc_s_TurbineTempDbnc" RAT_FUNC "%10.1" "s" COEFFS 0.000000 1.000000 0.000000 0.000000 0.000000 1.000000 /end COMPU_METHOD
/* Scalar calibration for DDE 'RFCc_b_Enable'. */
/begin CHARACTERISTIC RFCc_b_Enable "User Flag" VALUE 0x8a8bc RL_RFCC_B_ENABLE 1.000000 CU_RFCC_B_ENABLE 0.000000 1.000000 BYTE_ORDER MSB_FIRST /end CHARACTERISTIC
/begin RECORD_LAYOUT RL_RFCC_B_ENABLE FNC_VALUES 1 UBYTE COLUMN_DIR DIRECT /end RECORD_LAYOUT
/begin COMPU_METHOD CU_RFCC_B_ENABLE "Conversion method for RFCc_b_Enable" RAT_FUNC "%10.0" "b" COEFFS 0.000000 1.000000 0.000000 0.000000 0.000000 1.000000 /end COMPU_METHOD
/* Scalar calibration for DDE 'RFCc_mg_FuelRqstDeltaThrsh'. */
/begin CHARACTERISTIC RFCc_mg_FuelRqstDeltaThrsh "Fuelmass change theshold to trigger RFC activation" VALUE 0x8a8c0 RL_RFCC_MG_FUELRQSTDELTATHRSH 5.000000 CU_RFCC_MG_FUELRQSTDELTATHRSH 0.000000 5.000000 BYTE_ORDER MSB_FIRST /end CHARACTERISTIC
/begin RECORD_LAYOUT RL_RFCC_MG_FUELRQSTDELTATHRSH FNC_VALUES 1 FLOAT32_IEEE COLUMN_DIR DIRECT /end RECORD_LAYOUT
/begin COMPU_METHOD CU_RFCC_MG_FUELRQSTDELTATHRSH "Conversion method for RFCc_mg_FuelRqstDeltaThrsh" RAT_FUNC "%10.2" "NU" COEFFS 0.000000 1.000000 0.000000 0.000000 0.000000 1.000000 /end COMPU_METHOD
/* Scalar calibration for DDE 'RFCc_pct_MaxEnlean'. */
/begin CHARACTERISTIC RFCc_pct_MaxEnlean "Do not permit RFC to gain down the fuelmass more than this amount (1.0 implies RFC can reduce the fuel to zero)" VALUE 0x8a8ac RL_RFCC_PCT_MAXENLEAN 1.000000 CU_RFCC_PCT_MAXENLEAN 0.000000 1.000000 BYTE_ORDER MSB_FIRST /end CHARACTERISTIC
/begin RECORD_LAYOUT RL_RFCC_PCT_MAXENLEAN FNC_VALUES 1 FLOAT32_IEEE COLUMN_DIR DIRECT /end RECORD_LAYOUT
/begin COMPU_METHOD CU_RFCC_PCT_MAXENLEAN "Conversion method for RFCc_pct_MaxEnlean" RAT_FUNC "%10.2" "pct" COEFFS 0.000000 1.000000 0.000000 0.000000 0.000000 1.000000 /end COMPU_METHOD
/* Scalar calibration for DDE 'RFCc_pct_MaxEnrich'. */
/begin CHARACTERISTIC RFCc_pct_MaxEnrich "Do not permit RFC to gain up the fuelmass more than this amount (1.0 implies RFC can double the fuelmass)" VALUE 0x8a7e8 RL_RFCC_PCT_MAXENRICH 5.000000 CU_RFCC_PCT_MAXENRICH 0.000000 5.000000 BYTE_ORDER MSB_FIRST /end CHARACTERISTIC
/begin RECORD_LAYOUT RL_RFCC_PCT_MAXENRICH FNC_VALUES 1 FLOAT32_IEEE COLUMN_DIR DIRECT /end RECORD_LAYOUT
/begin COMPU_METHOD CU_RFCC_PCT_MAXENRICH "Conversion method for RFCc_pct_MaxEnrich" RAT_FUNC "%10.2" "pct" COEFFS 0.000000 1.000000 0.000000 0.000000 0.000000 1.000000 /end COMPU_METHOD
/* Scalar calibration for DDE 'RFCc_pct_PfInvThrsh'. */
/begin CHARACTERISTIC RFCc_pct_PfInvThrsh "Stop transient if RFC gain falls below this threshold" VALUE 0x8a8b8 RL_RFCC_PCT_PFINVTHRSH 1.000000 CU_RFCC_PCT_PFINVTHRSH 0.000000 1.000000 BYTE_ORDER MSB_FIRST /end CHARACTERISTIC
/begin RECORD_LAYOUT RL_RFCC_PCT_PFINVTHRSH FNC_VALUES 1 FLOAT32_IEEE COLUMN_DIR DIRECT /end RECORD_LAYOUT
/begin COMPU_METHOD CU_RFCC_PCT_PFINVTHRSH "Conversion method for RFCc_pct_PfInvThrsh" RAT_FUNC "%10.2" "pct" COEFFS 0.000000 1.000000 0.000000 0.000000 0.000000 1.000000 /end COMPU_METHOD
/* Scalar calibration for DDE 'RFCc_s_DbncTimer'. */
/begin CHARACTERISTIC RFCc_s_DbncTimer "Debounce Timer Cal" VALUE 0x8a8b4 RL_RFCC_S_DBNCTIMER 1000.000000 CU_RFCC_S_DBNCTIMER 0.000000 1000.000000 BYTE_ORDER MSB_FIRST /end CHARACTERISTIC
/begin RECORD_LAYOUT RL_RFCC_S_DBNCTIMER FNC_VALUES 1 FLOAT32_IEEE COLUMN_DIR DIRECT /end RECORD_LAYOUT
/begin COMPU_METHOD CU_RFCC_S_DBNCTIMER "Conversion method for RFCc_s_DbncTimer" RAT_FUNC "%10.2" "s" COEFFS 0.000000 1.000000 0.000000 0.000000 0.000000 1.000000 /end COMPU_METHOD
/* Scalar calibration for DDE 'RFCc_s_ExpTimer'. */
/begin CHARACTERISTIC RFCc_s_ExpTimer "Expiration Timer Cal" VALUE 0x8a8c4 RL_RFCC_S_EXPTIMER 1000.000000 CU_RFCC_S_EXPTIMER 0.000000 1000.000000 BYTE_ORDER MSB_FIRST /end CHARACTERISTIC
/begin RECORD_LAYOUT RL_RFCC_S_EXPTIMER FNC_VALUES 1 FLOAT32_IEEE COLUMN_DIR DIRECT /end RECORD_LAYOUT
/begin COMPU_METHOD CU_RFCC_S_EXPTIMER "Conversion method for RFCc_s_ExpTimer" RAT_FUNC "%10.2" "s" COEFFS 0.000000 1.000000 0.000000 0.000000 0.000000 1.000000 /end COMPU_METHOD
/* Map (2d) calibration for DDE 'RFCm_NU_PuddleVapTime_z'. */
/begin CHARACTERISTIC RFCm_NU_PuddleVapTime_z "Puddle vaporization time z-axis" MAP 0x8a758 RL_RFCM_NU_PUDDLEVAPTIME_Z 2.000000 CU_RFCM_NU_PUDDLEVAPTIME_Z 0.000000 2.000000
 /begin AXIS_DESCR COM_AXIS NO_INPUT_QUANTITY CU_RFCM_NU_PUDDLEVAPTIME_X 6 0.000000 300.000000 AXIS_PTS_REF APD_RFCM_NU_PUDDLEVAPTIME_X /end AXIS_DESCR
 /begin AXIS_DESCR COM_AXIS NO_INPUT_QUANTITY CU_RFCM_NU_PUDDLEVAPTIME_Y 6 -100.000000 200.000000 AXIS_PTS_REF APD_RFCM_NU_PUDDLEVAPTIME_Y /end AXIS_DESCR
 BYTE_ORDER MSB_FIRST /end CHARACTERISTIC
/begin RECORD_LAYOUT RL_RFCM_NU_PUDDLEVAPTIME_Z FNC_VALUES 1 FLOAT32_IEEE COLUMN_DIR DIRECT /end RECORD_LAYOUT
/begin COMPU_METHOD CU_RFCM_NU_PUDDLEVAPTIME_Z "Conversion method for RFCm_NU_PuddleVapTime_z" RAT_FUNC "%10.2" "s" COEFFS 0.000000 1.000000 0.000000 0.000000 0.000000 1.000000 /end COMPU_METHOD
/begin AXIS_PTS APD_RFCM_NU_PUDDLEVAPTIME_X "MAP y-axis" 0x8a728 NO_INPUT_QUANTITY RL_RFCM_NU_PUDDLEVAPTIME_X 300.000000 CU_RFCM_NU_PUDDLEVAPTIME_X 6 0.0 300.0 BYTE_ORDER MSB_FIRST /end AXIS_PTS
/begin RECORD_LAYOUT RL_RFCM_NU_PUDDLEVAPTIME_X AXIS_PTS_X 1 FLOAT32_IEEE INDEX_INCR DIRECT /end RECORD_LAYOUT
/begin COMPU_METHOD CU_RFCM_NU_PUDDLEVAPTIME_X "Conversion method for RFCm_NU_PuddleVapTime_x" RAT_FUNC "%10.0" "kPa" COEFFS 0.000000 1.000000 0.000000 0.000000 0.000000 1.000000 /end COMPU_METHOD
/begin AXIS_PTS APD_RFCM_NU_PUDDLEVAPTIME_Y "MAT x-axis" 0x8a740 NO_INPUT_QUANTITY RL_RFCM_NU_PUDDLEVAPTIME_Y 300.000000 CU_RFCM_NU_PUDDLEVAPTIME_Y 6 -100.0 200.0 BYTE_ORDER MSB_FIRST /end AXIS_PTS
/begin RECORD_LAYOUT RL_RFCM_NU_PUDDLEVAPTIME_Y AXIS_PTS_X 1 FLOAT32_IEEE INDEX_INCR DIRECT /end RECORD_LAYOUT
/begin COMPU_METHOD CU_RFCM_NU_PUDDLEVAPTIME_Y "Conversion method for RFCm_NU_PuddleVapTime_y" RAT_FUNC "%10.0" "C" COEFFS 0.000000 1.000000 0.000000 0.000000 0.000000 1.000000 /end COMPU_METHOD
/* Map (2d) calibration for DDE 'RFCm_NU_WallWetFraction_z'. */
/begin CHARACTERISTIC RFCm_NU_WallWetFraction_z "Amount of injected fuelmass that is taken by wall wetting and does not burn" MAP 0x8a81c RL_RFCM_NU_WALLWETFRACTION_Z 1.000000 CU_RFCM_NU_WALLWETFRACTION_Z 0.000000 1.000000
 /begin AXIS_DESCR COM_AXIS NO_INPUT_QUANTITY CU_RFCM_NU_WALLWETFRACTION_X 6 0.000000 10000.000000 AXIS_PTS_REF APD_RFCM_NU_WALLWETFRACTION_X /end AXIS_DESCR
 /begin AXIS_DESCR COM_AXIS NO_INPUT_QUANTITY CU_RFCM_NU_WALLWETFRACTION_Y 6 0.000000 720.000000 AXIS_PTS_REF APD_RFCM_NU_WALLWETFRACTION_Y /end AXIS_DESCR
 BYTE_ORDER MSB_FIRST /end CHARACTERISTIC
/begin RECORD_LAYOUT RL_RFCM_NU_WALLWETFRACTION_Z FNC_VALUES 1 FLOAT32_IEEE COLUMN_DIR DIRECT /end RECORD_LAYOUT
/begin COMPU_METHOD CU_RFCM_NU_WALLWETFRACTION_Z "Conversion method for RFCm_NU_WallWetFraction_z" RAT_FUNC "%10.2" "pct" COEFFS 0.000000 1.000000 0.000000 0.000000 0.000000 1.000000 /end COMPU_METHOD
/begin AXIS_PTS APD_RFCM_NU_WALLWETFRACTION_X "Engine Speed for calculation of wall wetting x-axis" 0x8a7ec NO_INPUT_QUANTITY RL_RFCM_NU_WALLWETFRACTION_X 10000.000000 CU_RFCM_NU_WALLWETFRACTION_X 6 0.0 10000.0 BYTE_ORDER MSB_FIRST /end AXIS_PTS
/begin RECORD_LAYOUT RL_RFCM_NU_WALLWETFRACTION_X AXIS_PTS_X 1 FLOAT32_IEEE INDEX_INCR DIRECT /end RECORD_LAYOUT
/begin COMPU_METHOD CU_RFCM_NU_WALLWETFRACTION_X "Conversion method for RFCm_NU_WallWetFraction_x" RAT_FUNC "%10.2" "RPM" COEFFS 0.000000 1.000000 0.000000 0.000000 0.000000 1.000000 /end COMPU_METHOD
/begin AXIS_PTS APD_RFCM_NU_WALLWETFRACTION_Y "Fuel Injection Time for calculating wall wetting y-axis" 0x8a804 NO_INPUT_QUANTITY RL_RFCM_NU_WALLWETFRACTION_Y 720.000000 CU_RFCM_NU_WALLWETFRACTION_Y 6 0.0 720.0 BYTE_ORDER MSB_FIRST /end AXIS_PTS
/begin RECORD_LAYOUT RL_RFCM_NU_WALLWETFRACTION_Y AXIS_PTS_X 1 FLOAT32_IEEE INDEX_INCR DIRECT /end RECORD_LAYOUT
/begin COMPU_METHOD CU_RFCM_NU_WALLWETFRACTION_Y "Conversion method for RFCm_NU_WallWetFraction_y" RAT_FUNC "%10.0" "adv" COEFFS 0.000000 1.000000 0.000000 0.000000 0.000000 1.000000 /end COMPU_METHOD
/* Scalar calibration for DDE 'SARc_NU_MBT_RiseRate'. */
/begin CHARACTERISTIC SARc_NU_MBT_RiseRate "(deg/s) Rising (advancing) rate limit on the BAS spark term for drivability improvements" VALUE 0x81984 RL_SARC_NU_MBT_RISERATE 999.000000 CU_SARC_NU_MBT_RISERATE 1.000000 1000.000000 BYTE_ORDER MSB_FIRST /end CHARACTERISTIC
/begin RECORD_LAYOUT RL_SARC_NU_MBT_RISERATE FNC_VALUES 1 FLOAT32_IEEE COLUMN_DIR DIRECT /end RECORD_LAYOUT
/begin COMPU_METHOD CU_SARC_NU_MBT_RISERATE "Conversion method for SARc_NU_MBT_RiseRate" RAT_FUNC "%10.0" "NU" COEFFS 0.000000 1.000000 0.000000 0.000000 0.000000 1.000000 /end COMPU_METHOD
/* Scalar calibration for DDE 'SARc_adv_RunningSparkMax'. */
/begin CHARACTERISTIC SARc_adv_RunningSparkMax "Maximum value of spark advance" VALUE 0x84f90 RL_SARC_ADV_RUNNINGSPARKMAX 45.000000 CU_SARC_ADV_RUNNINGSPARKMAX 25.000000 70.000000 BYTE_ORDER MSB_FIRST /end CHARACTERISTIC
/begin RECORD_LAYOUT RL_SARC_ADV_RUNNINGSPARKMAX FNC_VALUES 1 FLOAT32_IEEE COLUMN_DIR DIRECT /end RECORD_LAYOUT
/begin COMPU_METHOD CU_SARC_ADV_RUNNINGSPARKMAX "Conversion method for SARc_adv_RunningSparkMax" RAT_FUNC "%10.0" "adv" COEFFS 0.000000 1.000000 0.000000 0.000000 0.000000 1.000000 /end COMPU_METHOD
/* Scalar calibration for DDE 'SARc_adv_RunningSparkMin'. */
/begin CHARACTERISTIC SARc_adv_RunningSparkMin "Minimum value of spark advance" VALUE 0x84f94 RL_SARC_ADV_RUNNINGSPARKMIN 75.000000 CU_SARC_ADV_RUNNINGSPARKMIN -70.000000 5.000000 BYTE_ORDER MSB_FIRST /end CHARACTERISTIC
/begin RECORD_LAYOUT RL_SARC_ADV_RUNNINGSPARKMIN FNC_VALUES 1 FLOAT32_IEEE COLUMN_DIR DIRECT /end RECORD_LAYOUT
/begin COMPU_METHOD CU_SARC_ADV_RUNNINGSPARKMIN "Conversion method for SARc_adv_RunningSparkMin" RAT_FUNC "%10.0" "adv" COEFFS 0.000000 1.000000 0.000000 0.000000 0.000000 1.000000 /end COMPU_METHOD
/* Scalar calibration for DDE 'SARc_adv_SparkAng'. */
/begin CHARACTERISTIC SARc_adv_SparkAng "Arbitrated spark advance angle override value" VALUE 0x84f88 RL_SARC_ADV_SPARKANG 80.000000 CU_SARC_ADV_SPARKANG -40.000000 40.000000 BYTE_ORDER MSB_FIRST /end CHARACTERISTIC
/begin RECORD_LAYOUT RL_SARC_ADV_SPARKANG FNC_VALUES 1 FLOAT32_IEEE COLUMN_DIR DIRECT /end RECORD_LAYOUT
/begin COMPU_METHOD CU_SARC_ADV_SPARKANG "Conversion method for SARc_adv_SparkAng" RAT_FUNC "%10.1" "adv" COEFFS 0.000000 1.000000 0.000000 0.000000 0.000000 1.000000 /end COMPU_METHOD
/* Scalar calibration for DDE 'SARc_o_SparkAng'. */
/begin CHARACTERISTIC SARc_o_SparkAng "Arbitrated spark advance angle override flag" VALUE 0x84f84 RL_SARC_O_SPARKANG 1.000000 CU_SARC_O_SPARKANG 0.000000 1.000000 BYTE_ORDER MSB_FIRST /end CHARACTERISTIC
/begin RECORD_LAYOUT RL_SARC_O_SPARKANG FNC_VALUES 1 UBYTE COLUMN_DIR DIRECT /end RECORD_LAYOUT
/begin COMPU_METHOD CU_SARC_O_SPARKANG "Conversion method for SARc_o_SparkAng" RAT_FUNC "%10.0" "o" COEFFS 0.000000 1.000000 0.000000 0.000000 0.000000 1.000000 /end COMPU_METHOD
/* Scalar calibration for DDE 'SOVc_b_OpenValve1'. */
/begin CHARACTERISTIC SOVc_b_OpenValve1 "Calibration" VALUE 0x8d0a9 RL_SOVC_B_OPENVALVE1 1.000000 CU_SOVC_B_OPENVALVE1 0.000000 1.000000 BYTE_ORDER MSB_FIRST /end CHARACTERISTIC
/begin RECORD_LAYOUT RL_SOVC_B_OPENVALVE1 FNC_VALUES 1 UBYTE COLUMN_DIR DIRECT /end RECORD_LAYOUT
/begin COMPU_METHOD CU_SOVC_B_OPENVALVE1 "Conversion method for SOVc_b_OpenValve1" RAT_FUNC "%10.0" "b" COEFFS 0.000000 1.000000 0.000000 0.000000 0.000000 1.000000 /end COMPU_METHOD
/* Scalar calibration for DDE 'SOVc_b_OpenValve2'. */
/begin CHARACTERISTIC SOVc_b_OpenValve2 "Calibration" VALUE 0x8d0ab RL_SOVC_B_OPENVALVE2 1.000000 CU_SOVC_B_OPENVALVE2 0.000000 1.000000 BYTE_ORDER MSB_FIRST /end CHARACTERISTIC
/begin RECORD_LAYOUT RL_SOVC_B_OPENVALVE2 FNC_VALUES 1 UBYTE COLUMN_DIR DIRECT /end RECORD_LAYOUT
/begin COMPU_METHOD CU_SOVC_B_OPENVALVE2 "Conversion method for SOVc_b_OpenValve2" RAT_FUNC "%10.0" "b" COEFFS 0.000000 1.000000 0.000000 0.000000 0.000000 1.000000 /end COMPU_METHOD
/* Scalar calibration for DDE 'SOVc_o_OpenValve1'. */
/begin CHARACTERISTIC SOVc_o_OpenValve1 "Override" VALUE 0x8d0a8 RL_SOVC_O_OPENVALVE1 1.000000 CU_SOVC_O_OPENVALVE1 0.000000 1.000000 BYTE_ORDER MSB_FIRST /end CHARACTERISTIC
/begin RECORD_LAYOUT RL_SOVC_O_OPENVALVE1 FNC_VALUES 1 UBYTE COLUMN_DIR DIRECT /end RECORD_LAYOUT
/begin COMPU_METHOD CU_SOVC_O_OPENVALVE1 "Conversion method for SOVc_o_OpenValve1" RAT_FUNC "%10.0" "o" COEFFS 0.000000 1.000000 0.000000 0.000000 0.000000 1.000000 /end COMPU_METHOD
/* Scalar calibration for DDE 'SOVc_o_OpenValve2'. */
/begin CHARACTERISTIC SOVc_o_OpenValve2 "Override" VALUE 0x8d0aa RL_SOVC_O_OPENVALVE2 1.000000 CU_SOVC_O_OPENVALVE2 0.000000 1.000000 BYTE_ORDER MSB_FIRST /end CHARACTERISTIC
/begin RECORD_LAYOUT RL_SOVC_O_OPENVALVE2 FNC_VALUES 1 UBYTE COLUMN_DIR DIRECT /end RECORD_LAYOUT
/begin COMPU_METHOD CU_SOVC_O_OPENVALVE2 "Conversion method for SOVc_o_OpenValve2" RAT_FUNC "%10.0" "o" COEFFS 0.000000 1.000000 0.000000 0.000000 0.000000 1.000000 /end COMPU_METHOD
/* Scalar calibration for DDE 'SPTc_adv_CoilOffAng'. */
/begin CHARACTERISTIC SPTc_adv_CoilOffAng "Override value for spark coil off angle" VALUE 0x8be2c RL_SPTC_ADV_COILOFFANG 80.000000 CU_SPTC_ADV_COILOFFANG -40.000000 40.000000 BYTE_ORDER MSB_FIRST /end CHARACTERISTIC
/begin RECORD_LAYOUT RL_SPTC_ADV_COILOFFANG FNC_VALUES 1 FLOAT32_IEEE COLUMN_DIR DIRECT /end RECORD_LAYOUT
/begin COMPU_METHOD CU_SPTC_ADV_COILOFFANG "Conversion method for SPTc_adv_CoilOffAng" RAT_FUNC "%10.1" "adv" COEFFS 0.000000 1.000000 0.000000 0.000000 0.000000 1.000000 /end COMPU_METHOD
/* Scalar calibration for DDE 'SPTc_adv_CoilOnAng'. */
/begin CHARACTERISTIC SPTc_adv_CoilOnAng "Override value for spark coil on angle" VALUE 0x8be24 RL_SPTC_ADV_COILONANG 400.000000 CU_SPTC_ADV_COILONANG -40.000000 360.000000 BYTE_ORDER MSB_FIRST /end CHARACTERISTIC
/begin RECORD_LAYOUT RL_SPTC_ADV_COILONANG FNC_VALUES 1 FLOAT32_IEEE COLUMN_DIR DIRECT /end RECORD_LAYOUT
/begin COMPU_METHOD CU_SPTC_ADV_COILONANG "Conversion method for SPTc_adv_CoilOnAng" RAT_FUNC "%10.1" "adv" COEFFS 0.000000 1.000000 0.000000 0.000000 0.000000 1.000000 /end COMPU_METHOD
/* Scalar calibration for DDE 'SPTc_b_UseHalfVBatt'. */
/begin CHARACTERISTIC SPTc_b_UseHalfVBatt "Flag to allow switching between half of battery voltage/ full voltage (24V system)" VALUE 0x8b825 RL_SPTC_B_USEHALFVBATT 1.000000 CU_SPTC_B_USEHALFVBATT 0.000000 1.000000 BYTE_ORDER MSB_FIRST /end CHARACTERISTIC
/begin RECORD_LAYOUT RL_SPTC_B_USEHALFVBATT FNC_VALUES 1 UBYTE COLUMN_DIR DIRECT /end RECORD_LAYOUT
/begin COMPU_METHOD CU_SPTC_B_USEHALFVBATT "Conversion method for SPTc_b_UseHalfVBatt" RAT_FUNC "%10.0" "b" COEFFS 0.000000 1.000000 0.000000 0.000000 0.000000 1.000000 /end COMPU_METHOD
/* Scalar calibration for DDE 'SPTc_ms_MinDwellTime'. */
/begin CHARACTERISTIC SPTc_ms_MinDwellTime "Min Dwell Time" VALUE 0x8b858 RL_SPTC_MS_MINDWELLTIME 10.000000 CU_SPTC_MS_MINDWELLTIME 0.000000 10.000000 BYTE_ORDER MSB_FIRST /end CHARACTERISTIC
/begin RECORD_LAYOUT RL_SPTC_MS_MINDWELLTIME FNC_VALUES 1 FLOAT32_IEEE COLUMN_DIR DIRECT /end RECORD_LAYOUT
/begin COMPU_METHOD CU_SPTC_MS_MINDWELLTIME "Conversion method for SPTc_ms_MinDwellTime" RAT_FUNC "%10.3" "ms" COEFFS 0.000000 1.000000 0.000000 0.000000 0.000000 1.000000 /end COMPU_METHOD
/* Scalar calibration for DDE 'SPTc_ms_MinOffTime'. */
/begin CHARACTERISTIC SPTc_ms_MinOffTime "Dwell will be clipped to ensure this amount of coil off-time is provided at high engine speeds" VALUE 0x8b850 RL_SPTC_MS_MINOFFTIME 10.000000 CU_SPTC_MS_MINOFFTIME 0.000000 10.000000 BYTE_ORDER MSB_FIRST /end CHARACTERISTIC
/begin RECORD_LAYOUT RL_SPTC_MS_MINOFFTIME FNC_VALUES 1 FLOAT32_IEEE COLUMN_DIR DIRECT /end RECORD_LAYOUT
/begin COMPU_METHOD CU_SPTC_MS_MINOFFTIME "Conversion method for SPTc_ms_MinOffTime" RAT_FUNC "%10.3" "ms" COEFFS 0.000000 1.000000 0.000000 0.000000 0.000000 1.000000 /end COMPU_METHOD
/* Scalar calibration for DDE 'SPTc_o_CoilOffAng'. */
/begin CHARACTERISTIC SPTc_o_CoilOffAng "Override flag for spark coil off angle" VALUE 0x8be28 RL_SPTC_O_COILOFFANG 1.000000 CU_SPTC_O_COILOFFANG 0.000000 1.000000 BYTE_ORDER MSB_FIRST /end CHARACTERISTIC
/begin RECORD_LAYOUT RL_SPTC_O_COILOFFANG FNC_VALUES 1 UBYTE COLUMN_DIR DIRECT /end RECORD_LAYOUT
/begin COMPU_METHOD CU_SPTC_O_COILOFFANG "Conversion method for SPTc_o_CoilOffAng" RAT_FUNC "%10.0" "o" COEFFS 0.000000 1.000000 0.000000 0.000000 0.000000 1.000000 /end COMPU_METHOD
/* Scalar calibration for DDE 'SPTc_o_CoilOnAng'. */
/begin CHARACTERISTIC SPTc_o_CoilOnAng "Override flag for spark coil on angle" VALUE 0x8be20 RL_SPTC_O_COILONANG 1.000000 CU_SPTC_O_COILONANG 0.000000 1.000000 BYTE_ORDER MSB_FIRST /end CHARACTERISTIC
/begin RECORD_LAYOUT RL_SPTC_O_COILONANG FNC_VALUES 1 UBYTE COLUMN_DIR DIRECT /end RECORD_LAYOUT
/begin COMPU_METHOD CU_SPTC_O_COILONANG "Conversion method for SPTc_o_CoilOnAng" RAT_FUNC "%10.0" "o" COEFFS 0.000000 1.000000 0.000000 0.000000 0.000000 1.000000 /end COMPU_METHOD
/* Map (1d) calibration for DDE 'SPTm_NU_DwellTime_z'. */
/begin CHARACTERISTIC SPTm_NU_DwellTime_z "Spark dwell time table data" CURVE 0x8b83c RL_SPTM_NU_DWELLTIME_Z 10.000000 CU_SPTM_NU_DWELLTIME_Z 0.000000 10.000000
 /begin AXIS_DESCR COM_AXIS NO_INPUT_QUANTITY CU_SPTM_NU_DWELLTIME_X 5 0.000000 30.000000 AXIS_PTS_REF APD_SPTM_NU_DWELLTIME_X /end AXIS_DESCR
 BYTE_ORDER MSB_FIRST /end CHARACTERISTIC
/begin RECORD_LAYOUT RL_SPTM_NU_DWELLTIME_Z FNC_VALUES 1 FLOAT32_IEEE COLUMN_DIR DIRECT /end RECORD_LAYOUT
/begin COMPU_METHOD CU_SPTM_NU_DWELLTIME_Z "Conversion method for SPTm_NU_DwellTime_z" RAT_FUNC "%10.2" "ms" COEFFS 0.000000 1.000000 0.000000 0.000000 0.000000 1.000000 /end COMPU_METHOD
/begin AXIS_PTS APD_SPTM_NU_DWELLTIME_X "Spark dwell time table battery voltage axis" 0x8b828 NO_INPUT_QUANTITY RL_SPTM_NU_DWELLTIME_X 30.000000 CU_SPTM_NU_DWELLTIME_X 5 0.0 30.0 BYTE_ORDER MSB_FIRST /end AXIS_PTS
/begin RECORD_LAYOUT RL_SPTM_NU_DWELLTIME_X AXIS_PTS_X 1 FLOAT32_IEEE INDEX_INCR DIRECT /end RECORD_LAYOUT
/begin COMPU_METHOD CU_SPTM_NU_DWELLTIME_X "Conversion method for SPTm_NU_DwellTime_x" RAT_FUNC "%10.2" "V" COEFFS 0.000000 1.000000 0.000000 0.000000 0.000000 1.000000 /end COMPU_METHOD
/* Scalar calibration for DDE 'STRc_b_ManualStarter'. */
/begin CHARACTERISTIC STRc_b_ManualStarter "Override value" VALUE 0x8ce7d RL_STRC_B_MANUALSTARTER 1.000000 CU_STRC_B_MANUALSTARTER 0.000000 1.000000 BYTE_ORDER MSB_FIRST /end CHARACTERISTIC
/begin RECORD_LAYOUT RL_STRC_B_MANUALSTARTER FNC_VALUES 1 UBYTE COLUMN_DIR DIRECT /end RECORD_LAYOUT
/begin COMPU_METHOD CU_STRC_B_MANUALSTARTER "Conversion method for STRc_b_ManualStarter" RAT_FUNC "%10.0" "b" COEFFS 0.000000 1.000000 0.000000 0.000000 0.000000 1.000000 /end COMPU_METHOD
/* Scalar calibration for DDE 'STRc_o_ManualStarter'. */
/begin CHARACTERISTIC STRc_o_ManualStarter "Override flag" VALUE 0x8ce7c RL_STRC_O_MANUALSTARTER 1.000000 CU_STRC_O_MANUALSTARTER 0.000000 1.000000 BYTE_ORDER MSB_FIRST /end CHARACTERISTIC
/begin RECORD_LAYOUT RL_STRC_O_MANUALSTARTER FNC_VALUES 1 UBYTE COLUMN_DIR DIRECT /end RECORD_LAYOUT
/begin COMPU_METHOD CU_STRC_O_MANUALSTARTER "Conversion method for STRc_o_ManualStarter" RAT_FUNC "%10.0" "o" COEFFS 0.000000 1.000000 0.000000 0.000000 0.000000 1.000000 /end COMPU_METHOD
/* Scalar calibration for DDE 'SYSc_NU_CWG_GapRatioLongShort'. */
/begin CHARACTERISTIC SYSc_NU_CWG_GapRatioLongShort "Crank wheel configuration extended, Gap Ratio, long-short" VALUE 0x8d2c4 RL_SYSC_NU_CWG_GAPRATIOLONGSHO0 1.000000 CU_SYSC_NU_CWG_GAPRATIOLONGSHO0 0.000000 1.000000 BYTE_ORDER MSB_FIRST /end CHARACTERISTIC
/begin RECORD_LAYOUT RL_SYSC_NU_CWG_GAPRATIOLONGSHO0 FNC_VALUES 1 FLOAT32_IEEE COLUMN_DIR DIRECT /end RECORD_LAYOUT
/begin COMPU_METHOD CU_SYSC_NU_CWG_GAPRATIOLONGSHO0 "Conversion method for SYSc_NU_CWG_GapRatioLongShort" RAT_FUNC "%10.1" "NU" COEFFS 0.000000 1.000000 0.000000 0.000000 0.000000 1.000000 /end COMPU_METHOD
/* Scalar calibration for DDE 'SYSc_NU_CWG_GapRatioShortLong'. */
/begin CHARACTERISTIC SYSc_NU_CWG_GapRatioShortLong "Crank wheel configuration extended, Gap Ratio, short-long" VALUE 0x8d2c0 RL_SYSC_NU_CWG_GAPRATIOSHORTLO0 1.000000 CU_SYSC_NU_CWG_GAPRATIOSHORTLO0 0.000000 1.000000 BYTE_ORDER MSB_FIRST /end CHARACTERISTIC
/begin RECORD_LAYOUT RL_SYSC_NU_CWG_GAPRATIOSHORTLO0 FNC_VALUES 1 FLOAT32_IEEE COLUMN_DIR DIRECT /end RECORD_LAYOUT
/begin COMPU_METHOD CU_SYSC_NU_CWG_GAPRATIOSHORTLO0 "Conversion method for SYSc_NU_CWG_GapRatioShortLong" RAT_FUNC "%10.1" "NU" COEFFS 0.000000 1.000000 0.000000 0.000000 0.000000 1.000000 /end COMPU_METHOD
/* Scalar calibration for DDE 'SYSc_NU_CWG_NoiseRejRatioAcross'. */
/begin CHARACTERISTIC SYSc_NU_CWG_NoiseRejRatioAcross "Crank wheel configuration extended, Noise Rej Ratio, Across Teeth" VALUE 0x8d2c8 RL_SYSC_NU_CWG_NOISEREJRATIOAC0 1.000000 CU_SYSC_NU_CWG_NOISEREJRATIOAC0 0.000000 1.000000 BYTE_ORDER MSB_FIRST /end CHARACTERISTIC
/begin RECORD_LAYOUT RL_SYSC_NU_CWG_NOISEREJRATIOAC0 FNC_VALUES 1 FLOAT32_IEEE COLUMN_DIR DIRECT /end RECORD_LAYOUT
/begin COMPU_METHOD CU_SYSC_NU_CWG_NOISEREJRATIOAC0 "Conversion method for SYSc_NU_CWG_NoiseRejRatioAcross" RAT_FUNC "%10.1" "NU" COEFFS 0.000000 1.000000 0.000000 0.000000 0.000000 1.000000 /end COMPU_METHOD
/* Scalar calibration for DDE 'SYSc_NU_CWG_NoiseRejRatioAfter'. */
/begin CHARACTERISTIC SYSc_NU_CWG_NoiseRejRatioAfter "Crank wheel configuration extended, Noise Rej Ratio, After" VALUE 0x8d2d0 RL_SYSC_NU_CWG_NOISEREJRATIOAF0 1.000000 CU_SYSC_NU_CWG_NOISEREJRATIOAF0 0.000000 1.000000 BYTE_ORDER MSB_FIRST /end CHARACTERISTIC
/begin RECORD_LAYOUT RL_SYSC_NU_CWG_NOISEREJRATIOAF0 FNC_VALUES 1 FLOAT32_IEEE COLUMN_DIR DIRECT /end RECORD_LAYOUT
/begin COMPU_METHOD CU_SYSC_NU_CWG_NOISEREJRATIOAF0 "Conversion method for SYSc_NU_CWG_NoiseRejRatioAfter" RAT_FUNC "%10.1" "NU" COEFFS 0.000000 1.000000 0.000000 0.000000 0.000000 1.000000 /end COMPU_METHOD
/* Scalar calibration for DDE 'SYSc_NU_CWG_NoiseRejRatioNormal'. */
/begin CHARACTERISTIC SYSc_NU_CWG_NoiseRejRatioNormal "Crank wheel configuration extended, Noise Rej Ratio, Normal" VALUE 0x8d2d8 RL_SYSC_NU_CWG_NOISEREJRATIONO0 1.000000 CU_SYSC_NU_CWG_NOISEREJRATIONO0 0.000000 1.000000 BYTE_ORDER MSB_FIRST /end CHARACTERISTIC
/begin RECORD_LAYOUT RL_SYSC_NU_CWG_NOISEREJRATIONO0 FNC_VALUES 1 FLOAT32_IEEE COLUMN_DIR DIRECT /end RECORD_LAYOUT
/begin COMPU_METHOD CU_SYSC_NU_CWG_NOISEREJRATIONO0 "Conversion method for SYSc_NU_CWG_NoiseRejRatioNormal" RAT_FUNC "%10.1" "NU" COEFFS 0.000000 1.000000 0.000000 0.000000 0.000000 1.000000 /end COMPU_METHOD
/* Scalar calibration for DDE 'SYSc_NU_CWG_NoiseRejRatioTOTth'. */
/begin CHARACTERISTIC SYSc_NU_CWG_NoiseRejRatioTOTth "Crank wheel configuration extended, Noise Rej Ratio, Timeout Tooth" VALUE 0x8d2e0 RL_SYSC_NU_CWG_NOISEREJRATIOTO0 1.000000 CU_SYSC_NU_CWG_NOISEREJRATIOTO0 0.000000 1.000000 BYTE_ORDER MSB_FIRST /end CHARACTERISTIC
/begin RECORD_LAYOUT RL_SYSC_NU_CWG_NOISEREJRATIOTO0 FNC_VALUES 1 FLOAT32_IEEE COLUMN_DIR DIRECT /end RECORD_LAYOUT
/begin COMPU_METHOD CU_SYSC_NU_CWG_NOISEREJRATIOTO0 "Conversion method for SYSc_NU_CWG_NoiseRejRatioTOTth" RAT_FUNC "%10.1" "NU" COEFFS 0.000000 1.000000 0.000000 0.000000 0.000000 1.000000 /end COMPU_METHOD
/* Scalar calibration for DDE 'SYSc_NU_CWG_SkipTeeth'. */
/begin CHARACTERISTIC SYSc_NU_CWG_SkipTeeth "Crank wheel configuration extended, skip teeth" VALUE 0x8d2b8 RL_SYSC_NU_CWG_SKIPTEETH 255.000000 CU_SYSC_NU_CWG_SKIPTEETH 0.000000 255.000000 BYTE_ORDER MSB_FIRST /end CHARACTERISTIC
/begin RECORD_LAYOUT RL_SYSC_NU_CWG_SKIPTEETH FNC_VALUES 1 UBYTE COLUMN_DIR DIRECT /end RECORD_LAYOUT
/begin COMPU_METHOD CU_SYSC_NU_CWG_SKIPTEETH "Conversion method for SYSc_NU_CWG_SkipTeeth" RAT_FUNC "%10.0" "NU" COEFFS 0.000000 1.000000 0.000000 0.000000 0.000000 1.000000 /end COMPU_METHOD
/* Scalar calibration for DDE 'SYSc_NU_CWG_StallDetRatioAcross'. */
/begin CHARACTERISTIC SYSc_NU_CWG_StallDetRatioAcross "Crank wheel configuration extended, Stall Det Ratio, Across Teeth" VALUE 0x8d2cc RL_SYSC_NU_CWG_STALLDETRATIOAC0 4.000000 CU_SYSC_NU_CWG_STALLDETRATIOAC0 0.000000 4.000000 BYTE_ORDER MSB_FIRST /end CHARACTERISTIC
/begin RECORD_LAYOUT RL_SYSC_NU_CWG_STALLDETRATIOAC0 FNC_VALUES 1 FLOAT32_IEEE COLUMN_DIR DIRECT /end RECORD_LAYOUT
/begin COMPU_METHOD CU_SYSC_NU_CWG_STALLDETRATIOAC0 "Conversion method for SYSc_NU_CWG_StallDetRatioAcross" RAT_FUNC "%10.1" "NU" COEFFS 0.000000 1.000000 0.000000 0.000000 0.000000 1.000000 /end COMPU_METHOD
/* Scalar calibration for DDE 'SYSc_NU_CWG_StallDetRatioAfter'. */
/begin CHARACTERISTIC SYSc_NU_CWG_StallDetRatioAfter "Crank wheel configuration extended, Stall Det Ratio, After" VALUE 0x8d2d4 RL_SYSC_NU_CWG_STALLDETRATIOAF0 4.000000 CU_SYSC_NU_CWG_STALLDETRATIOAF0 0.000000 4.000000 BYTE_ORDER MSB_FIRST /end CHARACTERISTIC
/begin RECORD_LAYOUT RL_SYSC_NU_CWG_STALLDETRATIOAF0 FNC_VALUES 1 FLOAT32_IEEE COLUMN_DIR DIRECT /end RECORD_LAYOUT
/begin COMPU_METHOD CU_SYSC_NU_CWG_STALLDETRATIOAF0 "Conversion method for SYSc_NU_CWG_StallDetRatioAfter" RAT_FUNC "%10.1" "NU" COEFFS 0.000000 1.000000 0.000000 0.000000 0.000000 1.000000 /end COMPU_METHOD
/* Scalar calibration for DDE 'SYSc_NU_CWG_StallDetRatioNorm'. */
/begin CHARACTERISTIC SYSc_NU_CWG_StallDetRatioNorm "Crank wheel configuration extended, Stall Det Ratio, Norm" VALUE 0x8d2dc RL_SYSC_NU_CWG_STALLDETRATIONO0 4.000000 CU_SYSC_NU_CWG_STALLDETRATIONO0 0.000000 4.000000 BYTE_ORDER MSB_FIRST /end CHARACTERISTIC
/begin RECORD_LAYOUT RL_SYSC_NU_CWG_STALLDETRATIONO0 FNC_VALUES 1 FLOAT32_IEEE COLUMN_DIR DIRECT /end RECORD_LAYOUT
/begin COMPU_METHOD CU_SYSC_NU_CWG_STALLDETRATIONO0 "Conversion method for SYSc_NU_CWG_StallDetRatioNorm" RAT_FUNC "%10.1" "NU" COEFFS 0.000000 1.000000 0.000000 0.000000 0.000000 1.000000 /end COMPU_METHOD
/* Scalar calibration for DDE 'SYSc_NU_CWG_StallDetRatioTOTth'. */
/begin CHARACTERISTIC SYSc_NU_CWG_StallDetRatioTOTth "Crank wheel configuration extended, Stall Det Ratio, Timeout Tooth" VALUE 0x8d2e4 RL_SYSC_NU_CWG_STALLDETRATIOTO0 4.000000 CU_SYSC_NU_CWG_STALLDETRATIOTO0 0.000000 4.000000 BYTE_ORDER MSB_FIRST /end CHARACTERISTIC
/begin RECORD_LAYOUT RL_SYSC_NU_CWG_STALLDETRATIOTO0 FNC_VALUES 1 FLOAT32_IEEE COLUMN_DIR DIRECT /end RECORD_LAYOUT
/begin COMPU_METHOD CU_SYSC_NU_CWG_STALLDETRATIOTO0 "Conversion method for SYSc_NU_CWG_StallDetRatioTOTth" RAT_FUNC "%10.1" "NU" COEFFS 0.000000 1.000000 0.000000 0.000000 0.000000 1.000000 /end COMPU_METHOD
/* Scalar calibration for DDE 'SYSc_NU_EngSyncReq'. */
/begin CHARACTERISTIC SYSc_NU_EngSyncReq "SYSk_e_NoSync,SYSk_e_CrankRegionSync,SYSk_e_HalfEngSync,SYSk_e_FullEngSync" VALUE 0x8bf98 RL_SYSC_NU_ENGSYNCREQ 3.000000 CU_SYSC_NU_ENGSYNCREQ 0.000000 3.000000 BYTE_ORDER MSB_FIRST /end CHARACTERISTIC
/begin RECORD_LAYOUT RL_SYSC_NU_ENGSYNCREQ FNC_VALUES 1 FLOAT32_IEEE COLUMN_DIR DIRECT /end RECORD_LAYOUT
/begin COMPU_METHOD CU_SYSC_NU_ENGSYNCREQ "Conversion method for SYSc_NU_EngSyncReq" RAT_FUNC "%10.0" "NU" COEFFS 0.000000 1.000000 0.000000 0.000000 0.000000 1.000000 /end COMPU_METHOD
/* Scalar calibration for DDE 'SYSc_NU_MaxMissfire'. */
/begin CHARACTERISTIC SYSc_NU_MaxMissfire "Umbral disparo ventilador inferior" VALUE 0x8c4bc RL_SYSC_NU_MAXMISSFIRE 255.000000 CU_SYSC_NU_MAXMISSFIRE 0.000000 255.000000 BYTE_ORDER MSB_FIRST /end CHARACTERISTIC
/begin RECORD_LAYOUT RL_SYSC_NU_MAXMISSFIRE FNC_VALUES 1 UBYTE COLUMN_DIR DIRECT /end RECORD_LAYOUT
/begin COMPU_METHOD CU_SYSC_NU_MAXMISSFIRE "Conversion method for SYSc_NU_MaxMissfire" RAT_FUNC "%10.0" "NU" COEFFS 0.000000 1.000000 0.000000 0.000000 0.000000 1.000000 /end COMPU_METHOD
/* Scalar calibration for DDE 'SYSc_Nm_ManualTqRqst'. */
/begin CHARACTERISTIC SYSc_Nm_ManualTqRqst "Manual input to TAR" VALUE 0x83448 RL_SYSC_NM_MANUALTQRQST 250.000000 CU_SYSC_NM_MANUALTQRQST -200.000000 50.000000 BYTE_ORDER MSB_FIRST /end CHARACTERISTIC
/begin RECORD_LAYOUT RL_SYSC_NM_MANUALTQRQST FNC_VALUES 1 FLOAT32_IEEE COLUMN_DIR DIRECT /end RECORD_LAYOUT
/begin COMPU_METHOD CU_SYSC_NM_MANUALTQRQST "Conversion method for SYSc_Nm_ManualTqRqst" RAT_FUNC "%10.1" "Nm" COEFFS 0.000000 1.000000 0.000000 0.000000 0.000000 1.000000 /end COMPU_METHOD
/* Scalar calibration for DDE 'SYSc_adv_ManualSparkOfst'. */
/begin CHARACTERISTIC SYSc_adv_ManualSparkOfst "Manual advance term input to SAR" VALUE 0x84f8c RL_SYSC_ADV_MANUALSPARKOFST 40.000000 CU_SYSC_ADV_MANUALSPARKOFST -20.000000 20.000000 BYTE_ORDER MSB_FIRST /end CHARACTERISTIC
/begin RECORD_LAYOUT RL_SYSC_ADV_MANUALSPARKOFST FNC_VALUES 1 FLOAT32_IEEE COLUMN_DIR DIRECT /end RECORD_LAYOUT
/begin COMPU_METHOD CU_SYSC_ADV_MANUALSPARKOFST "Conversion method for SYSc_adv_ManualSparkOfst" RAT_FUNC "%10.1" "adv" COEFFS 0.000000 1.000000 0.000000 0.000000 0.000000 1.000000 /end COMPU_METHOD
/* Scalar calibration for DDE 'SYSc_b_CrankAngValid'. */
/begin CHARACTERISTIC SYSc_b_CrankAngValid "Override value" VALUE 0x8c4cd RL_SYSC_B_CRANKANGVALID 1.000000 CU_SYSC_B_CRANKANGVALID 0.000000 1.000000 BYTE_ORDER MSB_FIRST /end CHARACTERISTIC
/begin RECORD_LAYOUT RL_SYSC_B_CRANKANGVALID FNC_VALUES 1 UBYTE COLUMN_DIR DIRECT /end RECORD_LAYOUT
/begin COMPU_METHOD CU_SYSC_B_CRANKANGVALID "Conversion method for SYSc_b_CrankAngValid" RAT_FUNC "%10.0" "b" COEFFS 0.000000 1.000000 0.000000 0.000000 0.000000 1.000000 /end COMPU_METHOD
/* Scalar calibration for DDE 'SYSc_b_ModuleReset'. */
/begin CHARACTERISTIC SYSc_b_ModuleReset "Trigger ECU reboot" VALUE 0x8d2ae RL_SYSC_B_MODULERESET 1.000000 CU_SYSC_B_MODULERESET 0.000000 1.000000 BYTE_ORDER MSB_FIRST /end CHARACTERISTIC
/begin RECORD_LAYOUT RL_SYSC_B_MODULERESET FNC_VALUES 1 UBYTE COLUMN_DIR DIRECT /end RECORD_LAYOUT
/begin COMPU_METHOD CU_SYSC_B_MODULERESET "Conversion method for SYSc_b_ModuleReset" RAT_FUNC "%10.0" "b" COEFFS 0.000000 1.000000 0.000000 0.000000 0.000000 1.000000 /end COMPU_METHOD
/* Scalar calibration for DDE 'SYSc_b_TransmitVIN'. */
/begin CHARACTERISTIC SYSc_b_TransmitVIN "(not defined)" VALUE 0x80414 RL_SYSC_B_TRANSMITVIN 1.000000 CU_SYSC_B_TRANSMITVIN 0.000000 1.000000 BYTE_ORDER MSB_FIRST /end CHARACTERISTIC
/begin RECORD_LAYOUT RL_SYSC_B_TRANSMITVIN FNC_VALUES 1 UBYTE COLUMN_DIR DIRECT /end RECORD_LAYOUT
/begin COMPU_METHOD CU_SYSC_B_TRANSMITVIN "Conversion method for SYSc_b_TransmitVIN" RAT_FUNC "%10.0" "b" COEFFS 0.000000 1.000000 0.000000 0.000000 0.000000 1.000000 /end COMPU_METHOD
/* Scalar calibration for DDE 'SYSc_b_TurboPrsnt'. */
/begin CHARACTERISTIC SYSc_b_TurboPrsnt "Turbo Prsnt" VALUE 0x860fc RL_SYSC_B_TURBOPRSNT 1.000000 CU_SYSC_B_TURBOPRSNT 0.000000 1.000000 BYTE_ORDER MSB_FIRST /end CHARACTERISTIC
/begin RECORD_LAYOUT RL_SYSC_B_TURBOPRSNT FNC_VALUES 1 UBYTE COLUMN_DIR DIRECT /end RECORD_LAYOUT
/begin COMPU_METHOD CU_SYSC_B_TURBOPRSNT "Conversion method for SYSc_b_TurboPrsnt" RAT_FUNC "%10.0" "b" COEFFS 0.000000 1.000000 0.000000 0.000000 0.000000 1.000000 /end COMPU_METHOD
/* Scalar calibration for DDE 'SYSc_b_UseAND'. */
/begin CHARACTERISTIC SYSc_b_UseAND "(not defined)" VALUE 0x8bf8a RL_SYSC_B_USEAND 1.000000 CU_SYSC_B_USEAND 0.000000 1.000000 BYTE_ORDER MSB_FIRST /end CHARACTERISTIC
/begin RECORD_LAYOUT RL_SYSC_B_USEAND FNC_VALUES 1 UBYTE COLUMN_DIR DIRECT /end RECORD_LAYOUT
/begin COMPU_METHOD CU_SYSC_B_USEAND "Conversion method for SYSc_b_UseAND" RAT_FUNC "%10.0" "b" COEFFS 0.000000 1.000000 0.000000 0.000000 0.000000 1.000000 /end COMPU_METHOD
/* Scalar calibration for DDE 'SYSc_b_VCP'. */
/begin CHARACTERISTIC SYSc_b_VCP "VCP" VALUE 0x86fa4 RL_SYSC_B_VCP 1.000000 CU_SYSC_B_VCP 0.000000 1.000000 BYTE_ORDER MSB_FIRST /end CHARACTERISTIC
/begin RECORD_LAYOUT RL_SYSC_B_VCP FNC_VALUES 1 UBYTE COLUMN_DIR DIRECT /end RECORD_LAYOUT
/begin COMPU_METHOD CU_SYSC_B_VCP "Conversion method for SYSc_b_VCP" RAT_FUNC "%10.0" "b" COEFFS 0.000000 1.000000 0.000000 0.000000 0.000000 1.000000 /end COMPU_METHOD
/* Scalar calibration for DDE 'SYSc_cc_EngDisp'. */
/begin CHARACTERISTIC SYSc_cc_EngDisp "Engine Displazament" VALUE 0x80a60 RL_SYSC_CC_ENGDISP 10000.000000 CU_SYSC_CC_ENGDISP 0.000000 10000.000000 BYTE_ORDER MSB_FIRST /end CHARACTERISTIC
/begin RECORD_LAYOUT RL_SYSC_CC_ENGDISP FNC_VALUES 1 FLOAT32_IEEE COLUMN_DIR DIRECT /end RECORD_LAYOUT
/begin COMPU_METHOD CU_SYSC_CC_ENGDISP "Conversion method for SYSc_cc_EngDisp" RAT_FUNC "%10.0" "cc" COEFFS 0.000000 1.000000 0.000000 0.000000 0.000000 1.000000 /end COMPU_METHOD
/* Scalar calibration for DDE 'SYSc_cnt_NumOfCyls'. */
/begin CHARACTERISTIC SYSc_cnt_NumOfCyls "Num cilindros" VALUE 0x80a64 RL_SYSC_CNT_NUMOFCYLS 10.000000 CU_SYSC_CNT_NUMOFCYLS 0.000000 10.000000 BYTE_ORDER MSB_FIRST /end CHARACTERISTIC
/begin RECORD_LAYOUT RL_SYSC_CNT_NUMOFCYLS FNC_VALUES 1 FLOAT32_IEEE COLUMN_DIR DIRECT /end RECORD_LAYOUT
/begin COMPU_METHOD CU_SYSC_CNT_NUMOFCYLS "Conversion method for SYSc_cnt_NumOfCyls" RAT_FUNC "%10.0" "cnt" COEFFS 0.000000 1.000000 0.000000 0.000000 0.000000 1.000000 /end COMPU_METHOD
/* Scalar calibration for DDE 'SYSc_deg_AngTaskCalc'. */
/begin CHARACTERISTIC SYSc_deg_AngTaskCalc "(not defined)" VALUE 0x8d4f8 RL_SYSC_DEG_ANGTASKCALC 1440.000000 CU_SYSC_DEG_ANGTASKCALC -720.000000 720.000000 BYTE_ORDER MSB_FIRST /end CHARACTERISTIC
/begin RECORD_LAYOUT RL_SYSC_DEG_ANGTASKCALC FNC_VALUES 1 FLOAT32_IEEE COLUMN_DIR DIRECT /end RECORD_LAYOUT
/begin COMPU_METHOD CU_SYSC_DEG_ANGTASKCALC "Conversion method for SYSc_deg_AngTaskCalc" RAT_FUNC "%10.3" "deg" COEFFS 0.000000 1.000000 0.000000 0.000000 0.000000 1.000000 /end COMPU_METHOD
/* Scalar calibration for DDE 'SYSc_deg_EngAngOfstReq'. */
/begin CHARACTERISTIC SYSc_deg_EngAngOfstReq "(not defined)" VALUE 0x8bfa0 RL_SYSC_DEG_ENGANGOFSTREQ 1440.000000 CU_SYSC_DEG_ENGANGOFSTREQ -720.000000 720.000000 BYTE_ORDER MSB_FIRST /end CHARACTERISTIC
/begin RECORD_LAYOUT RL_SYSC_DEG_ENGANGOFSTREQ FNC_VALUES 1 FLOAT32_IEEE COLUMN_DIR DIRECT /end RECORD_LAYOUT
/begin COMPU_METHOD CU_SYSC_DEG_ENGANGOFSTREQ "Conversion method for SYSc_deg_EngAngOfstReq" RAT_FUNC "%10.3" "deg" COEFFS 0.000000 1.000000 0.000000 0.000000 0.000000 1.000000 /end COMPU_METHOD
/* Scalar calibration for DDE 'SYSc_deg_SyncEndAngle'. */
/begin CHARACTERISTIC SYSc_deg_SyncEndAngle "(not defined)" VALUE 0x8bf90 RL_SYSC_DEG_SYNCENDANGLE 720.000000 CU_SYSC_DEG_SYNCENDANGLE 0.000000 720.000000 BYTE_ORDER MSB_FIRST /end CHARACTERISTIC
/begin RECORD_LAYOUT RL_SYSC_DEG_SYNCENDANGLE FNC_VALUES 1 FLOAT32_IEEE COLUMN_DIR DIRECT /end RECORD_LAYOUT
/begin COMPU_METHOD CU_SYSC_DEG_SYNCENDANGLE "Conversion method for SYSc_deg_SyncEndAngle" RAT_FUNC "%10.0" "deg" COEFFS 0.000000 1.000000 0.000000 0.000000 0.000000 1.000000 /end COMPU_METHOD
/* Scalar calibration for DDE 'SYSc_deg_SyncStartAngle'. */
/begin CHARACTERISTIC SYSc_deg_SyncStartAngle "(not defined)" VALUE 0x8bf8c RL_SYSC_DEG_SYNCSTARTANGLE 720.000000 CU_SYSC_DEG_SYNCSTARTANGLE 0.000000 720.000000 BYTE_ORDER MSB_FIRST /end CHARACTERISTIC
/begin RECORD_LAYOUT RL_SYSC_DEG_SYNCSTARTANGLE FNC_VALUES 1 FLOAT32_IEEE COLUMN_DIR DIRECT /end RECORD_LAYOUT
/begin COMPU_METHOD CU_SYSC_DEG_SYNCSTARTANGLE "Conversion method for SYSc_deg_SyncStartAngle" RAT_FUNC "%10.0" "deg" COEFFS 0.000000 1.000000 0.000000 0.000000 0.000000 1.000000 /end COMPU_METHOD
/* Scalar calibration for DDE 'SYSc_ms_CWG_FirstToothTimeout'. */
/begin CHARACTERISTIC SYSc_ms_CWG_FirstToothTimeout "Crank wheel configuration extended, first tooth timeout" VALUE 0x8d2bc RL_SYSC_MS_CWG_FIRSTTOOTHTIMEO0 1000.000000 CU_SYSC_MS_CWG_FIRSTTOOTHTIMEO0 0.000000 1000.000000 BYTE_ORDER MSB_FIRST /end CHARACTERISTIC
/begin RECORD_LAYOUT RL_SYSC_MS_CWG_FIRSTTOOTHTIMEO0 FNC_VALUES 1 FLOAT32_IEEE COLUMN_DIR DIRECT /end RECORD_LAYOUT
/begin COMPU_METHOD CU_SYSC_MS_CWG_FIRSTTOOTHTIMEO0 "Conversion method for SYSc_ms_CWG_FirstToothTimeout" RAT_FUNC "%10.1" "ms" COEFFS 0.000000 1.000000 0.000000 0.000000 0.000000 1.000000 /end COMPU_METHOD
/* Scalar calibration for DDE 'SYSc_ms_InjDeadTime'. */
/begin CHARACTERISTIC SYSc_ms_InjDeadTime "Configures the minimum off-time between injection pulses" VALUE 0x8d4e0 RL_SYSC_MS_INJDEADTIME 9.900000 CU_SYSC_MS_INJDEADTIME 0.100000 10.000000 BYTE_ORDER MSB_FIRST /end CHARACTERISTIC
/begin RECORD_LAYOUT RL_SYSC_MS_INJDEADTIME FNC_VALUES 1 FLOAT32_IEEE COLUMN_DIR DIRECT /end RECORD_LAYOUT
/begin COMPU_METHOD CU_SYSC_MS_INJDEADTIME "Conversion method for SYSc_ms_InjDeadTime" RAT_FUNC "%10.1" "ms" COEFFS 0.000000 1.000000 0.000000 0.000000 0.000000 1.000000 /end COMPU_METHOD
/* Scalar calibration for DDE 'SYSc_ms_MinInjTime'. */
/begin CHARACTERISTIC SYSc_ms_MinInjTime "Configures the minimum injection duration" VALUE 0x8d4dc RL_SYSC_MS_MININJTIME 10.000000 CU_SYSC_MS_MININJTIME 0.000000 10.000000 BYTE_ORDER MSB_FIRST /end CHARACTERISTIC
/begin RECORD_LAYOUT RL_SYSC_MS_MININJTIME FNC_VALUES 1 FLOAT32_IEEE COLUMN_DIR DIRECT /end RECORD_LAYOUT
/begin COMPU_METHOD CU_SYSC_MS_MININJTIME "Conversion method for SYSc_ms_MinInjTime" RAT_FUNC "%10.1" "ms" COEFFS 0.000000 1.000000 0.000000 0.000000 0.000000 1.000000 /end COMPU_METHOD
/* Scalar calibration for DDE 'SYSc_o_CrankAngValid'. */
/begin CHARACTERISTIC SYSc_o_CrankAngValid "Override flag" VALUE 0x8c4cc RL_SYSC_O_CRANKANGVALID 1.000000 CU_SYSC_O_CRANKANGVALID 0.000000 1.000000 BYTE_ORDER MSB_FIRST /end CHARACTERISTIC
/begin RECORD_LAYOUT RL_SYSC_O_CRANKANGVALID FNC_VALUES 1 UBYTE COLUMN_DIR DIRECT /end RECORD_LAYOUT
/begin COMPU_METHOD CU_SYSC_O_CRANKANGVALID "Conversion method for SYSc_o_CrankAngValid" RAT_FUNC "%10.0" "o" COEFFS 0.000000 1.000000 0.000000 0.000000 0.000000 1.000000 /end COMPU_METHOD
/* Scalar calibration for DDE 'SYSc_o_EngAngOfstReq'. */
/begin CHARACTERISTIC SYSc_o_EngAngOfstReq "(not defined)" VALUE 0x8bf9c RL_SYSC_O_ENGANGOFSTREQ 1.000000 CU_SYSC_O_ENGANGOFSTREQ 0.000000 1.000000 BYTE_ORDER MSB_FIRST /end CHARACTERISTIC
/begin RECORD_LAYOUT RL_SYSC_O_ENGANGOFSTREQ FNC_VALUES 1 UBYTE COLUMN_DIR DIRECT /end RECORD_LAYOUT
/begin COMPU_METHOD CU_SYSC_O_ENGANGOFSTREQ "Conversion method for SYSc_o_EngAngOfstReq" RAT_FUNC "%10.0" "b" COEFFS 0.000000 1.000000 0.000000 0.000000 0.000000 1.000000 /end COMPU_METHOD
/* Scalar calibration for DDE 'SYSc_o_EngSyncReq'. */
/begin CHARACTERISTIC SYSc_o_EngSyncReq "(not defined)" VALUE 0x8bf94 RL_SYSC_O_ENGSYNCREQ 1.000000 CU_SYSC_O_ENGSYNCREQ 0.000000 1.000000 BYTE_ORDER MSB_FIRST /end CHARACTERISTIC
/begin RECORD_LAYOUT RL_SYSC_O_ENGSYNCREQ FNC_VALUES 1 UBYTE COLUMN_DIR DIRECT /end RECORD_LAYOUT
/begin COMPU_METHOD CU_SYSC_O_ENGSYNCREQ "Conversion method for SYSc_o_EngSyncReq" RAT_FUNC "%10.0" "b" COEFFS 0.000000 1.000000 0.000000 0.000000 0.000000 1.000000 /end COMPU_METHOD
/* Scalar calibration for DDE 'SYSc_pct_ManualFuelTrim'. */
/begin CHARACTERISTIC SYSc_pct_ManualFuelTrim "Manual gain to BAF fuelmass request (mixture screw)" VALUE 0x84b04 RL_SYSC_PCT_MANUALFUELTRIM 0.800000 CU_SYSC_PCT_MANUALFUELTRIM -0.300000 0.500000 BYTE_ORDER MSB_FIRST /end CHARACTERISTIC
/begin RECORD_LAYOUT RL_SYSC_PCT_MANUALFUELTRIM FNC_VALUES 1 FLOAT32_IEEE COLUMN_DIR DIRECT /end RECORD_LAYOUT
/begin COMPU_METHOD CU_SYSC_PCT_MANUALFUELTRIM "Conversion method for SYSc_pct_ManualFuelTrim" RAT_FUNC "%10.2" "pct" COEFFS 0.000000 1.000000 0.000000 0.000000 0.000000 1.000000 /end COMPU_METHOD
/* Scalar calibration for DDE 'SYSc_ret_InjDropDeadAng'. */
/begin CHARACTERISTIC SYSc_ret_InjDropDeadAng "Cylinder TDC-relative degrees: Injections that are requested after this angle will be ignored." VALUE 0x8043c RL_SYSC_RET_INJDROPDEADANG 720.000000 CU_SYSC_RET_INJDROPDEADANG 0.000000 720.000000 BYTE_ORDER MSB_FIRST /end CHARACTERISTIC
/begin RECORD_LAYOUT RL_SYSC_RET_INJDROPDEADANG FNC_VALUES 1 FLOAT32_IEEE COLUMN_DIR DIRECT /end RECORD_LAYOUT
/begin COMPU_METHOD CU_SYSC_RET_INJDROPDEADANG "Conversion method for SYSc_ret_InjDropDeadAng" RAT_FUNC "%10.0" "deg" COEFFS 0.000000 1.000000 0.000000 0.000000 0.000000 1.000000 /end COMPU_METHOD
/* Vector/array calibration for DDE 'SYSv_cnt_CylIndex'. */
/begin CHARACTERISTIC SYSv_cnt_CylIndex "NOT CALIBRATABLE; Cylinder index numbers (must be monotonic ie [1 2 3 4 5 6] for 6cyl engine); This is used to index per-cylinder vectors in the app" VAL_BLK 0x8a8b0 RL_SYSV_CNT_CYLINDEX 3.000000 CU_SYSV_CNT_CYLINDEX 1.000000 4.000000 NUMBER 4 BYTE_ORDER MSB_FIRST /end CHARACTERISTIC
/begin RECORD_LAYOUT RL_SYSV_CNT_CYLINDEX FNC_VALUES 1 UBYTE COLUMN_DIR DIRECT /end RECORD_LAYOUT
/begin COMPU_METHOD CU_SYSV_CNT_CYLINDEX "Conversion method for SYSv_cnt_CylIndex" RAT_FUNC "%10.0" "cnt" COEFFS 0.000000 1.000000 0.000000 0.000000 0.000000 1.000000 /end COMPU_METHOD
/* Vector/array calibration for DDE 'SYSv_deg_TDC_Angles'. */
/begin CHARACTERISTIC SYSv_deg_TDC_Angles "Cylinder TDC angles" VAL_BLK 0x8a710 RL_SYSV_DEG_TDC_ANGLES 719.000000 CU_SYSV_DEG_TDC_ANGLES 0.000000 719.000000 NUMBER 4 BYTE_ORDER MSB_FIRST /end CHARACTERISTIC
/begin RECORD_LAYOUT RL_SYSV_DEG_TDC_ANGLES FNC_VALUES 1 FLOAT32_IEEE COLUMN_DIR DIRECT /end RECORD_LAYOUT
/begin COMPU_METHOD CU_SYSV_DEG_TDC_ANGLES "Conversion method for SYSv_deg_TDC_Angles" RAT_FUNC "%10.0" "deg" COEFFS 0.000000 1.000000 0.000000 0.000000 0.000000 1.000000 /end COMPU_METHOD
/* Scalar calibration for DDE 'TARc_Hz_BrakeTqLPF'. */
/begin CHARACTERISTIC TARc_Hz_BrakeTqLPF "Brake torque request lowpass filter" VALUE 0x831c0 RL_TARC_HZ_BRAKETQLPF 9999.500000 CU_TARC_HZ_BRAKETQLPF 0.500000 10000.000000 BYTE_ORDER MSB_FIRST /end CHARACTERISTIC
/begin RECORD_LAYOUT RL_TARC_HZ_BRAKETQLPF FNC_VALUES 1 FLOAT32_IEEE COLUMN_DIR DIRECT /end RECORD_LAYOUT
/begin COMPU_METHOD CU_TARC_HZ_BRAKETQLPF "Conversion method for TARc_Hz_BrakeTqLPF" RAT_FUNC "%10.1" "Hz" COEFFS 0.000000 1.000000 0.000000 0.000000 0.000000 1.000000 /end COMPU_METHOD
/* Scalar calibration for DDE 'TARc_Hz_IdlAirToTqLPF'. */
/begin CHARACTERISTIC TARc_Hz_IdlAirToTqLPF "(not defined)" VALUE 0x8b81c RL_TARC_HZ_IDLAIRTOTQLPF 10000.000000 CU_TARC_HZ_IDLAIRTOTQLPF 0.000000 10000.000000 BYTE_ORDER MSB_FIRST /end CHARACTERISTIC
/begin RECORD_LAYOUT RL_TARC_HZ_IDLAIRTOTQLPF FNC_VALUES 1 FLOAT32_IEEE COLUMN_DIR DIRECT /end RECORD_LAYOUT
/begin COMPU_METHOD CU_TARC_HZ_IDLAIRTOTQLPF "Conversion method for TARc_Hz_IdlAirToTqLPF" RAT_FUNC "%10.2" "Hz" COEFFS 0.000000 1.000000 0.000000 0.000000 0.000000 1.000000 /end COMPU_METHOD
/* Scalar calibration for DDE 'TARc_NU_ClunkTqFallRate'. */
/begin CHARACTERISTIC TARc_NU_ClunkTqFallRate "(Nm/s) Slow fall rate used when anti-clunk is active" VALUE 0x831b8 RL_TARC_NU_CLUNKTQFALLRATE 10000.000000 CU_TARC_NU_CLUNKTQFALLRATE -10000.000000 0.000000 BYTE_ORDER MSB_FIRST /end CHARACTERISTIC
/begin RECORD_LAYOUT RL_TARC_NU_CLUNKTQFALLRATE FNC_VALUES 1 FLOAT32_IEEE COLUMN_DIR DIRECT /end RECORD_LAYOUT
/begin COMPU_METHOD CU_TARC_NU_CLUNKTQFALLRATE "Conversion method for TARc_NU_ClunkTqFallRate" RAT_FUNC "%10.0" "NU" COEFFS 0.000000 1.000000 0.000000 0.000000 0.000000 1.000000 /end COMPU_METHOD
/* Scalar calibration for DDE 'TARc_NU_ClunkTqRiseRate'. */
/begin CHARACTERISTIC TARc_NU_ClunkTqRiseRate "(Nm/s) Slow rise rate used when anti-clunk is active" VALUE 0x8be9c RL_TARC_NU_CLUNKTQRISERATE 10000.000000 CU_TARC_NU_CLUNKTQRISERATE 0.000000 10000.000000 BYTE_ORDER MSB_FIRST /end CHARACTERISTIC
/begin RECORD_LAYOUT RL_TARC_NU_CLUNKTQRISERATE FNC_VALUES 1 FLOAT32_IEEE COLUMN_DIR DIRECT /end RECORD_LAYOUT
/begin COMPU_METHOD CU_TARC_NU_CLUNKTQRISERATE "Conversion method for TARc_NU_ClunkTqRiseRate" RAT_FUNC "%10.0" "NU" COEFFS 0.000000 1.000000 0.000000 0.000000 0.000000 1.000000 /end COMPU_METHOD
/* Scalar calibration for DDE 'TARc_NU_RearAxleRatio'. */
/begin CHARACTERISTIC TARc_NU_RearAxleRatio "Rear Axle Ratio for GearBox ZF Hi Matic 8HP. Sent by CAN to Powertrain." VALUE 0x8bd98 RL_TARC_NU_REARAXLERATIO 10.000000 CU_TARC_NU_REARAXLERATIO 0.000000 10.000000 BYTE_ORDER MSB_FIRST /end CHARACTERISTIC
/begin RECORD_LAYOUT RL_TARC_NU_REARAXLERATIO FNC_VALUES 1 FLOAT32_IEEE COLUMN_DIR DIRECT /end RECORD_LAYOUT
/begin COMPU_METHOD CU_TARC_NU_REARAXLERATIO "Conversion method for TARc_NU_RearAxleRatio" RAT_FUNC "%10.2" "NU" COEFFS 0.000000 1.000000 0.000000 0.000000 0.000000 1.000000 /end COMPU_METHOD
/* Scalar calibration for DDE 'TARc_NU_TqFallRate'. */
/begin CHARACTERISTIC TARc_NU_TqFallRate "(Nm/s) Normal fall rate limit applied to brake tq" VALUE 0x831bc RL_TARC_NU_TQFALLRATE 10000.000000 CU_TARC_NU_TQFALLRATE -10000.000000 0.000000 BYTE_ORDER MSB_FIRST /end CHARACTERISTIC
/begin RECORD_LAYOUT RL_TARC_NU_TQFALLRATE FNC_VALUES 1 FLOAT32_IEEE COLUMN_DIR DIRECT /end RECORD_LAYOUT
/begin COMPU_METHOD CU_TARC_NU_TQFALLRATE "Conversion method for TARc_NU_TqFallRate" RAT_FUNC "%10.0" "NU" COEFFS 0.000000 1.000000 0.000000 0.000000 0.000000 1.000000 /end COMPU_METHOD
/* Scalar calibration for DDE 'TARc_NU_TqRiseRate'. */
/begin CHARACTERISTIC TARc_NU_TqRiseRate "(Nm/s) Normal rise rate limit applied to brake tq" VALUE 0x8be98 RL_TARC_NU_TQRISERATE 10000.000000 CU_TARC_NU_TQRISERATE 0.000000 10000.000000 BYTE_ORDER MSB_FIRST /end CHARACTERISTIC
/begin RECORD_LAYOUT RL_TARC_NU_TQRISERATE FNC_VALUES 1 FLOAT32_IEEE COLUMN_DIR DIRECT /end RECORD_LAYOUT
/begin COMPU_METHOD CU_TARC_NU_TQRISERATE "Conversion method for TARc_NU_TqRiseRate" RAT_FUNC "%10.0" "NU" COEFFS 0.000000 1.000000 0.000000 0.000000 0.000000 1.000000 /end COMPU_METHOD
/* Scalar calibration for DDE 'TARc_Nm_ClunkRegionMax'. */
/begin CHARACTERISTIC TARc_Nm_ClunkRegionMax "The slow rate-limit will apply when the requested torque falls within this range" VALUE 0x81d1c RL_TARC_NM_CLUNKREGIONMAX 50.000000 CU_TARC_NM_CLUNKREGIONMAX 0.000000 50.000000 BYTE_ORDER MSB_FIRST /end CHARACTERISTIC
/begin RECORD_LAYOUT RL_TARC_NM_CLUNKREGIONMAX FNC_VALUES 1 FLOAT32_IEEE COLUMN_DIR DIRECT /end RECORD_LAYOUT
/begin COMPU_METHOD CU_TARC_NM_CLUNKREGIONMAX "Conversion method for TARc_Nm_ClunkRegionMax" RAT_FUNC "%10.0" "Nm" COEFFS 0.000000 1.000000 0.000000 0.000000 0.000000 1.000000 /end COMPU_METHOD
/* Scalar calibration for DDE 'TARc_Nm_ClunkRegionMin'. */
/begin CHARACTERISTIC TARc_Nm_ClunkRegionMin "The slow rate-limit will apply when the requested torque falls within this range" VALUE 0x81d18 RL_TARC_NM_CLUNKREGIONMIN 50.000000 CU_TARC_NM_CLUNKREGIONMIN -50.000000 0.000000 BYTE_ORDER MSB_FIRST /end CHARACTERISTIC
/begin RECORD_LAYOUT RL_TARC_NM_CLUNKREGIONMIN FNC_VALUES 1 FLOAT32_IEEE COLUMN_DIR DIRECT /end RECORD_LAYOUT
/begin COMPU_METHOD CU_TARC_NM_CLUNKREGIONMIN "Conversion method for TARc_Nm_ClunkRegionMin" RAT_FUNC "%10.0" "Nm" COEFFS 0.000000 1.000000 0.000000 0.000000 0.000000 1.000000 /end COMPU_METHOD
/* Scalar calibration for DDE 'TARc_Nm_DFCTorque'. */
/begin CHARACTERISTIC TARc_Nm_DFCTorque "DFC constant torque" VALUE 0x83480 RL_TARC_NM_DFCTORQUE 1000.000000 CU_TARC_NM_DFCTORQUE 0.000000 1000.000000 BYTE_ORDER MSB_FIRST /end CHARACTERISTIC
/begin RECORD_LAYOUT RL_TARC_NM_DFCTORQUE FNC_VALUES 1 FLOAT32_IEEE COLUMN_DIR DIRECT /end RECORD_LAYOUT
/begin COMPU_METHOD CU_TARC_NM_DFCTORQUE "Conversion method for TARc_Nm_DFCTorque" RAT_FUNC "%10.2" "Nm" COEFFS 0.000000 1.000000 0.000000 0.000000 0.000000 1.000000 /end COMPU_METHOD
/* Scalar calibration for DDE 'TARc_Nm_DTC_LimitTq'. */
/begin CHARACTERISTIC TARc_Nm_DTC_LimitTq "Minimum value the torque demanded by the ESP-DTC is limited" VALUE 0x83470 RL_TARC_NM_DTC_LIMITTQ 100.000000 CU_TARC_NM_DTC_LIMITTQ 0.000000 100.000000 BYTE_ORDER MSB_FIRST /end CHARACTERISTIC
/begin RECORD_LAYOUT RL_TARC_NM_DTC_LIMITTQ FNC_VALUES 1 FLOAT32_IEEE COLUMN_DIR DIRECT /end RECORD_LAYOUT
/begin COMPU_METHOD CU_TARC_NM_DTC_LIMITTQ "Conversion method for TARc_Nm_DTC_LimitTq" RAT_FUNC "%10.2" "Nm" COEFFS 0.000000 1.000000 0.000000 0.000000 0.000000 1.000000 /end COMPU_METHOD
/* Scalar calibration for DDE 'TARc_Nm_EngReferenceTorque'. */
/begin CHARACTERISTIC TARc_Nm_EngReferenceTorque "Engine reference torque via CAN msg" VALUE 0x83464 RL_TARC_NM_ENGREFERENCETORQUE 1000.000000 CU_TARC_NM_ENGREFERENCETORQUE 0.000000 1000.000000 BYTE_ORDER MSB_FIRST /end CHARACTERISTIC
/begin RECORD_LAYOUT RL_TARC_NM_ENGREFERENCETORQUE FNC_VALUES 1 FLOAT32_IEEE COLUMN_DIR DIRECT /end RECORD_LAYOUT
/begin COMPU_METHOD CU_TARC_NM_ENGREFERENCETORQUE "Conversion method for TARc_Nm_EngReferenceTorque" RAT_FUNC "%10.0" "Nm" COEFFS 0.000000 1.000000 0.000000 0.000000 0.000000 1.000000 /end COMPU_METHOD
/* Scalar calibration for DDE 'TARc_Nm_Max'. */
/begin CHARACTERISTIC TARc_Nm_Max "Absolute maximum for final torque request" VALUE 0x83474 RL_TARC_NM_MAX 1000.000000 CU_TARC_NM_MAX 0.000000 1000.000000 BYTE_ORDER MSB_FIRST /end CHARACTERISTIC
/begin RECORD_LAYOUT RL_TARC_NM_MAX FNC_VALUES 1 FLOAT32_IEEE COLUMN_DIR DIRECT /end RECORD_LAYOUT
/begin COMPU_METHOD CU_TARC_NM_MAX "Conversion method for TARc_Nm_Max" RAT_FUNC "%10.0" "Nm" COEFFS 0.000000 1.000000 0.000000 0.000000 0.000000 1.000000 /end COMPU_METHOD
/* Scalar calibration for DDE 'TARc_Nm_TqRqst'. */
/begin CHARACTERISTIC TARc_Nm_TqRqst "Torque request override value" VALUE 0x8347c RL_TARC_NM_TQRQST 1000.000000 CU_TARC_NM_TQRQST 0.000000 1000.000000 BYTE_ORDER MSB_FIRST /end CHARACTERISTIC
/begin RECORD_LAYOUT RL_TARC_NM_TQRQST FNC_VALUES 1 FLOAT32_IEEE COLUMN_DIR DIRECT /end RECORD_LAYOUT
/begin COMPU_METHOD CU_TARC_NM_TQRQST "Conversion method for TARc_Nm_TqRqst" RAT_FUNC "%10.2" "Nm" COEFFS 0.000000 1.000000 0.000000 0.000000 0.000000 1.000000 /end COMPU_METHOD
/* Scalar calibration for DDE 'TARc_b_DTC_TqLimit'. */
/begin CHARACTERISTIC TARc_b_DTC_TqLimit "Override value" VALUE 0x8346d RL_TARC_B_DTC_TQLIMIT 1.000000 CU_TARC_B_DTC_TQLIMIT 0.000000 1.000000 BYTE_ORDER MSB_FIRST /end CHARACTERISTIC
/begin RECORD_LAYOUT RL_TARC_B_DTC_TQLIMIT FNC_VALUES 1 UBYTE COLUMN_DIR DIRECT /end RECORD_LAYOUT
/begin COMPU_METHOD CU_TARC_B_DTC_TQLIMIT "Conversion method for TARc_b_DTC_TqLimit" RAT_FUNC "%10.0" "b" COEFFS 0.000000 1.000000 0.000000 0.000000 0.000000 1.000000 /end COMPU_METHOD
/* Scalar calibration for DDE 'TARc_b_Disable_TQmodel'. */
/begin CHARACTERISTIC TARc_b_Disable_TQmodel "(not defined)" VALUE 0x8bdc0 RL_TARC_B_DISABLE_TQMODEL 1.000000 CU_TARC_B_DISABLE_TQMODEL 0.000000 1.000000 BYTE_ORDER MSB_FIRST /end CHARACTERISTIC
/begin RECORD_LAYOUT RL_TARC_B_DISABLE_TQMODEL FNC_VALUES 1 UBYTE COLUMN_DIR DIRECT /end RECORD_LAYOUT
/begin COMPU_METHOD CU_TARC_B_DISABLE_TQMODEL "Conversion method for TARc_b_Disable_TQmodel" RAT_FUNC "%10.0" "b" COEFFS 0.000000 1.000000 0.000000 0.000000 0.000000 1.000000 /end COMPU_METHOD
/* Scalar calibration for DDE 'TARc_b_EnableIdl_ELM'. */
/begin CHARACTERISTIC TARc_b_EnableIdl_ELM "(not defined)" VALUE 0x8b824 RL_TARC_B_ENABLEIDL_ELM 1.000000 CU_TARC_B_ENABLEIDL_ELM 0.000000 1.000000 BYTE_ORDER MSB_FIRST /end CHARACTERISTIC
/begin RECORD_LAYOUT RL_TARC_B_ENABLEIDL_ELM FNC_VALUES 1 UBYTE COLUMN_DIR DIRECT /end RECORD_LAYOUT
/begin COMPU_METHOD CU_TARC_B_ENABLEIDL_ELM "Conversion method for TARc_b_EnableIdl_ELM" RAT_FUNC "%10.0" "b" COEFFS 0.000000 1.000000 0.000000 0.000000 0.000000 1.000000 /end COMPU_METHOD
/* Scalar calibration for DDE 'TARc_b_LimpHome'. */
/begin CHARACTERISTIC TARc_b_LimpHome "Override value" VALUE 0x81ce1 RL_TARC_B_LIMPHOME 1.000000 CU_TARC_B_LIMPHOME 0.000000 1.000000 BYTE_ORDER MSB_FIRST /end CHARACTERISTIC
/begin RECORD_LAYOUT RL_TARC_B_LIMPHOME FNC_VALUES 1 UBYTE COLUMN_DIR DIRECT /end RECORD_LAYOUT
/begin COMPU_METHOD CU_TARC_B_LIMPHOME "Conversion method for TARc_b_LimpHome" RAT_FUNC "%10.0" "b" COEFFS 0.000000 1.000000 0.000000 0.000000 0.000000 1.000000 /end COMPU_METHOD
/* Scalar calibration for DDE 'TARc_b_TqModelSelect'. */
/begin CHARACTERISTIC TARc_b_TqModelSelect "Select Torque Model Based on MAP(1) or on Air(0)" VALUE 0x8b818 RL_TARC_B_TQMODELSELECT 1.000000 CU_TARC_B_TQMODELSELECT 0.000000 1.000000 BYTE_ORDER MSB_FIRST /end CHARACTERISTIC
/begin RECORD_LAYOUT RL_TARC_B_TQMODELSELECT FNC_VALUES 1 UBYTE COLUMN_DIR DIRECT /end RECORD_LAYOUT
/begin COMPU_METHOD CU_TARC_B_TQMODELSELECT "Conversion method for TARc_b_TqModelSelect" RAT_FUNC "%10.0" "b" COEFFS 0.000000 1.000000 0.000000 0.000000 0.000000 1.000000 /end COMPU_METHOD
/* Scalar calibration for DDE 'TARc_kph_ClunkEnblVehSpd'. */
/begin CHARACTERISTIC TARc_kph_ClunkEnblVehSpd "Anti-clunk rate limits will be enabled above this vehicle speed" VALUE 0x81d14 RL_TARC_KPH_CLUNKENBLVEHSPD 300.000000 CU_TARC_KPH_CLUNKENBLVEHSPD 0.000000 300.000000 BYTE_ORDER MSB_FIRST /end CHARACTERISTIC
/begin RECORD_LAYOUT RL_TARC_KPH_CLUNKENBLVEHSPD FNC_VALUES 1 FLOAT32_IEEE COLUMN_DIR DIRECT /end RECORD_LAYOUT
/begin COMPU_METHOD CU_TARC_KPH_CLUNKENBLVEHSPD "Conversion method for TARc_kph_ClunkEnblVehSpd" RAT_FUNC "%10.1" "kph" COEFFS 0.000000 1.000000 0.000000 0.000000 0.000000 1.000000 /end COMPU_METHOD
/* Scalar calibration for DDE 'TARc_mm_WheelCircumference'. */
/begin CHARACTERISTIC TARc_mm_WheelCircumference "Rear Wheel Circumference for GearBox ZF Hi Matic 8HP. Sent by CAN to Powertrain." VALUE 0x8bd94 RL_TARC_MM_WHEELCIRCUMFERENCE 10000.000000 CU_TARC_MM_WHEELCIRCUMFERENCE 0.000000 10000.000000 BYTE_ORDER MSB_FIRST /end CHARACTERISTIC
/begin RECORD_LAYOUT RL_TARC_MM_WHEELCIRCUMFERENCE FNC_VALUES 1 FLOAT32_IEEE COLUMN_DIR DIRECT /end RECORD_LAYOUT
/begin COMPU_METHOD CU_TARC_MM_WHEELCIRCUMFERENCE "Conversion method for TARc_mm_WheelCircumference" RAT_FUNC "%10.0" "NU" COEFFS 0.000000 1.000000 0.000000 0.000000 0.000000 1.000000 /end COMPU_METHOD
/* Scalar calibration for DDE 'TARc_o_DTC_TqLimit'. */
/begin CHARACTERISTIC TARc_o_DTC_TqLimit "Override flag" VALUE 0x8346c RL_TARC_O_DTC_TQLIMIT 1.000000 CU_TARC_O_DTC_TQLIMIT 0.000000 1.000000 BYTE_ORDER MSB_FIRST /end CHARACTERISTIC
/begin RECORD_LAYOUT RL_TARC_O_DTC_TQLIMIT FNC_VALUES 1 UBYTE COLUMN_DIR DIRECT /end RECORD_LAYOUT
/begin COMPU_METHOD CU_TARC_O_DTC_TQLIMIT "Conversion method for TARc_o_DTC_TqLimit" RAT_FUNC "%10.0" "o" COEFFS 0.000000 1.000000 0.000000 0.000000 0.000000 1.000000 /end COMPU_METHOD
/* Scalar calibration for DDE 'TARc_o_LimpHome'. */
/begin CHARACTERISTIC TARc_o_LimpHome "Override flag" VALUE 0x81ce0 RL_TARC_O_LIMPHOME 1.000000 CU_TARC_O_LIMPHOME 0.000000 1.000000 BYTE_ORDER MSB_FIRST /end CHARACTERISTIC
/begin RECORD_LAYOUT RL_TARC_O_LIMPHOME FNC_VALUES 1 UBYTE COLUMN_DIR DIRECT /end RECORD_LAYOUT
/begin COMPU_METHOD CU_TARC_O_LIMPHOME "Conversion method for TARc_o_LimpHome" RAT_FUNC "%10.0" "o" COEFFS 0.000000 1.000000 0.000000 0.000000 0.000000 1.000000 /end COMPU_METHOD
/* Scalar calibration for DDE 'TARc_o_TqRqst'. */
/begin CHARACTERISTIC TARc_o_TqRqst "Torque request override flag" VALUE 0x83478 RL_TARC_O_TQRQST 1.000000 CU_TARC_O_TQRQST 0.000000 1.000000 BYTE_ORDER MSB_FIRST /end CHARACTERISTIC
/begin RECORD_LAYOUT RL_TARC_O_TQRQST FNC_VALUES 1 UBYTE COLUMN_DIR DIRECT /end RECORD_LAYOUT
/begin COMPU_METHOD CU_TARC_O_TQRQST "Conversion method for TARc_o_TqRqst" RAT_FUNC "%10.0" "o" COEFFS 0.000000 1.000000 0.000000 0.000000 0.000000 1.000000 /end COMPU_METHOD
/* Scalar calibration for DDE 'TARc_s_DTC_LimitTime'. */
/begin CHARACTERISTIC TARc_s_DTC_LimitTime "during this time the torque demanded by the ESP-DTC is limited" VALUE 0x83468 RL_TARC_S_DTC_LIMITTIME 100.000000 CU_TARC_S_DTC_LIMITTIME 0.000000 100.000000 BYTE_ORDER MSB_FIRST /end CHARACTERISTIC
/begin RECORD_LAYOUT RL_TARC_S_DTC_LIMITTIME FNC_VALUES 1 FLOAT32_IEEE COLUMN_DIR DIRECT /end RECORD_LAYOUT
/begin COMPU_METHOD CU_TARC_S_DTC_LIMITTIME "Conversion method for TARc_s_DTC_LimitTime" RAT_FUNC "%10.2" "s" COEFFS 0.000000 1.000000 0.000000 0.000000 0.000000 1.000000 /end COMPU_METHOD
/* Scalar calibration for DDE 'TARc_s_EEC1TimeTqSmooth'. */
/begin CHARACTERISTIC TARc_s_EEC1TimeTqSmooth "(not defined)" VALUE 0x8b820 RL_TARC_S_EEC1TIMETQSMOOTH 10000.000000 CU_TARC_S_EEC1TIMETQSMOOTH 0.000000 10000.000000 BYTE_ORDER MSB_FIRST /end CHARACTERISTIC
/begin RECORD_LAYOUT RL_TARC_S_EEC1TIMETQSMOOTH FNC_VALUES 1 FLOAT32_IEEE COLUMN_DIR DIRECT /end RECORD_LAYOUT
/begin COMPU_METHOD CU_TARC_S_EEC1TIMETQSMOOTH "Conversion method for TARc_s_EEC1TimeTqSmooth" RAT_FUNC "%10.0" "s" COEFFS 0.000000 1.000000 0.000000 0.000000 0.000000 1.000000 /end COMPU_METHOD
/* Map (2d) calibration for DDE 'TARm_Nm_AirToTq_z'. */
/begin CHARACTERISTIC TARm_Nm_AirToTq_z "(not defined)" MAP 0x8b508 RL_TARM_NM_AIRTOTQ_Z 600.000000 CU_TARM_NM_AIRTOTQ_Z -100.000000 500.000000
 /begin AXIS_DESCR COM_AXIS NO_INPUT_QUANTITY CU_TARM_NM_AIRTOTQ_X 14 0.000000 10000.000000 AXIS_PTS_REF APD_TARM_NM_AIRTOTQ_X /end AXIS_DESCR
 /begin AXIS_DESCR COM_AXIS NO_INPUT_QUANTITY CU_TARM_NM_AIRTOTQ_Y 14 0.000000 10000.000000 AXIS_PTS_REF APD_TARM_NM_AIRTOTQ_Y /end AXIS_DESCR
 BYTE_ORDER MSB_FIRST /end CHARACTERISTIC
/begin RECORD_LAYOUT RL_TARM_NM_AIRTOTQ_Z FNC_VALUES 1 FLOAT32_IEEE COLUMN_DIR DIRECT /end RECORD_LAYOUT
/begin COMPU_METHOD CU_TARM_NM_AIRTOTQ_Z "Conversion method for TARm_Nm_AirToTq_z" RAT_FUNC "%10.0" "Nm" COEFFS 0.000000 1.000000 0.000000 0.000000 0.000000 1.000000 /end COMPU_METHOD
/begin AXIS_PTS APD_TARM_NM_AIRTOTQ_X "(not defined)" 0x8b498 NO_INPUT_QUANTITY RL_TARM_NM_AIRTOTQ_X 10000.000000 CU_TARM_NM_AIRTOTQ_X 14 0.0 10000.0 BYTE_ORDER MSB_FIRST /end AXIS_PTS
/begin RECORD_LAYOUT RL_TARM_NM_AIRTOTQ_X AXIS_PTS_X 1 FLOAT32_IEEE INDEX_INCR DIRECT /end RECORD_LAYOUT
/begin COMPU_METHOD CU_TARM_NM_AIRTOTQ_X "Conversion method for TARm_Nm_AirToTq_x" RAT_FUNC "%10.0" "RPM" COEFFS 0.000000 1.000000 0.000000 0.000000 0.000000 1.000000 /end COMPU_METHOD
/begin AXIS_PTS APD_TARM_NM_AIRTOTQ_Y "(not defined)" 0x8b4d0 NO_INPUT_QUANTITY RL_TARM_NM_AIRTOTQ_Y 10000.000000 CU_TARM_NM_AIRTOTQ_Y 14 0.0 10000.0 BYTE_ORDER MSB_FIRST /end AXIS_PTS
/begin RECORD_LAYOUT RL_TARM_NM_AIRTOTQ_Y AXIS_PTS_X 1 FLOAT32_IEEE INDEX_INCR DIRECT /end RECORD_LAYOUT
/begin COMPU_METHOD CU_TARM_NM_AIRTOTQ_Y "Conversion method for TARm_Nm_AirToTq_y" RAT_FUNC "%10.1" "kPa" COEFFS 0.000000 1.000000 0.000000 0.000000 0.000000 1.000000 /end COMPU_METHOD
/* Map (2d) calibration for DDE 'TARm_Nm_IdlMAPToTq_z'. */
/begin CHARACTERISTIC TARm_Nm_IdlMAPToTq_z "(not defined)" MAP 0x8ae08 RL_TARM_NM_IDLMAPTOTQ_Z 600.000000 CU_TARM_NM_IDLMAPTOTQ_Z -100.000000 500.000000
 /begin AXIS_DESCR COM_AXIS NO_INPUT_QUANTITY CU_TARM_NM_IDLMAPTOTQ_X 14 0.000000 10000.000000 AXIS_PTS_REF APD_TARM_NM_IDLMAPTOTQ_X /end AXIS_DESCR
 /begin AXIS_DESCR COM_AXIS NO_INPUT_QUANTITY CU_TARM_NM_IDLMAPTOTQ_Y 14 0.000000 10000.000000 AXIS_PTS_REF APD_TARM_NM_IDLMAPTOTQ_Y /end AXIS_DESCR
 BYTE_ORDER MSB_FIRST /end CHARACTERISTIC
/begin RECORD_LAYOUT RL_TARM_NM_IDLMAPTOTQ_Z FNC_VALUES 1 FLOAT32_IEEE COLUMN_DIR DIRECT /end RECORD_LAYOUT
/begin COMPU_METHOD CU_TARM_NM_IDLMAPTOTQ_Z "Conversion method for TARm_Nm_IdlMAPToTq_z" RAT_FUNC "%10.0" "Nm" COEFFS 0.000000 1.000000 0.000000 0.000000 0.000000 1.000000 /end COMPU_METHOD
/begin AXIS_PTS APD_TARM_NM_IDLMAPTOTQ_X "(not defined)" 0x8ad98 NO_INPUT_QUANTITY RL_TARM_NM_IDLMAPTOTQ_X 10000.000000 CU_TARM_NM_IDLMAPTOTQ_X 14 0.0 10000.0 BYTE_ORDER MSB_FIRST /end AXIS_PTS
/begin RECORD_LAYOUT RL_TARM_NM_IDLMAPTOTQ_X AXIS_PTS_X 1 FLOAT32_IEEE INDEX_INCR DIRECT /end RECORD_LAYOUT
/begin COMPU_METHOD CU_TARM_NM_IDLMAPTOTQ_X "Conversion method for TARm_Nm_IdlMAPToTq_x" RAT_FUNC "%10.0" "RPM" COEFFS 0.000000 1.000000 0.000000 0.000000 0.000000 1.000000 /end COMPU_METHOD
/begin AXIS_PTS APD_TARM_NM_IDLMAPTOTQ_Y "(not defined)" 0x8add0 NO_INPUT_QUANTITY RL_TARM_NM_IDLMAPTOTQ_Y 10000.000000 CU_TARM_NM_IDLMAPTOTQ_Y 14 0.0 10000.0 BYTE_ORDER MSB_FIRST /end AXIS_PTS
/begin RECORD_LAYOUT RL_TARM_NM_IDLMAPTOTQ_Y AXIS_PTS_X 1 FLOAT32_IEEE INDEX_INCR DIRECT /end RECORD_LAYOUT
/begin COMPU_METHOD CU_TARM_NM_IDLMAPTOTQ_Y "Conversion method for TARm_Nm_IdlMAPToTq_y" RAT_FUNC "%10.1" "kPa" COEFFS 0.000000 1.000000 0.000000 0.000000 0.000000 1.000000 /end COMPU_METHOD
/* Map (2d) calibration for DDE 'TARm_Nm_MAPToTq_z'. */
/begin CHARACTERISTIC TARm_Nm_MAPToTq_z "(not defined)" MAP 0x8b188 RL_TARM_NM_MAPTOTQ_Z 600.000000 CU_TARM_NM_MAPTOTQ_Z -100.000000 500.000000
 /begin AXIS_DESCR COM_AXIS NO_INPUT_QUANTITY CU_TARM_NM_MAPTOTQ_X 14 0.000000 10000.000000 AXIS_PTS_REF APD_TARM_NM_MAPTOTQ_X /end AXIS_DESCR
 /begin AXIS_DESCR COM_AXIS NO_INPUT_QUANTITY CU_TARM_NM_MAPTOTQ_Y 14 0.000000 10000.000000 AXIS_PTS_REF APD_TARM_NM_MAPTOTQ_Y /end AXIS_DESCR
 BYTE_ORDER MSB_FIRST /end CHARACTERISTIC
/begin RECORD_LAYOUT RL_TARM_NM_MAPTOTQ_Z FNC_VALUES 1 FLOAT32_IEEE COLUMN_DIR DIRECT /end RECORD_LAYOUT
/begin COMPU_METHOD CU_TARM_NM_MAPTOTQ_Z "Conversion method for TARm_Nm_MAPToTq_z" RAT_FUNC "%10.0" "Nm" COEFFS 0.000000 1.000000 0.000000 0.000000 0.000000 1.000000 /end COMPU_METHOD
/begin AXIS_PTS APD_TARM_NM_MAPTOTQ_X "(not defined)" 0x8b118 NO_INPUT_QUANTITY RL_TARM_NM_MAPTOTQ_X 10000.000000 CU_TARM_NM_MAPTOTQ_X 14 0.0 10000.0 BYTE_ORDER MSB_FIRST /end AXIS_PTS
/begin RECORD_LAYOUT RL_TARM_NM_MAPTOTQ_X AXIS_PTS_X 1 FLOAT32_IEEE INDEX_INCR DIRECT /end RECORD_LAYOUT
/begin COMPU_METHOD CU_TARM_NM_MAPTOTQ_X "Conversion method for TARm_Nm_MAPToTq_x" RAT_FUNC "%10.0" "RPM" COEFFS 0.000000 1.000000 0.000000 0.000000 0.000000 1.000000 /end COMPU_METHOD
/begin AXIS_PTS APD_TARM_NM_MAPTOTQ_Y "(not defined)" 0x8b150 NO_INPUT_QUANTITY RL_TARM_NM_MAPTOTQ_Y 10000.000000 CU_TARM_NM_MAPTOTQ_Y 14 0.0 10000.0 BYTE_ORDER MSB_FIRST /end AXIS_PTS
/begin RECORD_LAYOUT RL_TARM_NM_MAPTOTQ_Y AXIS_PTS_X 1 FLOAT32_IEEE INDEX_INCR DIRECT /end RECORD_LAYOUT
/begin COMPU_METHOD CU_TARM_NM_MAPTOTQ_Y "Conversion method for TARm_Nm_MAPToTq_y" RAT_FUNC "%10.1" "kPa" COEFFS 0.000000 1.000000 0.000000 0.000000 0.000000 1.000000 /end COMPU_METHOD
/* Map (2d) calibration for DDE 'TARm_Nm_MaxTqTable_z'. */
/begin CHARACTERISTIC TARm_Nm_MaxTqTable_z "Max feasible torque table data" MAP 0x81a60 RL_TARM_NM_MAXTQTABLE_Z 2000.000000 CU_TARM_NM_MAXTQTABLE_Z 0.000000 2000.000000
 /begin AXIS_DESCR COM_AXIS NO_INPUT_QUANTITY CU_TARM_NM_MAXTQTABLE_X 16 0.000000 10000.000000 AXIS_PTS_REF APD_TARM_NM_MAXTQTABLE_X /end AXIS_DESCR
 /begin AXIS_DESCR COM_AXIS NO_INPUT_QUANTITY CU_TARM_NM_MAXTQTABLE_Y 10 0.000000 2000.000000 AXIS_PTS_REF APD_TARM_NM_MAXTQTABLE_Y /end AXIS_DESCR
 BYTE_ORDER MSB_FIRST /end CHARACTERISTIC
/begin RECORD_LAYOUT RL_TARM_NM_MAXTQTABLE_Z FNC_VALUES 1 FLOAT32_IEEE COLUMN_DIR DIRECT /end RECORD_LAYOUT
/begin COMPU_METHOD CU_TARM_NM_MAXTQTABLE_Z "Conversion method for TARm_Nm_MaxTqTable_z" RAT_FUNC "%10.0" "Nm" COEFFS 0.000000 1.000000 0.000000 0.000000 0.000000 1.000000 /end COMPU_METHOD
/begin AXIS_PTS APD_TARM_NM_MAXTQTABLE_X "Max feasible torque table x axis engine rpm" 0x819f8 NO_INPUT_QUANTITY RL_TARM_NM_MAXTQTABLE_X 10000.000000 CU_TARM_NM_MAXTQTABLE_X 16 0.0 10000.0 BYTE_ORDER MSB_FIRST /end AXIS_PTS
/begin RECORD_LAYOUT RL_TARM_NM_MAXTQTABLE_X AXIS_PTS_X 1 FLOAT32_IEEE INDEX_INCR DIRECT /end RECORD_LAYOUT
/begin COMPU_METHOD CU_TARM_NM_MAXTQTABLE_X "Conversion method for TARm_Nm_MaxTqTable_x" RAT_FUNC "%10.0" "RPM" COEFFS 0.000000 1.000000 0.000000 0.000000 0.000000 1.000000 /end COMPU_METHOD
/begin AXIS_PTS APD_TARM_NM_MAXTQTABLE_Y "Max feasible torque table data" 0x81a38 NO_INPUT_QUANTITY RL_TARM_NM_MAXTQTABLE_Y 2000.000000 CU_TARM_NM_MAXTQTABLE_Y 10 0.0 2000.0 BYTE_ORDER MSB_FIRST /end AXIS_PTS
/begin RECORD_LAYOUT RL_TARM_NM_MAXTQTABLE_Y AXIS_PTS_X 1 FLOAT32_IEEE INDEX_INCR DIRECT /end RECORD_LAYOUT
/begin COMPU_METHOD CU_TARM_NM_MAXTQTABLE_Y "Conversion method for TARm_Nm_MaxTqTable_y" RAT_FUNC "%10.0" "C" COEFFS 0.000000 1.000000 0.000000 0.000000 0.000000 1.000000 /end COMPU_METHOD
/* Scalar calibration for DDE 'TCOc_NU_VehSpeed_Gain'. */
/begin CHARACTERISTIC TCOc_NU_VehSpeed_Gain "factor de conversion" VALUE 0x8bde0 RL_TCOC_NU_VEHSPEED_GAIN 1000.000000 CU_TCOC_NU_VEHSPEED_GAIN 0.000000 1000.000000 BYTE_ORDER MSB_FIRST /end CHARACTERISTIC
/begin RECORD_LAYOUT RL_TCOC_NU_VEHSPEED_GAIN FNC_VALUES 1 FLOAT32_IEEE COLUMN_DIR DIRECT /end RECORD_LAYOUT
/begin COMPU_METHOD CU_TCOC_NU_VEHSPEED_GAIN "Conversion method for TCOc_NU_VehSpeed_Gain" RAT_FUNC "%10.3" "NU" COEFFS 0.000000 1.000000 0.000000 0.000000 0.000000 1.000000 /end COMPU_METHOD
/* Scalar calibration for DDE 'TCOc_NU_VehSpeed_Ofst'. */
/begin CHARACTERISTIC TCOc_NU_VehSpeed_Ofst "factor de conversion" VALUE 0x8bde4 RL_TCOC_NU_VEHSPEED_OFST 1000.000000 CU_TCOC_NU_VEHSPEED_OFST 0.000000 1000.000000 BYTE_ORDER MSB_FIRST /end CHARACTERISTIC
/begin RECORD_LAYOUT RL_TCOC_NU_VEHSPEED_OFST FNC_VALUES 1 FLOAT32_IEEE COLUMN_DIR DIRECT /end RECORD_LAYOUT
/begin COMPU_METHOD CU_TCOC_NU_VEHSPEED_OFST "Conversion method for TCOc_NU_VehSpeed_Ofst" RAT_FUNC "%10.3" "NU" COEFFS 0.000000 1.000000 0.000000 0.000000 0.000000 1.000000 /end COMPU_METHOD
/* Scalar calibration for DDE 'TRFc_NU_TqHPF_TC'. */
/begin CHARACTERISTIC TRFc_NU_TqHPF_TC "HPF filter time-constant" VALUE 0x83e48 RL_TRFC_NU_TQHPF_TC 1.000000 CU_TRFC_NU_TQHPF_TC 0.000000 1.000000 BYTE_ORDER MSB_FIRST /end CHARACTERISTIC
/begin RECORD_LAYOUT RL_TRFC_NU_TQHPF_TC FNC_VALUES 1 FLOAT32_IEEE COLUMN_DIR DIRECT /end RECORD_LAYOUT
/begin COMPU_METHOD CU_TRFC_NU_TQHPF_TC "Conversion method for TRFc_NU_TqHPF_TC" RAT_FUNC "%10.2" "NU" COEFFS 0.000000 1.000000 0.000000 0.000000 0.000000 1.000000 /end COMPU_METHOD
/* Scalar calibration for DDE 'TRFc_Nm_FallingTransientThrsh'. */
/begin CHARACTERISTIC TRFc_Nm_FallingTransientThrsh "Torque HPF threshold to enable TRF" VALUE 0x83f60 RL_TRFC_NM_FALLINGTRANSIENTTHR0 500.000000 CU_TRFC_NM_FALLINGTRANSIENTTHR0 -500.000000 0.000000 BYTE_ORDER MSB_FIRST /end CHARACTERISTIC
/begin RECORD_LAYOUT RL_TRFC_NM_FALLINGTRANSIENTTHR0 FNC_VALUES 1 FLOAT32_IEEE COLUMN_DIR DIRECT /end RECORD_LAYOUT
/begin COMPU_METHOD CU_TRFC_NM_FALLINGTRANSIENTTHR0 "Conversion method for TRFc_Nm_FallingTransientThrsh" RAT_FUNC "%10.0" "Nm" COEFFS 0.000000 1.000000 0.000000 0.000000 0.000000 1.000000 /end COMPU_METHOD
/* Scalar calibration for DDE 'TRFc_Nm_RisingTransientThrsh'. */
/begin CHARACTERISTIC TRFc_Nm_RisingTransientThrsh "Torque HPF threshold to enable TRF" VALUE 0x83f64 RL_TRFC_NM_RISINGTRANSIENTTHRSH 500.000000 CU_TRFC_NM_RISINGTRANSIENTTHRSH 0.000000 500.000000 BYTE_ORDER MSB_FIRST /end CHARACTERISTIC
/begin RECORD_LAYOUT RL_TRFC_NM_RISINGTRANSIENTTHRSH FNC_VALUES 1 FLOAT32_IEEE COLUMN_DIR DIRECT /end RECORD_LAYOUT
/begin COMPU_METHOD CU_TRFC_NM_RISINGTRANSIENTTHRSH "Conversion method for TRFc_Nm_RisingTransientThrsh" RAT_FUNC "%10.0" "Nm" COEFFS 0.000000 1.000000 0.000000 0.000000 0.000000 1.000000 /end COMPU_METHOD
/* Scalar calibration for DDE 'TRFc_RPM_CoolantTempEnblThrsh'. */
/begin CHARACTERISTIC TRFc_RPM_CoolantTempEnblThrsh "Coolant temperature threshold to enable TRF" VALUE 0x83f6c RL_TRFC_RPM_COOLANTTEMPENBLTHR0 140.000000 CU_TRFC_RPM_COOLANTTEMPENBLTHR0 0.000000 140.000000 BYTE_ORDER MSB_FIRST /end CHARACTERISTIC
/begin RECORD_LAYOUT RL_TRFC_RPM_COOLANTTEMPENBLTHR0 FNC_VALUES 1 FLOAT32_IEEE COLUMN_DIR DIRECT /end RECORD_LAYOUT
/begin COMPU_METHOD CU_TRFC_RPM_COOLANTTEMPENBLTHR0 "Conversion method for TRFc_RPM_CoolantTempEnblThrsh" RAT_FUNC "%10.0" "C" COEFFS 0.000000 1.000000 0.000000 0.000000 0.000000 1.000000 /end COMPU_METHOD
/* Scalar calibration for DDE 'TRFc_RPM_EngSpdEnblThrsh'. */
/begin CHARACTERISTIC TRFc_RPM_EngSpdEnblThrsh "Engine speed threshold to enable TRF" VALUE 0x83f68 RL_TRFC_RPM_ENGSPDENBLTHRSH 10000.000000 CU_TRFC_RPM_ENGSPDENBLTHRSH 0.000000 10000.000000 BYTE_ORDER MSB_FIRST /end CHARACTERISTIC
/begin RECORD_LAYOUT RL_TRFC_RPM_ENGSPDENBLTHRSH FNC_VALUES 1 FLOAT32_IEEE COLUMN_DIR DIRECT /end RECORD_LAYOUT
/begin COMPU_METHOD CU_TRFC_RPM_ENGSPDENBLTHRSH "Conversion method for TRFc_RPM_EngSpdEnblThrsh" RAT_FUNC "%10.0" "RPM" COEFFS 0.000000 1.000000 0.000000 0.000000 0.000000 1.000000 /end COMPU_METHOD
/* Scalar calibration for DDE 'TRFc_b_IdlDisable'. */
/begin CHARACTERISTIC TRFc_b_IdlDisable "Disable TRF during closed loop idle" VALUE 0x83f70 RL_TRFC_B_IDLDISABLE 1.000000 CU_TRFC_B_IDLDISABLE 0.000000 1.000000 BYTE_ORDER MSB_FIRST /end CHARACTERISTIC
/begin RECORD_LAYOUT RL_TRFC_B_IDLDISABLE FNC_VALUES 1 UBYTE COLUMN_DIR DIRECT /end RECORD_LAYOUT
/begin COMPU_METHOD CU_TRFC_B_IDLDISABLE "Conversion method for TRFc_b_IdlDisable" RAT_FUNC "%10.0" "b" COEFFS 0.000000 1.000000 0.000000 0.000000 0.000000 1.000000 /end COMPU_METHOD
/* Scalar calibration for DDE 'TRFc_lam_MaxEnrichment'. */
/begin CHARACTERISTIC TRFc_lam_MaxEnrichment "Maximum trim value" VALUE 0x83f78 RL_TRFC_LAM_MAXENRICHMENT 1.000000 CU_TRFC_LAM_MAXENRICHMENT 0.000000 1.000000 BYTE_ORDER MSB_FIRST /end CHARACTERISTIC
/begin RECORD_LAYOUT RL_TRFC_LAM_MAXENRICHMENT FNC_VALUES 1 FLOAT32_IEEE COLUMN_DIR DIRECT /end RECORD_LAYOUT
/begin COMPU_METHOD CU_TRFC_LAM_MAXENRICHMENT "Conversion method for TRFc_lam_MaxEnrichment" RAT_FUNC "%10.2" "lam" COEFFS 0.000000 1.000000 0.000000 0.000000 0.000000 1.000000 /end COMPU_METHOD
/* Scalar calibration for DDE 'TRFc_lam_MinEnrichment'. */
/begin CHARACTERISTIC TRFc_lam_MinEnrichment "Minimum trim value" VALUE 0x83f7c RL_TRFC_LAM_MINENRICHMENT 1.000000 CU_TRFC_LAM_MINENRICHMENT -1.000000 0.000000 BYTE_ORDER MSB_FIRST /end CHARACTERISTIC
/begin RECORD_LAYOUT RL_TRFC_LAM_MINENRICHMENT FNC_VALUES 1 FLOAT32_IEEE COLUMN_DIR DIRECT /end RECORD_LAYOUT
/begin COMPU_METHOD CU_TRFC_LAM_MINENRICHMENT "Conversion method for TRFc_lam_MinEnrichment" RAT_FUNC "%10.2" "lam" COEFFS 0.000000 1.000000 0.000000 0.000000 0.000000 1.000000 /end COMPU_METHOD
/* Scalar calibration for DDE 'TRFc_lam_Trim'. */
/begin CHARACTERISTIC TRFc_lam_Trim "Final AFR modifier override value" VALUE 0x83f74 RL_TRFC_LAM_TRIM 1.900000 CU_TRFC_LAM_TRIM -0.900000 1.000000 BYTE_ORDER MSB_FIRST /end CHARACTERISTIC
/begin RECORD_LAYOUT RL_TRFC_LAM_TRIM FNC_VALUES 1 FLOAT32_IEEE COLUMN_DIR DIRECT /end RECORD_LAYOUT
/begin COMPU_METHOD CU_TRFC_LAM_TRIM "Conversion method for TRFc_lam_Trim" RAT_FUNC "%10.2" "lam" COEFFS 0.000000 1.000000 0.000000 0.000000 0.000000 1.000000 /end COMPU_METHOD
/* Scalar calibration for DDE 'TRFc_o_Trim'. */
/begin CHARACTERISTIC TRFc_o_Trim "Final AFR modifier override flag" VALUE 0x8bea8 RL_TRFC_O_TRIM 1.000000 CU_TRFC_O_TRIM 0.000000 1.000000 BYTE_ORDER MSB_FIRST /end CHARACTERISTIC
/begin RECORD_LAYOUT RL_TRFC_O_TRIM FNC_VALUES 1 UBYTE COLUMN_DIR DIRECT /end RECORD_LAYOUT
/begin COMPU_METHOD CU_TRFC_O_TRIM "Conversion method for TRFc_o_Trim" RAT_FUNC "%10.0" "b" COEFFS 0.000000 1.000000 0.000000 0.000000 0.000000 1.000000 /end COMPU_METHOD
/* Map (2d) calibration for DDE 'TRFm_NU_EnrichmentRqst_z'. */
/begin CHARACTERISTIC TRFm_NU_EnrichmentRqst_z "TRF AFR modifier table data" MAP 0x83e88 RL_TRFM_NU_ENRICHMENTRQST_Z 1.600000 CU_TRFM_NU_ENRICHMENTRQST_Z -0.800000 0.800000
 /begin AXIS_DESCR COM_AXIS NO_INPUT_QUANTITY CU_TRFM_NU_ENRICHMENTRQST_X 9 0.000000 10000.000000 AXIS_PTS_REF APD_TRFM_NU_ENRICHMENTRQST_X /end AXIS_DESCR
 /begin AXIS_DESCR COM_AXIS NO_INPUT_QUANTITY CU_TRFM_NU_ENRICHMENTRQST_Y 6 -1000.000000 1000.000000 AXIS_PTS_REF APD_TRFM_NU_ENRICHMENTRQST_Y /end AXIS_DESCR
 BYTE_ORDER MSB_FIRST /end CHARACTERISTIC
/begin RECORD_LAYOUT RL_TRFM_NU_ENRICHMENTRQST_Z FNC_VALUES 1 FLOAT32_IEEE COLUMN_DIR DIRECT /end RECORD_LAYOUT
/begin COMPU_METHOD CU_TRFM_NU_ENRICHMENTRQST_Z "Conversion method for TRFm_NU_EnrichmentRqst_z" RAT_FUNC "%10.2" "lam" COEFFS 0.000000 1.000000 0.000000 0.000000 0.000000 1.000000 /end COMPU_METHOD
/begin AXIS_PTS APD_TRFM_NU_ENRICHMENTRQST_X "TRF AFR modifier table engine speed axis" 0x83e4c NO_INPUT_QUANTITY RL_TRFM_NU_ENRICHMENTRQST_X 10000.000000 CU_TRFM_NU_ENRICHMENTRQST_X 9 0.0 10000.0 BYTE_ORDER MSB_FIRST /end AXIS_PTS
/begin RECORD_LAYOUT RL_TRFM_NU_ENRICHMENTRQST_X AXIS_PTS_X 1 FLOAT32_IEEE INDEX_INCR DIRECT /end RECORD_LAYOUT
/begin COMPU_METHOD CU_TRFM_NU_ENRICHMENTRQST_X "Conversion method for TRFm_NU_EnrichmentRqst_x" RAT_FUNC "%10.0" "RPM" COEFFS 0.000000 1.000000 0.000000 0.000000 0.000000 1.000000 /end COMPU_METHOD
/begin AXIS_PTS APD_TRFM_NU_ENRICHMENTRQST_Y "TRF AFR modifier table torque request ROC axis" 0x83e70 NO_INPUT_QUANTITY RL_TRFM_NU_ENRICHMENTRQST_Y 2000.000000 CU_TRFM_NU_ENRICHMENTRQST_Y 6 -1000.0 1000.0 BYTE_ORDER MSB_FIRST /end AXIS_PTS
/begin RECORD_LAYOUT RL_TRFM_NU_ENRICHMENTRQST_Y AXIS_PTS_X 1 FLOAT32_IEEE INDEX_INCR DIRECT /end RECORD_LAYOUT
/begin COMPU_METHOD CU_TRFM_NU_ENRICHMENTRQST_Y "Conversion method for TRFm_NU_EnrichmentRqst_y" RAT_FUNC "%10.1" "Nm" COEFFS 0.000000 1.000000 0.000000 0.000000 0.000000 1.000000 /end COMPU_METHOD
/* Scalar calibration for DDE 'TRSc_NU_SparkFallRate'. */
/begin CHARACTERISTIC TRSc_NU_SparkFallRate "(deg/s) retard request rate limit" VALUE 0x84da4 RL_TRSC_NU_SPARKFALLRATE 10000.000000 CU_TRSC_NU_SPARKFALLRATE -10000.000000 0.000000 BYTE_ORDER MSB_FIRST /end CHARACTERISTIC
/begin RECORD_LAYOUT RL_TRSC_NU_SPARKFALLRATE FNC_VALUES 1 FLOAT32_IEEE COLUMN_DIR DIRECT /end RECORD_LAYOUT
/begin COMPU_METHOD CU_TRSC_NU_SPARKFALLRATE "Conversion method for TRSc_NU_SparkFallRate" RAT_FUNC "%10.0" "NU" COEFFS 0.000000 1.000000 0.000000 0.000000 0.000000 1.000000 /end COMPU_METHOD
/* Scalar calibration for DDE 'TRSc_NU_TqHPF_TC'. */
/begin CHARACTERISTIC TRSc_NU_TqHPF_TC "HPF filter time-constant" VALUE 0x84cdc RL_TRSC_NU_TQHPF_TC 1.000000 CU_TRSC_NU_TQHPF_TC 0.000000 1.000000 BYTE_ORDER MSB_FIRST /end CHARACTERISTIC
/begin RECORD_LAYOUT RL_TRSC_NU_TQHPF_TC FNC_VALUES 1 FLOAT32_IEEE COLUMN_DIR DIRECT /end RECORD_LAYOUT
/begin COMPU_METHOD CU_TRSC_NU_TQHPF_TC "Conversion method for TRSc_NU_TqHPF_TC" RAT_FUNC "%10.2" "NU" COEFFS 0.000000 1.000000 0.000000 0.000000 0.000000 1.000000 /end COMPU_METHOD
/* Scalar calibration for DDE 'TRSc_Nm_TqHPF_Thrsh'. */
/begin CHARACTERISTIC TRSc_Nm_TqHPF_Thrsh "Torque HPF threshold to enable TRS" VALUE 0x84ce0 RL_TRSC_NM_TQHPF_THRSH 100.000000 CU_TRSC_NM_TQHPF_THRSH -100.000000 0.000000 BYTE_ORDER MSB_FIRST /end CHARACTERISTIC
/begin RECORD_LAYOUT RL_TRSC_NM_TQHPF_THRSH FNC_VALUES 1 FLOAT32_IEEE COLUMN_DIR DIRECT /end RECORD_LAYOUT
/begin COMPU_METHOD CU_TRSC_NM_TQHPF_THRSH "Conversion method for TRSc_Nm_TqHPF_Thrsh" RAT_FUNC "%10.1" "Nm" COEFFS 0.000000 1.000000 0.000000 0.000000 0.000000 1.000000 /end COMPU_METHOD
/* Scalar calibration for DDE 'TRSc_lam_AFR_EnblThrsh'. */
/begin CHARACTERISTIC TRSc_lam_AFR_EnblThrsh "Target AFR enable threshold" VALUE 0x84cd4 RL_TRSC_LAM_AFR_ENBLTHRSH 1.000000 CU_TRSC_LAM_AFR_ENBLTHRSH 0.000000 1.000000 BYTE_ORDER MSB_FIRST /end CHARACTERISTIC
/begin RECORD_LAYOUT RL_TRSC_LAM_AFR_ENBLTHRSH FNC_VALUES 1 FLOAT32_IEEE COLUMN_DIR DIRECT /end RECORD_LAYOUT
/begin COMPU_METHOD CU_TRSC_LAM_AFR_ENBLTHRSH "Conversion method for TRSc_lam_AFR_EnblThrsh" RAT_FUNC "%10.2" "lam" COEFFS 0.000000 1.000000 0.000000 0.000000 0.000000 1.000000 /end COMPU_METHOD
/* Scalar calibration for DDE 'TRSc_o_SparkRqst'. */
/begin CHARACTERISTIC TRSc_o_SparkRqst "Override flag" VALUE 0x84da8 RL_TRSC_O_SPARKRQST 1.000000 CU_TRSC_O_SPARKRQST 0.000000 1.000000 BYTE_ORDER MSB_FIRST /end CHARACTERISTIC
/begin RECORD_LAYOUT RL_TRSC_O_SPARKRQST FNC_VALUES 1 UBYTE COLUMN_DIR DIRECT /end RECORD_LAYOUT
/begin COMPU_METHOD CU_TRSC_O_SPARKRQST "Conversion method for TRSc_o_SparkRqst" RAT_FUNC "%10.0" "b" COEFFS 0.000000 1.000000 0.000000 0.000000 0.000000 1.000000 /end COMPU_METHOD
/* Scalar calibration for DDE 'TRSc_ret_SparkRqst'. */
/begin CHARACTERISTIC TRSc_ret_SparkRqst "Override value" VALUE 0x84dac RL_TRSC_RET_SPARKRQST 50.000000 CU_TRSC_RET_SPARKRQST 0.000000 50.000000 BYTE_ORDER MSB_FIRST /end CHARACTERISTIC
/begin RECORD_LAYOUT RL_TRSC_RET_SPARKRQST FNC_VALUES 1 FLOAT32_IEEE COLUMN_DIR DIRECT /end RECORD_LAYOUT
/begin COMPU_METHOD CU_TRSC_RET_SPARKRQST "Conversion method for TRSc_ret_SparkRqst" RAT_FUNC "%10.1" "ret" COEFFS 0.000000 1.000000 0.000000 0.000000 0.000000 1.000000 /end COMPU_METHOD
/* Scalar calibration for DDE 'TRSc_s_AFR_EnblDelay'. */
/begin CHARACTERISTIC TRSc_s_AFR_EnblDelay "Target AFR enable delay" VALUE 0x84cd8 RL_TRSC_S_AFR_ENBLDELAY 10.000000 CU_TRSC_S_AFR_ENBLDELAY 0.000000 10.000000 BYTE_ORDER MSB_FIRST /end CHARACTERISTIC
/begin RECORD_LAYOUT RL_TRSC_S_AFR_ENBLDELAY FNC_VALUES 1 FLOAT32_IEEE COLUMN_DIR DIRECT /end RECORD_LAYOUT
/begin COMPU_METHOD CU_TRSC_S_AFR_ENBLDELAY "Conversion method for TRSc_s_AFR_EnblDelay" RAT_FUNC "%10.2" "s" COEFFS 0.000000 1.000000 0.000000 0.000000 0.000000 1.000000 /end COMPU_METHOD
/* Map (2d) calibration for DDE 'TRSm_NU_SparkRqst_z'. */
/begin CHARACTERISTIC TRSm_NU_SparkRqst_z "Transient spark retard table data" MAP 0x84d14 RL_TRSM_NU_SPARKRQST_Z 15.000000 CU_TRSM_NU_SPARKRQST_Z 0.000000 15.000000
 /begin AXIS_DESCR COM_AXIS NO_INPUT_QUANTITY CU_TRSM_NU_SPARKRQST_X 6 0.000000 10000.000000 AXIS_PTS_REF APD_TRSM_NU_SPARKRQST_X /end AXIS_DESCR
 /begin AXIS_DESCR COM_AXIS NO_INPUT_QUANTITY CU_TRSM_NU_SPARKRQST_Y 6 -100.000000 0.000000 AXIS_PTS_REF APD_TRSM_NU_SPARKRQST_Y /end AXIS_DESCR
 BYTE_ORDER MSB_FIRST /end CHARACTERISTIC
/begin RECORD_LAYOUT RL_TRSM_NU_SPARKRQST_Z FNC_VALUES 1 FLOAT32_IEEE COLUMN_DIR DIRECT /end RECORD_LAYOUT
/begin COMPU_METHOD CU_TRSM_NU_SPARKRQST_Z "Conversion method for TRSm_NU_SparkRqst_z" RAT_FUNC "%10.1" "ret" COEFFS 0.000000 1.000000 0.000000 0.000000 0.000000 1.000000 /end COMPU_METHOD
/begin AXIS_PTS APD_TRSM_NU_SPARKRQST_X "Transient spark retard table engine speed axis" 0x84ce4 NO_INPUT_QUANTITY RL_TRSM_NU_SPARKRQST_X 10000.000000 CU_TRSM_NU_SPARKRQST_X 6 0.0 10000.0 BYTE_ORDER MSB_FIRST /end AXIS_PTS
/begin RECORD_LAYOUT RL_TRSM_NU_SPARKRQST_X AXIS_PTS_X 1 FLOAT32_IEEE INDEX_INCR DIRECT /end RECORD_LAYOUT
/begin COMPU_METHOD CU_TRSM_NU_SPARKRQST_X "Conversion method for TRSm_NU_SparkRqst_x" RAT_FUNC "%10.0" "RPM" COEFFS 0.000000 1.000000 0.000000 0.000000 0.000000 1.000000 /end COMPU_METHOD
/begin AXIS_PTS APD_TRSM_NU_SPARKRQST_Y "Transient spark retard table torque HPF peak axis" 0x84cfc NO_INPUT_QUANTITY RL_TRSM_NU_SPARKRQST_Y 100.000000 CU_TRSM_NU_SPARKRQST_Y 6 -100.0 0.0 BYTE_ORDER MSB_FIRST /end AXIS_PTS
/begin RECORD_LAYOUT RL_TRSM_NU_SPARKRQST_Y AXIS_PTS_X 1 FLOAT32_IEEE INDEX_INCR DIRECT /end RECORD_LAYOUT
/begin COMPU_METHOD CU_TRSM_NU_SPARKRQST_Y "Conversion method for TRSm_NU_SparkRqst_y" RAT_FUNC "%10.0" "Nm" COEFFS 0.000000 1.000000 0.000000 0.000000 0.000000 1.000000 /end COMPU_METHOD
/* Scalar calibration for DDE 'TSSc_b_OBDtimeOK'. */
/begin CHARACTERISTIC TSSc_b_OBDtimeOK "Override value" VALUE 0x8ce5f RL_TSSC_B_OBDTIMEOK 1.000000 CU_TSSC_B_OBDTIMEOK 0.000000 1.000000 BYTE_ORDER MSB_FIRST /end CHARACTERISTIC
/begin RECORD_LAYOUT RL_TSSC_B_OBDTIMEOK FNC_VALUES 1 UBYTE COLUMN_DIR DIRECT /end RECORD_LAYOUT
/begin COMPU_METHOD CU_TSSC_B_OBDTIMEOK "Conversion method for TSSc_b_OBDtimeOK" RAT_FUNC "%10.0" "b" COEFFS 0.000000 1.000000 0.000000 0.000000 0.000000 1.000000 /end COMPU_METHOD
/* Scalar calibration for DDE 'TSSc_o_OBDtimeOK'. */
/begin CHARACTERISTIC TSSc_o_OBDtimeOK "Override flag" VALUE 0x8ce5e RL_TSSC_O_OBDTIMEOK 1.000000 CU_TSSC_O_OBDTIMEOK 0.000000 1.000000 BYTE_ORDER MSB_FIRST /end CHARACTERISTIC
/begin RECORD_LAYOUT RL_TSSC_O_OBDTIMEOK FNC_VALUES 1 UBYTE COLUMN_DIR DIRECT /end RECORD_LAYOUT
/begin COMPU_METHOD CU_TSSC_O_OBDTIMEOK "Conversion method for TSSc_o_OBDtimeOK" RAT_FUNC "%10.0" "o" COEFFS 0.000000 1.000000 0.000000 0.000000 0.000000 1.000000 /end COMPU_METHOD
/* Scalar calibration for DDE 'TSTc_b_StopKnockChanges'. */
/begin CHARACTERISTIC TSTc_b_StopKnockChanges "For manual troubleshooting" VALUE 0x8c21b RL_TSTC_B_STOPKNOCKCHANGES 1.000000 CU_TSTC_B_STOPKNOCKCHANGES 0.000000 1.000000 BYTE_ORDER MSB_FIRST /end CHARACTERISTIC
/begin RECORD_LAYOUT RL_TSTC_B_STOPKNOCKCHANGES FNC_VALUES 1 UBYTE COLUMN_DIR DIRECT /end RECORD_LAYOUT
/begin COMPU_METHOD CU_TSTC_B_STOPKNOCKCHANGES "Conversion method for TSTc_b_StopKnockChanges" RAT_FUNC "%10.0" "o" COEFFS 0.000000 1.000000 0.000000 0.000000 0.000000 1.000000 /end COMPU_METHOD
/* Scalar calibration for DDE 'TSTc_b_UseY14'. */
/begin CHARACTERISTIC TSTc_b_UseY14 "(not defined)" VALUE 0x8bf89 RL_TSTC_B_USEY14 1.000000 CU_TSTC_B_USEY14 0.000000 1.000000 BYTE_ORDER MSB_FIRST /end CHARACTERISTIC
/begin RECORD_LAYOUT RL_TSTC_B_USEY14 FNC_VALUES 1 UBYTE COLUMN_DIR DIRECT /end RECORD_LAYOUT
/begin COMPU_METHOD CU_TSTC_B_USEY14 "Conversion method for TSTc_b_UseY14" RAT_FUNC "%10.0" "b" COEFFS 0.000000 1.000000 0.000000 0.000000 0.000000 1.000000 /end COMPU_METHOD
/* Scalar calibration for DDE 'TURc_NU_BoostPressErrROC_Thrsh'. */
/begin CHARACTERISTIC TURc_NU_BoostPressErrROC_Thrsh "Lower limit for activating derivative control for turbo actuator" VALUE 0x8b894 RL_TURC_NU_BOOSTPRESSERRROC_TH0 1.000000 CU_TURC_NU_BOOSTPRESSERRROC_TH0 0.000000 1.000000 BYTE_ORDER MSB_FIRST /end CHARACTERISTIC
/begin RECORD_LAYOUT RL_TURC_NU_BOOSTPRESSERRROC_TH0 FNC_VALUES 1 FLOAT32_IEEE COLUMN_DIR DIRECT /end RECORD_LAYOUT
/begin COMPU_METHOD CU_TURC_NU_BOOSTPRESSERRROC_TH0 "Conversion method for TURc_NU_BoostPressErrROC_Thrsh" RAT_FUNC "%10.3" "NU" COEFFS 0.000000 1.000000 0.000000 0.000000 0.000000 1.000000 /end COMPU_METHOD
/* Scalar calibration for DDE 'TURc_NU_DGain'. */
/begin CHARACTERISTIC TURc_NU_DGain "Derivative gain for turbo actuator control" VALUE 0x8b898 RL_TURC_NU_DGAIN 10.000000 CU_TURC_NU_DGAIN 0.000000 10.000000 BYTE_ORDER MSB_FIRST /end CHARACTERISTIC
/begin RECORD_LAYOUT RL_TURC_NU_DGAIN FNC_VALUES 1 FLOAT32_IEEE COLUMN_DIR DIRECT /end RECORD_LAYOUT
/begin COMPU_METHOD CU_TURC_NU_DGAIN "Conversion method for TURc_NU_DGain" RAT_FUNC "%10.3" "NU" COEFFS 0.000000 1.000000 0.000000 0.000000 0.000000 1.000000 /end COMPU_METHOD
/* Scalar calibration for DDE 'TURc_NU_IGain'. */
/begin CHARACTERISTIC TURc_NU_IGain "Integral gain for turbo actuator control" VALUE 0x8b888 RL_TURC_NU_IGAIN 10.000000 CU_TURC_NU_IGAIN 0.000000 10.000000 BYTE_ORDER MSB_FIRST /end CHARACTERISTIC
/begin RECORD_LAYOUT RL_TURC_NU_IGAIN FNC_VALUES 1 FLOAT32_IEEE COLUMN_DIR DIRECT /end RECORD_LAYOUT
/begin COMPU_METHOD CU_TURC_NU_IGAIN "Conversion method for TURc_NU_IGain" RAT_FUNC "%10.4" "NU" COEFFS 0.000000 1.000000 0.000000 0.000000 0.000000 1.000000 /end COMPU_METHOD
/* Scalar calibration for DDE 'TURc_NU_PGain'. */
/begin CHARACTERISTIC TURc_NU_PGain "Proportional gain for turbo actuator control" VALUE 0x8b87c RL_TURC_NU_PGAIN 10.000000 CU_TURC_NU_PGAIN 0.000000 10.000000 BYTE_ORDER MSB_FIRST /end CHARACTERISTIC
/begin RECORD_LAYOUT RL_TURC_NU_PGAIN FNC_VALUES 1 FLOAT32_IEEE COLUMN_DIR DIRECT /end RECORD_LAYOUT
/begin COMPU_METHOD CU_TURC_NU_PGAIN "Conversion method for TURc_NU_PGain" RAT_FUNC "%10.4" "NU" COEFFS 0.000000 1.000000 0.000000 0.000000 0.000000 1.000000 /end COMPU_METHOD
/* Scalar calibration for DDE 'TURc_b_AtMaxBoost'. */
/begin CHARACTERISTIC TURc_b_AtMaxBoost "Override value" VALUE 0x8be39 RL_TURC_B_ATMAXBOOST 1.000000 CU_TURC_B_ATMAXBOOST 0.000000 1.000000 BYTE_ORDER MSB_FIRST /end CHARACTERISTIC
/begin RECORD_LAYOUT RL_TURC_B_ATMAXBOOST FNC_VALUES 1 UBYTE COLUMN_DIR DIRECT /end RECORD_LAYOUT
/begin COMPU_METHOD CU_TURC_B_ATMAXBOOST "Conversion method for TURc_b_AtMaxBoost" RAT_FUNC "%10.0" "b" COEFFS 0.000000 1.000000 0.000000 0.000000 0.000000 1.000000 /end COMPU_METHOD
/* Scalar calibration for DDE 'TURc_b_AtMinBoost'. */
/begin CHARACTERISTIC TURc_b_AtMinBoost "Override value" VALUE 0x8be31 RL_TURC_B_ATMINBOOST 1.000000 CU_TURC_B_ATMINBOOST 0.000000 1.000000 BYTE_ORDER MSB_FIRST /end CHARACTERISTIC
/begin RECORD_LAYOUT RL_TURC_B_ATMINBOOST FNC_VALUES 1 UBYTE COLUMN_DIR DIRECT /end RECORD_LAYOUT
/begin COMPU_METHOD CU_TURC_B_ATMINBOOST "Conversion method for TURc_b_AtMinBoost" RAT_FUNC "%10.0" "b" COEFFS 0.000000 1.000000 0.000000 0.000000 0.000000 1.000000 /end COMPU_METHOD
/* Scalar calibration for DDE 'TURc_b_CompBypassValve'. */
/begin CHARACTERISTIC TURc_b_CompBypassValve "Override value" VALUE 0x8be6d RL_TURC_B_COMPBYPASSVALVE 1.000000 CU_TURC_B_COMPBYPASSVALVE 0.000000 1.000000 BYTE_ORDER MSB_FIRST /end CHARACTERISTIC
/begin RECORD_LAYOUT RL_TURC_B_COMPBYPASSVALVE FNC_VALUES 1 UBYTE COLUMN_DIR DIRECT /end RECORD_LAYOUT
/begin COMPU_METHOD CU_TURC_B_COMPBYPASSVALVE "Conversion method for TURc_b_CompBypassValve" RAT_FUNC "%10.0" "b" COEFFS 0.000000 1.000000 0.000000 0.000000 0.000000 1.000000 /end COMPU_METHOD
/* Scalar calibration for DDE 'TURc_b_FBTableUse'. */
/begin CHARACTERISTIC TURc_b_FBTableUse "Override value" VALUE 0x8bda4 RL_TURC_B_FBTABLEUSE 1.000000 CU_TURC_B_FBTABLEUSE 0.000000 1.000000 BYTE_ORDER MSB_FIRST /end CHARACTERISTIC
/begin RECORD_LAYOUT RL_TURC_B_FBTABLEUSE FNC_VALUES 1 UBYTE COLUMN_DIR DIRECT /end RECORD_LAYOUT
/begin COMPU_METHOD CU_TURC_B_FBTABLEUSE "Conversion method for TURc_b_FBTableUse" RAT_FUNC "%10.0" "b" COEFFS 0.000000 1.000000 0.000000 0.000000 0.000000 1.000000 /end COMPU_METHOD
/* Scalar calibration for DDE 'TURc_b_ResetITerm'. */
/begin CHARACTERISTIC TURc_b_ResetITerm "(not defined)" VALUE 0x8b880 RL_TURC_B_RESETITERM 1.000000 CU_TURC_B_RESETITERM 0.000000 1.000000 BYTE_ORDER MSB_FIRST /end CHARACTERISTIC
/begin RECORD_LAYOUT RL_TURC_B_RESETITERM FNC_VALUES 1 UBYTE COLUMN_DIR DIRECT /end RECORD_LAYOUT
/begin COMPU_METHOD CU_TURC_B_RESETITERM "Conversion method for TURc_b_ResetITerm" RAT_FUNC "%10.0" "b" COEFFS 0.000000 1.000000 0.000000 0.000000 0.000000 1.000000 /end COMPU_METHOD
/* Scalar calibration for DDE 'TURc_b_UsePrRatioForCtrl'. */
/begin CHARACTERISTIC TURc_b_UsePrRatioForCtrl "Use pressure ration instead of MAP target for turbo control" VALUE 0x8b8a4 RL_TURC_B_USEPRRATIOFORCTRL 1.000000 CU_TURC_B_USEPRRATIOFORCTRL 0.000000 1.000000 BYTE_ORDER MSB_FIRST /end CHARACTERISTIC
/begin RECORD_LAYOUT RL_TURC_B_USEPRRATIOFORCTRL FNC_VALUES 1 UBYTE COLUMN_DIR DIRECT /end RECORD_LAYOUT
/begin COMPU_METHOD CU_TURC_B_USEPRRATIOFORCTRL "Conversion method for TURc_b_UsePrRatioForCtrl" RAT_FUNC "%10.0" "b" COEFFS 0.000000 1.000000 0.000000 0.000000 0.000000 1.000000 /end COMPU_METHOD
/* Scalar calibration for DDE 'TURc_kPa_DbndLatchI'. */
/begin CHARACTERISTIC TURc_kPa_DbndLatchI "Deadband for integral anti windup" VALUE 0x8b884 RL_TURC_KPA_DBNDLATCHI 1000.000000 CU_TURC_KPA_DBNDLATCHI 0.000000 1000.000000 BYTE_ORDER MSB_FIRST /end CHARACTERISTIC
/begin RECORD_LAYOUT RL_TURC_KPA_DBNDLATCHI FNC_VALUES 1 FLOAT32_IEEE COLUMN_DIR DIRECT /end RECORD_LAYOUT
/begin COMPU_METHOD CU_TURC_KPA_DBNDLATCHI "Conversion method for TURc_kPa_DbndLatchI" RAT_FUNC "%10.2" "kPa" COEFFS 0.000000 1.000000 0.000000 0.000000 0.000000 1.000000 /end COMPU_METHOD
/* Scalar calibration for DDE 'TURc_kPa_MechanicalSetpoint'. */
/begin CHARACTERISTIC TURc_kPa_MechanicalSetpoint "Wastegate control will not begin until this amount of pressure is requested (mechanical boost delta-P across compressor)" VALUE 0x8b86c RL_TURC_KPA_MECHANICALSETPOINT 150.000000 CU_TURC_KPA_MECHANICALSETPOINT 0.000000 150.000000 BYTE_ORDER MSB_FIRST /end CHARACTERISTIC
/begin RECORD_LAYOUT RL_TURC_KPA_MECHANICALSETPOINT FNC_VALUES 1 FLOAT32_IEEE COLUMN_DIR DIRECT /end RECORD_LAYOUT
/begin COMPU_METHOD CU_TURC_KPA_MECHANICALSETPOINT "Conversion method for TURc_kPa_MechanicalSetpoint" RAT_FUNC "%10.0" "kPa" COEFFS 0.000000 1.000000 0.000000 0.000000 0.000000 1.000000 /end COMPU_METHOD
/* Scalar calibration for DDE 'TURc_kPa_TurboErroThr'. */
/begin CHARACTERISTIC TURc_kPa_TurboErroThr "Turbo kPa Error Thr" VALUE 0x8bf70 RL_TURC_KPA_TURBOERROTHR 1000.000000 CU_TURC_KPA_TURBOERROTHR 0.000000 1000.000000 BYTE_ORDER MSB_FIRST /end CHARACTERISTIC
/begin RECORD_LAYOUT RL_TURC_KPA_TURBOERROTHR FNC_VALUES 1 FLOAT32_IEEE COLUMN_DIR DIRECT /end RECORD_LAYOUT
/begin COMPU_METHOD CU_TURC_KPA_TURBOERROTHR "Conversion method for TURc_kPa_TurboErroThr" RAT_FUNC "%10.1" "kPa" COEFFS 0.000000 1.000000 0.000000 0.000000 0.000000 1.000000 /end COMPU_METHOD
/* Scalar calibration for DDE 'TURc_o_AtMaxBoost'. */
/begin CHARACTERISTIC TURc_o_AtMaxBoost "Override flag" VALUE 0x8be38 RL_TURC_O_ATMAXBOOST 1.000000 CU_TURC_O_ATMAXBOOST 0.000000 1.000000 BYTE_ORDER MSB_FIRST /end CHARACTERISTIC
/begin RECORD_LAYOUT RL_TURC_O_ATMAXBOOST FNC_VALUES 1 UBYTE COLUMN_DIR DIRECT /end RECORD_LAYOUT
/begin COMPU_METHOD CU_TURC_O_ATMAXBOOST "Conversion method for TURc_o_AtMaxBoost" RAT_FUNC "%10.0" "o" COEFFS 0.000000 1.000000 0.000000 0.000000 0.000000 1.000000 /end COMPU_METHOD
/* Scalar calibration for DDE 'TURc_o_AtMinBoost'. */
/begin CHARACTERISTIC TURc_o_AtMinBoost "Override flag" VALUE 0x8be30 RL_TURC_O_ATMINBOOST 1.000000 CU_TURC_O_ATMINBOOST 0.000000 1.000000 BYTE_ORDER MSB_FIRST /end CHARACTERISTIC
/begin RECORD_LAYOUT RL_TURC_O_ATMINBOOST FNC_VALUES 1 UBYTE COLUMN_DIR DIRECT /end RECORD_LAYOUT
/begin COMPU_METHOD CU_TURC_O_ATMINBOOST "Conversion method for TURc_o_AtMinBoost" RAT_FUNC "%10.0" "o" COEFFS 0.000000 1.000000 0.000000 0.000000 0.000000 1.000000 /end COMPU_METHOD
/* Scalar calibration for DDE 'TURc_o_CompBypassValve'. */
/begin CHARACTERISTIC TURc_o_CompBypassValve "Override flag" VALUE 0x8be6c RL_TURC_O_COMPBYPASSVALVE 1.000000 CU_TURC_O_COMPBYPASSVALVE 0.000000 1.000000 BYTE_ORDER MSB_FIRST /end CHARACTERISTIC
/begin RECORD_LAYOUT RL_TURC_O_COMPBYPASSVALVE FNC_VALUES 1 UBYTE COLUMN_DIR DIRECT /end RECORD_LAYOUT
/begin COMPU_METHOD CU_TURC_O_COMPBYPASSVALVE "Conversion method for TURc_o_CompBypassValve" RAT_FUNC "%10.0" "o" COEFFS 0.000000 1.000000 0.000000 0.000000 0.000000 1.000000 /end COMPU_METHOD
/* Scalar calibration for DDE 'TURc_o_TurCtrlDC'. */
/begin CHARACTERISTIC TURc_o_TurCtrlDC "Override flag" VALUE 0x8bd9c RL_TURC_O_TURCTRLDC 1.000000 CU_TURC_O_TURCTRLDC 0.000000 1.000000 BYTE_ORDER MSB_FIRST /end CHARACTERISTIC
/begin RECORD_LAYOUT RL_TURC_O_TURCTRLDC FNC_VALUES 1 UBYTE COLUMN_DIR DIRECT /end RECORD_LAYOUT
/begin COMPU_METHOD CU_TURC_O_TURCTRLDC "Conversion method for TURc_o_TurCtrlDC" RAT_FUNC "%10.0" "o" COEFFS 0.000000 1.000000 0.000000 0.000000 0.000000 1.000000 /end COMPU_METHOD
/* Scalar calibration for DDE 'TURc_pct_FB_EffortDbndMax'. */
/begin CHARACTERISTIC TURc_pct_FB_EffortDbndMax "End of deadband on PID effort for turbo control" VALUE 0x8b89c RL_TURC_PCT_FB_EFFORTDBNDMAX 1.000000 CU_TURC_PCT_FB_EFFORTDBNDMAX 0.000000 1.000000 BYTE_ORDER MSB_FIRST /end CHARACTERISTIC
/begin RECORD_LAYOUT RL_TURC_PCT_FB_EFFORTDBNDMAX FNC_VALUES 1 FLOAT32_IEEE COLUMN_DIR DIRECT /end RECORD_LAYOUT
/begin COMPU_METHOD CU_TURC_PCT_FB_EFFORTDBNDMAX "Conversion method for TURc_pct_FB_EffortDbndMax" RAT_FUNC "%10.2" "pct" COEFFS 0.000000 1.000000 0.000000 0.000000 0.000000 1.000000 /end COMPU_METHOD
/* Scalar calibration for DDE 'TURc_pct_FB_EffortDbndMin'. */
/begin CHARACTERISTIC TURc_pct_FB_EffortDbndMin "Start of deadband on PID effort for turbo control" VALUE 0x8b8a0 RL_TURC_PCT_FB_EFFORTDBNDMIN 1.000000 CU_TURC_PCT_FB_EFFORTDBNDMIN -1.000000 0.000000 BYTE_ORDER MSB_FIRST /end CHARACTERISTIC
/begin RECORD_LAYOUT RL_TURC_PCT_FB_EFFORTDBNDMIN FNC_VALUES 1 FLOAT32_IEEE COLUMN_DIR DIRECT /end RECORD_LAYOUT
/begin COMPU_METHOD CU_TURC_PCT_FB_EFFORTDBNDMIN "Conversion method for TURc_pct_FB_EffortDbndMin" RAT_FUNC "%10.2" "pct" COEFFS 0.000000 1.000000 0.000000 0.000000 0.000000 1.000000 /end COMPU_METHOD
/* Scalar calibration for DDE 'TURc_pct_ITermMax'. */
/begin CHARACTERISTIC TURc_pct_ITermMax "Integral anti windup maximum threshold for turbo actuator control" VALUE 0x8b890 RL_TURC_PCT_ITERMMAX 1.000000 CU_TURC_PCT_ITERMMAX 0.000000 1.000000 BYTE_ORDER MSB_FIRST /end CHARACTERISTIC
/begin RECORD_LAYOUT RL_TURC_PCT_ITERMMAX FNC_VALUES 1 FLOAT32_IEEE COLUMN_DIR DIRECT /end RECORD_LAYOUT
/begin COMPU_METHOD CU_TURC_PCT_ITERMMAX "Conversion method for TURc_pct_ITermMax" RAT_FUNC "%10.2" "pct" COEFFS 0.000000 1.000000 0.000000 0.000000 0.000000 1.000000 /end COMPU_METHOD
/* Scalar calibration for DDE 'TURc_pct_ITermMin'. */
/begin CHARACTERISTIC TURc_pct_ITermMin "Integral anti windup minimum threshold for turbo actuator control" VALUE 0x8b88c RL_TURC_PCT_ITERMMIN 1.000000 CU_TURC_PCT_ITERMMIN -1.000000 0.000000 BYTE_ORDER MSB_FIRST /end CHARACTERISTIC
/begin RECORD_LAYOUT RL_TURC_PCT_ITERMMIN FNC_VALUES 1 FLOAT32_IEEE COLUMN_DIR DIRECT /end RECORD_LAYOUT
/begin COMPU_METHOD CU_TURC_PCT_ITERMMIN "Conversion method for TURc_pct_ITermMin" RAT_FUNC "%10.2" "pct" COEFFS 0.000000 1.000000 0.000000 0.000000 0.000000 1.000000 /end COMPU_METHOD
/* Scalar calibration for DDE 'TURc_pct_TurCtrlDC'. */
/begin CHARACTERISTIC TURc_pct_TurCtrlDC "Override value" VALUE 0x8bda0 RL_TURC_PCT_TURCTRLDC 1.000000 CU_TURC_PCT_TURCTRLDC 0.000000 1.000000 BYTE_ORDER MSB_FIRST /end CHARACTERISTIC
/begin RECORD_LAYOUT RL_TURC_PCT_TURCTRLDC FNC_VALUES 1 FLOAT32_IEEE COLUMN_DIR DIRECT /end RECORD_LAYOUT
/begin COMPU_METHOD CU_TURC_PCT_TURCTRLDC "Conversion method for TURc_pct_TurCtrlDC" RAT_FUNC "%10.3" "pct" COEFFS 0.000000 1.000000 0.000000 0.000000 0.000000 1.000000 /end COMPU_METHOD
/* Map (1d) calibration for DDE 'TURm_NU_EffortToDuty_z'. */
/begin CHARACTERISTIC TURm_NU_EffortToDuty_z "Turbo control effort to duty cycle table data" CURVE 0x8ba0c RL_TURM_NU_EFFORTTODUTY_Z 1.000000 CU_TURM_NU_EFFORTTODUTY_Z 0.000000 1.000000
 /begin AXIS_DESCR COM_AXIS TUR_pct_TotalEffort CU_TURM_NU_EFFORTTODUTY_X 6 0.000000 1.000000 AXIS_PTS_REF APD_TURM_NU_EFFORTTODUTY_X /end AXIS_DESCR
 BYTE_ORDER MSB_FIRST /end CHARACTERISTIC
/begin RECORD_LAYOUT RL_TURM_NU_EFFORTTODUTY_Z FNC_VALUES 1 FLOAT32_IEEE COLUMN_DIR DIRECT /end RECORD_LAYOUT
/begin COMPU_METHOD CU_TURM_NU_EFFORTTODUTY_Z "Conversion method for TURm_NU_EffortToDuty_z" RAT_FUNC "%10.4" "pct" COEFFS 0.000000 1.000000 0.000000 0.000000 0.000000 1.000000 /end COMPU_METHOD
/begin AXIS_PTS APD_TURM_NU_EFFORTTODUTY_X "Turbo control effort to duty cycle table effort axis" 0x8b9f4 TUR_pct_TotalEffort RL_TURM_NU_EFFORTTODUTY_X 1.000000 CU_TURM_NU_EFFORTTODUTY_X 6 0.0 1.0 BYTE_ORDER MSB_FIRST /end AXIS_PTS
/begin RECORD_LAYOUT RL_TURM_NU_EFFORTTODUTY_X AXIS_PTS_X 1 FLOAT32_IEEE INDEX_INCR DIRECT /end RECORD_LAYOUT
/begin COMPU_METHOD CU_TURM_NU_EFFORTTODUTY_X "Conversion method for TURm_NU_EffortToDuty_x" RAT_FUNC "%10.4" "pct" COEFFS 0.000000 1.000000 0.000000 0.000000 0.000000 1.000000 /end COMPU_METHOD
/* Map (2d) calibration for DDE 'TURm_NU_FF1_z'. */
/begin CHARACTERISTIC TURm_NU_FF1_z "Turbo feedforward effort table data" MAP 0x8ba6c RL_TURM_NU_FF1_Z 1.000000 CU_TURM_NU_FF1_Z 0.000000 1.000000
 /begin AXIS_DESCR COM_AXIS NO_INPUT_QUANTITY CU_TURM_NU_FF1_X 10 0.000000 2.500000 AXIS_PTS_REF APD_TURM_NU_FF1_X /end AXIS_DESCR
 /begin AXIS_DESCR COM_AXIS NO_INPUT_QUANTITY CU_TURM_NU_FF1_Y 8 0.000000 8000.000000 AXIS_PTS_REF APD_TURM_NU_FF1_Y /end AXIS_DESCR
 BYTE_ORDER MSB_FIRST /end CHARACTERISTIC
/begin RECORD_LAYOUT RL_TURM_NU_FF1_Z FNC_VALUES 1 FLOAT32_IEEE COLUMN_DIR DIRECT /end RECORD_LAYOUT
/begin COMPU_METHOD CU_TURM_NU_FF1_Z "Conversion method for TURm_NU_FF1_z" RAT_FUNC "%10.3" "pct" COEFFS 0.000000 1.000000 0.000000 0.000000 0.000000 1.000000 /end COMPU_METHOD
/begin AXIS_PTS APD_TURM_NU_FF1_X "Pressure Ratio" 0x8ba24 NO_INPUT_QUANTITY RL_TURM_NU_FF1_X 2.500000 CU_TURM_NU_FF1_X 10 0.0 2.5 BYTE_ORDER MSB_FIRST /end AXIS_PTS
/begin RECORD_LAYOUT RL_TURM_NU_FF1_X AXIS_PTS_X 1 FLOAT32_IEEE INDEX_INCR DIRECT /end RECORD_LAYOUT
/begin COMPU_METHOD CU_TURM_NU_FF1_X "Conversion method for TURm_NU_FF1_x" RAT_FUNC "%10.2" "kPa" COEFFS 0.000000 1.000000 0.000000 0.000000 0.000000 1.000000 /end COMPU_METHOD
/begin AXIS_PTS APD_TURM_NU_FF1_Y "Engine Speed" 0x8ba4c NO_INPUT_QUANTITY RL_TURM_NU_FF1_Y 8000.000000 CU_TURM_NU_FF1_Y 8 0.0 8000.0 BYTE_ORDER MSB_FIRST /end AXIS_PTS
/begin RECORD_LAYOUT RL_TURM_NU_FF1_Y AXIS_PTS_X 1 FLOAT32_IEEE INDEX_INCR DIRECT /end RECORD_LAYOUT
/begin COMPU_METHOD CU_TURM_NU_FF1_Y "Conversion method for TURm_NU_FF1_y" RAT_FUNC "%10.2" "RPM" COEFFS 0.000000 1.000000 0.000000 0.000000 0.000000 1.000000 /end COMPU_METHOD
/* Map (2d) calibration for DDE 'TURm_NU_FF_z'. */
/begin CHARACTERISTIC TURm_NU_FF_z "Turbo feedforward effort table data" MAP 0x8b8ec RL_TURM_NU_FF_Z 1.000000 CU_TURM_NU_FF_Z 0.000000 1.000000
 /begin AXIS_DESCR COM_AXIS NO_INPUT_QUANTITY CU_TURM_NU_FF_X 11 0.000000 250.000000 AXIS_PTS_REF APD_TURM_NU_FF_X /end AXIS_DESCR
 /begin AXIS_DESCR COM_AXIS NO_INPUT_QUANTITY CU_TURM_NU_FF_Y 6 0.000000 1000.000000 AXIS_PTS_REF APD_TURM_NU_FF_Y /end AXIS_DESCR
 BYTE_ORDER MSB_FIRST /end CHARACTERISTIC
/begin RECORD_LAYOUT RL_TURM_NU_FF_Z FNC_VALUES 1 FLOAT32_IEEE COLUMN_DIR DIRECT /end RECORD_LAYOUT
/begin COMPU_METHOD CU_TURM_NU_FF_Z "Conversion method for TURm_NU_FF_z" RAT_FUNC "%10.3" "pct" COEFFS 0.000000 1.000000 0.000000 0.000000 0.000000 1.000000 /end COMPU_METHOD
/begin AXIS_PTS APD_TURM_NU_FF_X "(pressure ratio) Turbo feedforward effort table pressure ratio axis" 0x8b8a8 NO_INPUT_QUANTITY RL_TURM_NU_FF_X 250.000000 CU_TURM_NU_FF_X 11 0.0 250.0 BYTE_ORDER MSB_FIRST /end AXIS_PTS
/begin RECORD_LAYOUT RL_TURM_NU_FF_X AXIS_PTS_X 1 FLOAT32_IEEE INDEX_INCR DIRECT /end RECORD_LAYOUT
/begin COMPU_METHOD CU_TURM_NU_FF_X "Conversion method for TURm_NU_FF_x" RAT_FUNC "%10.2" "NU" COEFFS 0.000000 1.000000 0.000000 0.000000 0.000000 1.000000 /end COMPU_METHOD
/begin AXIS_PTS APD_TURM_NU_FF_Y "(gps MAF) Turbo feedforward effort table mass air flow axis" 0x8b8d4 NO_INPUT_QUANTITY RL_TURM_NU_FF_Y 1000.000000 CU_TURM_NU_FF_Y 6 0.0 1000.0 BYTE_ORDER MSB_FIRST /end AXIS_PTS
/begin RECORD_LAYOUT RL_TURM_NU_FF_Y AXIS_PTS_X 1 FLOAT32_IEEE INDEX_INCR DIRECT /end RECORD_LAYOUT
/begin COMPU_METHOD CU_TURM_NU_FF_Y "Conversion method for TURm_NU_FF_y" RAT_FUNC "%10.2" "gps" COEFFS 0.000000 1.000000 0.000000 0.000000 0.000000 1.000000 /end COMPU_METHOD
/* Scalar calibration for DDE 'VCPc_NU_CamDGain'. */
/begin CHARACTERISTIC VCPc_NU_CamDGain "Differential Gain for VCP Controller" VALUE 0x8bd40 RL_VCPC_NU_CAMDGAIN 10.000000 CU_VCPC_NU_CAMDGAIN 0.000000 10.000000 BYTE_ORDER MSB_FIRST /end CHARACTERISTIC
/begin RECORD_LAYOUT RL_VCPC_NU_CAMDGAIN FNC_VALUES 1 FLOAT32_IEEE COLUMN_DIR DIRECT /end RECORD_LAYOUT
/begin COMPU_METHOD CU_VCPC_NU_CAMDGAIN "Conversion method for VCPc_NU_CamDGain" RAT_FUNC "%10.3" "NU" COEFFS 0.000000 1.000000 0.000000 0.000000 0.000000 1.000000 /end COMPU_METHOD
/* Scalar calibration for DDE 'VCPc_NU_CamErrROCThrsh'. */
/begin CHARACTERISTIC VCPc_NU_CamErrROCThrsh "(deg/s) D-term will become inactive for rate of change below this threshold" VALUE 0x8bd3c RL_VCPC_NU_CAMERRROCTHRSH 1000.000000 CU_VCPC_NU_CAMERRROCTHRSH 0.000000 1000.000000 BYTE_ORDER MSB_FIRST /end CHARACTERISTIC
/begin RECORD_LAYOUT RL_VCPC_NU_CAMERRROCTHRSH FNC_VALUES 1 FLOAT32_IEEE COLUMN_DIR DIRECT /end RECORD_LAYOUT
/begin COMPU_METHOD CU_VCPC_NU_CAMERRROCTHRSH "Conversion method for VCPc_NU_CamErrROCThrsh" RAT_FUNC "%10.2" "NU" COEFFS 0.000000 1.000000 0.000000 0.000000 0.000000 1.000000 /end COMPU_METHOD
/* Scalar calibration for DDE 'VCPc_NU_CamIGain'. */
/begin CHARACTERISTIC VCPc_NU_CamIGain "Integral Gain" VALUE 0x8bd30 RL_VCPC_NU_CAMIGAIN 10.000000 CU_VCPC_NU_CAMIGAIN 0.000000 10.000000 BYTE_ORDER MSB_FIRST /end CHARACTERISTIC
/begin RECORD_LAYOUT RL_VCPC_NU_CAMIGAIN FNC_VALUES 1 FLOAT32_IEEE COLUMN_DIR DIRECT /end RECORD_LAYOUT
/begin COMPU_METHOD CU_VCPC_NU_CAMIGAIN "Conversion method for VCPc_NU_CamIGain" RAT_FUNC "%10.3" "NU" COEFFS 0.000000 1.000000 0.000000 0.000000 0.000000 1.000000 /end COMPU_METHOD
/* Scalar calibration for DDE 'VCPc_NU_CamPGain'. */
/begin CHARACTERISTIC VCPc_NU_CamPGain "(pct/deg) Proportional Controller Gain" VALUE 0x8bd14 RL_VCPC_NU_CAMPGAIN 10.000000 CU_VCPC_NU_CAMPGAIN 0.000000 10.000000 BYTE_ORDER MSB_FIRST /end CHARACTERISTIC
/begin RECORD_LAYOUT RL_VCPC_NU_CAMPGAIN FNC_VALUES 1 FLOAT32_IEEE COLUMN_DIR DIRECT /end RECORD_LAYOUT
/begin COMPU_METHOD CU_VCPC_NU_CAMPGAIN "Conversion method for VCPc_NU_CamPGain" RAT_FUNC "%10.3" "NU" COEFFS 0.000000 1.000000 0.000000 0.000000 0.000000 1.000000 /end COMPU_METHOD
/* Scalar calibration for DDE 'VCPc_NU_TrgtFallRate'. */
/begin CHARACTERISTIC VCPc_NU_TrgtFallRate "(deg/s) Falling Rate Limiter" VALUE 0x8bbc0 RL_VCPC_NU_TRGTFALLRATE 1000.000000 CU_VCPC_NU_TRGTFALLRATE -1000.000000 0.000000 BYTE_ORDER MSB_FIRST /end CHARACTERISTIC
/begin RECORD_LAYOUT RL_VCPC_NU_TRGTFALLRATE FNC_VALUES 1 FLOAT32_IEEE COLUMN_DIR DIRECT /end RECORD_LAYOUT
/begin COMPU_METHOD CU_VCPC_NU_TRGTFALLRATE "Conversion method for VCPc_NU_TrgtFallRate" RAT_FUNC "%10.0" "NU" COEFFS 0.000000 1.000000 0.000000 0.000000 0.000000 1.000000 /end COMPU_METHOD
/* Scalar calibration for DDE 'VCPc_NU_TrgtRiseRate'. */
/begin CHARACTERISTIC VCPc_NU_TrgtRiseRate "(deg/s) Rising Rate Limiter" VALUE 0x8bbc4 RL_VCPC_NU_TRGTRISERATE 1000.000000 CU_VCPC_NU_TRGTRISERATE 0.000000 1000.000000 BYTE_ORDER MSB_FIRST /end CHARACTERISTIC
/begin RECORD_LAYOUT RL_VCPC_NU_TRGTRISERATE FNC_VALUES 1 FLOAT32_IEEE COLUMN_DIR DIRECT /end RECORD_LAYOUT
/begin COMPU_METHOD CU_VCPC_NU_TRGTRISERATE "Conversion method for VCPc_NU_TrgtRiseRate" RAT_FUNC "%10.0" "NU" COEFFS 0.000000 1.000000 0.000000 0.000000 0.000000 1.000000 /end COMPU_METHOD
/* Scalar calibration for DDE 'VCPc_adv_CamHiStop'. */
/begin CHARACTERISTIC VCPc_adv_CamHiStop "Requests above this amount will be considered full-range" VALUE 0x8bd1c RL_VCPC_ADV_CAMHISTOP 200.000000 CU_VCPC_ADV_CAMHISTOP 0.000000 200.000000 BYTE_ORDER MSB_FIRST /end CHARACTERISTIC
/begin RECORD_LAYOUT RL_VCPC_ADV_CAMHISTOP FNC_VALUES 1 FLOAT32_IEEE COLUMN_DIR DIRECT /end RECORD_LAYOUT
/begin COMPU_METHOD CU_VCPC_ADV_CAMHISTOP "Conversion method for VCPc_adv_CamHiStop" RAT_FUNC "%10.1" "adv" COEFFS 0.000000 1.000000 0.000000 0.000000 0.000000 1.000000 /end COMPU_METHOD
/* Scalar calibration for DDE 'VCPc_adv_CamLoStop'. */
/begin CHARACTERISTIC VCPc_adv_CamLoStop "Requests below this amount will be considered full-range" VALUE 0x8bd28 RL_VCPC_ADV_CAMLOSTOP 200.000000 CU_VCPC_ADV_CAMLOSTOP 0.000000 200.000000 BYTE_ORDER MSB_FIRST /end CHARACTERISTIC
/begin RECORD_LAYOUT RL_VCPC_ADV_CAMLOSTOP FNC_VALUES 1 FLOAT32_IEEE COLUMN_DIR DIRECT /end RECORD_LAYOUT
/begin COMPU_METHOD CU_VCPC_ADV_CAMLOSTOP "Conversion method for VCPc_adv_CamLoStop" RAT_FUNC "%10.1" "NU" COEFFS 0.000000 1.000000 0.000000 0.000000 0.000000 1.000000 /end COMPU_METHOD
/* Scalar calibration for DDE 'VCPc_b_CamResetITerm'. */
/begin CHARACTERISTIC VCPc_b_CamResetITerm "Reset PID Signal" VALUE 0x8bd18 RL_VCPC_B_CAMRESETITERM 1.000000 CU_VCPC_B_CAMRESETITERM 0.000000 1.000000 BYTE_ORDER MSB_FIRST /end CHARACTERISTIC
/begin RECORD_LAYOUT RL_VCPC_B_CAMRESETITERM FNC_VALUES 1 UBYTE COLUMN_DIR DIRECT /end RECORD_LAYOUT
/begin COMPU_METHOD CU_VCPC_B_CAMRESETITERM "Conversion method for VCPc_b_CamResetITerm" RAT_FUNC "%10.0" "b" COEFFS 0.000000 1.000000 0.000000 0.000000 0.000000 1.000000 /end COMPU_METHOD
/* Scalar calibration for DDE 'VCPc_deg_CamDbndLatchI'. */
/begin CHARACTERISTIC VCPc_deg_CamDbndLatchI "Iterm will become frozen whenever error is less than this magnitude" VALUE 0x8bd2c RL_VCPC_DEG_CAMDBNDLATCHI 200.000000 CU_VCPC_DEG_CAMDBNDLATCHI 0.000000 200.000000 BYTE_ORDER MSB_FIRST /end CHARACTERISTIC
/begin RECORD_LAYOUT RL_VCPC_DEG_CAMDBNDLATCHI FNC_VALUES 1 FLOAT32_IEEE COLUMN_DIR DIRECT /end RECORD_LAYOUT
/begin COMPU_METHOD CU_VCPC_DEG_CAMDBNDLATCHI "Conversion method for VCPc_deg_CamDbndLatchI" RAT_FUNC "%10.1" "deg" COEFFS 0.000000 1.000000 0.000000 0.000000 0.000000 1.000000 /end COMPU_METHOD
/* Scalar calibration for DDE 'VCPc_deg_CamHiLatchI'. */
/begin CHARACTERISTIC VCPc_deg_CamHiLatchI "Iterm will become frozen for a full-range request once error falls below this value" VALUE 0x8bd20 RL_VCPC_DEG_CAMHILATCHI 200.000000 CU_VCPC_DEG_CAMHILATCHI 0.000000 200.000000 BYTE_ORDER MSB_FIRST /end CHARACTERISTIC
/begin RECORD_LAYOUT RL_VCPC_DEG_CAMHILATCHI FNC_VALUES 1 FLOAT32_IEEE COLUMN_DIR DIRECT /end RECORD_LAYOUT
/begin COMPU_METHOD CU_VCPC_DEG_CAMHILATCHI "Conversion method for VCPc_deg_CamHiLatchI" RAT_FUNC "%10.1" "deg" COEFFS 0.000000 1.000000 0.000000 0.000000 0.000000 1.000000 /end COMPU_METHOD
/* Scalar calibration for DDE 'VCPc_deg_CamLoLatchI'. */
/begin CHARACTERISTIC VCPc_deg_CamLoLatchI "Iterm will become frozen for a full-range request once error falls below this value" VALUE 0x8bd24 RL_VCPC_DEG_CAMLOLATCHI 200.000000 CU_VCPC_DEG_CAMLOLATCHI 0.000000 200.000000 BYTE_ORDER MSB_FIRST /end CHARACTERISTIC
/begin RECORD_LAYOUT RL_VCPC_DEG_CAMLOLATCHI FNC_VALUES 1 FLOAT32_IEEE COLUMN_DIR DIRECT /end RECORD_LAYOUT
/begin COMPU_METHOD CU_VCPC_DEG_CAMLOLATCHI "Conversion method for VCPc_deg_CamLoLatchI" RAT_FUNC "%10.1" "deg" COEFFS 0.000000 1.000000 0.000000 0.000000 0.000000 1.000000 /end COMPU_METHOD
/* Scalar calibration for DDE 'VCPc_o_CamDC'. */
/begin CHARACTERISTIC VCPc_o_CamDC "PWM Signal Override" VALUE 0x8be32 RL_VCPC_O_CAMDC 1.000000 CU_VCPC_O_CAMDC 0.000000 1.000000 BYTE_ORDER MSB_FIRST /end CHARACTERISTIC
/begin RECORD_LAYOUT RL_VCPC_O_CAMDC FNC_VALUES 1 UBYTE COLUMN_DIR DIRECT /end RECORD_LAYOUT
/begin COMPU_METHOD CU_VCPC_O_CAMDC "Conversion method for VCPc_o_CamDC" RAT_FUNC "%10.0" "o" COEFFS 0.000000 1.000000 0.000000 0.000000 0.000000 1.000000 /end COMPU_METHOD
/* Scalar calibration for DDE 'VCPc_pct_CamDC'. */
/begin CHARACTERISTIC VCPc_pct_CamDC "PWM Signal Override Value" VALUE 0x8be34 RL_VCPC_PCT_CAMDC 1.000000 CU_VCPC_PCT_CAMDC 0.000000 1.000000 BYTE_ORDER MSB_FIRST /end CHARACTERISTIC
/begin RECORD_LAYOUT RL_VCPC_PCT_CAMDC FNC_VALUES 1 FLOAT32_IEEE COLUMN_DIR DIRECT /end RECORD_LAYOUT
/begin COMPU_METHOD CU_VCPC_PCT_CAMDC "Conversion method for VCPc_pct_CamDC" RAT_FUNC "%10.2" "pct" COEFFS 0.000000 1.000000 0.000000 0.000000 0.000000 1.000000 /end COMPU_METHOD
/* Scalar calibration for DDE 'VCPc_pct_CamITermMax'. */
/begin CHARACTERISTIC VCPc_pct_CamITermMax "Input Cam Angle" VALUE 0x8bd38 RL_VCPC_PCT_CAMITERMMAX 1.000000 CU_VCPC_PCT_CAMITERMMAX 0.000000 1.000000 BYTE_ORDER MSB_FIRST /end CHARACTERISTIC
/begin RECORD_LAYOUT RL_VCPC_PCT_CAMITERMMAX FNC_VALUES 1 FLOAT32_IEEE COLUMN_DIR DIRECT /end RECORD_LAYOUT
/begin COMPU_METHOD CU_VCPC_PCT_CAMITERMMAX "Conversion method for VCPc_pct_CamITermMax" RAT_FUNC "%10.2" "NU" COEFFS 0.000000 1.000000 0.000000 0.000000 0.000000 1.000000 /end COMPU_METHOD
/* Scalar calibration for DDE 'VCPc_pct_CamITermMin'. */
/begin CHARACTERISTIC VCPc_pct_CamITermMin "Input Cam Angle" VALUE 0x8bd34 RL_VCPC_PCT_CAMITERMMIN 1.000000 CU_VCPC_PCT_CAMITERMMIN -1.000000 0.000000 BYTE_ORDER MSB_FIRST /end CHARACTERISTIC
/begin RECORD_LAYOUT RL_VCPC_PCT_CAMITERMMIN FNC_VALUES 1 FLOAT32_IEEE COLUMN_DIR DIRECT /end RECORD_LAYOUT
/begin COMPU_METHOD CU_VCPC_PCT_CAMITERMMIN "Conversion method for VCPc_pct_CamITermMin" RAT_FUNC "%10.2" "NU" COEFFS 0.000000 1.000000 0.000000 0.000000 0.000000 1.000000 /end COMPU_METHOD
/* Scalar calibration for DDE 'VCPc_pct_CamPID_Dbnd'. */
/begin CHARACTERISTIC VCPc_pct_CamPID_Dbnd "PID controller output effort deadband" VALUE 0x8bd44 RL_VCPC_PCT_CAMPID_DBND 1.000000 CU_VCPC_PCT_CAMPID_DBND 0.000000 1.000000 BYTE_ORDER MSB_FIRST /end CHARACTERISTIC
/begin RECORD_LAYOUT RL_VCPC_PCT_CAMPID_DBND FNC_VALUES 1 FLOAT32_IEEE COLUMN_DIR DIRECT /end RECORD_LAYOUT
/begin COMPU_METHOD CU_VCPC_PCT_CAMPID_DBND "Conversion method for VCPc_pct_CamPID_Dbnd" RAT_FUNC "%10.2" "NU" COEFFS 0.000000 1.000000 0.000000 0.000000 0.000000 1.000000 /end COMPU_METHOD
/* Scalar calibration for DDE 'VCPc_pct_CamPID_Max'. */
/begin CHARACTERISTIC VCPc_pct_CamPID_Max "PID Controller Upper Saturation Limit" VALUE 0x8bd48 RL_VCPC_PCT_CAMPID_MAX 1.000000 CU_VCPC_PCT_CAMPID_MAX 0.000000 1.000000 BYTE_ORDER MSB_FIRST /end CHARACTERISTIC
/begin RECORD_LAYOUT RL_VCPC_PCT_CAMPID_MAX FNC_VALUES 1 FLOAT32_IEEE COLUMN_DIR DIRECT /end RECORD_LAYOUT
/begin COMPU_METHOD CU_VCPC_PCT_CAMPID_MAX "Conversion method for VCPc_pct_CamPID_Max" RAT_FUNC "%10.2" "NU" COEFFS 0.000000 1.000000 0.000000 0.000000 0.000000 1.000000 /end COMPU_METHOD
/* Scalar calibration for DDE 'VCPc_pct_CamPID_Min'. */
/begin CHARACTERISTIC VCPc_pct_CamPID_Min "PID Controller Upper Lower Limit" VALUE 0x8bd4c RL_VCPC_PCT_CAMPID_MIN 1.000000 CU_VCPC_PCT_CAMPID_MIN -1.000000 0.000000 BYTE_ORDER MSB_FIRST /end CHARACTERISTIC
/begin RECORD_LAYOUT RL_VCPC_PCT_CAMPID_MIN FNC_VALUES 1 FLOAT32_IEEE COLUMN_DIR DIRECT /end RECORD_LAYOUT
/begin COMPU_METHOD CU_VCPC_PCT_CAMPID_MIN "Conversion method for VCPc_pct_CamPID_Min" RAT_FUNC "%10.2" "NU" COEFFS 0.000000 1.000000 0.000000 0.000000 0.000000 1.000000 /end COMPU_METHOD
/* Map (2d) calibration for DDE 'VCPm_NU_CamDC_FF_z'. */
/begin CHARACTERISTIC VCPm_NU_CamDC_FF_z "VCP FF Term z-axis" MAP 0x8bc0c RL_VCPM_NU_CAMDC_FF_Z 1.000000 CU_VCPM_NU_CAMDC_FF_Z 0.000000 1.000000
 /begin AXIS_DESCR COM_AXIS VCP_adv_CamTrgt CU_VCPM_NU_CAMDC_FF_X 11 -50.000000 100.000000 AXIS_PTS_REF APD_VCPM_NU_CAMDC_FF_X /end AXIS_DESCR
 /begin AXIS_DESCR COM_AXIS AME_gps_FreshMassAirFlow CU_VCPM_NU_CAMDC_FF_Y 6 0.000000 500.000000 AXIS_PTS_REF APD_VCPM_NU_CAMDC_FF_Y /end AXIS_DESCR
 BYTE_ORDER MSB_FIRST /end CHARACTERISTIC
/begin RECORD_LAYOUT RL_VCPM_NU_CAMDC_FF_Z FNC_VALUES 1 FLOAT32_IEEE COLUMN_DIR DIRECT /end RECORD_LAYOUT
/begin COMPU_METHOD CU_VCPM_NU_CAMDC_FF_Z "Conversion method for VCPm_NU_CamDC_FF_z" RAT_FUNC "%10.3" "NU" COEFFS 0.000000 1.000000 0.000000 0.000000 0.000000 1.000000 /end COMPU_METHOD
/begin AXIS_PTS APD_VCPM_NU_CAMDC_FF_X "(target adv) VCP FF Term y-axis" 0x8bbc8 VCP_adv_CamTrgt RL_VCPM_NU_CAMDC_FF_X 150.000000 CU_VCPM_NU_CAMDC_FF_X 11 -50.0 100.0 BYTE_ORDER MSB_FIRST /end AXIS_PTS
/begin RECORD_LAYOUT RL_VCPM_NU_CAMDC_FF_X AXIS_PTS_X 1 FLOAT32_IEEE INDEX_INCR DIRECT /end RECORD_LAYOUT
/begin COMPU_METHOD CU_VCPM_NU_CAMDC_FF_X "Conversion method for VCPm_NU_CamDC_FF_x" RAT_FUNC "%10.2" "adv" COEFFS 0.000000 1.000000 0.000000 0.000000 0.000000 1.000000 /end COMPU_METHOD
/begin AXIS_PTS APD_VCPM_NU_CAMDC_FF_Y "(MAF gps) VCP FF Term x-axis" 0x8bbf4 AME_gps_FreshMassAirFlow RL_VCPM_NU_CAMDC_FF_Y 500.000000 CU_VCPM_NU_CAMDC_FF_Y 6 0.0 500.0 BYTE_ORDER MSB_FIRST /end AXIS_PTS
/begin RECORD_LAYOUT RL_VCPM_NU_CAMDC_FF_Y AXIS_PTS_X 1 FLOAT32_IEEE INDEX_INCR DIRECT /end RECORD_LAYOUT
/begin COMPU_METHOD CU_VCPM_NU_CAMDC_FF_Y "Conversion method for VCPm_NU_CamDC_FF_y" RAT_FUNC "%10.0" "gps" COEFFS 0.000000 1.000000 0.000000 0.000000 0.000000 1.000000 /end COMPU_METHOD
/* Map (1d) calibration for DDE 'VCPm_NU_DutyCycle_z'. */
/begin CHARACTERISTIC VCPm_NU_DutyCycle_z "VCP Duty Cycle z-axis" CURVE 0x8bd6c RL_VCPM_NU_DUTYCYCLE_Z 4.000000 CU_VCPM_NU_DUTYCYCLE_Z -2.000000 2.000000
 /begin AXIS_DESCR COM_AXIS NO_INPUT_QUANTITY CU_VCPM_NU_DUTYCYCLE_X 7 -2.000000 2.000000 AXIS_PTS_REF APD_VCPM_NU_DUTYCYCLE_X /end AXIS_DESCR
 BYTE_ORDER MSB_FIRST /end CHARACTERISTIC
/begin RECORD_LAYOUT RL_VCPM_NU_DUTYCYCLE_Z FNC_VALUES 1 FLOAT32_IEEE COLUMN_DIR DIRECT /end RECORD_LAYOUT
/begin COMPU_METHOD CU_VCPM_NU_DUTYCYCLE_Z "Conversion method for VCPm_NU_DutyCycle_z" RAT_FUNC "%10.2" "pct" COEFFS 0.000000 1.000000 0.000000 0.000000 0.000000 1.000000 /end COMPU_METHOD
/begin AXIS_PTS APD_VCPM_NU_DUTYCYCLE_X "VCP Duty Cycle x-axis" 0x8bd50 NO_INPUT_QUANTITY RL_VCPM_NU_DUTYCYCLE_X 4.000000 CU_VCPM_NU_DUTYCYCLE_X 7 -2.0 2.0 BYTE_ORDER MSB_FIRST /end AXIS_PTS
/begin RECORD_LAYOUT RL_VCPM_NU_DUTYCYCLE_X AXIS_PTS_X 1 FLOAT32_IEEE INDEX_INCR DIRECT /end RECORD_LAYOUT
/begin COMPU_METHOD CU_VCPM_NU_DUTYCYCLE_X "Conversion method for VCPm_NU_DutyCycle_x" RAT_FUNC "%10.2" "pct" COEFFS 0.000000 1.000000 0.000000 0.000000 0.000000 1.000000 /end COMPU_METHOD
/* Scalar calibration for DDE 'exdc_clear_unconditionally'. */
/begin CHARACTERISTIC exdc_clear_unconditionally "DTC Erase" VALUE 0x8ce70 RL_EXDC_CLEAR_UNCONDITIONALLY 1.000000 CU_EXDC_CLEAR_UNCONDITIONALLY 0.000000 1.000000 BYTE_ORDER MSB_FIRST /end CHARACTERISTIC
/begin RECORD_LAYOUT RL_EXDC_CLEAR_UNCONDITIONALLY FNC_VALUES 1 UBYTE COLUMN_DIR DIRECT /end RECORD_LAYOUT
/begin COMPU_METHOD CU_EXDC_CLEAR_UNCONDITIONALLY "Conversion method for exdc_clear_unconditionally" RAT_FUNC "%10.0" "b" COEFFS 0.000000 1.000000 0.000000 0.000000 0.000000 1.000000 /end COMPU_METHOD
/* Scalar calibration for DDE 'exdc_dm5c_obd_compliance'. */
/begin CHARACTERISTIC exdc_dm5c_obd_compliance "OBD compliance that this ECU meets" VALUE 0x8040c RL_EXDC_DM5C_OBD_COMPLIANCE 25.000000 CU_EXDC_DM5C_OBD_COMPLIANCE 1.000000 26.000000 BYTE_ORDER MSB_FIRST /end CHARACTERISTIC
/begin RECORD_LAYOUT RL_EXDC_DM5C_OBD_COMPLIANCE FNC_VALUES 1 UBYTE COLUMN_DIR DIRECT /end RECORD_LAYOUT
/begin COMPU_METHOD CU_EXDC_DM5C_OBD_COMPLIANCE "Conversion method for exdc_dm5c_obd_compliance" TAB_VERB "%12.0" "(not defined)" COMPU_TAB_REF CT_EXDC_DM5C_OBD_COMPLIANCE /end COMPU_METHOD
/begin COMPU_VTAB CT_EXDC_DM5C_OBD_COMPLIANCE "Conversion method for exdc_dm5c_obd_compliance" TAB_VERB 26 1 "OBD2_CARB" 2 "OBD_Federal_EPA" 3 "OBD_and_OBD2" 4 "OBD1" 5 "Not_intended_to_meet_OBD2" 6 "Euro_OBD" 7 "Euro_OBD_and_OBD2" 8 "Euro_OBD_and_OBD" 9 "Euro_OBD_OBD_and_OBD2" 10 "JOBD" 11 "JOBD_and_OBD2" 12 "JOBD_and_EOBD" 13 "JOBD_EOBD_and_OBD2" 14 "HDV_Euro_V_B1" 15 "HDV_Euro_V_B2" 16 "HDV_Euro_EEC_C_Gas_Engines" 17 "EMD_" 18 "EMD_plus" 19 "HD_On_Bioard_Diagnostics" 20 "HD_On_Board" 21 "WWH_OBD" 22 "OBD_II_CARB_CCR_1968_2017_Rev" 23 "HDV_EURO_IV_V_2005_2006" 24 "SAE_Reserved" 25 "OBD_M" 26 "HDV_EURO_VIUN_ECE_R49_Anex_9" /end COMPU_VTAB
/* Vector/array calibration for DDE 'exdv_ff_spn_set_d'. */
/begin CHARACTERISTIC exdv_ff_spn_set_d "ff list of spns" VAL_BLK 0x8d514 RL_EXDV_FF_SPN_SET_D 4294967295.000000 CU_EXDV_FF_SPN_SET_D 0.000000 4294967295.000000 NUMBER 12 BYTE_ORDER MSB_FIRST /end CHARACTERISTIC
/begin RECORD_LAYOUT RL_EXDV_FF_SPN_SET_D FNC_VALUES 1 ULONG COLUMN_DIR DIRECT /end RECORD_LAYOUT
/begin COMPU_METHOD CU_EXDV_FF_SPN_SET_D "Conversion method for exdv_ff_spn_set_d" RAT_FUNC "%10.0" "(not defined)" COEFFS 0.000000 1.000000 0.000000 0.000000 0.000000 1.000000 /end COMPU_METHOD
/* Scalar calibration for DDE 'isoc_emissions_report_min_sev'. */
/begin CHARACTERISTIC isoc_emissions_report_min_sev "Emissions severity report status" VALUE 0x8de00 RL_ISOC_EMISSIONS_REPORT_MIN_S0 5.000000 CU_ISOC_EMISSIONS_REPORT_MIN_S0 0.000000 5.000000 BYTE_ORDER MSB_FIRST /end CHARACTERISTIC
/begin RECORD_LAYOUT RL_ISOC_EMISSIONS_REPORT_MIN_S0 FNC_VALUES 1 UBYTE COLUMN_DIR DIRECT /end RECORD_LAYOUT
/begin COMPU_METHOD CU_ISOC_EMISSIONS_REPORT_MIN_S0 "Conversion method for isoc_emissions_report_min_sev" RAT_FUNC "%10.0" "n/a" COEFFS 0.000000 1.000000 0.000000 0.000000 0.000000 1.000000 /end COMPU_METHOD
/* Scalar calibration for DDE 'isoc_override_service_03'. */
/begin CHARACTERISTIC isoc_override_service_03 "J1979 calibration to override service $03 response.  Set this to 1 to add Previously Active DTCs to the message" VALUE 0x8ddf8 RL_ISOC_OVERRIDE_SERVICE_03 1.000000 CU_ISOC_OVERRIDE_SERVICE_03 0.000000 1.000000 BYTE_ORDER MSB_FIRST /end CHARACTERISTIC
/begin RECORD_LAYOUT RL_ISOC_OVERRIDE_SERVICE_03 FNC_VALUES 1 UBYTE COLUMN_DIR DIRECT /end RECORD_LAYOUT
/begin COMPU_METHOD CU_ISOC_OVERRIDE_SERVICE_03 "Conversion method for isoc_override_service_03" RAT_FUNC "%10.0" "n/a" COEFFS 0.000000 1.000000 0.000000 0.000000 0.000000 1.000000 /end COMPU_METHOD
/* Scalar calibration for DDE 'isoc_override_service_07'. */
/begin CHARACTERISTIC isoc_override_service_07 "J1979 calibration to override service $07 response.  Set this to 1 to add Active DTCs to the message" VALUE 0x8ddf4 RL_ISOC_OVERRIDE_SERVICE_07 1.000000 CU_ISOC_OVERRIDE_SERVICE_07 0.000000 1.000000 BYTE_ORDER MSB_FIRST /end CHARACTERISTIC
/begin RECORD_LAYOUT RL_ISOC_OVERRIDE_SERVICE_07 FNC_VALUES 1 UBYTE COLUMN_DIR DIRECT /end RECORD_LAYOUT
/begin COMPU_METHOD CU_ISOC_OVERRIDE_SERVICE_07 "Conversion method for isoc_override_service_07" RAT_FUNC "%10.0" "n/a" COEFFS 0.000000 1.000000 0.000000 0.000000 0.000000 1.000000 /end COMPU_METHOD
/* Scalar calibration for DDE 'isoc_override_service_0a'. */
/begin CHARACTERISTIC isoc_override_service_0a "J1979 calibration to override service $0A response.  Set this to 1 to add Previously Active DTCs to the message" VALUE 0x8ddf0 RL_ISOC_OVERRIDE_SERVICE_0A 1.000000 CU_ISOC_OVERRIDE_SERVICE_0A 0.000000 1.000000 BYTE_ORDER MSB_FIRST /end CHARACTERISTIC
/begin RECORD_LAYOUT RL_ISOC_OVERRIDE_SERVICE_0A FNC_VALUES 1 UBYTE COLUMN_DIR DIRECT /end RECORD_LAYOUT
/begin COMPU_METHOD CU_ISOC_OVERRIDE_SERVICE_0A "Conversion method for isoc_override_service_0a" RAT_FUNC "%10.0" "n/a" COEFFS 0.000000 1.000000 0.000000 0.000000 0.000000 1.000000 /end COMPU_METHOD
/* Scalar calibration for DDE 'mplc_fi_config_din_pin_y21'. */
/begin CHARACTERISTIC mplc_fi_config_din_pin_y21 "Configuration data for frequency input channel (eTPU only)." VALUE 0x8c518 RL_MPLC_FI_CONFIG_DIN_PIN_Y21 3.000000 CU_MPLC_FI_CONFIG_DIN_PIN_Y21 0.000000 3.000000 BYTE_ORDER MSB_FIRST /end CHARACTERISTIC
/begin RECORD_LAYOUT RL_MPLC_FI_CONFIG_DIN_PIN_Y21 FNC_VALUES 1 UWORD COLUMN_DIR DIRECT /end RECORD_LAYOUT
/begin COMPU_METHOD CU_MPLC_FI_CONFIG_DIN_PIN_Y21 "Conversion method for mplc_fi_config_din_pin_y21" RAT_FUNC "%10.0" "bitmap" COEFFS 0.000000 1.000000 0.000000 0.000000 0.000000 1.000000 /end COMPU_METHOD
/* Scalar calibration for DDE 'mplc_fi_count_din_pin_y21'. */
/begin CHARACTERISTIC mplc_fi_count_din_pin_y21 "Cycles to average frequency input channel over (eTPU only)." VALUE 0x8c51a RL_MPLC_FI_COUNT_DIN_PIN_Y21 254.000000 CU_MPLC_FI_COUNT_DIN_PIN_Y21 1.000000 255.000000 BYTE_ORDER MSB_FIRST /end CHARACTERISTIC
/begin RECORD_LAYOUT RL_MPLC_FI_COUNT_DIN_PIN_Y21 FNC_VALUES 1 UBYTE COLUMN_DIR DIRECT /end RECORD_LAYOUT
/begin COMPU_METHOD CU_MPLC_FI_COUNT_DIN_PIN_Y21 "Conversion method for mplc_fi_count_din_pin_y21" RAT_FUNC "%10.0" "count" COEFFS 0.000000 1.000000 0.000000 0.000000 0.000000 1.000000 /end COMPU_METHOD
/* String calibration for DDE 'mpls_app_build_time'. */
/begin CHARACTERISTIC mpls_app_build_time "Date and time of app build." ASCII 0x917d8 RL_MPLS_APP_BUILD_TIME 0 CU_MPLS_APP_BUILD_TIME 0 255 NUMBER 26 /end CHARACTERISTIC
/begin RECORD_LAYOUT RL_MPLS_APP_BUILD_TIME FNC_VALUES 1 UBYTE COLUMN_DIR DIRECT /end RECORD_LAYOUT
/begin COMPU_METHOD CU_MPLS_APP_BUILD_TIME "Conversion method for mpls_app_build_time" RAT_FUNC "%10.0" "" COEFFS 0.0 1.0 0.0 0.0 0.0 1.0 /end COMPU_METHOD
/* String calibration for DDE 'mpls_app_copyright'. */
/begin CHARACTERISTIC mpls_app_copyright "The application copyright text." ASCII 0x9183c RL_MPLS_APP_COPYRIGHT 0 CU_MPLS_APP_COPYRIGHT 0 255 NUMBER 25 /end CHARACTERISTIC
/begin RECORD_LAYOUT RL_MPLS_APP_COPYRIGHT FNC_VALUES 1 UBYTE COLUMN_DIR DIRECT /end RECORD_LAYOUT
/begin COMPU_METHOD CU_MPLS_APP_COPYRIGHT "Conversion method for mpls_app_copyright" RAT_FUNC "%10.0" "" COEFFS 0.0 1.0 0.0 0.0 0.0 1.0 /end COMPU_METHOD
/* String calibration for DDE 'mpls_app_description'. */
/begin CHARACTERISTIC mpls_app_description "Description from the application." ASCII 0x91818 RL_MPLS_APP_DESCRIPTION 0 CU_MPLS_APP_DESCRIPTION 0 255 NUMBER 32 /end CHARACTERISTIC
/begin RECORD_LAYOUT RL_MPLS_APP_DESCRIPTION FNC_VALUES 1 UBYTE COLUMN_DIR DIRECT /end RECORD_LAYOUT
/begin COMPU_METHOD CU_MPLS_APP_DESCRIPTION "Conversion method for mpls_app_description" RAT_FUNC "%10.0" "" COEFFS 0.0 1.0 0.0 0.0 0.0 1.0 /end COMPU_METHOD
/* String calibration for DDE 'mpls_app_name'. */
/begin CHARACTERISTIC mpls_app_name "The application name." ASCII 0x917f4 RL_MPLS_APP_NAME 0 CU_MPLS_APP_NAME 0 255 NUMBER 34 /end CHARACTERISTIC
/begin RECORD_LAYOUT RL_MPLS_APP_NAME FNC_VALUES 1 UBYTE COLUMN_DIR DIRECT /end RECORD_LAYOUT
/begin COMPU_METHOD CU_MPLS_APP_NAME "Conversion method for mpls_app_name" RAT_FUNC "%10.0" "" COEFFS 0.0 1.0 0.0 0.0 0.0 1.0 /end COMPU_METHOD
/* String calibration for DDE 'mpls_app_version'. */
/begin CHARACTERISTIC mpls_app_version "The application version." ASCII 0x92aa8 RL_MPLS_APP_VERSION 0 CU_MPLS_APP_VERSION 0 255 NUMBER 5 /end CHARACTERISTIC
/begin RECORD_LAYOUT RL_MPLS_APP_VERSION FNC_VALUES 1 UBYTE COLUMN_DIR DIRECT /end RECORD_LAYOUT
/begin COMPU_METHOD CU_MPLS_APP_VERSION "Conversion method for mpls_app_version" RAT_FUNC "%10.0" "" COEFFS 0.0 1.0 0.0 0.0 0.0 1.0 /end COMPU_METHOD
/* String calibration for DDE 'mpls_plat_build_time'. */
/begin CHARACTERISTIC mpls_plat_build_time "Date and time of platform build." ASCII 0x8de54 RL_MPLS_PLAT_BUILD_TIME 0 CU_MPLS_PLAT_BUILD_TIME 0 255 NUMBER 30 /end CHARACTERISTIC
/begin RECORD_LAYOUT RL_MPLS_PLAT_BUILD_TIME FNC_VALUES 1 UBYTE COLUMN_DIR DIRECT /end RECORD_LAYOUT
/begin COMPU_METHOD CU_MPLS_PLAT_BUILD_TIME "Conversion method for mpls_plat_build_time" RAT_FUNC "%10.0" "" COEFFS 0.0 1.0 0.0 0.0 0.0 1.0 /end COMPU_METHOD
/* String calibration for DDE 'mpls_plat_copyright'. */
/begin CHARACTERISTIC mpls_plat_copyright "Date and time of platform build." ASCII 0x8de7c RL_MPLS_PLAT_COPYRIGHT 0 CU_MPLS_PLAT_COPYRIGHT 0 255 NUMBER 29 /end CHARACTERISTIC
/begin RECORD_LAYOUT RL_MPLS_PLAT_COPYRIGHT FNC_VALUES 1 UBYTE COLUMN_DIR DIRECT /end RECORD_LAYOUT
/begin COMPU_METHOD CU_MPLS_PLAT_COPYRIGHT "Conversion method for mpls_plat_copyright" RAT_FUNC "%10.0" "" COEFFS 0.0 1.0 0.0 0.0 0.0 1.0 /end COMPU_METHOD
/* String calibration for DDE 'mpls_plat_target'. */
/begin CHARACTERISTIC mpls_plat_target "Target platform." ASCII 0x8de74 RL_MPLS_PLAT_TARGET 0 CU_MPLS_PLAT_TARGET 0 255 NUMBER 4 /end CHARACTERISTIC
/begin RECORD_LAYOUT RL_MPLS_PLAT_TARGET FNC_VALUES 1 UBYTE COLUMN_DIR DIRECT /end RECORD_LAYOUT
/begin COMPU_METHOD CU_MPLS_PLAT_TARGET "Conversion method for mpls_plat_target" RAT_FUNC "%10.0" "" COEFFS 0.0 1.0 0.0 0.0 0.0 1.0 /end COMPU_METHOD
/* String calibration for DDE 'mpls_plat_version'. */
/begin CHARACTERISTIC mpls_plat_version "Version of platform." ASCII 0x8de9c RL_MPLS_PLAT_VERSION 0 CU_MPLS_PLAT_VERSION 0 255 NUMBER 13 /end CHARACTERISTIC
/begin RECORD_LAYOUT RL_MPLS_PLAT_VERSION FNC_VALUES 1 UBYTE COLUMN_DIR DIRECT /end RECORD_LAYOUT
/begin COMPU_METHOD CU_MPLS_PLAT_VERSION "Conversion method for mpls_plat_version" RAT_FUNC "%10.0" "" COEFFS 0.0 1.0 0.0 0.0 0.0 1.0 /end COMPU_METHOD
/* Scalar calibration for DDE 'pioc_inj_diag_blank'. */
/begin CHARACTERISTIC pioc_inj_diag_blank "Injector channel voltage will be sampled after this amount of time after the injector reaches zero-current (end of T6.) See M670 Technical Specification section (4.33. Digital outputs ? waveform control) for more information." VALUE 0x8de2c RL_PIOC_INJ_DIAG_BLANK 65535.000000 CU_PIOC_INJ_DIAG_BLANK 0.000000 65535.000000 BYTE_ORDER MSB_FIRST /end CHARACTERISTIC
/begin RECORD_LAYOUT RL_PIOC_INJ_DIAG_BLANK FNC_VALUES 1 SLONG COLUMN_DIR DIRECT /end RECORD_LAYOUT
/begin COMPU_METHOD CU_PIOC_INJ_DIAG_BLANK "Conversion method for pioc_inj_diag_blank" RAT_FUNC "%10.0" "16/6 us" COEFFS 0.000000 1.000000 0.000000 0.000000 0.000000 1.000000 /end COMPU_METHOD
/* Scalar calibration for DDE 'pioc_inj_t6_max'. */
/begin CHARACTERISTIC pioc_inj_t6_max "Current must fall to zero within this duration after an injection event stops" VALUE 0x8de38 RL_PIOC_INJ_T6_MAX 65535.000000 CU_PIOC_INJ_T6_MAX 0.000000 65535.000000 BYTE_ORDER MSB_FIRST /end CHARACTERISTIC
/begin RECORD_LAYOUT RL_PIOC_INJ_T6_MAX FNC_VALUES 1 SLONG COLUMN_DIR DIRECT /end RECORD_LAYOUT
/begin COMPU_METHOD CU_PIOC_INJ_T6_MAX "Conversion method for pioc_inj_t6_max" RAT_FUNC "%10.0" "1/6 us" COEFFS 0.000000 1.000000 0.000000 0.000000 0.000000 1.000000 /end COMPU_METHOD
/* Scalar calibration for DDE 'pioc_inj_t7'. */
/begin CHARACTERISTIC pioc_inj_t7 "Minimum zero-current time between injection pulses. Coordinate with SYSc_ms_InjDeadTime" VALUE 0x8de34 RL_PIOC_INJ_T7 65535.000000 CU_PIOC_INJ_T7 0.000000 65535.000000 BYTE_ORDER MSB_FIRST /end CHARACTERISTIC
/begin RECORD_LAYOUT RL_PIOC_INJ_T7 FNC_VALUES 1 SLONG COLUMN_DIR DIRECT /end RECORD_LAYOUT
/begin COMPU_METHOD CU_PIOC_INJ_T7 "Conversion method for pioc_inj_t7" RAT_FUNC "%10.0" "1/6 us" COEFFS 0.000000 1.000000 0.000000 0.000000 0.000000 1.000000 /end COMPU_METHOD
/* Scalar calibration for DDE 'pioc_inj_t7_on_time'. */
/begin CHARACTERISTIC pioc_inj_t7_on_time "Injector lowside will be connected (and highside disconnected) for this duration after current falls to zero to more quickly suppress voltage ripple before sampling voltages for diagnostics" VALUE 0x8de30 RL_PIOC_INJ_T7_ON_TIME 65535.000000 CU_PIOC_INJ_T7_ON_TIME 0.000000 65535.000000 BYTE_ORDER MSB_FIRST /end CHARACTERISTIC
/begin RECORD_LAYOUT RL_PIOC_INJ_T7_ON_TIME FNC_VALUES 1 SLONG COLUMN_DIR DIRECT /end RECORD_LAYOUT
/begin COMPU_METHOD CU_PIOC_INJ_T7_ON_TIME "Conversion method for pioc_inj_t7_on_time" RAT_FUNC "%10.0" "1/6 us" COEFFS 0.000000 1.000000 0.000000 0.000000 0.000000 1.000000 /end COMPU_METHOD
/* Scalar calibration for DDE 'pioc_rate_pot_max_hz'. */
/begin CHARACTERISTIC pioc_rate_pot_max_hz "(exposes platform cal to a2l)" VALUE 0x8de48 RL_PIOC_RATE_POT_MAX_HZ 50000.000000 CU_PIOC_RATE_POT_MAX_HZ 0.000000 50000.000000 BYTE_ORDER MSB_FIRST /end CHARACTERISTIC
/begin RECORD_LAYOUT RL_PIOC_RATE_POT_MAX_HZ FNC_VALUES 1 FLOAT32_IEEE COLUMN_DIR DIRECT /end RECORD_LAYOUT
/begin COMPU_METHOD CU_PIOC_RATE_POT_MAX_HZ "Conversion method for pioc_rate_pot_max_hz" RAT_FUNC "%10.0" "Hz" COEFFS 0.000000 1.000000 0.000000 0.000000 0.000000 1.000000 /end COMPU_METHOD
/* Scalar calibration for DDE 'pj1939c_node_addr_0'. */
/begin CHARACTERISTIC pj1939c_node_addr_0 "J1939 node address set up during initialisation" VALUE 0x8de1c RL_PJ1939C_NODE_ADDR_0 253.000000 CU_PJ1939C_NODE_ADDR_0 0.000000 253.000000 BYTE_ORDER MSB_FIRST /end CHARACTERISTIC
/begin RECORD_LAYOUT RL_PJ1939C_NODE_ADDR_0 FNC_VALUES 1 UBYTE COLUMN_DIR DIRECT /end RECORD_LAYOUT
/begin COMPU_METHOD CU_PJ1939C_NODE_ADDR_0 "Conversion method for pj1939c_node_addr_0" RAT_FUNC "%10.0" "none" COEFFS 0.000000 1.000000 0.000000 0.000000 0.000000 1.000000 /end COMPU_METHOD
/* Scalar calibration for DDE 'svcc_ecu_config_seedkey_cal'. */
/begin CHARACTERISTIC svcc_ecu_config_seedkey_cal "J1939 security config calibration" VALUE 0x8de18 RL_SVCC_ECU_CONFIG_SEEDKEY_CAL 4294967295.000000 CU_SVCC_ECU_CONFIG_SEEDKEY_CAL 0.000000 4294967295.000000 BYTE_ORDER MSB_FIRST /end CHARACTERISTIC
/begin RECORD_LAYOUT RL_SVCC_ECU_CONFIG_SEEDKEY_CAL FNC_VALUES 1 ULONG COLUMN_DIR DIRECT /end RECORD_LAYOUT
/begin COMPU_METHOD CU_SVCC_ECU_CONFIG_SEEDKEY_CAL "Conversion method for svcc_ecu_config_seedkey_cal" RAT_FUNC "%10.0" "-" COEFFS 0.000000 1.000000 0.000000 0.000000 0.000000 1.000000 /end COMPU_METHOD
/* Scalar calibration for DDE 'svcc_ecu_reprog_seedkey_cal'. */
/begin CHARACTERISTIC svcc_ecu_reprog_seedkey_cal "J1939 security reprogramming calibration" VALUE 0x8de14 RL_SVCC_ECU_REPROG_SEEDKEY_CAL 4294967295.000000 CU_SVCC_ECU_REPROG_SEEDKEY_CAL 0.000000 4294967295.000000 BYTE_ORDER MSB_FIRST /end CHARACTERISTIC
/begin RECORD_LAYOUT RL_SVCC_ECU_REPROG_SEEDKEY_CAL FNC_VALUES 1 ULONG COLUMN_DIR DIRECT /end RECORD_LAYOUT
/begin COMPU_METHOD CU_SVCC_ECU_REPROG_SEEDKEY_CAL "Conversion method for svcc_ecu_reprog_seedkey_cal" RAT_FUNC "%10.0" "-" COEFFS 0.000000 1.000000 0.000000 0.000000 0.000000 1.000000 /end COMPU_METHOD
/end MODULE
/end PROJECT
