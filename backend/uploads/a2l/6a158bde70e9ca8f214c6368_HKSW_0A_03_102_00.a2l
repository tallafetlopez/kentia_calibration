ASAP2_VERSION 1 31
/begin PROJECT M670_Engine_Control_1.2.0_M670_000 "BeGas B430LG Turbocharged engine"
/begin HEADER "Begas Motor 2017-2022 (c)" VERSION "1_2_0" /end HEADER
/begin MODULE OpenECU_M670_000 ""
/* Scalar measurable for DDE 'ADM_b_TurOverspeed'. */
/begin MEASUREMENT ADM_b_TurOverspeed "Status displayable" UBYTE CU_ADM_B_TUROVERSPEED 1 100 0.0 1.0 ECU_ADDRESS 0x40002e90 BYTE_ORDER MSB_FIRST /end MEASUREMENT
/begin COMPU_METHOD CU_ADM_B_TUROVERSPEED "Conversion method for ADM_b_TurOverspeed" RAT_FUNC "%10.0" "b" COEFFS 0.000000 1.000000 0.000000 0.000000 0.000000 1.000000 /end COMPU_METHOD
/* Scalar measurable for DDE 'ADM_deg_ThrottleTrgt'. */
/begin MEASUREMENT ADM_deg_ThrottleTrgt "Corrected Throttle Angle request output" FLOAT32_IEEE CU_ADM_DEG_THROTTLETRGT 1 100 0.0 0.0 ECU_ADDRESS 0x4000333c BYTE_ORDER MSB_FIRST /end MEASUREMENT
/begin COMPU_METHOD CU_ADM_DEG_THROTTLETRGT "Conversion method for ADM_deg_ThrottleTrgt" RAT_FUNC "%10.2" "deg" COEFFS 0.000000 1.000000 0.000000 0.000000 0.000000 1.000000 /end COMPU_METHOD
/* Scalar measurable for DDE 'ADM_gps_AirDemandRAW'. */
/begin MEASUREMENT ADM_gps_AirDemandRAW "Torque request air demand" FLOAT32_IEEE CU_ADM_GPS_AIRDEMANDRAW 1 100 0.0 0.0 ECU_ADDRESS 0x40003200 BYTE_ORDER MSB_FIRST /end MEASUREMENT
/begin COMPU_METHOD CU_ADM_GPS_AIRDEMANDRAW "Conversion method for ADM_gps_AirDemandRAW" RAT_FUNC "%10.3" "gps" COEFFS 0.000000 1.000000 0.000000 0.000000 0.000000 1.000000 /end COMPU_METHOD
/* Scalar measurable for DDE 'ADM_kPa_BoostPressTrgt'. */
/begin MEASUREMENT ADM_kPa_BoostPressTrgt "Target Boost Pressure Output" FLOAT32_IEEE CU_ADM_KPA_BOOSTPRESSTRGT 1 100 0.0 0.0 ECU_ADDRESS 0x40003294 BYTE_ORDER MSB_FIRST /end MEASUREMENT
/begin COMPU_METHOD CU_ADM_KPA_BOOSTPRESSTRGT "Conversion method for ADM_kPa_BoostPressTrgt" RAT_FUNC "%10.2" "kPa" COEFFS 0.000000 1.000000 0.000000 0.000000 0.000000 1.000000 /end COMPU_METHOD
/* Scalar measurable for DDE 'ADM_pct_AirDemand'. */
/begin MEASUREMENT ADM_pct_AirDemand "Corrected Throttle Angle request output" FLOAT32_IEEE CU_ADM_PCT_AIRDEMAND 1 100 0.0 0.0 ECU_ADDRESS 0x400031e8 BYTE_ORDER MSB_FIRST /end MEASUREMENT
/begin COMPU_METHOD CU_ADM_PCT_AIRDEMAND "Conversion method for ADM_pct_AirDemand" RAT_FUNC "%10.2" "pct" COEFFS 0.000000 1.000000 0.000000 0.000000 0.000000 1.000000 /end COMPU_METHOD
/* Scalar measurable for DDE 'ADM_ret_VCP_Trgt'. */
/begin MEASUREMENT ADM_ret_VCP_Trgt "Intake Cam Angle Output for monitoring" FLOAT32_IEEE CU_ADM_RET_VCP_TRGT 1 100 0.0 0.0 ECU_ADDRESS 0x4000325c BYTE_ORDER MSB_FIRST /end MEASUREMENT
/begin COMPU_METHOD CU_ADM_RET_VCP_TRGT "Conversion method for ADM_ret_VCP_Trgt" RAT_FUNC "%10.2" "ret" COEFFS 0.000000 1.000000 0.000000 0.000000 0.000000 1.000000 /end COMPU_METHOD
/* Scalar measurable for DDE 'AFR_lam_FinalTrgt1'. */
/begin MEASUREMENT AFR_lam_FinalTrgt1 "Final AFR target 1" FLOAT32_IEEE CU_AFR_LAM_FINALTRGT1 1 100 0.0 0.0 ECU_ADDRESS 0x400034ac BYTE_ORDER MSB_FIRST /end MEASUREMENT
/begin COMPU_METHOD CU_AFR_LAM_FINALTRGT1 "Conversion method for AFR_lam_FinalTrgt1" RAT_FUNC "%10.3" "lam" COEFFS 0.000000 1.000000 0.000000 0.000000 0.000000 1.000000 /end COMPU_METHOD
/* Scalar measurable for DDE 'AFR_lam_FinalTrgt2'. */
/begin MEASUREMENT AFR_lam_FinalTrgt2 "Final AFR target 2" FLOAT32_IEEE CU_AFR_LAM_FINALTRGT2 1 100 0.0 0.0 ECU_ADDRESS 0x400031e0 BYTE_ORDER MSB_FIRST /end MEASUREMENT
/begin COMPU_METHOD CU_AFR_LAM_FINALTRGT2 "Conversion method for AFR_lam_FinalTrgt2" RAT_FUNC "%10.3" "lam" COEFFS 0.000000 1.000000 0.000000 0.000000 0.000000 1.000000 /end COMPU_METHOD
/* Scalar measurable for DDE 'AME_kPa_Baro'. */
/begin MEASUREMENT AME_kPa_Baro "Displayable" FLOAT32_IEEE CU_AME_KPA_BARO 1 100 0.0 0.0 ECU_ADDRESS 0x400031f4 BYTE_ORDER MSB_FIRST /end MEASUREMENT
/begin COMPU_METHOD CU_AME_KPA_BARO "Conversion method for AME_kPa_Baro" RAT_FUNC "%10.1" "kPa" COEFFS 0.000000 1.000000 0.000000 0.000000 0.000000 1.000000 /end COMPU_METHOD
/* Scalar measurable for DDE 'AME_mg_FreshAirMass'. */
/begin MEASUREMENT AME_mg_FreshAirMass "Fresh air mass" FLOAT32_IEEE CU_AME_MG_FRESHAIRMASS 1 100 0.0 0.0 ECU_ADDRESS 0x40003544 BYTE_ORDER MSB_FIRST /end MEASUREMENT
/begin COMPU_METHOD CU_AME_MG_FRESHAIRMASS "Conversion method for AME_mg_FreshAirMass" RAT_FUNC "%10.1" "mg" COEFFS 0.000000 1.000000 0.000000 0.000000 0.000000 1.000000 /end COMPU_METHOD
/* Scalar measurable for DDE 'AME_pct_Load'. */
/begin MEASUREMENT AME_pct_Load "Airflow-based load: will be > 1.0 for boost conditions" FLOAT32_IEEE CU_AME_PCT_LOAD 1 100 0.0 0.0 ECU_ADDRESS 0x40003610 BYTE_ORDER MSB_FIRST /end MEASUREMENT
/begin COMPU_METHOD CU_AME_PCT_LOAD "Conversion method for AME_pct_Load" RAT_FUNC "%10.2" "pct" COEFFS 0.000000 1.000000 0.000000 0.000000 0.000000 1.000000 /end COMPU_METHOD
/* Scalar measurable for DDE 'APP_Nm_DrvrDmndTq'. */
/begin MEASUREMENT APP_Nm_DrvrDmndTq "Final driver demanded torque" FLOAT32_IEEE CU_APP_NM_DRVRDMNDTQ 1 100 0.0 0.0 ECU_ADDRESS 0x4000358c BYTE_ORDER MSB_FIRST /end MEASUREMENT
/begin COMPU_METHOD CU_APP_NM_DRVRDMNDTQ "Conversion method for APP_Nm_DrvrDmndTq" RAT_FUNC "%10.2" "Nm" COEFFS 0.000000 1.000000 0.000000 0.000000 0.000000 1.000000 /end COMPU_METHOD
/* Scalar measurable for DDE 'APP_b_Fault'. */
/begin MEASUREMENT APP_b_Fault "APP faulted override value" UBYTE CU_APP_B_FAULT 1 100 0.0 1.0 ECU_ADDRESS 0x40002e80 BYTE_ORDER MSB_FIRST /end MEASUREMENT
/begin COMPU_METHOD CU_APP_B_FAULT "Conversion method for APP_b_Fault" RAT_FUNC "%10.0" "b" COEFFS 0.000000 1.000000 0.000000 0.000000 0.000000 1.000000 /end COMPU_METHOD
/* Scalar measurable for DDE 'APP_e_PdlMode'. */
/begin MEASUREMENT APP_e_PdlMode "Pdl Mode" UBYTE CU_APP_E_PDLMODE 1 100 0.0 0.0 ECU_ADDRESS 0x40002fe7 BYTE_ORDER MSB_FIRST /end MEASUREMENT
/begin COMPU_METHOD CU_APP_E_PDLMODE "Conversion method for APP_e_PdlMode" TAB_VERB "%12.0" "e" COMPU_TAB_REF CT_APP_E_PDLMODE /end COMPU_METHOD
/begin COMPU_VTAB CT_APP_E_PDLMODE "Conversion method for APP_e_PdlMode" TAB_VERB 3 0 "APPk_e_Zero" 1 "APPk_e_Partial" 2 "APPk_e_Full" /end COMPU_VTAB
/* Scalar measurable for DDE 'APP_pct_Dmnd'. */
/begin MEASUREMENT APP_pct_Dmnd "Arbitrated pedal position override value" FLOAT32_IEEE CU_APP_PCT_DMND 1 100 0.0 0.0 ECU_ADDRESS 0x40003340 BYTE_ORDER MSB_FIRST /end MEASUREMENT
/begin COMPU_METHOD CU_APP_PCT_DMND "Conversion method for APP_pct_Dmnd" RAT_FUNC "%10.2" "pct" COEFFS 0.000000 1.000000 0.000000 0.000000 0.000000 1.000000 /end COMPU_METHOD
/* Scalar measurable for DDE 'BAF_mg_FuelRqst1'. */
/begin MEASUREMENT BAF_mg_FuelRqst1 "(mg/cyl/firing) Torque-making fuel mass request for Bank 1" FLOAT32_IEEE CU_BAF_MG_FUELRQST1 1 100 0.0 0.0 ECU_ADDRESS 0x400034a0 BYTE_ORDER MSB_FIRST /end MEASUREMENT
/begin COMPU_METHOD CU_BAF_MG_FUELRQST1 "Conversion method for BAF_mg_FuelRqst1" RAT_FUNC "%10.2" "mg" COEFFS 0.000000 1.000000 0.000000 0.000000 0.000000 1.000000 /end COMPU_METHOD
/* Scalar measurable for DDE 'BAS_adv_BaseSpark'. */
/begin MEASUREMENT BAS_adv_BaseSpark "Final Ignition Advance Angle from BAS feature" FLOAT32_IEEE CU_BAS_ADV_BASESPARK 1 100 0.0 0.0 ECU_ADDRESS 0x40003604 BYTE_ORDER MSB_FIRST /end MEASUREMENT
/begin COMPU_METHOD CU_BAS_ADV_BASESPARK "Conversion method for BAS_adv_BaseSpark" RAT_FUNC "%10.1" "adv" COEFFS 0.000000 1.000000 0.000000 0.000000 0.000000 1.000000 /end COMPU_METHOD
/* Scalar measurable for DDE 'CIN_Nm_TqCtrRq_ESP'. */
/begin MEASUREMENT CIN_Nm_TqCtrRq_ESP "(not defined)" FLOAT32_IEEE CU_CIN_NM_TQCTRRQ_ESP 1 100 0.0 0.0 ECU_ADDRESS 0x40003558 BYTE_ORDER MSB_FIRST /end MEASUREMENT
/begin COMPU_METHOD CU_CIN_NM_TQCTRRQ_ESP "Conversion method for CIN_Nm_TqCtrRq_ESP" RAT_FUNC "%10.0" "Nm" COEFFS 0.000000 1.000000 0.000000 0.000000 0.000000 1.000000 /end COMPU_METHOD
/* Scalar measurable for DDE 'CIN_Nm_TqCtrRq_TCM'. */
/begin MEASUREMENT CIN_Nm_TqCtrRq_TCM "(not defined)" FLOAT32_IEEE CU_CIN_NM_TQCTRRQ_TCM 1 100 0.0 0.0 ECU_ADDRESS 0x40003554 BYTE_ORDER MSB_FIRST /end MEASUREMENT
/begin COMPU_METHOD CU_CIN_NM_TQCTRRQ_TCM "Conversion method for CIN_Nm_TqCtrRq_TCM" RAT_FUNC "%10.0" "Nm" COEFFS 0.000000 1.000000 0.000000 0.000000 0.000000 1.000000 /end COMPU_METHOD
/* Scalar measurable for DDE 'CLF_b_FB1_Active'. */
/begin MEASUREMENT CLF_b_FB1_Active "Displayable" UBYTE CU_CLF_B_FB1_ACTIVE 1 100 0.0 1.0 ECU_ADDRESS 0x40002e7e BYTE_ORDER MSB_FIRST /end MEASUREMENT
/begin COMPU_METHOD CU_CLF_B_FB1_ACTIVE "Conversion method for CLF_b_FB1_Active" RAT_FUNC "%10.0" "b" COEFFS 0.000000 1.000000 0.000000 0.000000 0.000000 1.000000 /end COMPU_METHOD
/* Scalar measurable for DDE 'CLF_b_FB2_Active'. */
/begin MEASUREMENT CLF_b_FB2_Active "Displayable" UBYTE CU_CLF_B_FB2_ACTIVE 1 100 0.0 1.0 ECU_ADDRESS 0x40002e7d BYTE_ORDER MSB_FIRST /end MEASUREMENT
/begin COMPU_METHOD CU_CLF_B_FB2_ACTIVE "Conversion method for CLF_b_FB2_Active" RAT_FUNC "%10.0" "b" COEFFS 0.000000 1.000000 0.000000 0.000000 0.000000 1.000000 /end COMPU_METHOD
/* Scalar measurable for DDE 'CLF_lam_FB1_Ctrl'. */
/begin MEASUREMENT CLF_lam_FB1_Ctrl "Delta-lambda displayable" FLOAT32_IEEE CU_CLF_LAM_FB1_CTRL 1 100 0.0 0.0 ECU_ADDRESS 0x400034d4 BYTE_ORDER MSB_FIRST /end MEASUREMENT
/begin COMPU_METHOD CU_CLF_LAM_FB1_CTRL "Conversion method for CLF_lam_FB1_Ctrl" RAT_FUNC "%10.3" "lam" COEFFS 0.000000 1.000000 0.000000 0.000000 0.000000 1.000000 /end COMPU_METHOD
/* Scalar measurable for DDE 'CLF_lam_FB2_Ctrl'. */
/begin MEASUREMENT CLF_lam_FB2_Ctrl "Delta-lambda displayable" FLOAT32_IEEE CU_CLF_LAM_FB2_CTRL 1 100 0.0 0.0 ECU_ADDRESS 0x40003384 BYTE_ORDER MSB_FIRST /end MEASUREMENT
/begin COMPU_METHOD CU_CLF_LAM_FB2_CTRL "Conversion method for CLF_lam_FB2_Ctrl" RAT_FUNC "%10.3" "lam" COEFFS 0.000000 1.000000 0.000000 0.000000 0.000000 1.000000 /end COMPU_METHOD
/* Scalar measurable for DDE 'CLF_lam_LTFT1'. */
/begin MEASUREMENT CLF_lam_LTFT1 "Longterm trim delta-lambda displayable" FLOAT32_IEEE CU_CLF_LAM_LTFT1 1 100 0.0 0.0 ECU_ADDRESS 0x400034d0 BYTE_ORDER MSB_FIRST /end MEASUREMENT
/begin COMPU_METHOD CU_CLF_LAM_LTFT1 "Conversion method for CLF_lam_LTFT1" RAT_FUNC "%10.3" "lam" COEFFS 0.000000 1.000000 0.000000 0.000000 0.000000 1.000000 /end COMPU_METHOD
/* Scalar measurable for DDE 'CLF_lam_LTFT2'. */
/begin MEASUREMENT CLF_lam_LTFT2 "Longterm trim delta-lambda displayable" FLOAT32_IEEE CU_CLF_LAM_LTFT2 1 100 0.0 0.0 ECU_ADDRESS 0x40003380 BYTE_ORDER MSB_FIRST /end MEASUREMENT
/begin COMPU_METHOD CU_CLF_LAM_LTFT2 "Conversion method for CLF_lam_LTFT2" RAT_FUNC "%10.3" "lam" COEFFS 0.000000 1.000000 0.000000 0.000000 0.000000 1.000000 /end COMPU_METHOD
/* Scalar measurable for DDE 'CLF_lam_O2_Dither1'. */
/begin MEASUREMENT CLF_lam_O2_Dither1 "Delta-lambda displayable" FLOAT32_IEEE CU_CLF_LAM_O2_DITHER1 1 100 0.0 0.0 ECU_ADDRESS 0x400031ec BYTE_ORDER MSB_FIRST /end MEASUREMENT
/begin COMPU_METHOD CU_CLF_LAM_O2_DITHER1 "Conversion method for CLF_lam_O2_Dither1" RAT_FUNC "%10.3" "lam" COEFFS 0.000000 1.000000 0.000000 0.000000 0.000000 1.000000 /end COMPU_METHOD
/* Scalar measurable for DDE 'CLF_lam_O2_Dither2'. */
/begin MEASUREMENT CLF_lam_O2_Dither2 "Delta-lambda displayable" FLOAT32_IEEE CU_CLF_LAM_O2_DITHER2 1 100 0.0 0.0 ECU_ADDRESS 0x400031e4 BYTE_ORDER MSB_FIRST /end MEASUREMENT
/begin COMPU_METHOD CU_CLF_LAM_O2_DITHER2 "Conversion method for CLF_lam_O2_Dither2" RAT_FUNC "%10.3" "lam" COEFFS 0.000000 1.000000 0.000000 0.000000 0.000000 1.000000 /end COMPU_METHOD
/* Scalar measurable for DDE 'CPL_b_CutSpark'. */
/begin MEASUREMENT CPL_b_CutSpark "Displayable" UBYTE CU_CPL_B_CUTSPARK 1 100 0.0 1.0 ECU_ADDRESS 0x40002e91 BYTE_ORDER MSB_FIRST /end MEASUREMENT
/begin COMPU_METHOD CU_CPL_B_CUTSPARK "Conversion method for CPL_b_CutSpark" RAT_FUNC "%10.0" "b" COEFFS 0.000000 1.000000 0.000000 0.000000 0.000000 1.000000 /end COMPU_METHOD
/* Scalar measurable for DDE 'CPL_ret_SparkRetardRqst'. */
/begin MEASUREMENT CPL_ret_SparkRetardRqst "Displayable" FLOAT32_IEEE CU_CPL_RET_SPARKRETARDRQST 1 100 0.0 0.0 ECU_ADDRESS 0x40003458 BYTE_ORDER MSB_FIRST /end MEASUREMENT
/begin COMPU_METHOD CU_CPL_RET_SPARKRETARDRQST "Conversion method for CPL_ret_SparkRetardRqst" RAT_FUNC "%10.1" "ret" COEFFS 0.000000 1.000000 0.000000 0.000000 0.000000 1.000000 /end COMPU_METHOD
/* Scalar measurable for DDE 'CTC_lam_FuelOfst'. */
/begin MEASUREMENT CTC_lam_FuelOfst "Final charge temp fuel modifier angle" FLOAT32_IEEE CU_CTC_LAM_FUELOFST 1 100 0.0 0.0 ECU_ADDRESS 0x400034bc BYTE_ORDER MSB_FIRST /end MEASUREMENT
/begin COMPU_METHOD CU_CTC_LAM_FUELOFST "Conversion method for CTC_lam_FuelOfst" RAT_FUNC "%10.3" "lam" COEFFS 0.000000 1.000000 0.000000 0.000000 0.000000 1.000000 /end COMPU_METHOD
/* Scalar measurable for DDE 'CTC_ret_SparkRqst'. */
/begin MEASUREMENT CTC_ret_SparkRqst "Final charge temp spark modifier angle" FLOAT32_IEEE CU_CTC_RET_SPARKRQST 1 100 0.0 0.0 ECU_ADDRESS 0x4000348c BYTE_ORDER MSB_FIRST /end MEASUREMENT
/begin COMPU_METHOD CU_CTC_RET_SPARKRQST "Conversion method for CTC_ret_SparkRqst" RAT_FUNC "%10.2" "ret" COEFFS 0.000000 1.000000 0.000000 0.000000 0.000000 1.000000 /end COMPU_METHOD
/* Scalar measurable for DDE 'DFC_b_FuelCut'. */
/begin MEASUREMENT DFC_b_FuelCut "DFC fuel cut flag" UBYTE CU_DFC_B_FUELCUT 1 100 0.0 1.0 ECU_ADDRESS 0x40002ecf BYTE_ORDER MSB_FIRST /end MEASUREMENT
/begin COMPU_METHOD CU_DFC_B_FUELCUT "Conversion method for DFC_b_FuelCut" RAT_FUNC "%10.0" "b" COEFFS 0.000000 1.000000 0.000000 0.000000 0.000000 1.000000 /end COMPU_METHOD
/* Scalar measurable for DDE 'DFC_ret_SparkRetard'. */
/begin MEASUREMENT DFC_ret_SparkRetard "Spark retard before fuel is cut when DFC is active" FLOAT32_IEEE CU_DFC_RET_SPARKRETARD 1 100 0.0 0.0 ECU_ADDRESS 0x40003450 BYTE_ORDER MSB_FIRST /end MEASUREMENT
/begin COMPU_METHOD CU_DFC_RET_SPARKRETARD "Conversion method for DFC_ret_SparkRetard" RAT_FUNC "%10.1" "ret" COEFFS 0.000000 1.000000 0.000000 0.000000 0.000000 1.000000 /end COMPU_METHOD
/* Scalar measurable for DDE 'DRL_gps_DynoAirRqst'. */
/begin MEASUREMENT DRL_gps_DynoAirRqst "Displayable" FLOAT32_IEEE CU_DRL_GPS_DYNOAIRRQST 1 100 0.0 0.0 ECU_ADDRESS 0x4000340c BYTE_ORDER MSB_FIRST /end MEASUREMENT
/begin COMPU_METHOD CU_DRL_GPS_DYNOAIRRQST "Conversion method for DRL_gps_DynoAirRqst" RAT_FUNC "%10.1" "gps" COEFFS 0.000000 1.000000 0.000000 0.000000 0.000000 1.000000 /end COMPU_METHOD
/* Scalar measurable for DDE 'DTC_NU_KNKButaneThr'. */
/begin MEASUREMENT DTC_NU_KNKButaneThr "(not defined)" FLOAT32_IEEE CU_DTC_NU_KNKBUTANETHR 1 100 0.0 0.0 ECU_ADDRESS 0x400032c8 BYTE_ORDER MSB_FIRST /end MEASUREMENT
/begin COMPU_METHOD CU_DTC_NU_KNKBUTANETHR "Conversion method for DTC_NU_KNKButaneThr" RAT_FUNC "%10.2" "ret" COEFFS 0.000000 1.000000 0.000000 0.000000 0.000000 1.000000 /end COMPU_METHOD
/* Scalar measurable for DDE 'DTC_b_ETC_MotorFLT'. */
/begin MEASUREMENT DTC_b_ETC_MotorFLT "DTC134" UBYTE CU_DTC_B_ETC_MOTORFLT 1 100 0.0 1.0 ECU_ADDRESS 0x40002ea4 BYTE_ORDER MSB_FIRST /end MEASUREMENT
/begin COMPU_METHOD CU_DTC_B_ETC_MOTORFLT "Conversion method for DTC_b_ETC_MotorFLT" RAT_FUNC "%10.0" "b" COEFFS 0.000000 1.000000 0.000000 0.000000 0.000000 1.000000 /end COMPU_METHOD
/* Scalar measurable for DDE 'DTC_b_KNOCK_Cyl1'. */
/begin MEASUREMENT DTC_b_KNOCK_Cyl1 "DTC152" UBYTE CU_DTC_B_KNOCK_CYL1 1 100 0.0 1.0 ECU_ADDRESS 0x40002e97 BYTE_ORDER MSB_FIRST /end MEASUREMENT
/begin COMPU_METHOD CU_DTC_B_KNOCK_CYL1 "Conversion method for DTC_b_KNOCK_Cyl1" RAT_FUNC "%10.0" "b" COEFFS 0.000000 1.000000 0.000000 0.000000 0.000000 1.000000 /end COMPU_METHOD
/* Scalar measurable for DDE 'DTC_b_KNOCK_Cyl2'. */
/begin MEASUREMENT DTC_b_KNOCK_Cyl2 "DTC153" UBYTE CU_DTC_B_KNOCK_CYL2 1 100 0.0 1.0 ECU_ADDRESS 0x40002e96 BYTE_ORDER MSB_FIRST /end MEASUREMENT
/begin COMPU_METHOD CU_DTC_B_KNOCK_CYL2 "Conversion method for DTC_b_KNOCK_Cyl2" RAT_FUNC "%10.0" "b" COEFFS 0.000000 1.000000 0.000000 0.000000 0.000000 1.000000 /end COMPU_METHOD
/* Scalar measurable for DDE 'DTC_b_KNOCK_Cyl3'. */
/begin MEASUREMENT DTC_b_KNOCK_Cyl3 "DTC154" UBYTE CU_DTC_B_KNOCK_CYL3 1 100 0.0 1.0 ECU_ADDRESS 0x40002e95 BYTE_ORDER MSB_FIRST /end MEASUREMENT
/begin COMPU_METHOD CU_DTC_B_KNOCK_CYL3 "Conversion method for DTC_b_KNOCK_Cyl3" RAT_FUNC "%10.0" "b" COEFFS 0.000000 1.000000 0.000000 0.000000 0.000000 1.000000 /end COMPU_METHOD
/* Scalar measurable for DDE 'DTC_b_KNOCK_Cyl4'. */
/begin MEASUREMENT DTC_b_KNOCK_Cyl4 "DTC155" UBYTE CU_DTC_B_KNOCK_CYL4 1 100 0.0 1.0 ECU_ADDRESS 0x40002e94 BYTE_ORDER MSB_FIRST /end MEASUREMENT
/begin COMPU_METHOD CU_DTC_B_KNOCK_CYL4 "Conversion method for DTC_b_KNOCK_Cyl4" RAT_FUNC "%10.0" "b" COEFFS 0.000000 1.000000 0.000000 0.000000 0.000000 1.000000 /end COMPU_METHOD
/* Scalar measurable for DDE 'DTC_b_TP_CorrFLT'. */
/begin MEASUREMENT DTC_b_TP_CorrFLT "DTC128" UBYTE CU_DTC_B_TP_CORRFLT 1 100 0.0 1.0 ECU_ADDRESS 0x40002ea1 BYTE_ORDER MSB_FIRST /end MEASUREMENT
/begin COMPU_METHOD CU_DTC_B_TP_CORRFLT "Conversion method for DTC_b_TP_CorrFLT" RAT_FUNC "%10.0" "b" COEFFS 0.000000 1.000000 0.000000 0.000000 0.000000 1.000000 /end COMPU_METHOD
/* Scalar measurable for DDE 'DTC_b_TurboError'. */
/begin MEASUREMENT DTC_b_TurboError "DTC" UBYTE CU_DTC_B_TURBOERROR 1 100 0.0 1.0 ECU_ADDRESS 0x40002e8f BYTE_ORDER MSB_FIRST /end MEASUREMENT
/begin COMPU_METHOD CU_DTC_B_TURBOERROR "Conversion method for DTC_b_TurboError" RAT_FUNC "%10.0" "b" COEFFS 0.000000 1.000000 0.000000 0.000000 0.000000 1.000000 /end COMPU_METHOD
/* Scalar measurable for DDE 'ELM_Nm_AlternatorTq'. */
/begin MEASUREMENT ELM_Nm_AlternatorTq "Alternator load torque value" FLOAT32_IEEE CU_ELM_NM_ALTERNATORTQ 1 100 0.0 0.0 ECU_ADDRESS 0x400035b4 BYTE_ORDER MSB_FIRST /end MEASUREMENT
/begin COMPU_METHOD CU_ELM_NM_ALTERNATORTQ "Conversion method for ELM_Nm_AlternatorTq" RAT_FUNC "%10.2" "Nm" COEFFS 0.000000 1.000000 0.000000 0.000000 0.000000 1.000000 /end COMPU_METHOD
/* Scalar measurable for DDE 'ELM_Nm_FrictionTq'. */
/begin MEASUREMENT ELM_Nm_FrictionTq "Friction torque value" FLOAT32_IEEE CU_ELM_NM_FRICTIONTQ 1 100 0.0 0.0 ECU_ADDRESS 0x40003580 BYTE_ORDER MSB_FIRST /end MEASUREMENT
/begin COMPU_METHOD CU_ELM_NM_FRICTIONTQ "Conversion method for ELM_Nm_FrictionTq" RAT_FUNC "%10.2" "Nm" COEFFS 0.000000 1.000000 0.000000 0.000000 0.000000 1.000000 /end COMPU_METHOD
/* Scalar measurable for DDE 'ELM_Nm_HVAC_Tq'. */
/begin MEASUREMENT ELM_Nm_HVAC_Tq "HVAC load torque value" FLOAT32_IEEE CU_ELM_NM_HVAC_TQ 1 100 0.0 0.0 ECU_ADDRESS 0x40003588 BYTE_ORDER MSB_FIRST /end MEASUREMENT
/begin COMPU_METHOD CU_ELM_NM_HVAC_TQ "Conversion method for ELM_Nm_HVAC_Tq" RAT_FUNC "%10.2" "Nm" COEFFS 0.000000 1.000000 0.000000 0.000000 0.000000 1.000000 /end COMPU_METHOD
/* Scalar measurable for DDE 'ELM_Nm_PwrStrTq'. */
/begin MEASUREMENT ELM_Nm_PwrStrTq "Power steering load torque value" FLOAT32_IEEE CU_ELM_NM_PWRSTRTQ 1 100 0.0 0.0 ECU_ADDRESS 0x40003584 BYTE_ORDER MSB_FIRST /end MEASUREMENT
/begin COMPU_METHOD CU_ELM_NM_PWRSTRTQ "Conversion method for ELM_Nm_PwrStrTq" RAT_FUNC "%10.2" "Nm" COEFFS 0.000000 1.000000 0.000000 0.000000 0.000000 1.000000 /end COMPU_METHOD
/* Scalar measurable for DDE 'ELM_Nm_Tq'. */
/begin MEASUREMENT ELM_Nm_Tq "Total engine load torque" FLOAT32_IEEE CU_ELM_NM_TQ 1 100 0.0 0.0 ECU_ADDRESS 0x40003574 BYTE_ORDER MSB_FIRST /end MEASUREMENT
/begin COMPU_METHOD CU_ELM_NM_TQ "Conversion method for ELM_Nm_Tq" RAT_FUNC "%10.2" "Nm" COEFFS 0.000000 1.000000 0.000000 0.000000 0.000000 1.000000 /end COMPU_METHOD
/* Scalar measurable for DDE 'ELM_Nm_ZFFAN_Tq'. */
/begin MEASUREMENT ELM_Nm_ZFFAN_Tq "Fuel pump load torque value" FLOAT32_IEEE CU_ELM_NM_ZFFAN_TQ 1 100 0.0 0.0 ECU_ADDRESS 0x4000357c BYTE_ORDER MSB_FIRST /end MEASUREMENT
/begin COMPU_METHOD CU_ELM_NM_ZFFAN_TQ "Conversion method for ELM_Nm_ZFFAN_Tq" RAT_FUNC "%10.2" "Nm" COEFFS 0.000000 1.000000 0.000000 0.000000 0.000000 1.000000 /end COMPU_METHOD
/* Scalar measurable for DDE 'ERL_RPM_HardLim'. */
/begin MEASUREMENT ERL_RPM_HardLim "Hard engine speed limit" FLOAT32_IEEE CU_ERL_RPM_HARDLIM 1 100 0.0 0.0 ECU_ADDRESS 0x4000356c BYTE_ORDER MSB_FIRST /end MEASUREMENT
/begin COMPU_METHOD CU_ERL_RPM_HARDLIM "Conversion method for ERL_RPM_HardLim" RAT_FUNC "%10.0" "RPM" COEFFS 0.000000 1.000000 0.000000 0.000000 0.000000 1.000000 /end COMPU_METHOD
/* Scalar measurable for DDE 'ERL_RPM_Overspd'. */
/begin MEASUREMENT ERL_RPM_Overspd "Engine over speed" FLOAT32_IEEE CU_ERL_RPM_OVERSPD 1 100 0.0 0.0 ECU_ADDRESS 0x40003568 BYTE_ORDER MSB_FIRST /end MEASUREMENT
/begin COMPU_METHOD CU_ERL_RPM_OVERSPD "Conversion method for ERL_RPM_Overspd" RAT_FUNC "%10.0" "RPM" COEFFS 0.000000 1.000000 0.000000 0.000000 0.000000 1.000000 /end COMPU_METHOD
/* Scalar measurable for DDE 'ERL_b_Active'. */
/begin MEASUREMENT ERL_b_Active "Engine speed limiting active flag" UBYTE CU_ERL_B_ACTIVE 1 100 0.0 1.0 ECU_ADDRESS 0x40002ecc BYTE_ORDER MSB_FIRST /end MEASUREMENT
/begin COMPU_METHOD CU_ERL_B_ACTIVE "Conversion method for ERL_b_Active" RAT_FUNC "%10.0" "b" COEFFS 0.000000 1.000000 0.000000 0.000000 0.000000 1.000000 /end COMPU_METHOD
/* Scalar measurable for DDE 'ERL_b_CutFuel'. */
/begin MEASUREMENT ERL_b_CutFuel "Engine speed limited fuel cut command" UBYTE CU_ERL_B_CUTFUEL 1 100 0.0 1.0 ECU_ADDRESS 0x40002ece BYTE_ORDER MSB_FIRST /end MEASUREMENT
/begin COMPU_METHOD CU_ERL_B_CUTFUEL "Conversion method for ERL_b_CutFuel" RAT_FUNC "%10.0" "b" COEFFS 0.000000 1.000000 0.000000 0.000000 0.000000 1.000000 /end COMPU_METHOD
/* Scalar measurable for DDE 'ERL_b_CutSpark'. */
/begin MEASUREMENT ERL_b_CutSpark "Engine speed limited spark cut command" UBYTE CU_ERL_B_CUTSPARK 1 100 0.0 1.0 ECU_ADDRESS 0x40002e92 BYTE_ORDER MSB_FIRST /end MEASUREMENT
/begin COMPU_METHOD CU_ERL_B_CUTSPARK "Conversion method for ERL_b_CutSpark" RAT_FUNC "%10.0" "b" COEFFS 0.000000 1.000000 0.000000 0.000000 0.000000 1.000000 /end COMPU_METHOD
/* Scalar measurable for DDE 'ERL_b_HardLimReached'. */
/begin MEASUREMENT ERL_b_HardLimReached "Hard engine speed limit reached" UBYTE CU_ERL_B_HARDLIMREACHED 1 100 0.0 1.0 ECU_ADDRESS 0x40002ed2 BYTE_ORDER MSB_FIRST /end MEASUREMENT
/begin COMPU_METHOD CU_ERL_B_HARDLIMREACHED "Conversion method for ERL_b_HardLimReached" RAT_FUNC "%10.0" "b" COEFFS 0.000000 1.000000 0.000000 0.000000 0.000000 1.000000 /end COMPU_METHOD
/* Scalar measurable for DDE 'ERL_pct_PTerm'. */
/begin MEASUREMENT ERL_pct_PTerm "Torque demand multiplier for proportional speed limiting" FLOAT32_IEEE CU_ERL_PCT_PTERM 1 100 0.0 0.0 ECU_ADDRESS 0x40003564 BYTE_ORDER MSB_FIRST /end MEASUREMENT
/begin COMPU_METHOD CU_ERL_PCT_PTERM "Conversion method for ERL_pct_PTerm" RAT_FUNC "%10.2" "pct" COEFFS 0.000000 1.000000 0.000000 0.000000 0.000000 1.000000 /end COMPU_METHOD
/* Scalar measurable for DDE 'ERL_pct_TqMult'. */
/begin MEASUREMENT ERL_pct_TqMult "Final torque demand multiplier" FLOAT32_IEEE CU_ERL_PCT_TQMULT 1 100 0.0 0.0 ECU_ADDRESS 0x40003560 BYTE_ORDER MSB_FIRST /end MEASUREMENT
/begin COMPU_METHOD CU_ERL_PCT_TQMULT "Conversion method for ERL_pct_TqMult" RAT_FUNC "%10.2" "pct" COEFFS 0.000000 1.000000 0.000000 0.000000 0.000000 1.000000 /end COMPU_METHOD
/* Scalar measurable for DDE 'ERL_ret_SparkRetard'. */
/begin MEASUREMENT ERL_ret_SparkRetard "Engine speed limiting spark retard angle" FLOAT32_IEEE CU_ERL_RET_SPARKRETARD 1 100 0.0 0.0 ECU_ADDRESS 0x40003454 BYTE_ORDER MSB_FIRST /end MEASUREMENT
/begin COMPU_METHOD CU_ERL_RET_SPARKRETARD "Conversion method for ERL_ret_SparkRetard" RAT_FUNC "%10.0" "ret" COEFFS 0.000000 1.000000 0.000000 0.000000 0.000000 1.000000 /end COMPU_METHOD
/* Scalar measurable for DDE 'ERM_e_RunningMode'. */
/begin MEASUREMENT ERM_e_RunningMode "Displayable" UBYTE CU_ERM_E_RUNNINGMODE 1 100 0.0 0.0 ECU_ADDRESS 0x40002fe8 BYTE_ORDER MSB_FIRST /end MEASUREMENT
/begin COMPU_METHOD CU_ERM_E_RUNNINGMODE "Conversion method for ERM_e_RunningMode" TAB_VERB "%12.0" "e" COMPU_TAB_REF CT_ERM_E_RUNNINGMODE /end COMPU_METHOD
/begin COMPU_VTAB CT_ERM_E_RUNNINGMODE "Conversion method for ERM_e_RunningMode" TAB_VERB 5 0 "ERMk_e_Stopped" 1 "ERMk_e_Stalled" 2 "ERMk_e_Cranking" 3 "ERMk_e_360_Mode" 4 "ERMk_e_Running" /end COMPU_VTAB
/* Scalar measurable for DDE 'ERM_s_TimeSinceStart'. */
/begin MEASUREMENT ERM_s_TimeSinceStart "Displayable" FLOAT32_IEEE CU_ERM_S_TIMESINCESTART 1 100 0.0 0.0 ECU_ADDRESS 0x400035bc BYTE_ORDER MSB_FIRST /end MEASUREMENT
/begin COMPU_METHOD CU_ERM_S_TIMESINCESTART "Conversion method for ERM_s_TimeSinceStart" RAT_FUNC "%10.0" "s" COEFFS 0.000000 1.000000 0.000000 0.000000 0.000000 1.000000 /end COMPU_METHOD
/* Scalar measurable for DDE 'ETC_NU_DTerm'. */
/begin MEASUREMENT ETC_NU_DTerm "Displayable" FLOAT32_IEEE CU_ETC_NU_DTERM 1 100 0.0 0.0 ECU_ADDRESS 0x40003188 BYTE_ORDER MSB_FIRST /end MEASUREMENT
/begin COMPU_METHOD CU_ETC_NU_DTERM "Conversion method for ETC_NU_DTerm" RAT_FUNC "%10.3" "NU" COEFFS 0.000000 1.000000 0.000000 0.000000 0.000000 1.000000 /end COMPU_METHOD
/* Scalar measurable for DDE 'ETC_NU_Error_Int'. */
/begin MEASUREMENT ETC_NU_Error_Int "(not defined)" FLOAT32_IEEE CU_ETC_NU_ERROR_INT 1 100 -1000.0 1000.0 ECU_ADDRESS 0x40003170 BYTE_ORDER MSB_FIRST /end MEASUREMENT
/begin COMPU_METHOD CU_ETC_NU_ERROR_INT "Conversion method for ETC_NU_Error_Int" RAT_FUNC "%10.2" "NU" COEFFS 0.000000 1.000000 0.000000 0.000000 0.000000 1.000000 /end COMPU_METHOD
/* Scalar measurable for DDE 'ETC_NU_ITerm'. */
/begin MEASUREMENT ETC_NU_ITerm "Displayable" FLOAT32_IEEE CU_ETC_NU_ITERM 1 100 0.0 0.0 ECU_ADDRESS 0x40003178 BYTE_ORDER MSB_FIRST /end MEASUREMENT
/begin COMPU_METHOD CU_ETC_NU_ITERM "Conversion method for ETC_NU_ITerm" RAT_FUNC "%10.3" "NU" COEFFS 0.000000 1.000000 0.000000 0.000000 0.000000 1.000000 /end COMPU_METHOD
/* Scalar measurable for DDE 'ETC_NU_PTerm'. */
/begin MEASUREMENT ETC_NU_PTerm "Displayable" FLOAT32_IEEE CU_ETC_NU_PTERM 1 100 0.0 0.0 ECU_ADDRESS 0x40003194 BYTE_ORDER MSB_FIRST /end MEASUREMENT
/begin COMPU_METHOD CU_ETC_NU_PTERM "Conversion method for ETC_NU_PTerm" RAT_FUNC "%10.3" "NU" COEFFS 0.000000 1.000000 0.000000 0.000000 0.000000 1.000000 /end COMPU_METHOD
/* Scalar measurable for DDE 'ETC_NU_TP1_FullPos'. */
/begin MEASUREMENT ETC_NU_TP1_FullPos "Displayable" FLOAT32_IEEE CU_ETC_NU_TP1_FULLPOS 1 100 0.0 0.0 ECU_ADDRESS 0x40003360 BYTE_ORDER MSB_FIRST /end MEASUREMENT
/begin COMPU_METHOD CU_ETC_NU_TP1_FULLPOS "Conversion method for ETC_NU_TP1_FullPos" RAT_FUNC "%10.3" "NU" COEFFS 0.000000 1.000000 0.000000 0.000000 0.000000 1.000000 /end COMPU_METHOD
/* Scalar measurable for DDE 'ETC_NU_TP1_Slow'. */
/begin MEASUREMENT ETC_NU_TP1_Slow "Result of lowspeed filter for TP endstop learning" FLOAT32_IEEE CU_ETC_NU_TP1_SLOW 1 100 0.0 0.0 ECU_ADDRESS 0x40003368 BYTE_ORDER MSB_FIRST /end MEASUREMENT
/begin COMPU_METHOD CU_ETC_NU_TP1_SLOW "Conversion method for ETC_NU_TP1_Slow" RAT_FUNC "%10.3" "NU" COEFFS 0.000000 1.000000 0.000000 0.000000 0.000000 1.000000 /end COMPU_METHOD
/* Scalar measurable for DDE 'ETC_NU_TP1_ZeroPos'. */
/begin MEASUREMENT ETC_NU_TP1_ZeroPos "Displayable" FLOAT32_IEEE CU_ETC_NU_TP1_ZEROPOS 1 100 0.0 0.0 ECU_ADDRESS 0x40003364 BYTE_ORDER MSB_FIRST /end MEASUREMENT
/begin COMPU_METHOD CU_ETC_NU_TP1_ZEROPOS "Conversion method for ETC_NU_TP1_ZeroPos" RAT_FUNC "%10.3" "NU" COEFFS 0.000000 1.000000 0.000000 0.000000 0.000000 1.000000 /end COMPU_METHOD
/* Scalar measurable for DDE 'ETC_NU_TP2_FullPos'. */
/begin MEASUREMENT ETC_NU_TP2_FullPos "Displayable" FLOAT32_IEEE CU_ETC_NU_TP2_FULLPOS 1 100 0.0 0.0 ECU_ADDRESS 0x40003354 BYTE_ORDER MSB_FIRST /end MEASUREMENT
/begin COMPU_METHOD CU_ETC_NU_TP2_FULLPOS "Conversion method for ETC_NU_TP2_FullPos" RAT_FUNC "%10.3" "NU" COEFFS 0.000000 1.000000 0.000000 0.000000 0.000000 1.000000 /end COMPU_METHOD
/* Scalar measurable for DDE 'ETC_NU_TP2_Slow'. */
/begin MEASUREMENT ETC_NU_TP2_Slow "Result of lowspeed filter for TP endstop learning" FLOAT32_IEEE CU_ETC_NU_TP2_SLOW 1 100 0.0 0.0 ECU_ADDRESS 0x40003374 BYTE_ORDER MSB_FIRST /end MEASUREMENT
/begin COMPU_METHOD CU_ETC_NU_TP2_SLOW "Conversion method for ETC_NU_TP2_Slow" RAT_FUNC "%10.3" "NU" COEFFS 0.000000 1.000000 0.000000 0.000000 0.000000 1.000000 /end COMPU_METHOD
/* Scalar measurable for DDE 'ETC_NU_TP2_ZeroPos'. */
/begin MEASUREMENT ETC_NU_TP2_ZeroPos "Displayable" FLOAT32_IEEE CU_ETC_NU_TP2_ZEROPOS 1 100 0.0 0.0 ECU_ADDRESS 0x40003358 BYTE_ORDER MSB_FIRST /end MEASUREMENT
/begin COMPU_METHOD CU_ETC_NU_TP2_ZEROPOS "Conversion method for ETC_NU_TP2_ZeroPos" RAT_FUNC "%10.3" "NU" COEFFS 0.000000 1.000000 0.000000 0.000000 0.000000 1.000000 /end COMPU_METHOD
/* Scalar measurable for DDE 'ETC_NU_TPRate'. */
/begin MEASUREMENT ETC_NU_TPRate "Displayable" FLOAT32_IEEE CU_ETC_NU_TPRATE 1 100 0.0 0.0 ECU_ADDRESS 0x4000336c BYTE_ORDER MSB_FIRST /end MEASUREMENT
/begin COMPU_METHOD CU_ETC_NU_TPRATE "Conversion method for ETC_NU_TPRate" RAT_FUNC "%10.3" "NU" COEFFS 0.000000 1.000000 0.000000 0.000000 0.000000 1.000000 /end COMPU_METHOD
/* Scalar measurable for DDE 'ETC_NU_TP_Dot'. */
/begin MEASUREMENT ETC_NU_TP_Dot "(V/s) Raw TPS rate of change" FLOAT32_IEEE CU_ETC_NU_TP_DOT 1 100 0.0 0.0 ECU_ADDRESS 0x40003038 BYTE_ORDER MSB_FIRST /end MEASUREMENT
/begin COMPU_METHOD CU_ETC_NU_TP_DOT "Conversion method for ETC_NU_TP_Dot" RAT_FUNC "%10.2" "NU" COEFFS 0.000000 1.000000 0.000000 0.000000 0.000000 1.000000 /end COMPU_METHOD
/* Scalar measurable for DDE 'ETC_b_AuthorityReduced'. */
/begin MEASUREMENT ETC_b_AuthorityReduced "Flag to indicate to other features that ETC cannot currently provide high-precision position control" UBYTE CU_ETC_B_AUTHORITYREDUCED 1 100 0.0 1.0 ECU_ADDRESS 0x40002e81 BYTE_ORDER MSB_FIRST /end MEASUREMENT
/begin COMPU_METHOD CU_ETC_B_AUTHORITYREDUCED "Conversion method for ETC_b_AuthorityReduced" RAT_FUNC "%10.0" "b" COEFFS 0.000000 1.000000 0.000000 0.000000 0.000000 1.000000 /end COMPU_METHOD
/* Scalar measurable for DDE 'ETC_b_CloseComplete'. */
/begin MEASUREMENT ETC_b_CloseComplete "Displayable" UBYTE CU_ETC_B_CLOSECOMPLETE 1 100 0.0 1.0 ECU_ADDRESS 0x40002fe1 BYTE_ORDER MSB_FIRST /end MEASUREMENT
/begin COMPU_METHOD CU_ETC_B_CLOSECOMPLETE "Conversion method for ETC_b_CloseComplete" RAT_FUNC "%10.0" "b" COEFFS 0.000000 1.000000 0.000000 0.000000 0.000000 1.000000 /end COMPU_METHOD
/* Scalar measurable for DDE 'ETC_b_Expired'. */
/begin MEASUREMENT ETC_b_Expired "Displayable" UBYTE CU_ETC_B_EXPIRED 1 100 0.0 1.0 ECU_ADDRESS 0x40002ea6 BYTE_ORDER MSB_FIRST /end MEASUREMENT
/begin COMPU_METHOD CU_ETC_B_EXPIRED "Conversion method for ETC_b_Expired" RAT_FUNC "%10.0" "b" COEFFS 0.000000 1.000000 0.000000 0.000000 0.000000 1.000000 /end COMPU_METHOD
/* Scalar measurable for DDE 'ETC_b_ForceClosed'. */
/begin MEASUREMENT ETC_b_ForceClosed "Displayable" UBYTE CU_ETC_B_FORCECLOSED 1 100 0.0 1.0 ECU_ADDRESS 0x40002e71 BYTE_ORDER MSB_FIRST /end MEASUREMENT
/begin COMPU_METHOD CU_ETC_B_FORCECLOSED "Conversion method for ETC_b_ForceClosed" RAT_FUNC "%10.0" "b" COEFFS 0.000000 1.000000 0.000000 0.000000 0.000000 1.000000 /end COMPU_METHOD
/* Scalar measurable for DDE 'ETC_b_ForceOpen'. */
/begin MEASUREMENT ETC_b_ForceOpen "Displayable" UBYTE CU_ETC_B_FORCEOPEN 1 100 0.0 1.0 ECU_ADDRESS 0x40002e72 BYTE_ORDER MSB_FIRST /end MEASUREMENT
/begin COMPU_METHOD CU_ETC_B_FORCEOPEN "Conversion method for ETC_b_ForceOpen" RAT_FUNC "%10.0" "b" COEFFS 0.000000 1.000000 0.000000 0.000000 0.000000 1.000000 /end COMPU_METHOD
/* Scalar measurable for DDE 'ETC_b_LearnReady'. */
/begin MEASUREMENT ETC_b_LearnReady "Displayable" UBYTE CU_ETC_B_LEARNREADY 1 100 0.0 1.0 ECU_ADDRESS 0x40002eaa BYTE_ORDER MSB_FIRST /end MEASUREMENT
/begin COMPU_METHOD CU_ETC_B_LEARNREADY "Conversion method for ETC_b_LearnReady" RAT_FUNC "%10.0" "b" COEFFS 0.000000 1.000000 0.000000 0.000000 0.000000 1.000000 /end COMPU_METHOD
/* Scalar measurable for DDE 'ETC_b_LearnRest'. */
/begin MEASUREMENT ETC_b_LearnRest "Displayable" UBYTE CU_ETC_B_LEARNREST 1 100 0.0 1.0 ECU_ADDRESS 0x40002ea7 BYTE_ORDER MSB_FIRST /end MEASUREMENT
/begin COMPU_METHOD CU_ETC_B_LEARNREST "Conversion method for ETC_b_LearnRest" RAT_FUNC "%10.0" "b" COEFFS 0.000000 1.000000 0.000000 0.000000 0.000000 1.000000 /end COMPU_METHOD
/* Scalar measurable for DDE 'ETC_b_LearnSequenceFailed'. */
/begin MEASUREMENT ETC_b_LearnSequenceFailed "Displayable" UBYTE CU_ETC_B_LEARNSEQUENCEFAILED 1 100 0.0 1.0 ECU_ADDRESS 0x40002e6f BYTE_ORDER MSB_FIRST /end MEASUREMENT
/begin COMPU_METHOD CU_ETC_B_LEARNSEQUENCEFAILED "Conversion method for ETC_b_LearnSequenceFailed" RAT_FUNC "%10.0" "b" COEFFS 0.000000 1.000000 0.000000 0.000000 0.000000 1.000000 /end COMPU_METHOD
/* Scalar measurable for DDE 'ETC_b_LearnSequenceSuccess'. */
/begin MEASUREMENT ETC_b_LearnSequenceSuccess "Displayable" UBYTE CU_ETC_B_LEARNSEQUENCESUCCESS 1 100 0.0 1.0 ECU_ADDRESS 0x40002e70 BYTE_ORDER MSB_FIRST /end MEASUREMENT
/begin COMPU_METHOD CU_ETC_B_LEARNSEQUENCESUCCESS "Conversion method for ETC_b_LearnSequenceSuccess" RAT_FUNC "%10.0" "b" COEFFS 0.000000 1.000000 0.000000 0.000000 0.000000 1.000000 /end COMPU_METHOD
/* Scalar measurable for DDE 'ETC_b_OpenComplete'. */
/begin MEASUREMENT ETC_b_OpenComplete "Displayable" UBYTE CU_ETC_B_OPENCOMPLETE 1 100 0.0 1.0 ECU_ADDRESS 0x40002fe0 BYTE_ORDER MSB_FIRST /end MEASUREMENT
/begin COMPU_METHOD CU_ETC_B_OPENCOMPLETE "Conversion method for ETC_b_OpenComplete" RAT_FUNC "%10.0" "b" COEFFS 0.000000 1.000000 0.000000 0.000000 0.000000 1.000000 /end COMPU_METHOD
/* Scalar measurable for DDE 'ETC_b_RangeCheckFailed'. */
/begin MEASUREMENT ETC_b_RangeCheckFailed "Displayable" UBYTE CU_ETC_B_RANGECHECKFAILED 1 100 0.0 1.0 ECU_ADDRESS 0x40002ea5 BYTE_ORDER MSB_FIRST /end MEASUREMENT
/begin COMPU_METHOD CU_ETC_B_RANGECHECKFAILED "Conversion method for ETC_b_RangeCheckFailed" RAT_FUNC "%10.0" "b" COEFFS 0.000000 1.000000 0.000000 0.000000 0.000000 1.000000 /end COMPU_METHOD
/* Scalar measurable for DDE 'ETC_b_RestPosOOR'. */
/begin MEASUREMENT ETC_b_RestPosOOR "Displayable" UBYTE CU_ETC_B_RESTPOSOOR 1 100 0.0 1.0 ECU_ADDRESS 0x40002ea2 BYTE_ORDER MSB_FIRST /end MEASUREMENT
/begin COMPU_METHOD CU_ETC_B_RESTPOSOOR "Conversion method for ETC_b_RestPosOOR" RAT_FUNC "%10.0" "b" COEFFS 0.000000 1.000000 0.000000 0.000000 0.000000 1.000000 /end COMPU_METHOD
/* Scalar measurable for DDE 'ETC_b_Stable'. */
/begin MEASUREMENT ETC_b_Stable "Displayable" UBYTE CU_ETC_B_STABLE 1 100 0.0 1.0 ECU_ADDRESS 0x40002eb3 BYTE_ORDER MSB_FIRST /end MEASUREMENT
/begin COMPU_METHOD CU_ETC_B_STABLE "Conversion method for ETC_b_Stable" RAT_FUNC "%10.0" "b" COEFFS 0.000000 1.000000 0.000000 0.000000 0.000000 1.000000 /end COMPU_METHOD
/* Scalar measurable for DDE 'ETC_b_StoppedClosing'. */
/begin MEASUREMENT ETC_b_StoppedClosing "Displayable" UBYTE CU_ETC_B_STOPPEDCLOSING 1 100 0.0 1.0 ECU_ADDRESS 0x40002ea8 BYTE_ORDER MSB_FIRST /end MEASUREMENT
/begin COMPU_METHOD CU_ETC_B_STOPPEDCLOSING "Conversion method for ETC_b_StoppedClosing" RAT_FUNC "%10.0" "b" COEFFS 0.000000 1.000000 0.000000 0.000000 0.000000 1.000000 /end COMPU_METHOD
/* Scalar measurable for DDE 'ETC_b_StoppedOpening'. */
/begin MEASUREMENT ETC_b_StoppedOpening "Displayable" UBYTE CU_ETC_B_STOPPEDOPENING 1 100 0.0 1.0 ECU_ADDRESS 0x40002ea9 BYTE_ORDER MSB_FIRST /end MEASUREMENT
/begin COMPU_METHOD CU_ETC_B_STOPPEDOPENING "Conversion method for ETC_b_StoppedOpening" RAT_FUNC "%10.0" "b" COEFFS 0.000000 1.000000 0.000000 0.000000 0.000000 1.000000 /end COMPU_METHOD
/* Scalar measurable for DDE 'ETC_b_TP1_FullPosOOR'. */
/begin MEASUREMENT ETC_b_TP1_FullPosOOR "Displayable" UBYTE CU_ETC_B_TP1_FULLPOSOOR 1 100 0.0 1.0 ECU_ADDRESS 0x40002eab BYTE_ORDER MSB_FIRST /end MEASUREMENT
/begin COMPU_METHOD CU_ETC_B_TP1_FULLPOSOOR "Conversion method for ETC_b_TP1_FullPosOOR" RAT_FUNC "%10.0" "b" COEFFS 0.000000 1.000000 0.000000 0.000000 0.000000 1.000000 /end COMPU_METHOD
/* Scalar measurable for DDE 'ETC_b_TP1_LearnFull'. */
/begin MEASUREMENT ETC_b_TP1_LearnFull "Displayable" UBYTE CU_ETC_B_TP1_LEARNFULL 1 100 0.0 1.0 ECU_ADDRESS 0x40002eac BYTE_ORDER MSB_FIRST /end MEASUREMENT
/begin COMPU_METHOD CU_ETC_B_TP1_LEARNFULL "Conversion method for ETC_b_TP1_LearnFull" RAT_FUNC "%10.0" "b" COEFFS 0.000000 1.000000 0.000000 0.000000 0.000000 1.000000 /end COMPU_METHOD
/* Scalar measurable for DDE 'ETC_b_TP1_LearnZero'. */
/begin MEASUREMENT ETC_b_TP1_LearnZero "Displayable" UBYTE CU_ETC_B_TP1_LEARNZERO 1 100 0.0 1.0 ECU_ADDRESS 0x40002eb0 BYTE_ORDER MSB_FIRST /end MEASUREMENT
/begin COMPU_METHOD CU_ETC_B_TP1_LEARNZERO "Conversion method for ETC_b_TP1_LearnZero" RAT_FUNC "%10.0" "b" COEFFS 0.000000 1.000000 0.000000 0.000000 0.000000 1.000000 /end COMPU_METHOD
/* Scalar measurable for DDE 'ETC_b_TP1_ZeroPosOOR'. */
/begin MEASUREMENT ETC_b_TP1_ZeroPosOOR "Displayable" UBYTE CU_ETC_B_TP1_ZEROPOSOOR 1 100 0.0 1.0 ECU_ADDRESS 0x40002eaf BYTE_ORDER MSB_FIRST /end MEASUREMENT
/begin COMPU_METHOD CU_ETC_B_TP1_ZEROPOSOOR "Conversion method for ETC_b_TP1_ZeroPosOOR" RAT_FUNC "%10.0" "b" COEFFS 0.000000 1.000000 0.000000 0.000000 0.000000 1.000000 /end COMPU_METHOD
/* Scalar measurable for DDE 'ETC_b_TP2_FullPosOOR'. */
/begin MEASUREMENT ETC_b_TP2_FullPosOOR "Displayable" UBYTE CU_ETC_B_TP2_FULLPOSOOR 1 100 0.0 1.0 ECU_ADDRESS 0x40002ead BYTE_ORDER MSB_FIRST /end MEASUREMENT
/begin COMPU_METHOD CU_ETC_B_TP2_FULLPOSOOR "Conversion method for ETC_b_TP2_FullPosOOR" RAT_FUNC "%10.0" "b" COEFFS 0.000000 1.000000 0.000000 0.000000 0.000000 1.000000 /end COMPU_METHOD
/* Scalar measurable for DDE 'ETC_b_TP2_LearnFull'. */
/begin MEASUREMENT ETC_b_TP2_LearnFull "Displayable" UBYTE CU_ETC_B_TP2_LEARNFULL 1 100 0.0 1.0 ECU_ADDRESS 0x40002eae BYTE_ORDER MSB_FIRST /end MEASUREMENT
/begin COMPU_METHOD CU_ETC_B_TP2_LEARNFULL "Conversion method for ETC_b_TP2_LearnFull" RAT_FUNC "%10.0" "b" COEFFS 0.000000 1.000000 0.000000 0.000000 0.000000 1.000000 /end COMPU_METHOD
/* Scalar measurable for DDE 'ETC_b_TP2_LearnZero'. */
/begin MEASUREMENT ETC_b_TP2_LearnZero "Displayable" UBYTE CU_ETC_B_TP2_LEARNZERO 1 100 0.0 1.0 ECU_ADDRESS 0x40002eb2 BYTE_ORDER MSB_FIRST /end MEASUREMENT
/begin COMPU_METHOD CU_ETC_B_TP2_LEARNZERO "Conversion method for ETC_b_TP2_LearnZero" RAT_FUNC "%10.0" "b" COEFFS 0.000000 1.000000 0.000000 0.000000 0.000000 1.000000 /end COMPU_METHOD
/* Scalar measurable for DDE 'ETC_b_TP2_ZeroPosOOR'. */
/begin MEASUREMENT ETC_b_TP2_ZeroPosOOR "Displayable" UBYTE CU_ETC_B_TP2_ZEROPOSOOR 1 100 0.0 1.0 ECU_ADDRESS 0x40002eb1 BYTE_ORDER MSB_FIRST /end MEASUREMENT
/begin COMPU_METHOD CU_ETC_B_TP2_ZEROPOSOOR "Conversion method for ETC_b_TP2_ZeroPosOOR" RAT_FUNC "%10.0" "b" COEFFS 0.000000 1.000000 0.000000 0.000000 0.000000 1.000000 /end COMPU_METHOD
/* Scalar measurable for DDE 'ETC_b_TP_CorrFlt'. */
/begin MEASUREMENT ETC_b_TP_CorrFlt "DiagFail flag" UBYTE CU_ETC_B_TP_CORRFLT 1 100 0.0 1.0 ECU_ADDRESS 0x40002ea3 BYTE_ORDER MSB_FIRST /end MEASUREMENT
/begin COMPU_METHOD CU_ETC_B_TP_CORRFLT "Conversion method for ETC_b_TP_CorrFlt" RAT_FUNC "%10.0" "b" COEFFS 0.000000 1.000000 0.000000 0.000000 0.000000 1.000000 /end COMPU_METHOD
/* Scalar measurable for DDE 'ETC_deg_Error'. */
/begin MEASUREMENT ETC_deg_Error "Displayable" FLOAT32_IEEE CU_ETC_DEG_ERROR 1 100 0.0 0.0 ECU_ADDRESS 0x400031a4 BYTE_ORDER MSB_FIRST /end MEASUREMENT
/begin COMPU_METHOD CU_ETC_DEG_ERROR "Conversion method for ETC_deg_Error" RAT_FUNC "%10.1" "deg" COEFFS 0.000000 1.000000 0.000000 0.000000 0.000000 1.000000 /end COMPU_METHOD
/* Scalar measurable for DDE 'ETC_deg_RelativeThRqst'. */
/begin MEASUREMENT ETC_deg_RelativeThRqst "Difference between rqst and rest position (used for FF lookup)" FLOAT32_IEEE CU_ETC_DEG_RELATIVETHRQST 1 100 0.0 0.0 ECU_ADDRESS 0x4000319c BYTE_ORDER MSB_FIRST /end MEASUREMENT
/begin COMPU_METHOD CU_ETC_DEG_RELATIVETHRQST "Conversion method for ETC_deg_RelativeThRqst" RAT_FUNC "%10.1" "deg" COEFFS 0.000000 1.000000 0.000000 0.000000 0.000000 1.000000 /end COMPU_METHOD
/* Scalar measurable for DDE 'ETC_deg_RestPos'. */
/begin MEASUREMENT ETC_deg_RestPos "Displayable" FLOAT32_IEEE CU_ETC_DEG_RESTPOS 1 100 0.0 90.0 ECU_ADDRESS 0x40003344 BYTE_ORDER MSB_FIRST /end MEASUREMENT
/begin COMPU_METHOD CU_ETC_DEG_RESTPOS "Conversion method for ETC_deg_RestPos" RAT_FUNC "%10.2" "deg" COEFFS 0.000000 1.000000 0.000000 0.000000 0.000000 1.000000 /end COMPU_METHOD
/* Scalar measurable for DDE 'ETC_deg_ThRqstFiltd'. */
/begin MEASUREMENT ETC_deg_ThRqstFiltd "Monitoring Corrected Throttle Angle" FLOAT32_IEEE CU_ETC_DEG_THRQSTFILTD 1 100 0.0 0.0 ECU_ADDRESS 0x40003338 BYTE_ORDER MSB_FIRST /end MEASUREMENT
/begin COMPU_METHOD CU_ETC_DEG_THRQSTFILTD "Conversion method for ETC_deg_ThRqstFiltd" RAT_FUNC "%10.3" "deg" COEFFS 0.000000 1.000000 0.000000 0.000000 0.000000 1.000000 /end COMPU_METHOD
/* Scalar measurable for DDE 'ETC_deg_ThRqstHPF'. */
/begin MEASUREMENT ETC_deg_ThRqstHPF "Throttle request HPF result" FLOAT32_IEEE CU_ETC_DEG_THRQSTHPF 1 100 0.0 0.0 ECU_ADDRESS 0x400031a8 BYTE_ORDER MSB_FIRST /end MEASUREMENT
/begin COMPU_METHOD CU_ETC_DEG_THRQSTHPF "Conversion method for ETC_deg_ThRqstHPF" RAT_FUNC "%10.2" "deg" COEFFS 0.000000 1.000000 0.000000 0.000000 0.000000 1.000000 /end COMPU_METHOD
/* Scalar measurable for DDE 'ETC_deg_VlvPos'. */
/begin MEASUREMENT ETC_deg_VlvPos "Arbitrated throttle blade position" FLOAT32_IEEE CU_ETC_DEG_VLVPOS 1 100 0.0 0.0 ECU_ADDRESS 0x40003348 BYTE_ORDER MSB_FIRST /end MEASUREMENT
/begin COMPU_METHOD CU_ETC_DEG_VLVPOS "Conversion method for ETC_deg_VlvPos" RAT_FUNC "%10.1" "deg" COEFFS 0.000000 1.000000 0.000000 0.000000 0.000000 1.000000 /end COMPU_METHOD
/* Scalar measurable for DDE 'ETC_pct_AvgTP'. */
/begin MEASUREMENT ETC_pct_AvgTP "Average throttle position (taken after xfr)" FLOAT32_IEEE CU_ETC_PCT_AVGTP 1 100 0.0 0.0 ECU_ADDRESS 0x40003230 BYTE_ORDER MSB_FIRST /end MEASUREMENT
/begin COMPU_METHOD CU_ETC_PCT_AVGTP "Conversion method for ETC_pct_AvgTP" RAT_FUNC "%10.2" "pct" COEFFS 0.000000 1.000000 0.000000 0.000000 0.000000 1.000000 /end COMPU_METHOD
/* Scalar measurable for DDE 'ETC_pct_Effort'. */
/begin MEASUREMENT ETC_pct_Effort "Displayable" FLOAT32_IEEE CU_ETC_PCT_EFFORT 1 100 0.0 0.0 ECU_ADDRESS 0x4000317c BYTE_ORDER MSB_FIRST /end MEASUREMENT
/begin COMPU_METHOD CU_ETC_PCT_EFFORT "Conversion method for ETC_pct_Effort" RAT_FUNC "%10.2" "pct" COEFFS 0.000000 1.000000 0.000000 0.000000 0.000000 1.000000 /end COMPU_METHOD
/* Scalar measurable for DDE 'ETC_pct_FB'. */
/begin MEASUREMENT ETC_pct_FB "Displayable" FLOAT32_IEEE CU_ETC_PCT_FB 1 100 0.0 0.0 ECU_ADDRESS 0x40003180 BYTE_ORDER MSB_FIRST /end MEASUREMENT
/begin COMPU_METHOD CU_ETC_PCT_FB "Conversion method for ETC_pct_FB" RAT_FUNC "%10.2" "pct" COEFFS 0.000000 1.000000 0.000000 0.000000 0.000000 1.000000 /end COMPU_METHOD
/* Scalar measurable for DDE 'ETC_pct_FF'. */
/begin MEASUREMENT ETC_pct_FF "Feedforward effort" FLOAT32_IEEE CU_ETC_PCT_FF 1 100 0.0 0.0 ECU_ADDRESS 0x40003198 BYTE_ORDER MSB_FIRST /end MEASUREMENT
/begin COMPU_METHOD CU_ETC_PCT_FF "Conversion method for ETC_pct_FF" RAT_FUNC "%10.2" "pct" COEFFS 0.000000 1.000000 0.000000 0.000000 0.000000 1.000000 /end COMPU_METHOD
/* Scalar measurable for DDE 'ETC_pct_Hyst'. */
/begin MEASUREMENT ETC_pct_Hyst "Feedforward effort" FLOAT32_IEEE CU_ETC_PCT_HYST 1 100 0.0 0.0 ECU_ADDRESS 0x400031a0 BYTE_ORDER MSB_FIRST /end MEASUREMENT
/begin COMPU_METHOD CU_ETC_PCT_HYST "Conversion method for ETC_pct_Hyst" RAT_FUNC "%10.3" "pct" COEFFS 0.000000 1.000000 0.000000 0.000000 0.000000 1.000000 /end COMPU_METHOD
/* Scalar measurable for DDE 'ETC_pct_Kick'. */
/begin MEASUREMENT ETC_pct_Kick "Kick term output" FLOAT32_IEEE CU_ETC_PCT_KICK 1 100 0.0 0.0 ECU_ADDRESS 0x40003174 BYTE_ORDER MSB_FIRST /end MEASUREMENT
/begin COMPU_METHOD CU_ETC_PCT_KICK "Conversion method for ETC_pct_Kick" RAT_FUNC "%10.3" "pct" COEFFS 0.000000 1.000000 0.000000 0.000000 0.000000 1.000000 /end COMPU_METHOD
/* Scalar measurable for DDE 'ETC_pct_Kick_error'. */
/begin MEASUREMENT ETC_pct_Kick_error "(not defined)" FLOAT32_IEEE CU_ETC_PCT_KICK_ERROR 1 100 -1000.0 1000.0 ECU_ADDRESS 0x4000316c BYTE_ORDER MSB_FIRST /end MEASUREMENT
/begin COMPU_METHOD CU_ETC_PCT_KICK_ERROR "Conversion method for ETC_pct_Kick_error" RAT_FUNC "%10.2" "pct" COEFFS 0.000000 1.000000 0.000000 0.000000 0.000000 1.000000 /end COMPU_METHOD
/* Scalar measurable for DDE 'ETC_pct_MotorCmd'. */
/begin MEASUREMENT ETC_pct_MotorCmd "Final actuator command" FLOAT32_IEEE CU_ETC_PCT_MOTORCMD 1 100 0.0 0.0 ECU_ADDRESS 0x400031fc BYTE_ORDER MSB_FIRST /end MEASUREMENT
/begin COMPU_METHOD CU_ETC_PCT_MOTORCMD "Conversion method for ETC_pct_MotorCmd" RAT_FUNC "%10.2" "pct" COEFFS 0.000000 1.000000 0.000000 0.000000 0.000000 1.000000 /end COMPU_METHOD
/* Scalar measurable for DDE 'ETC_pct_MotorCmdVb'. */
/begin MEASUREMENT ETC_pct_MotorCmdVb "Final actuator command" FLOAT32_IEEE CU_ETC_PCT_MOTORCMDVB 1 100 0.0 0.0 ECU_ADDRESS 0x40003334 BYTE_ORDER MSB_FIRST /end MEASUREMENT
/begin COMPU_METHOD CU_ETC_PCT_MOTORCMDVB "Conversion method for ETC_pct_MotorCmdVb" RAT_FUNC "%10.2" "pct" COEFFS 0.000000 1.000000 0.000000 0.000000 0.000000 1.000000 /end COMPU_METHOD
/* Scalar measurable for DDE 'ETC_pct_TP1'. */
/begin MEASUREMENT ETC_pct_TP1 "throttle position 1 percent" FLOAT32_IEEE CU_ETC_PCT_TP1 1 100 0.0 0.0 ECU_ADDRESS 0x4000335c BYTE_ORDER MSB_FIRST /end MEASUREMENT
/begin COMPU_METHOD CU_ETC_PCT_TP1 "Conversion method for ETC_pct_TP1" RAT_FUNC "%10.3" "pct" COEFFS 0.000000 1.000000 0.000000 0.000000 0.000000 1.000000 /end COMPU_METHOD
/* Scalar measurable for DDE 'ETC_pct_TP2'. */
/begin MEASUREMENT ETC_pct_TP2 "throttle position 2 percent" FLOAT32_IEEE CU_ETC_PCT_TP2 1 100 0.0 0.0 ECU_ADDRESS 0x40003350 BYTE_ORDER MSB_FIRST /end MEASUREMENT
/begin COMPU_METHOD CU_ETC_PCT_TP2 "Conversion method for ETC_pct_TP2" RAT_FUNC "%10.3" "pct" COEFFS 0.000000 1.000000 0.000000 0.000000 0.000000 1.000000 /end COMPU_METHOD
/* Scalar measurable for DDE 'ETC_pct_TP_Delta'. */
/begin MEASUREMENT ETC_pct_TP_Delta "TP1-TP2 difference" FLOAT32_IEEE CU_ETC_PCT_TP_DELTA 1 100 0.0 0.0 ECU_ADDRESS 0x4000334c BYTE_ORDER MSB_FIRST /end MEASUREMENT
/begin COMPU_METHOD CU_ETC_PCT_TP_DELTA "Conversion method for ETC_pct_TP_Delta" RAT_FUNC "%10.2" "pct" COEFFS 0.000000 1.000000 0.000000 0.000000 0.000000 1.000000 /end COMPU_METHOD
/* Scalar measurable for DDE 'FCA_Km_AcumDistance'. */
/begin MEASUREMENT FCA_Km_AcumDistance "Distance learn default value" FLOAT32_IEEE CU_FCA_KM_ACUMDISTANCE 1 100 0.0 0.0 ECU_ADDRESS 0x400031d8 BYTE_ORDER MSB_FIRST /end MEASUREMENT
/begin COMPU_METHOD CU_FCA_KM_ACUMDISTANCE "Conversion method for FCA_Km_AcumDistance" RAT_FUNC "%10.0" "km" COEFFS 0.000000 1.000000 0.000000 0.000000 0.000000 1.000000 /end COMPU_METHOD
/* Scalar measurable for DDE 'FCA_L_AcumFuelComsuption'. */
/begin MEASUREMENT FCA_L_AcumFuelComsuption "Fuel consumption learn default value" FLOAT32_IEEE CU_FCA_L_ACUMFUELCOMSUPTION 1 100 0.0 0.0 ECU_ADDRESS 0x400031d0 BYTE_ORDER MSB_FIRST /end MEASUREMENT
/begin COMPU_METHOD CU_FCA_L_ACUMFUELCOMSUPTION "Conversion method for FCA_L_AcumFuelComsuption" RAT_FUNC "%10.1" "L" COEFFS 0.000000 1.000000 0.000000 0.000000 0.000000 1.000000 /end COMPU_METHOD
/* Scalar measurable for DDE 'FCA_L_TotalFuelFlow'. */
/begin MEASUREMENT FCA_L_TotalFuelFlow "Fuel consumption" FLOAT32_IEEE CU_FCA_L_TOTALFUELFLOW 1 100 0.0 0.0 ECU_ADDRESS 0x400031d4 BYTE_ORDER MSB_FIRST /end MEASUREMENT
/begin COMPU_METHOD CU_FCA_L_TOTALFUELFLOW "Conversion method for FCA_L_TotalFuelFlow" RAT_FUNC "%10.1" "L" COEFFS 0.000000 1.000000 0.000000 0.000000 0.000000 1.000000 /end COMPU_METHOD
/* Scalar measurable for DDE 'FCA_kps_VhSpd'. */
/begin MEASUREMENT FCA_kps_VhSpd "vehicle speed (kilometers per seconds)" FLOAT32_IEEE CU_FCA_KPS_VHSPD 1 100 0.0 0.0 ECU_ADDRESS 0x400031dc BYTE_ORDER MSB_FIRST /end MEASUREMENT
/begin COMPU_METHOD CU_FCA_KPS_VHSPD "Conversion method for FCA_kps_VhSpd" RAT_FUNC "%10.5" "kps" COEFFS 0.000000 1.000000 0.000000 0.000000 0.000000 1.000000 /end COMPU_METHOD
/* Scalar measurable for DDE 'FCA_lpk_AverageFuelConsumption'. */
/begin MEASUREMENT FCA_lpk_AverageFuelConsumption "Fuel consumption in Liters per 100km" FLOAT32_IEEE CU_FCA_LPK_AVERAGEFUELCONSUMPT0 1 100 0.0 0.0 ECU_ADDRESS 0x400031f8 BYTE_ORDER MSB_FIRST /end MEASUREMENT
/begin COMPU_METHOD CU_FCA_LPK_AVERAGEFUELCONSUMPT0 "Conversion method for FCA_lpk_AverageFuelConsumption" RAT_FUNC "%10.1" "lpk" COEFFS 0.000000 1.000000 0.000000 0.000000 0.000000 1.000000 /end COMPU_METHOD
/* Scalar measurable for DDE 'IDL_NU_AirDTerm'. */
/begin MEASUREMENT IDL_NU_AirDTerm "Displayable" FLOAT32_IEEE CU_IDL_NU_AIRDTERM 1 100 0.0 0.0 ECU_ADDRESS 0x40003400 BYTE_ORDER MSB_FIRST /end MEASUREMENT
/begin COMPU_METHOD CU_IDL_NU_AIRDTERM "Conversion method for IDL_NU_AirDTerm" RAT_FUNC "%10.3" "NU" COEFFS 0.000000 1.000000 0.000000 0.000000 0.000000 1.000000 /end COMPU_METHOD
/* Scalar measurable for DDE 'IDL_NU_AirITerm'. */
/begin MEASUREMENT IDL_NU_AirITerm "Displayable" FLOAT32_IEEE CU_IDL_NU_AIRITERM 1 100 0.0 0.0 ECU_ADDRESS 0x40003404 BYTE_ORDER MSB_FIRST /end MEASUREMENT
/begin COMPU_METHOD CU_IDL_NU_AIRITERM "Conversion method for IDL_NU_AirITerm" RAT_FUNC "%10.3" "NU" COEFFS 0.000000 1.000000 0.000000 0.000000 0.000000 1.000000 /end COMPU_METHOD
/* Scalar measurable for DDE 'IDL_NU_AirPIDEffort'. */
/begin MEASUREMENT IDL_NU_AirPIDEffort "Effort displayable" FLOAT32_IEEE CU_IDL_NU_AIRPIDEFFORT 1 100 0.0 0.0 ECU_ADDRESS 0x400033fc BYTE_ORDER MSB_FIRST /end MEASUREMENT
/begin COMPU_METHOD CU_IDL_NU_AIRPIDEFFORT "Conversion method for IDL_NU_AirPIDEffort" RAT_FUNC "%10.3" "NU" COEFFS 0.000000 1.000000 0.000000 0.000000 0.000000 1.000000 /end COMPU_METHOD
/* Scalar measurable for DDE 'IDL_NU_AirPTerm'. */
/begin MEASUREMENT IDL_NU_AirPTerm "Displayable" FLOAT32_IEEE CU_IDL_NU_AIRPTERM 1 100 0.0 0.0 ECU_ADDRESS 0x40003408 BYTE_ORDER MSB_FIRST /end MEASUREMENT
/begin COMPU_METHOD CU_IDL_NU_AIRPTERM "Conversion method for IDL_NU_AirPTerm" RAT_FUNC "%10.3" "NU" COEFFS 0.000000 1.000000 0.000000 0.000000 0.000000 1.000000 /end COMPU_METHOD
/* Scalar measurable for DDE 'IDL_NU_ErrorROC'. */
/begin MEASUREMENT IDL_NU_ErrorROC "(RPM/s) rate of change of air flow rate error" FLOAT32_IEEE CU_IDL_NU_ERRORROC 1 100 0.0 0.0 ECU_ADDRESS 0x4000346c BYTE_ORDER MSB_FIRST /end MEASUREMENT
/begin COMPU_METHOD CU_IDL_NU_ERRORROC "Conversion method for IDL_NU_ErrorROC" RAT_FUNC "%10.0" "NU" COEFFS 0.000000 1.000000 0.000000 0.000000 0.000000 1.000000 /end COMPU_METHOD
/* Scalar measurable for DDE 'IDL_NU_IdlAirGEAR_FF'. */
/begin MEASUREMENT IDL_NU_IdlAirGEAR_FF "Feedforward idle Air" FLOAT32_IEEE CU_IDL_NU_IDLAIRGEAR_FF 1 100 0.0 0.0 ECU_ADDRESS 0x400033f0 BYTE_ORDER MSB_FIRST /end MEASUREMENT
/begin COMPU_METHOD CU_IDL_NU_IDLAIRGEAR_FF "Conversion method for IDL_NU_IdlAirGEAR_FF" RAT_FUNC "%10.3" "NU" COEFFS 0.000000 1.000000 0.000000 0.000000 0.000000 1.000000 /end COMPU_METHOD
/* Scalar measurable for DDE 'IDL_NU_SparkDTerm'. */
/begin MEASUREMENT IDL_NU_SparkDTerm "Displayable" FLOAT32_IEEE CU_IDL_NU_SPARKDTERM 1 100 0.0 0.0 ECU_ADDRESS 0x40003468 BYTE_ORDER MSB_FIRST /end MEASUREMENT
/begin COMPU_METHOD CU_IDL_NU_SPARKDTERM "Conversion method for IDL_NU_SparkDTerm" RAT_FUNC "%10.3" "NU" COEFFS 0.000000 1.000000 0.000000 0.000000 0.000000 1.000000 /end COMPU_METHOD
/* Scalar measurable for DDE 'IDL_NU_SparkITerm'. */
/begin MEASUREMENT IDL_NU_SparkITerm "Displayable" FLOAT32_IEEE CU_IDL_NU_SPARKITERM 1 100 0.0 0.0 ECU_ADDRESS 0x40003474 BYTE_ORDER MSB_FIRST /end MEASUREMENT
/begin COMPU_METHOD CU_IDL_NU_SPARKITERM "Conversion method for IDL_NU_SparkITerm" RAT_FUNC "%10.3" "NU" COEFFS 0.000000 1.000000 0.000000 0.000000 0.000000 1.000000 /end COMPU_METHOD
/* Scalar measurable for DDE 'IDL_NU_SparkPID_Effort'. */
/begin MEASUREMENT IDL_NU_SparkPID_Effort "Effort displayable" FLOAT32_IEEE CU_IDL_NU_SPARKPID_EFFORT 1 100 0.0 0.0 ECU_ADDRESS 0x40003464 BYTE_ORDER MSB_FIRST /end MEASUREMENT
/begin COMPU_METHOD CU_IDL_NU_SPARKPID_EFFORT "Conversion method for IDL_NU_SparkPID_Effort" RAT_FUNC "%10.3" "NU" COEFFS 0.000000 1.000000 0.000000 0.000000 0.000000 1.000000 /end COMPU_METHOD
/* Scalar measurable for DDE 'IDL_NU_SparkPTerm'. */
/begin MEASUREMENT IDL_NU_SparkPTerm "Displayable" FLOAT32_IEEE CU_IDL_NU_SPARKPTERM 1 100 0.0 0.0 ECU_ADDRESS 0x40003478 BYTE_ORDER MSB_FIRST /end MEASUREMENT
/begin COMPU_METHOD CU_IDL_NU_SPARKPTERM "Conversion method for IDL_NU_SparkPTerm" RAT_FUNC "%10.3" "NU" COEFFS 0.000000 1.000000 0.000000 0.000000 0.000000 1.000000 /end COMPU_METHOD
/* Scalar measurable for DDE 'IDL_RPM_AC_Term'. */
/begin MEASUREMENT IDL_RPM_AC_Term "Idle speed adder based on AC compressor" FLOAT32_IEEE CU_IDL_RPM_AC_TERM 1 100 0.0 0.0 ECU_ADDRESS 0x400035a8 BYTE_ORDER MSB_FIRST /end MEASUREMENT
/begin COMPU_METHOD CU_IDL_RPM_AC_TERM "Conversion method for IDL_RPM_AC_Term" RAT_FUNC "%10.0" "RPM" COEFFS 0.000000 1.000000 0.000000 0.000000 0.000000 1.000000 /end COMPU_METHOD
/* Scalar measurable for DDE 'IDL_RPM_Added'. */
/begin MEASUREMENT IDL_RPM_Added "Displayable" FLOAT32_IEEE CU_IDL_RPM_ADDED 1 100 0.0 0.0 ECU_ADDRESS 0x4000359c BYTE_ORDER MSB_FIRST /end MEASUREMENT
/begin COMPU_METHOD CU_IDL_RPM_ADDED "Conversion method for IDL_RPM_Added" RAT_FUNC "%10.0" "RPM" COEFFS 0.000000 1.000000 0.000000 0.000000 0.000000 1.000000 /end COMPU_METHOD
/* Scalar measurable for DDE 'IDL_RPM_AlternatorTerm'. */
/begin MEASUREMENT IDL_RPM_AlternatorTerm "Idle speed adder based on alternator current" FLOAT32_IEEE CU_IDL_RPM_ALTERNATORTERM 1 100 0.0 0.0 ECU_ADDRESS 0x400035ac BYTE_ORDER MSB_FIRST /end MEASUREMENT
/begin COMPU_METHOD CU_IDL_RPM_ALTERNATORTERM "Conversion method for IDL_RPM_AlternatorTerm" RAT_FUNC "%10.0" "RPM" COEFFS 0.000000 1.000000 0.000000 0.000000 0.000000 1.000000 /end COMPU_METHOD
/* Scalar measurable for DDE 'IDL_RPM_AlternatorTermRaw'. */
/begin MEASUREMENT IDL_RPM_AlternatorTermRaw "Map output value" FLOAT32_IEEE CU_IDL_RPM_ALTERNATORTERMRAW 1 100 0.0 0.0 ECU_ADDRESS 0x400035b0 BYTE_ORDER MSB_FIRST /end MEASUREMENT
/begin COMPU_METHOD CU_IDL_RPM_ALTERNATORTERMRAW "Conversion method for IDL_RPM_AlternatorTermRaw" RAT_FUNC "%10.0" "RPM" COEFFS 0.000000 1.000000 0.000000 0.000000 0.000000 1.000000 /end COMPU_METHOD
/* Scalar measurable for DDE 'IDL_RPM_Base'. */
/begin MEASUREMENT IDL_RPM_Base "Temp and StartTime idle speed target result" FLOAT32_IEEE CU_IDL_RPM_BASE 1 100 0.0 0.0 ECU_ADDRESS 0x400035b8 BYTE_ORDER MSB_FIRST /end MEASUREMENT
/begin COMPU_METHOD CU_IDL_RPM_BASE "Conversion method for IDL_RPM_Base" RAT_FUNC "%10.0" "RPM" COEFFS 0.000000 1.000000 0.000000 0.000000 0.000000 1.000000 /end COMPU_METHOD
/* Scalar measurable for DDE 'IDL_RPM_DrivingTerm'. */
/begin MEASUREMENT IDL_RPM_DrivingTerm "Displayable" FLOAT32_IEEE CU_IDL_RPM_DRIVINGTERM 1 100 0.0 0.0 ECU_ADDRESS 0x400035a4 BYTE_ORDER MSB_FIRST /end MEASUREMENT
/begin COMPU_METHOD CU_IDL_RPM_DRIVINGTERM "Conversion method for IDL_RPM_DrivingTerm" RAT_FUNC "%10.0" "RPM" COEFFS 0.000000 1.000000 0.000000 0.000000 0.000000 1.000000 /end COMPU_METHOD
/* Scalar measurable for DDE 'IDL_RPM_Error'. */
/begin MEASUREMENT IDL_RPM_Error "Speed error used for FB control" FLOAT32_IEEE CU_IDL_RPM_ERROR 1 100 0.0 0.0 ECU_ADDRESS 0x40003594 BYTE_ORDER MSB_FIRST /end MEASUREMENT
/begin COMPU_METHOD CU_IDL_RPM_ERROR "Conversion method for IDL_RPM_Error" RAT_FUNC "%10.0" "RPM" COEFFS 0.000000 1.000000 0.000000 0.000000 0.000000 1.000000 /end COMPU_METHOD
/* Scalar measurable for DDE 'IDL_RPM_ErrorLPF'. */
/begin MEASUREMENT IDL_RPM_ErrorLPF "Displayable" FLOAT32_IEEE CU_IDL_RPM_ERRORLPF 1 100 0.0 0.0 ECU_ADDRESS 0x40003470 BYTE_ORDER MSB_FIRST /end MEASUREMENT
/begin COMPU_METHOD CU_IDL_RPM_ERRORLPF "Conversion method for IDL_RPM_ErrorLPF" RAT_FUNC "%10.0" "RPM" COEFFS 0.000000 1.000000 0.000000 0.000000 0.000000 1.000000 /end COMPU_METHOD
/* Scalar measurable for DDE 'IDL_RPM_Trgt'. */
/begin MEASUREMENT IDL_RPM_Trgt "Displayable" FLOAT32_IEEE CU_IDL_RPM_TRGT 1 100 0.0 0.0 ECU_ADDRESS 0x400035a0 BYTE_ORDER MSB_FIRST /end MEASUREMENT
/begin COMPU_METHOD CU_IDL_RPM_TRGT "Conversion method for IDL_RPM_Trgt" RAT_FUNC "%10.0" "RPM" COEFFS 0.000000 1.000000 0.000000 0.000000 0.000000 1.000000 /end COMPU_METHOD
/* Scalar measurable for DDE 'IDL_RPM_Trgt_trt'. */
/begin MEASUREMENT IDL_RPM_Trgt_trt "Displayable" FLOAT32_IEEE CU_IDL_RPM_TRGT_TRT 1 100 0.0 0.0 ECU_ADDRESS 0x40003598 BYTE_ORDER MSB_FIRST /end MEASUREMENT
/begin COMPU_METHOD CU_IDL_RPM_TRGT_TRT "Conversion method for IDL_RPM_Trgt_trt" RAT_FUNC "%10.0" "RPM" COEFFS 0.000000 1.000000 0.000000 0.000000 0.000000 1.000000 /end COMPU_METHOD
/* Scalar measurable for DDE 'IDL_b_Actv'. */
/begin MEASUREMENT IDL_b_Actv "Displayable" UBYTE CU_IDL_B_ACTV 1 100 0.0 1.0 ECU_ADDRESS 0x40002ed4 BYTE_ORDER MSB_FIRST /end MEASUREMENT
/begin COMPU_METHOD CU_IDL_B_ACTV "Conversion method for IDL_b_Actv" RAT_FUNC "%10.0" "b" COEFFS 0.000000 1.000000 0.000000 0.000000 0.000000 1.000000 /end COMPU_METHOD
/* Scalar measurable for DDE 'IDL_gps_Air'. */
/begin MEASUREMENT IDL_gps_Air "Final Idle Air request" FLOAT32_IEEE CU_IDL_GPS_AIR 1 100 0.0 0.0 ECU_ADDRESS 0x400033e8 BYTE_ORDER MSB_FIRST /end MEASUREMENT
/begin COMPU_METHOD CU_IDL_GPS_AIR "Conversion method for IDL_gps_Air" RAT_FUNC "%10.3" "gps" COEFFS 0.000000 1.000000 0.000000 0.000000 0.000000 1.000000 /end COMPU_METHOD
/* Scalar measurable for DDE 'IDL_gps_IdlAC_FF'. */
/begin MEASUREMENT IDL_gps_IdlAC_FF "Feedforward idle Air" FLOAT32_IEEE CU_IDL_GPS_IDLAC_FF 1 100 0.0 0.0 ECU_ADDRESS 0x400033ec BYTE_ORDER MSB_FIRST /end MEASUREMENT
/begin COMPU_METHOD CU_IDL_GPS_IDLAC_FF "Conversion method for IDL_gps_IdlAC_FF" RAT_FUNC "%10.3" "NU" COEFFS 0.000000 1.000000 0.000000 0.000000 0.000000 1.000000 /end COMPU_METHOD
/* Scalar measurable for DDE 'IDL_gps_IdlAir_FF'. */
/begin MEASUREMENT IDL_gps_IdlAir_FF "Feedforward idle Air" FLOAT32_IEEE CU_IDL_GPS_IDLAIR_FF 1 100 0.0 100.0 ECU_ADDRESS 0x400033f4 BYTE_ORDER MSB_FIRST /end MEASUREMENT
/begin COMPU_METHOD CU_IDL_GPS_IDLAIR_FF "Conversion method for IDL_gps_IdlAir_FF" RAT_FUNC "%10.3" "gps" COEFFS 0.000000 1.000000 0.000000 0.000000 0.000000 1.000000 /end COMPU_METHOD
/* Scalar measurable for DDE 'IDL_gps_IdlAir_PID'. */
/begin MEASUREMENT IDL_gps_IdlAir_PID "Idle Air feedback term" FLOAT32_IEEE CU_IDL_GPS_IDLAIR_PID 1 100 -1000.0 1000.0 ECU_ADDRESS 0x400033f8 BYTE_ORDER MSB_FIRST /end MEASUREMENT
/begin COMPU_METHOD CU_IDL_GPS_IDLAIR_PID "Conversion method for IDL_gps_IdlAir_PID" RAT_FUNC "%10.3" "gps" COEFFS 0.000000 1.000000 0.000000 0.000000 0.000000 1.000000 /end COMPU_METHOD
/* Scalar measurable for DDE 'IDL_ret_Spark'. */
/begin MEASUREMENT IDL_ret_Spark "Final Idle spark request" FLOAT32_IEEE CU_IDL_RET_SPARK 1 100 0.0 0.0 ECU_ADDRESS 0x40003460 BYTE_ORDER MSB_FIRST /end MEASUREMENT
/begin COMPU_METHOD CU_IDL_RET_SPARK "Conversion method for IDL_ret_Spark" RAT_FUNC "%10.1" "(not defined)" COEFFS 0.000000 1.000000 0.000000 0.000000 0.000000 1.000000 /end COMPU_METHOD
/* Scalar measurable for DDE 'IJT_NU_TotalFuelFlowKgPerHr'. */
/begin MEASUREMENT IJT_NU_TotalFuelFlowKgPerHr "(kg/hr) Commanded engine-total fuel flow rate" FLOAT32_IEEE CU_IJT_NU_TOTALFUELFLOWKGPERHR 1 100 0.0 0.0 ECU_ADDRESS 0x400032fc BYTE_ORDER MSB_FIRST /end MEASUREMENT
/begin COMPU_METHOD CU_IJT_NU_TOTALFUELFLOWKGPERHR "Conversion method for IJT_NU_TotalFuelFlowKgPerHr" RAT_FUNC "%10.1" "NU" COEFFS 0.000000 1.000000 0.000000 0.000000 0.000000 1.000000 /end COMPU_METHOD
/* Scalar measurable for DDE 'IJT_adv_CrankingSOI'. */
/begin MEASUREMENT IJT_adv_CrankingSOI "Displayable" FLOAT32_IEEE CU_IJT_ADV_CRANKINGSOI 1 100 0.0 0.0 ECU_ADDRESS 0x40003330 BYTE_ORDER MSB_FIRST /end MEASUREMENT
/begin COMPU_METHOD CU_IJT_ADV_CRANKINGSOI "Conversion method for IJT_adv_CrankingSOI" RAT_FUNC "%10.2" "adv" COEFFS 0.000000 1.000000 0.000000 0.000000 0.000000 1.000000 /end COMPU_METHOD
/* Scalar measurable for DDE 'IJT_adv_RunningSOI'. */
/begin MEASUREMENT IJT_adv_RunningSOI "Displayable" FLOAT32_IEEE CU_IJT_ADV_RUNNINGSOI 1 100 0.0 0.0 ECU_ADDRESS 0x4000332c BYTE_ORDER MSB_FIRST /end MEASUREMENT
/begin COMPU_METHOD CU_IJT_ADV_RUNNINGSOI "Conversion method for IJT_adv_RunningSOI" RAT_FUNC "%10.2" "adv" COEFFS 0.000000 1.000000 0.000000 0.000000 0.000000 1.000000 /end COMPU_METHOD
/* Scalar measurable for DDE 'IJT_adv_SOC_Inj1'. */
/begin MEASUREMENT IJT_adv_SOC_Inj1 "Displayable" FLOAT32_IEEE CU_IJT_ADV_SOC_INJ1 1 100 0.0 0.0 ECU_ADDRESS 0x40003324 BYTE_ORDER MSB_FIRST /end MEASUREMENT
/begin COMPU_METHOD CU_IJT_ADV_SOC_INJ1 "Conversion method for IJT_adv_SOC_Inj1" RAT_FUNC "%10.2" "adv" COEFFS 0.000000 1.000000 0.000000 0.000000 0.000000 1.000000 /end COMPU_METHOD
/* Scalar measurable for DDE 'IJT_adv_SOC_Inj2'. */
/begin MEASUREMENT IJT_adv_SOC_Inj2 "Displayable" FLOAT32_IEEE CU_IJT_ADV_SOC_INJ2 1 100 0.0 0.0 ECU_ADDRESS 0x40003320 BYTE_ORDER MSB_FIRST /end MEASUREMENT
/begin COMPU_METHOD CU_IJT_ADV_SOC_INJ2 "Conversion method for IJT_adv_SOC_Inj2" RAT_FUNC "%10.2" "adv" COEFFS 0.000000 1.000000 0.000000 0.000000 0.000000 1.000000 /end COMPU_METHOD
/* Scalar measurable for DDE 'IJT_adv_SOC_Inj3'. */
/begin MEASUREMENT IJT_adv_SOC_Inj3 "Displayable" FLOAT32_IEEE CU_IJT_ADV_SOC_INJ3 1 100 0.0 0.0 ECU_ADDRESS 0x4000331c BYTE_ORDER MSB_FIRST /end MEASUREMENT
/begin COMPU_METHOD CU_IJT_ADV_SOC_INJ3 "Conversion method for IJT_adv_SOC_Inj3" RAT_FUNC "%10.2" "adv" COEFFS 0.000000 1.000000 0.000000 0.000000 0.000000 1.000000 /end COMPU_METHOD
/* Scalar measurable for DDE 'IJT_adv_SOC_Inj4'. */
/begin MEASUREMENT IJT_adv_SOC_Inj4 "Displayable" FLOAT32_IEEE CU_IJT_ADV_SOC_INJ4 1 100 0.0 0.0 ECU_ADDRESS 0x40003318 BYTE_ORDER MSB_FIRST /end MEASUREMENT
/begin COMPU_METHOD CU_IJT_ADV_SOC_INJ4 "Conversion method for IJT_adv_SOC_Inj4" RAT_FUNC "%10.2" "adv" COEFFS 0.000000 1.000000 0.000000 0.000000 0.000000 1.000000 /end COMPU_METHOD
/* Scalar measurable for DDE 'IJT_b_Inj1_InjectionSent'. */
/begin MEASUREMENT IJT_b_Inj1_InjectionSent "Displayable" UBYTE CU_IJT_B_INJ1_INJECTIONSENT 1 100 0.0 1.0 ECU_ADDRESS 0x40002ea0 BYTE_ORDER MSB_FIRST /end MEASUREMENT
/begin COMPU_METHOD CU_IJT_B_INJ1_INJECTIONSENT "Conversion method for IJT_b_Inj1_InjectionSent" RAT_FUNC "%10.0" "b" COEFFS 0.000000 1.000000 0.000000 0.000000 0.000000 1.000000 /end COMPU_METHOD
/* Scalar measurable for DDE 'IJT_b_Inj2_InjectionSent'. */
/begin MEASUREMENT IJT_b_Inj2_InjectionSent "Displayable" UBYTE CU_IJT_B_INJ2_INJECTIONSENT 1 100 0.0 1.0 ECU_ADDRESS 0x40002e9f BYTE_ORDER MSB_FIRST /end MEASUREMENT
/begin COMPU_METHOD CU_IJT_B_INJ2_INJECTIONSENT "Conversion method for IJT_b_Inj2_InjectionSent" RAT_FUNC "%10.0" "b" COEFFS 0.000000 1.000000 0.000000 0.000000 0.000000 1.000000 /end COMPU_METHOD
/* Scalar measurable for DDE 'IJT_b_Inj3_InjectionSent'. */
/begin MEASUREMENT IJT_b_Inj3_InjectionSent "Displayable" UBYTE CU_IJT_B_INJ3_INJECTIONSENT 1 100 0.0 1.0 ECU_ADDRESS 0x40002e9e BYTE_ORDER MSB_FIRST /end MEASUREMENT
/begin COMPU_METHOD CU_IJT_B_INJ3_INJECTIONSENT "Conversion method for IJT_b_Inj3_InjectionSent" RAT_FUNC "%10.0" "b" COEFFS 0.000000 1.000000 0.000000 0.000000 0.000000 1.000000 /end COMPU_METHOD
/* Scalar measurable for DDE 'IJT_b_Inj4_InjectionSent'. */
/begin MEASUREMENT IJT_b_Inj4_InjectionSent "Displayable" UBYTE CU_IJT_B_INJ4_INJECTIONSENT 1 100 0.0 1.0 ECU_ADDRESS 0x40002e9d BYTE_ORDER MSB_FIRST /end MEASUREMENT
/begin COMPU_METHOD CU_IJT_B_INJ4_INJECTIONSENT "Conversion method for IJT_b_Inj4_InjectionSent" RAT_FUNC "%10.0" "b" COEFFS 0.000000 1.000000 0.000000 0.000000 0.000000 1.000000 /end COMPU_METHOD
/* Scalar measurable for DDE 'IJT_b_InjectorOverlap'. */
/begin MEASUREMENT IJT_b_InjectorOverlap "Displayable" UBYTE CU_IJT_B_INJECTOROVERLAP 1 100 0.0 1.0 ECU_ADDRESS 0x40002e98 BYTE_ORDER MSB_FIRST /end MEASUREMENT
/begin COMPU_METHOD CU_IJT_B_INJECTOROVERLAP "Conversion method for IJT_b_InjectorOverlap" RAT_FUNC "%10.0" "b" COEFFS 0.000000 1.000000 0.000000 0.000000 0.000000 1.000000 /end COMPU_METHOD
/* Scalar measurable for DDE 'IJT_b_PrimingPulseActiveCyl1'. */
/begin MEASUREMENT IJT_b_PrimingPulseActiveCyl1 "Displayable" UBYTE CU_IJT_B_PRIMINGPULSEACTIVECYL1 1 100 0.0 1.0 ECU_ADDRESS 0x40002e9c BYTE_ORDER MSB_FIRST /end MEASUREMENT
/begin COMPU_METHOD CU_IJT_B_PRIMINGPULSEACTIVECYL1 "Conversion method for IJT_b_PrimingPulseActiveCyl1" RAT_FUNC "%10.0" "b" COEFFS 0.000000 1.000000 0.000000 0.000000 0.000000 1.000000 /end COMPU_METHOD
/* Scalar measurable for DDE 'IJT_b_PrimingPulseActiveCyl2'. */
/begin MEASUREMENT IJT_b_PrimingPulseActiveCyl2 "Displayable" UBYTE CU_IJT_B_PRIMINGPULSEACTIVECYL2 1 100 0.0 1.0 ECU_ADDRESS 0x40002e9b BYTE_ORDER MSB_FIRST /end MEASUREMENT
/begin COMPU_METHOD CU_IJT_B_PRIMINGPULSEACTIVECYL2 "Conversion method for IJT_b_PrimingPulseActiveCyl2" RAT_FUNC "%10.0" "b" COEFFS 0.000000 1.000000 0.000000 0.000000 0.000000 1.000000 /end COMPU_METHOD
/* Scalar measurable for DDE 'IJT_b_PrimingPulseActiveCyl3'. */
/begin MEASUREMENT IJT_b_PrimingPulseActiveCyl3 "Displayable" UBYTE CU_IJT_B_PRIMINGPULSEACTIVECYL3 1 100 0.0 1.0 ECU_ADDRESS 0x40002e9a BYTE_ORDER MSB_FIRST /end MEASUREMENT
/begin COMPU_METHOD CU_IJT_B_PRIMINGPULSEACTIVECYL3 "Conversion method for IJT_b_PrimingPulseActiveCyl3" RAT_FUNC "%10.0" "b" COEFFS 0.000000 1.000000 0.000000 0.000000 0.000000 1.000000 /end COMPU_METHOD
/* Scalar measurable for DDE 'IJT_b_PrimingPulseActiveCyl4'. */
/begin MEASUREMENT IJT_b_PrimingPulseActiveCyl4 "Displayable" UBYTE CU_IJT_B_PRIMINGPULSEACTIVECYL4 1 100 0.0 1.0 ECU_ADDRESS 0x40002e99 BYTE_ORDER MSB_FIRST /end MEASUREMENT
/begin COMPU_METHOD CU_IJT_B_PRIMINGPULSEACTIVECYL4 "Conversion method for IJT_b_PrimingPulseActiveCyl4" RAT_FUNC "%10.0" "b" COEFFS 0.000000 1.000000 0.000000 0.000000 0.000000 1.000000 /end COMPU_METHOD
/* Scalar measurable for DDE 'IJT_bar_EffectivePress'. */
/begin MEASUREMENT IJT_bar_EffectivePress "Effective pressure (DeltaP) at injector" FLOAT32_IEEE CU_IJT_BAR_EFFECTIVEPRESS 1 100 0.0 200.0 ECU_ADDRESS 0x400032f4 BYTE_ORDER MSB_FIRST /end MEASUREMENT
/begin COMPU_METHOD CU_IJT_BAR_EFFECTIVEPRESS "Conversion method for IJT_bar_EffectivePress" RAT_FUNC "%10.2" "bar" COEFFS 0.000000 1.000000 0.000000 0.000000 0.000000 1.000000 /end COMPU_METHOD
/* Scalar measurable for DDE 'IJT_cnt_PrimingPulsesCyl1'. */
/begin MEASUREMENT IJT_cnt_PrimingPulsesCyl1 "Displayable" UBYTE CU_IJT_CNT_PRIMINGPULSESCYL1 1 100 0.0 0.0 ECU_ADDRESS 0x40002fdf BYTE_ORDER MSB_FIRST /end MEASUREMENT
/begin COMPU_METHOD CU_IJT_CNT_PRIMINGPULSESCYL1 "Conversion method for IJT_cnt_PrimingPulsesCyl1" RAT_FUNC "%10.0" "cnt" COEFFS 0.000000 1.000000 0.000000 0.000000 0.000000 1.000000 /end COMPU_METHOD
/* Scalar measurable for DDE 'IJT_cnt_PrimingPulsesCyl2'. */
/begin MEASUREMENT IJT_cnt_PrimingPulsesCyl2 "Displayable" UBYTE CU_IJT_CNT_PRIMINGPULSESCYL2 1 100 0.0 0.0 ECU_ADDRESS 0x40002fde BYTE_ORDER MSB_FIRST /end MEASUREMENT
/begin COMPU_METHOD CU_IJT_CNT_PRIMINGPULSESCYL2 "Conversion method for IJT_cnt_PrimingPulsesCyl2" RAT_FUNC "%10.0" "cnt" COEFFS 0.000000 1.000000 0.000000 0.000000 0.000000 1.000000 /end COMPU_METHOD
/* Scalar measurable for DDE 'IJT_cnt_PrimingPulsesCyl3'. */
/begin MEASUREMENT IJT_cnt_PrimingPulsesCyl3 "Displayable" UBYTE CU_IJT_CNT_PRIMINGPULSESCYL3 1 100 0.0 0.0 ECU_ADDRESS 0x40002fdd BYTE_ORDER MSB_FIRST /end MEASUREMENT
/begin COMPU_METHOD CU_IJT_CNT_PRIMINGPULSESCYL3 "Conversion method for IJT_cnt_PrimingPulsesCyl3" RAT_FUNC "%10.0" "cnt" COEFFS 0.000000 1.000000 0.000000 0.000000 0.000000 1.000000 /end COMPU_METHOD
/* Scalar measurable for DDE 'IJT_cnt_PrimingPulsesCyl4'. */
/begin MEASUREMENT IJT_cnt_PrimingPulsesCyl4 "Displayable" UBYTE CU_IJT_CNT_PRIMINGPULSESCYL4 1 100 0.0 0.0 ECU_ADDRESS 0x40002fdc BYTE_ORDER MSB_FIRST /end MEASUREMENT
/begin COMPU_METHOD CU_IJT_CNT_PRIMINGPULSESCYL4 "Conversion method for IJT_cnt_PrimingPulsesCyl4" RAT_FUNC "%10.0" "cnt" COEFFS 0.000000 1.000000 0.000000 0.000000 0.000000 1.000000 /end COMPU_METHOD
/* Scalar measurable for DDE 'IJT_deg_Inj1'. */
/begin MEASUREMENT IJT_deg_Inj1 "Displayable" FLOAT32_IEEE CU_IJT_DEG_INJ1 1 100 0.0 0.0 ECU_ADDRESS 0x400032e8 BYTE_ORDER MSB_FIRST /end MEASUREMENT
/begin COMPU_METHOD CU_IJT_DEG_INJ1 "Conversion method for IJT_deg_Inj1" RAT_FUNC "%10.2" "deg" COEFFS 0.000000 1.000000 0.000000 0.000000 0.000000 1.000000 /end COMPU_METHOD
/* Scalar measurable for DDE 'IJT_deg_Inj2'. */
/begin MEASUREMENT IJT_deg_Inj2 "Displayable" FLOAT32_IEEE CU_IJT_DEG_INJ2 1 100 0.0 0.0 ECU_ADDRESS 0x400032e4 BYTE_ORDER MSB_FIRST /end MEASUREMENT
/begin COMPU_METHOD CU_IJT_DEG_INJ2 "Conversion method for IJT_deg_Inj2" RAT_FUNC "%10.2" "deg" COEFFS 0.000000 1.000000 0.000000 0.000000 0.000000 1.000000 /end COMPU_METHOD
/* Scalar measurable for DDE 'IJT_deg_Inj3'. */
/begin MEASUREMENT IJT_deg_Inj3 "Displayable" FLOAT32_IEEE CU_IJT_DEG_INJ3 1 100 0.0 0.0 ECU_ADDRESS 0x400032e0 BYTE_ORDER MSB_FIRST /end MEASUREMENT
/begin COMPU_METHOD CU_IJT_DEG_INJ3 "Conversion method for IJT_deg_Inj3" RAT_FUNC "%10.2" "deg" COEFFS 0.000000 1.000000 0.000000 0.000000 0.000000 1.000000 /end COMPU_METHOD
/* Scalar measurable for DDE 'IJT_deg_Inj4'. */
/begin MEASUREMENT IJT_deg_Inj4 "Displayable" FLOAT32_IEEE CU_IJT_DEG_INJ4 1 100 0.0 0.0 ECU_ADDRESS 0x400032dc BYTE_ORDER MSB_FIRST /end MEASUREMENT
/begin COMPU_METHOD CU_IJT_DEG_INJ4 "Conversion method for IJT_deg_Inj4" RAT_FUNC "%10.2" "deg" COEFFS 0.000000 1.000000 0.000000 0.000000 0.000000 1.000000 /end COMPU_METHOD
/* Scalar measurable for DDE 'IJT_gps_InjectorFlowRatePFI'. */
/begin MEASUREMENT IJT_gps_InjectorFlowRatePFI "(not defined)" FLOAT32_IEEE CU_IJT_GPS_INJECTORFLOWRATEPFI 1 100 0.0 0.0 ECU_ADDRESS 0x400032f0 BYTE_ORDER MSB_FIRST /end MEASUREMENT
/begin COMPU_METHOD CU_IJT_GPS_INJECTORFLOWRATEPFI "Conversion method for IJT_gps_InjectorFlowRatePFI" RAT_FUNC "%10.4" "gps" COEFFS 0.000000 1.000000 0.000000 0.000000 0.000000 1.000000 /end COMPU_METHOD
/* Scalar measurable for DDE 'IJT_gps_TotalFuelFlow'. */
/begin MEASUREMENT IJT_gps_TotalFuelFlow "(g/s) Commanded engine-total fuel flow rate" FLOAT32_IEEE CU_IJT_GPS_TOTALFUELFLOW 1 100 0.0 0.0 ECU_ADDRESS 0x40003300 BYTE_ORDER MSB_FIRST /end MEASUREMENT
/begin COMPU_METHOD CU_IJT_GPS_TOTALFUELFLOW "Conversion method for IJT_gps_TotalFuelFlow" RAT_FUNC "%10.1" "gps" COEFFS 0.000000 1.000000 0.000000 0.000000 0.000000 1.000000 /end COMPU_METHOD
/* Scalar measurable for DDE 'IJT_mg_Inj1'. */
/begin MEASUREMENT IJT_mg_Inj1 "Displayable" FLOAT32_IEEE CU_IJT_MG_INJ1 1 100 0.0 0.0 ECU_ADDRESS 0x400032d8 BYTE_ORDER MSB_FIRST /end MEASUREMENT
/begin COMPU_METHOD CU_IJT_MG_INJ1 "Conversion method for IJT_mg_Inj1" RAT_FUNC "%10.2" "mg" COEFFS 0.000000 1.000000 0.000000 0.000000 0.000000 1.000000 /end COMPU_METHOD
/* Scalar measurable for DDE 'IJT_mg_Inj2'. */
/begin MEASUREMENT IJT_mg_Inj2 "Displayable" FLOAT32_IEEE CU_IJT_MG_INJ2 1 100 0.0 0.0 ECU_ADDRESS 0x400032d4 BYTE_ORDER MSB_FIRST /end MEASUREMENT
/begin COMPU_METHOD CU_IJT_MG_INJ2 "Conversion method for IJT_mg_Inj2" RAT_FUNC "%10.2" "mg" COEFFS 0.000000 1.000000 0.000000 0.000000 0.000000 1.000000 /end COMPU_METHOD
/* Scalar measurable for DDE 'IJT_mg_Inj3'. */
/begin MEASUREMENT IJT_mg_Inj3 "Displayable" FLOAT32_IEEE CU_IJT_MG_INJ3 1 100 0.0 0.0 ECU_ADDRESS 0x400032d0 BYTE_ORDER MSB_FIRST /end MEASUREMENT
/begin COMPU_METHOD CU_IJT_MG_INJ3 "Conversion method for IJT_mg_Inj3" RAT_FUNC "%10.2" "mg" COEFFS 0.000000 1.000000 0.000000 0.000000 0.000000 1.000000 /end COMPU_METHOD
/* Scalar measurable for DDE 'IJT_mg_Inj4'. */
/begin MEASUREMENT IJT_mg_Inj4 "Displayable" FLOAT32_IEEE CU_IJT_MG_INJ4 1 100 0.0 0.0 ECU_ADDRESS 0x400032cc BYTE_ORDER MSB_FIRST /end MEASUREMENT
/begin COMPU_METHOD CU_IJT_MG_INJ4 "Conversion method for IJT_mg_Inj4" RAT_FUNC "%10.2" "mg" COEFFS 0.000000 1.000000 0.000000 0.000000 0.000000 1.000000 /end COMPU_METHOD
/* Scalar measurable for DDE 'IJT_ms_Inj1'. */
/begin MEASUREMENT IJT_ms_Inj1 "Displayable" FLOAT32_IEEE CU_IJT_MS_INJ1 1 100 0.0 0.0 ECU_ADDRESS 0x40003220 BYTE_ORDER MSB_FIRST /end MEASUREMENT
/begin COMPU_METHOD CU_IJT_MS_INJ1 "Conversion method for IJT_ms_Inj1" RAT_FUNC "%10.3" "ms" COEFFS 0.000000 1.000000 0.000000 0.000000 0.000000 1.000000 /end COMPU_METHOD
/* Scalar measurable for DDE 'IJT_ms_Inj2'. */
/begin MEASUREMENT IJT_ms_Inj2 "Displayable" FLOAT32_IEEE CU_IJT_MS_INJ2 1 100 0.0 0.0 ECU_ADDRESS 0x40003224 BYTE_ORDER MSB_FIRST /end MEASUREMENT
/begin COMPU_METHOD CU_IJT_MS_INJ2 "Conversion method for IJT_ms_Inj2" RAT_FUNC "%10.3" "ms" COEFFS 0.000000 1.000000 0.000000 0.000000 0.000000 1.000000 /end COMPU_METHOD
/* Scalar measurable for DDE 'IJT_ms_Inj3'. */
/begin MEASUREMENT IJT_ms_Inj3 "Displayable" FLOAT32_IEEE CU_IJT_MS_INJ3 1 100 0.0 0.0 ECU_ADDRESS 0x4000322c BYTE_ORDER MSB_FIRST /end MEASUREMENT
/begin COMPU_METHOD CU_IJT_MS_INJ3 "Conversion method for IJT_ms_Inj3" RAT_FUNC "%10.3" "ms" COEFFS 0.000000 1.000000 0.000000 0.000000 0.000000 1.000000 /end COMPU_METHOD
/* Scalar measurable for DDE 'IJT_ms_Inj4'. */
/begin MEASUREMENT IJT_ms_Inj4 "Displayable" FLOAT32_IEEE CU_IJT_MS_INJ4 1 100 0.0 0.0 ECU_ADDRESS 0x40003228 BYTE_ORDER MSB_FIRST /end MEASUREMENT
/begin COMPU_METHOD CU_IJT_MS_INJ4 "Conversion method for IJT_ms_Inj4" RAT_FUNC "%10.3" "ms" COEFFS 0.000000 1.000000 0.000000 0.000000 0.000000 1.000000 /end COMPU_METHOD
/* Scalar measurable for DDE 'IJT_ms_OpeningDelay'. */
/begin MEASUREMENT IJT_ms_OpeningDelay "Calculated Opening delay" FLOAT32_IEEE CU_IJT_MS_OPENINGDELAY 1 100 0.0 2.0 ECU_ADDRESS 0x40003328 BYTE_ORDER MSB_FIRST /end MEASUREMENT
/begin COMPU_METHOD CU_IJT_MS_OPENINGDELAY "Conversion method for IJT_ms_OpeningDelay" RAT_FUNC "%10.3" "ms" COEFFS 0.000000 1.000000 0.000000 0.000000 0.000000 1.000000 /end COMPU_METHOD
/* Scalar measurable for DDE 'IJT_ms_OpeningDelayInj1'. */
/begin MEASUREMENT IJT_ms_OpeningDelayInj1 "Displayable" FLOAT32_IEEE CU_IJT_MS_OPENINGDELAYINJ1 1 100 0.0 0.0 ECU_ADDRESS 0x4000321c BYTE_ORDER MSB_FIRST /end MEASUREMENT
/begin COMPU_METHOD CU_IJT_MS_OPENINGDELAYINJ1 "Conversion method for IJT_ms_OpeningDelayInj1" RAT_FUNC "%10.3" "ms" COEFFS 0.000000 1.000000 0.000000 0.000000 0.000000 1.000000 /end COMPU_METHOD
/* Scalar measurable for DDE 'IJT_ms_OpeningDelayInj2'. */
/begin MEASUREMENT IJT_ms_OpeningDelayInj2 "Displayable" FLOAT32_IEEE CU_IJT_MS_OPENINGDELAYINJ2 1 100 0.0 0.0 ECU_ADDRESS 0x40003218 BYTE_ORDER MSB_FIRST /end MEASUREMENT
/begin COMPU_METHOD CU_IJT_MS_OPENINGDELAYINJ2 "Conversion method for IJT_ms_OpeningDelayInj2" RAT_FUNC "%10.3" "ms" COEFFS 0.000000 1.000000 0.000000 0.000000 0.000000 1.000000 /end COMPU_METHOD
/* Scalar measurable for DDE 'IJT_ms_OpeningDelayInj3'. */
/begin MEASUREMENT IJT_ms_OpeningDelayInj3 "Displayable" FLOAT32_IEEE CU_IJT_MS_OPENINGDELAYINJ3 1 100 0.0 0.0 ECU_ADDRESS 0x40003214 BYTE_ORDER MSB_FIRST /end MEASUREMENT
/begin COMPU_METHOD CU_IJT_MS_OPENINGDELAYINJ3 "Conversion method for IJT_ms_OpeningDelayInj3" RAT_FUNC "%10.3" "ms" COEFFS 0.000000 1.000000 0.000000 0.000000 0.000000 1.000000 /end COMPU_METHOD
/* Scalar measurable for DDE 'IJT_ms_OpeningDelayInj4'. */
/begin MEASUREMENT IJT_ms_OpeningDelayInj4 "Displayable" FLOAT32_IEEE CU_IJT_MS_OPENINGDELAYINJ4 1 100 0.0 0.0 ECU_ADDRESS 0x40003210 BYTE_ORDER MSB_FIRST /end MEASUREMENT
/begin COMPU_METHOD CU_IJT_MS_OPENINGDELAYINJ4 "Conversion method for IJT_ms_OpeningDelayInj4" RAT_FUNC "%10.3" "ms" COEFFS 0.000000 1.000000 0.000000 0.000000 0.000000 1.000000 /end COMPU_METHOD
/* Scalar measurable for DDE 'IJT_ms_OverlapThrsh'. */
/begin MEASUREMENT IJT_ms_OverlapThrsh "If injector flow time exceeds this value consider it overlap" FLOAT32_IEEE CU_IJT_MS_OVERLAPTHRSH 1 100 0.0 0.0 ECU_ADDRESS 0x400032ec BYTE_ORDER MSB_FIRST /end MEASUREMENT
/begin COMPU_METHOD CU_IJT_MS_OVERLAPTHRSH "Conversion method for IJT_ms_OverlapThrsh" RAT_FUNC "%10.1" "ms" COEFFS 0.000000 1.000000 0.000000 0.000000 0.000000 1.000000 /end COMPU_METHOD
/* Scalar measurable for DDE 'IJT_pct_FuelTempCF'. */
/begin MEASUREMENT IJT_pct_FuelTempCF "Injection quantity fuel rail temperature compensation factor" FLOAT32_IEEE CU_IJT_PCT_FUELTEMPCF 1 100 0.0 0.0 ECU_ADDRESS 0x400032f8 BYTE_ORDER MSB_FIRST /end MEASUREMENT
/begin COMPU_METHOD CU_IJT_PCT_FUELTEMPCF "Conversion method for IJT_pct_FuelTempCF" RAT_FUNC "%10.2" "pct" COEFFS 0.000000 1.000000 0.000000 0.000000 0.000000 1.000000 /end COMPU_METHOD
/* Scalar measurable for DDE 'IJT_s_Slack'. */
/begin MEASUREMENT IJT_s_Slack "Displayable" FLOAT32_IEEE CU_IJT_S_SLACK 1 100 0.0 0.0 ECU_ADDRESS 0x40003314 BYTE_ORDER MSB_FIRST /end MEASUREMENT
/begin COMPU_METHOD CU_IJT_S_SLACK "Conversion method for IJT_s_Slack" RAT_FUNC "%10.3" "s" COEFFS 0.000000 1.000000 0.000000 0.000000 0.000000 1.000000 /end COMPU_METHOD
/* Scalar measurable for DDE 'KNK_NU_EngSpdCorr'. */
/begin MEASUREMENT KNK_NU_EngSpdCorr "Map output displayable" FLOAT32_IEEE CU_KNK_NU_ENGSPDCORR 1 100 0.0 0.0 ECU_ADDRESS 0x4000349c BYTE_ORDER MSB_FIRST /end MEASUREMENT
/begin COMPU_METHOD CU_KNK_NU_ENGSPDCORR "Conversion method for KNK_NU_EngSpdCorr" RAT_FUNC "%10.2" "pct" COEFFS 0.000000 1.000000 0.000000 0.000000 0.000000 1.000000 /end COMPU_METHOD
/* Scalar measurable for DDE 'KNK_b_EnrichFuel'. */
/begin MEASUREMENT KNK_b_EnrichFuel "Displayable" UBYTE CU_KNK_B_ENRICHFUEL 1 100 0.0 1.0 ECU_ADDRESS 0x40002e73 BYTE_ORDER MSB_FIRST /end MEASUREMENT
/begin COMPU_METHOD CU_KNK_B_ENRICHFUEL "Conversion method for KNK_b_EnrichFuel" RAT_FUNC "%10.0" "b" COEFFS 0.000000 1.000000 0.000000 0.000000 0.000000 1.000000 /end COMPU_METHOD
/* Scalar measurable for DDE 'KNK_b_NewKnockEvent'. */
/begin MEASUREMENT KNK_b_NewKnockEvent "Displayable" UBYTE CU_KNK_B_NEWKNOCKEVENT 1 100 0.0 1.0 ECU_ADDRESS 0x40002ee2 BYTE_ORDER MSB_FIRST /end MEASUREMENT
/begin COMPU_METHOD CU_KNK_B_NEWKNOCKEVENT "Conversion method for KNK_b_NewKnockEvent" RAT_FUNC "%10.0" "b" COEFFS 0.000000 1.000000 0.000000 0.000000 0.000000 1.000000 /end COMPU_METHOD
/* Scalar measurable for DDE 'KNK_lam_AFR_Lim'. */
/begin MEASUREMENT KNK_lam_AFR_Lim "AFR limit" FLOAT32_IEEE CU_KNK_LAM_AFR_LIM 1 100 0.0 0.0 ECU_ADDRESS 0x400031f0 BYTE_ORDER MSB_FIRST /end MEASUREMENT
/begin COMPU_METHOD CU_KNK_LAM_AFR_LIM "Conversion method for KNK_lam_AFR_Lim" RAT_FUNC "%10.2" "lam" COEFFS 0.000000 1.000000 0.000000 0.000000 0.000000 1.000000 /end COMPU_METHOD
/* Scalar measurable for DDE 'KNK_ret_SensorBased'. */
/begin MEASUREMENT KNK_ret_SensorBased "Output from sensor-based retard logic" FLOAT32_IEEE CU_KNK_RET_SENSORBASED 1 100 0.0 0.0 ECU_ADDRESS 0x400031ac BYTE_ORDER MSB_FIRST /end MEASUREMENT
/begin COMPU_METHOD CU_KNK_RET_SENSORBASED "Conversion method for KNK_ret_SensorBased" RAT_FUNC "%10.1" "ret" COEFFS 0.000000 1.000000 0.000000 0.000000 0.000000 1.000000 /end COMPU_METHOD
/* Scalar measurable for DDE 'KNK_ret_SparkMod'. */
/begin MEASUREMENT KNK_ret_SparkMod "Final knock spark modifier" FLOAT32_IEEE CU_KNK_RET_SPARKMOD 1 100 0.0 0.0 ECU_ADDRESS 0x40003494 BYTE_ORDER MSB_FIRST /end MEASUREMENT
/begin COMPU_METHOD CU_KNK_RET_SPARKMOD "Conversion method for KNK_ret_SparkMod" RAT_FUNC "%10.2" "ret" COEFFS 0.000000 1.000000 0.000000 0.000000 0.000000 1.000000 /end COMPU_METHOD
/* Scalar measurable for DDE 'KNK_ret_TempBased'. */
/begin MEASUREMENT KNK_ret_TempBased "Open-loop retard command" FLOAT32_IEEE CU_KNK_RET_TEMPBASED 1 100 0.0 0.0 ECU_ADDRESS 0x40003498 BYTE_ORDER MSB_FIRST /end MEASUREMENT
/begin COMPU_METHOD CU_KNK_RET_TEMPBASED "Conversion method for KNK_ret_TempBased" RAT_FUNC "%10.1" "ret" COEFFS 0.000000 1.000000 0.000000 0.000000 0.000000 1.000000 /end COMPU_METHOD
/* Scalar measurable for DDE 'OUT_C_FAN_ZF'. */
/begin MEASUREMENT OUT_C_FAN_ZF "Displayable" FLOAT32_IEEE CU_OUT_C_FAN_ZF 1 100 0.0 0.0 ECU_ADDRESS 0x40003578 BYTE_ORDER MSB_FIRST /end MEASUREMENT
/begin COMPU_METHOD CU_OUT_C_FAN_ZF "Conversion method for OUT_C_FAN_ZF" RAT_FUNC "%10.3" "NU" COEFFS 0.000000 1.000000 0.000000 0.000000 0.000000 1.000000 /end COMPU_METHOD
/* Scalar measurable for DDE 'OUT_b_18F00000_ena'. */
/begin MEASUREMENT OUT_b_18F00000_ena "Value of enable ERC1 msg @ 250ms" UBYTE CU_OUT_B_18F00000_ENA 1 100 0.0 1.0 ECU_ADDRESS 0x40002e85 BYTE_ORDER MSB_FIRST /end MEASUREMENT
/begin COMPU_METHOD CU_OUT_B_18F00000_ENA "Conversion method for OUT_b_18F00000_ena" RAT_FUNC "%10.0" "NU" COEFFS 0.000000 1.000000 0.000000 0.000000 0.000000 1.000000 /end COMPU_METHOD
/* Scalar measurable for DDE 'OUT_b_18F0010B_ena'. */
/begin MEASUREMENT OUT_b_18F0010B_ena "Value of enable EBC1 msg" UBYTE CU_OUT_B_18F0010B_ENA 1 100 0.0 1.0 ECU_ADDRESS 0x40002e8b BYTE_ORDER MSB_FIRST /end MEASUREMENT
/begin COMPU_METHOD CU_OUT_B_18F0010B_ENA "Conversion method for OUT_b_18F0010B_ena" RAT_FUNC "%10.0" "NU" COEFFS 0.000000 1.000000 0.000000 0.000000 0.000000 1.000000 /end COMPU_METHOD
/* Scalar measurable for DDE 'OUT_b_18FDC40B_ena'. */
/begin MEASUREMENT OUT_b_18FDC40B_ena "Value of enable EBC5 msg @ 100ms" UBYTE CU_OUT_B_18FDC40B_ENA 1 100 0.0 1.0 ECU_ADDRESS 0x40002e8a BYTE_ORDER MSB_FIRST /end MEASUREMENT
/begin COMPU_METHOD CU_OUT_B_18FDC40B_ENA "Conversion method for OUT_b_18FDC40B_ena" RAT_FUNC "%10.0" "NU" COEFFS 0.000000 1.000000 0.000000 0.000000 0.000000 1.000000 /end COMPU_METHOD
/* Scalar measurable for DDE 'OUT_b_18FE6E00_ena'. */
/begin MEASUREMENT OUT_b_18FE6E00_ena "Value of enable HRW msg @ 20ms" UBYTE CU_OUT_B_18FE6E00_ENA 1 100 0.0 1.0 ECU_ADDRESS 0x40002e88 BYTE_ORDER MSB_FIRST /end MEASUREMENT
/begin COMPU_METHOD CU_OUT_B_18FE6E00_ENA "Conversion method for OUT_b_18FE6E00_ena" RAT_FUNC "%10.0" "NU" COEFFS 0.000000 1.000000 0.000000 0.000000 0.000000 1.000000 /end COMPU_METHOD
/* Scalar measurable for DDE 'OUT_b_18FEE100_ena'. */
/begin MEASUREMENT OUT_b_18FEE100_ena "Value of enable FEE1 msg @ 250ms" UBYTE CU_OUT_B_18FEE100_ENA 1 100 0.0 1.0 ECU_ADDRESS 0x40002e84 BYTE_ORDER MSB_FIRST /end MEASUREMENT
/begin COMPU_METHOD CU_OUT_B_18FEE100_ENA "Conversion method for OUT_b_18FEE100_ena" RAT_FUNC "%10.0" "NU" COEFFS 0.000000 1.000000 0.000000 0.000000 0.000000 1.000000 /end COMPU_METHOD
/* Scalar measurable for DDE 'OUT_b_18FEE600_ena'. */
/begin MEASUREMENT OUT_b_18FEE600_ena "Value of enable FEE6 msg @ 1000ms" UBYTE CU_OUT_B_18FEE600_ENA 1 100 0.0 1.0 ECU_ADDRESS 0x40002e86 BYTE_ORDER MSB_FIRST /end MEASUREMENT
/begin COMPU_METHOD CU_OUT_B_18FEE600_ENA "Conversion method for OUT_b_18FEE600_ena" RAT_FUNC "%10.0" "NU" COEFFS 0.000000 1.000000 0.000000 0.000000 0.000000 1.000000 /end COMPU_METHOD
/* Scalar measurable for DDE 'OUT_b_18FEEE00_ena'. */
/begin MEASUREMENT OUT_b_18FEEE00_ena "Value of enable FEEE msg @ 1000ms" UBYTE CU_OUT_B_18FEEE00_ENA 1 100 0.0 1.0 ECU_ADDRESS 0x40002e89 BYTE_ORDER MSB_FIRST /end MEASUREMENT
/begin COMPU_METHOD CU_OUT_B_18FEEE00_ENA "Conversion method for OUT_b_18FEEE00_ena" RAT_FUNC "%10.0" "NU" COEFFS 0.000000 1.000000 0.000000 0.000000 0.000000 1.000000 /end COMPU_METHOD
/* Scalar measurable for DDE 'OUT_b_TCO_ena'. */
/begin MEASUREMENT OUT_b_TCO_ena "Value of enable TCO" UBYTE CU_OUT_B_TCO_ENA 1 100 0.0 1.0 ECU_ADDRESS 0x40002e87 BYTE_ORDER MSB_FIRST /end MEASUREMENT
/begin COMPU_METHOD CU_OUT_B_TCO_ENA "Conversion method for OUT_b_TCO_ena" RAT_FUNC "%10.0" "NU" COEFFS 0.000000 1.000000 0.000000 0.000000 0.000000 1.000000 /end COMPU_METHOD
/* Scalar measurable for DDE 'OUT_b_VentiladorZF'. */
/begin MEASUREMENT OUT_b_VentiladorZF "ZF Fan" UBYTE CU_OUT_B_VENTILADORZF 1 100 0.0 1.0 ECU_ADDRESS 0x40002ed3 BYTE_ORDER MSB_FIRST /end MEASUREMENT
/begin COMPU_METHOD CU_OUT_B_VENTILADORZF "Conversion method for OUT_b_VentiladorZF" RAT_FUNC "%10.0" "b" COEFFS 0.000000 1.000000 0.000000 0.000000 0.000000 1.000000 /end COMPU_METHOD
/* Scalar measurable for DDE 'PID_NU_DTerm'. */
/begin MEASUREMENT PID_NU_DTerm "Displayable" FLOAT32_IEEE CU_PID_NU_DTERM 1 100 0.0 0.0 ECU_ADDRESS 0x40003184 BYTE_ORDER MSB_FIRST /end MEASUREMENT
/begin COMPU_METHOD CU_PID_NU_DTERM "Conversion method for PID_NU_DTerm" RAT_FUNC "%10.3" "NU" COEFFS 0.000000 1.000000 0.000000 0.000000 0.000000 1.000000 /end COMPU_METHOD
/* Scalar measurable for DDE 'PID_NU_ITerm'. */
/begin MEASUREMENT PID_NU_ITerm "Displayable" FLOAT32_IEEE CU_PID_NU_ITERM 1 100 0.0 0.0 ECU_ADDRESS 0x4000318c BYTE_ORDER MSB_FIRST /end MEASUREMENT
/begin COMPU_METHOD CU_PID_NU_ITERM "Conversion method for PID_NU_ITerm" RAT_FUNC "%10.3" "NU" COEFFS 0.000000 1.000000 0.000000 0.000000 0.000000 1.000000 /end COMPU_METHOD
/* Scalar measurable for DDE 'PID_NU_PTerm'. */
/begin MEASUREMENT PID_NU_PTerm "Displayable" FLOAT32_IEEE CU_PID_NU_PTERM 1 100 0.0 0.0 ECU_ADDRESS 0x40003190 BYTE_ORDER MSB_FIRST /end MEASUREMENT
/begin COMPU_METHOD CU_PID_NU_PTERM "Conversion method for PID_NU_PTerm" RAT_FUNC "%10.3" "NU" COEFFS 0.000000 1.000000 0.000000 0.000000 0.000000 1.000000 /end COMPU_METHOD
/* Scalar measurable for DDE 'RFC_b_Active'. */
/begin MEASUREMENT RFC_b_Active "State displayable" UBYTE CU_RFC_B_ACTIVE 1 100 0.0 1.0 ECU_ADDRESS 0x40002e74 BYTE_ORDER MSB_FIRST /end MEASUREMENT
/begin COMPU_METHOD CU_RFC_B_ACTIVE "Conversion method for RFC_b_Active" RAT_FUNC "%10.0" "b" COEFFS 0.000000 1.000000 0.000000 0.000000 0.000000 1.000000 /end COMPU_METHOD
/* Scalar measurable for DDE 'RFC_mg_FuelRqstDelta'. */
/begin MEASUREMENT RFC_mg_FuelRqstDelta "Fuelmass change vs previous injection" FLOAT32_IEEE CU_RFC_MG_FUELRQSTDELTA 1 100 0.0 0.0 ECU_ADDRESS 0x40003030 BYTE_ORDER MSB_FIRST /end MEASUREMENT
/begin COMPU_METHOD CU_RFC_MG_FUELRQSTDELTA "Conversion method for RFC_mg_FuelRqstDelta" RAT_FUNC "%10.2" "mg" COEFFS 0.000000 1.000000 0.000000 0.000000 0.000000 1.000000 /end COMPU_METHOD
/* Scalar measurable for DDE 'RFC_pct_PfInvCyl1'. */
/begin MEASUREMENT RFC_pct_PfInvCyl1 "Fuel compensation factor" FLOAT32_IEEE CU_RFC_PCT_PFINVCYL1 1 100 0.0 0.0 ECU_ADDRESS 0x400031c8 BYTE_ORDER MSB_FIRST /end MEASUREMENT
/begin COMPU_METHOD CU_RFC_PCT_PFINVCYL1 "Conversion method for RFC_pct_PfInvCyl1" RAT_FUNC "%10.2" "pct" COEFFS 0.000000 1.000000 0.000000 0.000000 0.000000 1.000000 /end COMPU_METHOD
/* Scalar measurable for DDE 'RFC_pct_PfInvCyl2'. */
/begin MEASUREMENT RFC_pct_PfInvCyl2 "Fuel compensation factor" FLOAT32_IEEE CU_RFC_PCT_PFINVCYL2 1 100 0.0 0.0 ECU_ADDRESS 0x400031c4 BYTE_ORDER MSB_FIRST /end MEASUREMENT
/begin COMPU_METHOD CU_RFC_PCT_PFINVCYL2 "Conversion method for RFC_pct_PfInvCyl2" RAT_FUNC "%10.2" "pct" COEFFS 0.000000 1.000000 0.000000 0.000000 0.000000 1.000000 /end COMPU_METHOD
/* Scalar measurable for DDE 'RFC_pct_PfInvCyl3'. */
/begin MEASUREMENT RFC_pct_PfInvCyl3 "Fuel compensation factor" FLOAT32_IEEE CU_RFC_PCT_PFINVCYL3 1 100 0.0 0.0 ECU_ADDRESS 0x400031c0 BYTE_ORDER MSB_FIRST /end MEASUREMENT
/begin COMPU_METHOD CU_RFC_PCT_PFINVCYL3 "Conversion method for RFC_pct_PfInvCyl3" RAT_FUNC "%10.2" "pct" COEFFS 0.000000 1.000000 0.000000 0.000000 0.000000 1.000000 /end COMPU_METHOD
/* Scalar measurable for DDE 'RFC_pct_PfInvCyl4'. */
/begin MEASUREMENT RFC_pct_PfInvCyl4 "Fuel compensation factor" FLOAT32_IEEE CU_RFC_PCT_PFINVCYL4 1 100 0.0 0.0 ECU_ADDRESS 0x400031bc BYTE_ORDER MSB_FIRST /end MEASUREMENT
/begin COMPU_METHOD CU_RFC_PCT_PFINVCYL4 "Conversion method for RFC_pct_PfInvCyl4" RAT_FUNC "%10.2" "pct" COEFFS 0.000000 1.000000 0.000000 0.000000 0.000000 1.000000 /end COMPU_METHOD
/* Scalar measurable for DDE 'RFC_pct_RelativePfInv'. */
/begin MEASUREMENT RFC_pct_RelativePfInv "PfInv (relative gain) max from all cyls" FLOAT32_IEEE CU_RFC_PCT_RELATIVEPFINV 1 100 0.0 0.0 ECU_ADDRESS 0x40003034 BYTE_ORDER MSB_FIRST /end MEASUREMENT
/begin COMPU_METHOD CU_RFC_PCT_RELATIVEPFINV "Conversion method for RFC_pct_RelativePfInv" RAT_FUNC "%10.2" "pct" COEFFS 0.000000 1.000000 0.000000 0.000000 0.000000 1.000000 /end COMPU_METHOD
/* Scalar measurable for DDE 'RFC_pct_WallWetFraction'. */
/begin MEASUREMENT RFC_pct_WallWetFraction "Map output displayable" FLOAT32_IEEE CU_RFC_PCT_WALLWETFRACTION 1 100 0.0 0.0 ECU_ADDRESS 0x400031b8 BYTE_ORDER MSB_FIRST /end MEASUREMENT
/begin COMPU_METHOD CU_RFC_PCT_WALLWETFRACTION "Conversion method for RFC_pct_WallWetFraction" RAT_FUNC "%10.2" "pct" COEFFS 0.000000 1.000000 0.000000 0.000000 0.000000 1.000000 /end COMPU_METHOD
/* Scalar measurable for DDE 'RFC_s_DbncTimer'. */
/begin MEASUREMENT RFC_s_DbncTimer "Displayable" FLOAT32_IEEE CU_RFC_S_DBNCTIMER 1 100 0.0 0.0 ECU_ADDRESS 0x400031b0 BYTE_ORDER MSB_FIRST /end MEASUREMENT
/begin COMPU_METHOD CU_RFC_S_DBNCTIMER "Conversion method for RFC_s_DbncTimer" RAT_FUNC "%10.2" "s" COEFFS 0.000000 1.000000 0.000000 0.000000 0.000000 1.000000 /end COMPU_METHOD
/* Scalar measurable for DDE 'RFC_s_ExpTimer'. */
/begin MEASUREMENT RFC_s_ExpTimer "Displayable" FLOAT32_IEEE CU_RFC_S_EXPTIMER 1 100 0.0 0.0 ECU_ADDRESS 0x400031b4 BYTE_ORDER MSB_FIRST /end MEASUREMENT
/begin COMPU_METHOD CU_RFC_S_EXPTIMER "Conversion method for RFC_s_ExpTimer" RAT_FUNC "%10.2" "s" COEFFS 0.000000 1.000000 0.000000 0.000000 0.000000 1.000000 /end COMPU_METHOD
/* Scalar measurable for DDE 'RFC_s_PuddleVapTime'. */
/begin MEASUREMENT RFC_s_PuddleVapTime "Map output displayable" FLOAT32_IEEE CU_RFC_S_PUDDLEVAPTIME 1 100 0.0 0.0 ECU_ADDRESS 0x400031cc BYTE_ORDER MSB_FIRST /end MEASUREMENT
/begin COMPU_METHOD CU_RFC_S_PUDDLEVAPTIME "Conversion method for RFC_s_PuddleVapTime" RAT_FUNC "%10.2" "s" COEFFS 0.000000 1.000000 0.000000 0.000000 0.000000 1.000000 /end COMPU_METHOD
/* Scalar measurable for DDE 'SAR_adv_SparkAng'. */
/begin MEASUREMENT SAR_adv_SparkAng "Arbitrated spark advance angle" FLOAT32_IEEE CU_SAR_ADV_SPARKANG 1 100 -40.0 40.0 ECU_ADDRESS 0x40003448 BYTE_ORDER MSB_FIRST /end MEASUREMENT
/begin COMPU_METHOD CU_SAR_ADV_SPARKANG "Conversion method for SAR_adv_SparkAng" RAT_FUNC "%10.1" "adv" COEFFS 0.000000 1.000000 0.000000 0.000000 0.000000 1.000000 /end COMPU_METHOD
/* Scalar measurable for DDE 'SAR_ret_ArbitratedRetardRqst'. */
/begin MEASUREMENT SAR_ret_ArbitratedRetardRqst "Result of all retard modifers" FLOAT32_IEEE CU_SAR_RET_ARBITRATEDRETARDRQST 1 100 0.0 0.0 ECU_ADDRESS 0x4000344c BYTE_ORDER MSB_FIRST /end MEASUREMENT
/begin COMPU_METHOD CU_SAR_RET_ARBITRATEDRETARDRQST "Conversion method for SAR_ret_ArbitratedRetardRqst" RAT_FUNC "%10.1" "ret" COEFFS 0.000000 1.000000 0.000000 0.000000 0.000000 1.000000 /end COMPU_METHOD
/* Scalar measurable for DDE 'SPT_adv_CoilOffAng'. */
/begin MEASUREMENT SPT_adv_CoilOffAng "Spark coil off angle" FLOAT32_IEEE CU_SPT_ADV_COILOFFANG 1 100 -40.0 40.0 ECU_ADDRESS 0x40003208 BYTE_ORDER MSB_FIRST /end MEASUREMENT
/begin COMPU_METHOD CU_SPT_ADV_COILOFFANG "Conversion method for SPT_adv_CoilOffAng" RAT_FUNC "%10.1" "adv" COEFFS 0.000000 1.000000 0.000000 0.000000 0.000000 1.000000 /end COMPU_METHOD
/* Scalar measurable for DDE 'SPT_adv_CoilOnAng'. */
/begin MEASUREMENT SPT_adv_CoilOnAng "Spark coil on angle" FLOAT32_IEEE CU_SPT_ADV_COILONANG 1 100 -40.0 360.0 ECU_ADDRESS 0x4000320c BYTE_ORDER MSB_FIRST /end MEASUREMENT
/begin COMPU_METHOD CU_SPT_ADV_COILONANG "Conversion method for SPT_adv_CoilOnAng" RAT_FUNC "%10.1" "adv" COEFFS 0.000000 1.000000 0.000000 0.000000 0.000000 1.000000 /end COMPU_METHOD
/* Scalar measurable for DDE 'SPT_deg_DwellTime'. */
/begin MEASUREMENT SPT_deg_DwellTime "Dwell time in degrees of crank rotation" FLOAT32_IEEE CU_SPT_DEG_DWELLTIME 1 100 0.0 360.0 ECU_ADDRESS 0x4000329c BYTE_ORDER MSB_FIRST /end MEASUREMENT
/begin COMPU_METHOD CU_SPT_DEG_DWELLTIME "Conversion method for SPT_deg_DwellTime" RAT_FUNC "%10.2" "deg" COEFFS 0.000000 1.000000 0.000000 0.000000 0.000000 1.000000 /end COMPU_METHOD
/* Scalar measurable for DDE 'SPT_ms_DwellTime'. */
/begin MEASUREMENT SPT_ms_DwellTime "Final dwell time value" FLOAT32_IEEE CU_SPT_MS_DWELLTIME 1 100 0.0 20.0 ECU_ADDRESS 0x400032a0 BYTE_ORDER MSB_FIRST /end MEASUREMENT
/begin COMPU_METHOD CU_SPT_MS_DWELLTIME "Conversion method for SPT_ms_DwellTime" RAT_FUNC "%10.2" "ms" COEFFS 0.000000 1.000000 0.000000 0.000000 0.000000 1.000000 /end COMPU_METHOD
/* Scalar measurable for DDE 'SPT_ms_DwellTimeRaw'. */
/begin MEASUREMENT SPT_ms_DwellTimeRaw "Raw spark dwell time" FLOAT32_IEEE CU_SPT_MS_DWELLTIMERAW 1 100 0.0 10.0 ECU_ADDRESS 0x400032a8 BYTE_ORDER MSB_FIRST /end MEASUREMENT
/begin COMPU_METHOD CU_SPT_MS_DWELLTIMERAW "Conversion method for SPT_ms_DwellTimeRaw" RAT_FUNC "%10.2" "ms" COEFFS 0.000000 1.000000 0.000000 0.000000 0.000000 1.000000 /end COMPU_METHOD
/* Scalar measurable for DDE 'SPT_ms_MaxDwellTime'. */
/begin MEASUREMENT SPT_ms_MaxDwellTime "Calculated dwell limit based on current engine speed" FLOAT32_IEEE CU_SPT_MS_MAXDWELLTIME 1 100 0.0 0.0 ECU_ADDRESS 0x400032a4 BYTE_ORDER MSB_FIRST /end MEASUREMENT
/begin COMPU_METHOD CU_SPT_MS_MAXDWELLTIME "Conversion method for SPT_ms_MaxDwellTime" RAT_FUNC "%10.3" "ms" COEFFS 0.000000 1.000000 0.000000 0.000000 0.000000 1.000000 /end COMPU_METHOD
/* Scalar measurable for DDE 'SYS_cnt_LoopCounter'. */
/begin MEASUREMENT SYS_cnt_LoopCounter "Counter increments every loop.  Multiply by loop period to get actual time" ULONG CU_SYS_CNT_LOOPCOUNTER 1 100 0.0 4294967295.0 ECU_ADDRESS 0x40003078 BYTE_ORDER MSB_FIRST /end MEASUREMENT
/begin COMPU_METHOD CU_SYS_CNT_LOOPCOUNTER "Conversion method for SYS_cnt_LoopCounter" RAT_FUNC "%10.0" "cnt" COEFFS 0.000000 1.000000 0.000000 0.000000 0.000000 1.000000 /end COMPU_METHOD
/* Scalar measurable for DDE 'TAR_Nm_EEC1Tq'. */
/begin MEASUREMENT TAR_Nm_EEC1Tq "(not defined)" FLOAT32_IEEE CU_TAR_NM_EEC1TQ 1 100 0.0 0.0 ECU_ADDRESS 0x400032b0 BYTE_ORDER MSB_FIRST /end MEASUREMENT
/begin COMPU_METHOD CU_TAR_NM_EEC1TQ "Conversion method for TAR_Nm_EEC1Tq" RAT_FUNC "%10.0" "Nm" COEFFS 0.000000 1.000000 0.000000 0.000000 0.000000 1.000000 /end COMPU_METHOD
/* Scalar measurable for DDE 'TAR_Nm_EEC1Tqt'. */
/begin MEASUREMENT TAR_Nm_EEC1Tqt "(not defined)" FLOAT32_IEEE CU_TAR_NM_EEC1TQT 1 100 0.0 0.0 ECU_ADDRESS 0x400032ac BYTE_ORDER MSB_FIRST /end MEASUREMENT
/begin COMPU_METHOD CU_TAR_NM_EEC1TQT "Conversion method for TAR_Nm_EEC1Tqt" RAT_FUNC "%10.0" "Nm" COEFFS 0.000000 1.000000 0.000000 0.000000 0.000000 1.000000 /end COMPU_METHOD
/* Scalar measurable for DDE 'TAR_Nm_EngDmnd'. */
/begin MEASUREMENT TAR_Nm_EngDmnd "(not defined)" FLOAT32_IEEE CU_TAR_NM_ENGDMND 1 100 0.0 0.0 ECU_ADDRESS 0x4000355c BYTE_ORDER MSB_FIRST /end MEASUREMENT
/begin COMPU_METHOD CU_TAR_NM_ENGDMND "Conversion method for TAR_Nm_EngDmnd" RAT_FUNC "%10.0" "Nm" COEFFS 0.000000 1.000000 0.000000 0.000000 0.000000 1.000000 /end COMPU_METHOD
/* Scalar measurable for DDE 'TAR_Nm_MaxTqTable'. */
/begin MEASUREMENT TAR_Nm_MaxTqTable "Maximum feasible torque at current RPM" FLOAT32_IEEE CU_TAR_NM_MAXTQTABLE 1 100 0.0 0.0 ECU_ADDRESS 0x40003600 BYTE_ORDER MSB_FIRST /end MEASUREMENT
/begin COMPU_METHOD CU_TAR_NM_MAXTQTABLE "Conversion method for TAR_Nm_MaxTqTable" RAT_FUNC "%10.1" "Nm" COEFFS 0.000000 1.000000 0.000000 0.000000 0.000000 1.000000 /end COMPU_METHOD
/* Scalar measurable for DDE 'TAR_Nm_RawArbTqRqst'. */
/begin MEASUREMENT TAR_Nm_RawArbTqRqst "Raw arbitrated torque request" FLOAT32_IEEE CU_TAR_NM_RAWARBTQRQST 1 100 0.0 0.0 ECU_ADDRESS 0x40003570 BYTE_ORDER MSB_FIRST /end MEASUREMENT
/begin COMPU_METHOD CU_TAR_NM_RAWARBTQRQST "Conversion method for TAR_Nm_RawArbTqRqst" RAT_FUNC "%10.1" "Nm" COEFFS 0.000000 1.000000 0.000000 0.000000 0.000000 1.000000 /end COMPU_METHOD
/* Scalar measurable for DDE 'TAR_Nm_TqFromAir'. */
/begin MEASUREMENT TAR_Nm_TqFromAir "(not defined)" FLOAT32_IEEE CU_TAR_NM_TQFROMAIR 1 100 0.0 0.0 ECU_ADDRESS 0x400032bc BYTE_ORDER MSB_FIRST /end MEASUREMENT
/begin COMPU_METHOD CU_TAR_NM_TQFROMAIR "Conversion method for TAR_Nm_TqFromAir" RAT_FUNC "%10.0" "Nm" COEFFS 0.000000 1.000000 0.000000 0.000000 0.000000 1.000000 /end COMPU_METHOD
/* Scalar measurable for DDE 'TAR_Nm_TqFromMAP'. */
/begin MEASUREMENT TAR_Nm_TqFromMAP "(not defined)" FLOAT32_IEEE CU_TAR_NM_TQFROMMAP 1 100 0.0 0.0 ECU_ADDRESS 0x400032c0 BYTE_ORDER MSB_FIRST /end MEASUREMENT
/begin COMPU_METHOD CU_TAR_NM_TQFROMMAP "Conversion method for TAR_Nm_TqFromMAP" RAT_FUNC "%10.0" "Nm" COEFFS 0.000000 1.000000 0.000000 0.000000 0.000000 1.000000 /end COMPU_METHOD
/* Scalar measurable for DDE 'TAR_Nm_TqFromMAP_Idle'. */
/begin MEASUREMENT TAR_Nm_TqFromMAP_Idle "(not defined)" FLOAT32_IEEE CU_TAR_NM_TQFROMMAP_IDLE 1 100 0.0 0.0 ECU_ADDRESS 0x400032c4 BYTE_ORDER MSB_FIRST /end MEASUREMENT
/begin COMPU_METHOD CU_TAR_NM_TQFROMMAP_IDLE "Conversion method for TAR_Nm_TqFromMAP_Idle" RAT_FUNC "%10.0" "Nm" COEFFS 0.000000 1.000000 0.000000 0.000000 0.000000 1.000000 /end COMPU_METHOD
/* Scalar measurable for DDE 'TAR_Nm_TqRqst'. */
/begin MEASUREMENT TAR_Nm_TqRqst "Arbitrated torque request" FLOAT32_IEEE CU_TAR_NM_TQRQST 1 100 0.0 0.0 ECU_ADDRESS 0x40003550 BYTE_ORDER MSB_FIRST /end MEASUREMENT
/begin COMPU_METHOD CU_TAR_NM_TQRQST "Conversion method for TAR_Nm_TqRqst" RAT_FUNC "%10.2" "Nm" COEFFS 0.000000 1.000000 0.000000 0.000000 0.000000 1.000000 /end COMPU_METHOD
/* Scalar measurable for DDE 'TAR_Nm_TqiFromMAP_Idle'. */
/begin MEASUREMENT TAR_Nm_TqiFromMAP_Idle "(not defined)" FLOAT32_IEEE CU_TAR_NM_TQIFROMMAP_IDLE 1 100 0.0 0.0 ECU_ADDRESS 0x400032b8 BYTE_ORDER MSB_FIRST /end MEASUREMENT
/begin COMPU_METHOD CU_TAR_NM_TQIFROMMAP_IDLE "Conversion method for TAR_Nm_TqiFromMAP_Idle" RAT_FUNC "%10.0" "Nm" COEFFS 0.000000 1.000000 0.000000 0.000000 0.000000 1.000000 /end COMPU_METHOD
/* Scalar measurable for DDE 'TAR_Nm_TqiFromModel'. */
/begin MEASUREMENT TAR_Nm_TqiFromModel "(not defined)" FLOAT32_IEEE CU_TAR_NM_TQIFROMMODEL 1 100 0.0 0.0 ECU_ADDRESS 0x400032b4 BYTE_ORDER MSB_FIRST /end MEASUREMENT
/begin COMPU_METHOD CU_TAR_NM_TQIFROMMODEL "Conversion method for TAR_Nm_TqiFromModel" RAT_FUNC "%10.0" "Nm" COEFFS 0.000000 1.000000 0.000000 0.000000 0.000000 1.000000 /end COMPU_METHOD
/* Scalar measurable for DDE 'TAR_b_DTC_TqLimit'. */
/begin MEASUREMENT TAR_b_DTC_TqLimit "Displayable" UBYTE CU_TAR_B_DTC_TQLIMIT 1 100 0.0 1.0 ECU_ADDRESS 0x40002ed1 BYTE_ORDER MSB_FIRST /end MEASUREMENT
/begin COMPU_METHOD CU_TAR_B_DTC_TQLIMIT "Conversion method for TAR_b_DTC_TqLimit" RAT_FUNC "%10.0" "b" COEFFS 0.000000 1.000000 0.000000 0.000000 0.000000 1.000000 /end COMPU_METHOD
/* Scalar measurable for DDE 'TAR_b_LimpHome'. */
/begin MEASUREMENT TAR_b_LimpHome "Displayable" UBYTE CU_TAR_B_LIMPHOME 1 100 0.0 1.0 ECU_ADDRESS 0x40002ee1 BYTE_ORDER MSB_FIRST /end MEASUREMENT
/begin COMPU_METHOD CU_TAR_B_LIMPHOME "Conversion method for TAR_b_LimpHome" RAT_FUNC "%10.0" "b" COEFFS 0.000000 1.000000 0.000000 0.000000 0.000000 1.000000 /end COMPU_METHOD
/* Scalar measurable for DDE 'TAR_b_TqFromMAP_act'. */
/begin MEASUREMENT TAR_b_TqFromMAP_act "(not defined)" UBYTE CU_TAR_B_TQFROMMAP_ACT 1 100 0.0 1.0 ECU_ADDRESS 0x40002e93 BYTE_ORDER MSB_FIRST /end MEASUREMENT
/begin COMPU_METHOD CU_TAR_B_TQFROMMAP_ACT "Conversion method for TAR_b_TqFromMAP_act" RAT_FUNC "%10.0" "b" COEFFS 0.000000 1.000000 0.000000 0.000000 0.000000 1.000000 /end COMPU_METHOD
/* Scalar measurable for DDE 'TRF_Nm_TqHPF'. */
/begin MEASUREMENT TRF_Nm_TqHPF "Filter result" FLOAT32_IEEE CU_TRF_NM_TQHPF 1 100 0.0 0.0 ECU_ADDRESS 0x400034cc BYTE_ORDER MSB_FIRST /end MEASUREMENT
/begin COMPU_METHOD CU_TRF_NM_TQHPF "Conversion method for TRF_Nm_TqHPF" RAT_FUNC "%10.2" "Nm" COEFFS 0.000000 1.000000 0.000000 0.000000 0.000000 1.000000 /end COMPU_METHOD
/* Scalar measurable for DDE 'TRF_b_Actv'. */
/begin MEASUREMENT TRF_b_Actv "TRF enabled" UBYTE CU_TRF_B_ACTV 1 100 0.0 1.0 ECU_ADDRESS 0x40002ec0 BYTE_ORDER MSB_FIRST /end MEASUREMENT
/begin COMPU_METHOD CU_TRF_B_ACTV "Conversion method for TRF_b_Actv" RAT_FUNC "%10.0" "b" COEFFS 0.000000 1.000000 0.000000 0.000000 0.000000 1.000000 /end COMPU_METHOD
/* Scalar measurable for DDE 'TRF_b_Transient'. */
/begin MEASUREMENT TRF_b_Transient "TRF Rate of change enable criteria passed" UBYTE CU_TRF_B_TRANSIENT 1 100 0.0 1.0 ECU_ADDRESS 0x40002ec1 BYTE_ORDER MSB_FIRST /end MEASUREMENT
/begin COMPU_METHOD CU_TRF_B_TRANSIENT "Conversion method for TRF_b_Transient" RAT_FUNC "%10.0" "b" COEFFS 0.000000 1.000000 0.000000 0.000000 0.000000 1.000000 /end COMPU_METHOD
/* Scalar measurable for DDE 'TRF_lam_EnrichmentRqst'. */
/begin MEASUREMENT TRF_lam_EnrichmentRqst "TRF AFR modifier raw value" FLOAT32_IEEE CU_TRF_LAM_ENRICHMENTRQST 1 100 0.0 0.0 ECU_ADDRESS 0x400034c8 BYTE_ORDER MSB_FIRST /end MEASUREMENT
/begin COMPU_METHOD CU_TRF_LAM_ENRICHMENTRQST "Conversion method for TRF_lam_EnrichmentRqst" RAT_FUNC "%10.3" "lam" COEFFS 0.000000 1.000000 0.000000 0.000000 0.000000 1.000000 /end COMPU_METHOD
/* Scalar measurable for DDE 'TRF_lam_Trim'. */
/begin MEASUREMENT TRF_lam_Trim "Final AFR modifier (lambda adder)" FLOAT32_IEEE CU_TRF_LAM_TRIM 1 100 0.0 0.0 ECU_ADDRESS 0x400034c4 BYTE_ORDER MSB_FIRST /end MEASUREMENT
/begin COMPU_METHOD CU_TRF_LAM_TRIM "Conversion method for TRF_lam_Trim" RAT_FUNC "%10.2" "lam" COEFFS 0.000000 1.000000 0.000000 0.000000 0.000000 1.000000 /end COMPU_METHOD
/* Scalar measurable for DDE 'TRS_Nm_TqHPF'. */
/begin MEASUREMENT TRS_Nm_TqHPF "Filter result" FLOAT32_IEEE CU_TRS_NM_TQHPF 1 100 0.0 0.0 ECU_ADDRESS 0x40003488 BYTE_ORDER MSB_FIRST /end MEASUREMENT
/begin COMPU_METHOD CU_TRS_NM_TQHPF "Conversion method for TRS_Nm_TqHPF" RAT_FUNC "%10.2" "Nm" COEFFS 0.000000 1.000000 0.000000 0.000000 0.000000 1.000000 /end COMPU_METHOD
/* Scalar measurable for DDE 'TRS_Nm_TqHPF_Peak'. */
/begin MEASUREMENT TRS_Nm_TqHPF_Peak "Peak value of the Torque HPF" FLOAT32_IEEE CU_TRS_NM_TQHPF_PEAK 1 100 0.0 0.0 ECU_ADDRESS 0x40003484 BYTE_ORDER MSB_FIRST /end MEASUREMENT
/begin COMPU_METHOD CU_TRS_NM_TQHPF_PEAK "Conversion method for TRS_Nm_TqHPF_Peak" RAT_FUNC "%10.2" "Nm" COEFFS 0.000000 1.000000 0.000000 0.000000 0.000000 1.000000 /end COMPU_METHOD
/* Scalar measurable for DDE 'TRS_b_Transient'. */
/begin MEASUREMENT TRS_b_Transient "TRS transient detected" UBYTE CU_TRS_B_TRANSIENT 1 100 0.0 1.0 ECU_ADDRESS 0x40002ebe BYTE_ORDER MSB_FIRST /end MEASUREMENT
/begin COMPU_METHOD CU_TRS_B_TRANSIENT "Conversion method for TRS_b_Transient" RAT_FUNC "%10.0" "b" COEFFS 0.000000 1.000000 0.000000 0.000000 0.000000 1.000000 /end COMPU_METHOD
/* Scalar measurable for DDE 'TRS_ret_SparkRqst'. */
/begin MEASUREMENT TRS_ret_SparkRqst "Displayable" FLOAT32_IEEE CU_TRS_RET_SPARKRQST 1 100 0.0 0.0 ECU_ADDRESS 0x4000347c BYTE_ORDER MSB_FIRST /end MEASUREMENT
/begin COMPU_METHOD CU_TRS_RET_SPARKRQST "Conversion method for TRS_ret_SparkRqst" RAT_FUNC "%10.1" "ret" COEFFS 0.000000 1.000000 0.000000 0.000000 0.000000 1.000000 /end COMPU_METHOD
/* Scalar measurable for DDE 'TRS_ret_SparkRqstRaw'. */
/begin MEASUREMENT TRS_ret_SparkRqstRaw "Raw transient spark retard" FLOAT32_IEEE CU_TRS_RET_SPARKRQSTRAW 1 100 0.0 0.0 ECU_ADDRESS 0x40003480 BYTE_ORDER MSB_FIRST /end MEASUREMENT
/begin COMPU_METHOD CU_TRS_RET_SPARKRQSTRAW "Conversion method for TRS_ret_SparkRqstRaw" RAT_FUNC "%10.1" "ret" COEFFS 0.000000 1.000000 0.000000 0.000000 0.000000 1.000000 /end COMPU_METHOD
/* Scalar measurable for DDE 'TUR_NU_BoostPressErrROC'. */
/begin MEASUREMENT TUR_NU_BoostPressErrROC "Rate of change of manifold pressure error" FLOAT32_IEEE CU_TUR_NU_BOOSTPRESSERRROC 1 100 0.0 0.0 ECU_ADDRESS 0x40003284 BYTE_ORDER MSB_FIRST /end MEASUREMENT
/begin COMPU_METHOD CU_TUR_NU_BOOSTPRESSERRROC "Conversion method for TUR_NU_BoostPressErrROC" RAT_FUNC "%10.2" "NU" COEFFS 0.000000 1.000000 0.000000 0.000000 0.000000 1.000000 /end COMPU_METHOD
/* Scalar measurable for DDE 'TUR_NU_FB_DC'. */
/begin MEASUREMENT TUR_NU_FB_DC "Tubo Feedback DC" FLOAT32_IEEE CU_TUR_NU_FB_DC 1 100 0.0 0.0 ECU_ADDRESS 0x40003264 BYTE_ORDER MSB_FIRST /end MEASUREMENT
/begin COMPU_METHOD CU_TUR_NU_FB_DC "Conversion method for TUR_NU_FB_DC" RAT_FUNC "%10.3" "pct" COEFFS 0.000000 1.000000 0.000000 0.000000 0.000000 1.000000 /end COMPU_METHOD
/* Scalar measurable for DDE 'TUR_NU_FF_DC'. */
/begin MEASUREMENT TUR_NU_FF_DC "Tubo Feedback DC" FLOAT32_IEEE CU_TUR_NU_FF_DC 1 100 0.0 0.0 ECU_ADDRESS 0x40003260 BYTE_ORDER MSB_FIRST /end MEASUREMENT
/begin COMPU_METHOD CU_TUR_NU_FF_DC "Conversion method for TUR_NU_FF_DC" RAT_FUNC "%10.3" "pct" COEFFS 0.000000 1.000000 0.000000 0.000000 0.000000 1.000000 /end COMPU_METHOD
/* Scalar measurable for DDE 'TUR_NU_PressRatioTrgt'. */
/begin MEASUREMENT TUR_NU_PressRatioTrgt "Target boost pressure ratio" FLOAT32_IEEE CU_TUR_NU_PRESSRATIOTRGT 1 100 0.0 0.0 ECU_ADDRESS 0x40003274 BYTE_ORDER MSB_FIRST /end MEASUREMENT
/begin COMPU_METHOD CU_TUR_NU_PRESSRATIOTRGT "Conversion method for TUR_NU_PressRatioTrgt" RAT_FUNC "%10.2" "NU" COEFFS 0.000000 1.000000 0.000000 0.000000 0.000000 1.000000 /end COMPU_METHOD
/* Scalar measurable for DDE 'TUR_b_AtMaxBoost'. */
/begin MEASUREMENT TUR_b_AtMaxBoost "Indicates actuator is at its limit of authority" UBYTE CU_TUR_B_ATMAXBOOST 1 100 0.0 1.0 ECU_ADDRESS 0x40002e82 BYTE_ORDER MSB_FIRST /end MEASUREMENT
/begin COMPU_METHOD CU_TUR_B_ATMAXBOOST "Conversion method for TUR_b_AtMaxBoost" RAT_FUNC "%10.0" "b" COEFFS 0.000000 1.000000 0.000000 0.000000 0.000000 1.000000 /end COMPU_METHOD
/* Scalar measurable for DDE 'TUR_b_AtMinBoost'. */
/begin MEASUREMENT TUR_b_AtMinBoost "Indicates actuator is at its limit of authority" UBYTE CU_TUR_B_ATMINBOOST 1 100 0.0 1.0 ECU_ADDRESS 0x40002e83 BYTE_ORDER MSB_FIRST /end MEASUREMENT
/begin COMPU_METHOD CU_TUR_B_ATMINBOOST "Conversion method for TUR_b_AtMinBoost" RAT_FUNC "%10.0" "b" COEFFS 0.000000 1.000000 0.000000 0.000000 0.000000 1.000000 /end COMPU_METHOD
/* Scalar measurable for DDE 'TUR_b_CompBypassValve'. */
/begin MEASUREMENT TUR_b_CompBypassValve "Compressor bypass valve command" UBYTE CU_TUR_B_COMPBYPASSVALVE 1 100 0.0 1.0 ECU_ADDRESS 0x40002e7f BYTE_ORDER MSB_FIRST /end MEASUREMENT
/begin COMPU_METHOD CU_TUR_B_COMPBYPASSVALVE "Conversion method for TUR_b_CompBypassValve" RAT_FUNC "%10.0" "b" COEFFS 0.000000 1.000000 0.000000 0.000000 0.000000 1.000000 /end COMPU_METHOD
/* Scalar measurable for DDE 'TUR_kPa_BoostPressErr'. */
/begin MEASUREMENT TUR_kPa_BoostPressErr "Manifold pressure error" FLOAT32_IEEE CU_TUR_KPA_BOOSTPRESSERR 1 100 0.0 0.0 ECU_ADDRESS 0x40003290 BYTE_ORDER MSB_FIRST /end MEASUREMENT
/begin COMPU_METHOD CU_TUR_KPA_BOOSTPRESSERR "Conversion method for TUR_kPa_BoostPressErr" RAT_FUNC "%10.2" "kPa" COEFFS 0.000000 1.000000 0.000000 0.000000 0.000000 1.000000 /end COMPU_METHOD
/* Scalar measurable for DDE 'TUR_pct_DTerm'. */
/begin MEASUREMENT TUR_pct_DTerm "Derivative effort term for turbo actuator control" FLOAT32_IEEE CU_TUR_PCT_DTERM 1 100 0.0 0.0 ECU_ADDRESS 0x40003280 BYTE_ORDER MSB_FIRST /end MEASUREMENT
/begin COMPU_METHOD CU_TUR_PCT_DTERM "Conversion method for TUR_pct_DTerm" RAT_FUNC "%10.3" "pct" COEFFS 0.000000 1.000000 0.000000 0.000000 0.000000 1.000000 /end COMPU_METHOD
/* Scalar measurable for DDE 'TUR_pct_FB_Effort'. */
/begin MEASUREMENT TUR_pct_FB_Effort "Final PID effort for turbo boost control" FLOAT32_IEEE CU_TUR_PCT_FB_EFFORT 1 100 0.0 0.0 ECU_ADDRESS 0x40003278 BYTE_ORDER MSB_FIRST /end MEASUREMENT
/begin COMPU_METHOD CU_TUR_PCT_FB_EFFORT "Conversion method for TUR_pct_FB_Effort" RAT_FUNC "%10.3" "pct" COEFFS 0.000000 1.000000 0.000000 0.000000 0.000000 1.000000 /end COMPU_METHOD
/* Scalar measurable for DDE 'TUR_pct_FB_EffortRaw'. */
/begin MEASUREMENT TUR_pct_FB_EffortRaw "Raw PID effort for turbo boost control" FLOAT32_IEEE CU_TUR_PCT_FB_EFFORTRAW 1 100 0.0 0.0 ECU_ADDRESS 0x4000327c BYTE_ORDER MSB_FIRST /end MEASUREMENT
/begin COMPU_METHOD CU_TUR_PCT_FB_EFFORTRAW "Conversion method for TUR_pct_FB_EffortRaw" RAT_FUNC "%10.3" "pct" COEFFS 0.000000 1.000000 0.000000 0.000000 0.000000 1.000000 /end COMPU_METHOD
/* Scalar measurable for DDE 'TUR_pct_FF_Effort'. */
/begin MEASUREMENT TUR_pct_FF_Effort "Turbo feedforward effort" FLOAT32_IEEE CU_TUR_PCT_FF_EFFORT 1 100 0.0 0.0 ECU_ADDRESS 0x40003270 BYTE_ORDER MSB_FIRST /end MEASUREMENT
/begin COMPU_METHOD CU_TUR_PCT_FF_EFFORT "Conversion method for TUR_pct_FF_Effort" RAT_FUNC "%10.3" "pct" COEFFS 0.000000 1.000000 0.000000 0.000000 0.000000 1.000000 /end COMPU_METHOD
/* Scalar measurable for DDE 'TUR_pct_ITerm'. */
/begin MEASUREMENT TUR_pct_ITerm "Integral effort term in turbo actuator control" FLOAT32_IEEE CU_TUR_PCT_ITERM 1 100 0.0 0.0 ECU_ADDRESS 0x40003288 BYTE_ORDER MSB_FIRST /end MEASUREMENT
/begin COMPU_METHOD CU_TUR_PCT_ITERM "Conversion method for TUR_pct_ITerm" RAT_FUNC "%10.4" "pct" COEFFS 0.000000 1.000000 0.000000 0.000000 0.000000 1.000000 /end COMPU_METHOD
/* Scalar measurable for DDE 'TUR_pct_PTerm'. */
/begin MEASUREMENT TUR_pct_PTerm "Proportional effort term in turbo actuator control" FLOAT32_IEEE CU_TUR_PCT_PTERM 1 100 0.0 0.0 ECU_ADDRESS 0x4000328c BYTE_ORDER MSB_FIRST /end MEASUREMENT
/begin COMPU_METHOD CU_TUR_PCT_PTERM "Conversion method for TUR_pct_PTerm" RAT_FUNC "%10.4" "pct" COEFFS 0.000000 1.000000 0.000000 0.000000 0.000000 1.000000 /end COMPU_METHOD
/* Scalar measurable for DDE 'TUR_pct_TotalEffort'. */
/begin MEASUREMENT TUR_pct_TotalEffort "Final total turbo control effort" FLOAT32_IEEE CU_TUR_PCT_TOTALEFFORT 1 100 0.0 0.0 ECU_ADDRESS 0x40003268 BYTE_ORDER MSB_FIRST /end MEASUREMENT
/begin COMPU_METHOD CU_TUR_PCT_TOTALEFFORT "Conversion method for TUR_pct_TotalEffort" RAT_FUNC "%10.3" "pct" COEFFS 0.000000 1.000000 0.000000 0.000000 0.000000 1.000000 /end COMPU_METHOD
/* Scalar measurable for DDE 'TUR_pct_TotalEffortRaw'. */
/begin MEASUREMENT TUR_pct_TotalEffortRaw "Raw total turbo control effort" FLOAT32_IEEE CU_TUR_PCT_TOTALEFFORTRAW 1 100 0.0 0.0 ECU_ADDRESS 0x4000326c BYTE_ORDER MSB_FIRST /end MEASUREMENT
/begin COMPU_METHOD CU_TUR_PCT_TOTALEFFORTRAW "Conversion method for TUR_pct_TotalEffortRaw" RAT_FUNC "%10.3" "pct" COEFFS 0.000000 1.000000 0.000000 0.000000 0.000000 1.000000 /end COMPU_METHOD
/* Scalar measurable for DDE 'TUR_pct_TurCtrlDC'. */
/begin MEASUREMENT TUR_pct_TurCtrlDC "Final value of turbo control actuator duty cycle" FLOAT32_IEEE CU_TUR_PCT_TURCTRLDC 1 100 0.0 0.0 ECU_ADDRESS 0x40003234 BYTE_ORDER MSB_FIRST /end MEASUREMENT
/begin COMPU_METHOD CU_TUR_PCT_TURCTRLDC "Conversion method for TUR_pct_TurCtrlDC" RAT_FUNC "%10.3" "pct" COEFFS 0.000000 1.000000 0.000000 0.000000 0.000000 1.000000 /end COMPU_METHOD
/* Scalar measurable for DDE 'VCP_NU_CamErrROC'. */
/begin MEASUREMENT VCP_NU_CamErrROC "(deg/s) Time derivative of position error" FLOAT32_IEEE CU_VCP_NU_CAMERRROC 1 100 -100.0 100.0 ECU_ADDRESS 0x40003244 BYTE_ORDER MSB_FIRST /end MEASUREMENT
/begin COMPU_METHOD CU_VCP_NU_CAMERRROC "Conversion method for VCP_NU_CamErrROC" RAT_FUNC "%10.3" "NU" COEFFS 0.000000 1.000000 0.000000 0.000000 0.000000 1.000000 /end COMPU_METHOD
/* Scalar measurable for DDE 'VCP_adv_CamTrgt'. */
/begin MEASUREMENT VCP_adv_CamTrgt "Rate limited  cam phasing target" FLOAT32_IEEE CU_VCP_ADV_CAMTRGT 1 100 -5.0 100.0 ECU_ADDRESS 0x40003258 BYTE_ORDER MSB_FIRST /end MEASUREMENT
/begin COMPU_METHOD CU_VCP_ADV_CAMTRGT "Conversion method for VCP_adv_CamTrgt" RAT_FUNC "%10.1" "adv" COEFFS 0.000000 1.000000 0.000000 0.000000 0.000000 1.000000 /end COMPU_METHOD
/* Scalar measurable for DDE 'VCP_deg_CamErr'. */
/begin MEASUREMENT VCP_deg_CamErr "VVT error" FLOAT32_IEEE CU_VCP_DEG_CAMERR 1 100 -100.0 100.0 ECU_ADDRESS 0x40003250 BYTE_ORDER MSB_FIRST /end MEASUREMENT
/begin COMPU_METHOD CU_VCP_DEG_CAMERR "Conversion method for VCP_deg_CamErr" RAT_FUNC "%10.3" "NU" COEFFS 0.000000 1.000000 0.000000 0.000000 0.000000 1.000000 /end COMPU_METHOD
/* Scalar measurable for DDE 'VCP_pct_CamDC'. */
/begin MEASUREMENT VCP_pct_CamDC "PWM Signal percentage for Monitoring" FLOAT32_IEEE CU_VCP_PCT_CAMDC 1 100 0.0 1.0 ECU_ADDRESS 0x40003204 BYTE_ORDER MSB_FIRST /end MEASUREMENT
/begin COMPU_METHOD CU_VCP_PCT_CAMDC "Conversion method for VCP_pct_CamDC" RAT_FUNC "%10.2" "pct" COEFFS 0.000000 1.000000 0.000000 0.000000 0.000000 1.000000 /end COMPU_METHOD
/* Scalar measurable for DDE 'VCP_pct_CamDC_FF'. */
/begin MEASUREMENT VCP_pct_CamDC_FF "Feed-forward control effort for  cam phasing" FLOAT32_IEEE CU_VCP_PCT_CAMDC_FF 1 100 0.0 1.0 ECU_ADDRESS 0x40003254 BYTE_ORDER MSB_FIRST /end MEASUREMENT
/begin COMPU_METHOD CU_VCP_PCT_CAMDC_FF "Conversion method for VCP_pct_CamDC_FF" RAT_FUNC "%10.3" "NU" COEFFS 0.000000 1.000000 0.000000 0.000000 0.000000 1.000000 /end COMPU_METHOD
/* Scalar measurable for DDE 'VCP_pct_CamDC_PID'. */
/begin MEASUREMENT VCP_pct_CamDC_PID "Feedback control effort for  cam phasing" FLOAT32_IEEE CU_VCP_PCT_CAMDC_PID 1 100 0.0 1.0 ECU_ADDRESS 0x40003238 BYTE_ORDER MSB_FIRST /end MEASUREMENT
/begin COMPU_METHOD CU_VCP_PCT_CAMDC_PID "Conversion method for VCP_pct_CamDC_PID" RAT_FUNC "%10.3" "NU" COEFFS 0.000000 1.000000 0.000000 0.000000 0.000000 1.000000 /end COMPU_METHOD
/* Scalar measurable for DDE 'VCP_pct_CamDTerm'. */
/begin MEASUREMENT VCP_pct_CamDTerm "Derivative effort for  cam" FLOAT32_IEEE CU_VCP_PCT_CAMDTERM 1 100 -1.0 1.0 ECU_ADDRESS 0x40003240 BYTE_ORDER MSB_FIRST /end MEASUREMENT
/begin COMPU_METHOD CU_VCP_PCT_CAMDTERM "Conversion method for VCP_pct_CamDTerm" RAT_FUNC "%10.3" "NU" COEFFS 0.000000 1.000000 0.000000 0.000000 0.000000 1.000000 /end COMPU_METHOD
/* Scalar measurable for DDE 'VCP_pct_CamITerm'. */
/begin MEASUREMENT VCP_pct_CamITerm "Integral effort for  cam" FLOAT32_IEEE CU_VCP_PCT_CAMITERM 1 100 -1.0 1.0 ECU_ADDRESS 0x40003248 BYTE_ORDER MSB_FIRST /end MEASUREMENT
/begin COMPU_METHOD CU_VCP_PCT_CAMITERM "Conversion method for VCP_pct_CamITerm" RAT_FUNC "%10.3" "NU" COEFFS 0.000000 1.000000 0.000000 0.000000 0.000000 1.000000 /end COMPU_METHOD
/* Scalar measurable for DDE 'VCP_pct_CamPIDRaw'. */
/begin MEASUREMENT VCP_pct_CamPIDRaw "Cam PID effort raw" FLOAT32_IEEE CU_VCP_PCT_CAMPIDRAW 1 100 -1.0 1.0 ECU_ADDRESS 0x4000323c BYTE_ORDER MSB_FIRST /end MEASUREMENT
/begin COMPU_METHOD CU_VCP_PCT_CAMPIDRAW "Conversion method for VCP_pct_CamPIDRaw" RAT_FUNC "%10.3" "NU" COEFFS 0.000000 1.000000 0.000000 0.000000 0.000000 1.000000 /end COMPU_METHOD
/* Scalar measurable for DDE 'VCP_pct_CamPTerm'. */
/begin MEASUREMENT VCP_pct_CamPTerm "Proportional effort" FLOAT32_IEEE CU_VCP_PCT_CAMPTERM 1 100 0.0 1.0 ECU_ADDRESS 0x4000324c BYTE_ORDER MSB_FIRST /end MEASUREMENT
/begin COMPU_METHOD CU_VCP_PCT_CAMPTERM "Conversion method for VCP_pct_CamPTerm" RAT_FUNC "%10.3" "NU" COEFFS 0.000000 1.000000 0.000000 0.000000 0.000000 1.000000 /end COMPU_METHOD
/begin FUNCTION EGF1_OK "Group /ByModelHeirarchy/Gasoline/4.Engine_Control/EGF1_OK" /begin SUB_FUNCTION LogEnable83 /end SUB_FUNCTION /end FUNCTION
/begin FUNCTION OVR_AndExport95 "Group /ByModelHeirarchy/Gasoline/4.Engine_Control/ELM/OVR_AndExport9" /begin LOC_MEASUREMENT ELM_Nm_AlternatorTq /end LOC_MEASUREMENT /begin REF_CHARACTERISTIC ELMc_Nm_AlternatorTq ELMc_o_AlternatorTq /end REF_CHARACTERISTIC /end FUNCTION
/begin FUNCTION OVR_AndExport56 "Group /ByModelHeirarchy/Gasoline/4.Engine_Control/ELM/Ventilador ZF/OVR_AndExport1" /begin LOC_MEASUREMENT OUT_C_FAN_ZF /end LOC_MEASUREMENT /begin REF_CHARACTERISTIC OUTc_C_FAN_ZF OUTc_o_FAN_ZF /end REF_CHARACTERISTIC /end FUNCTION
/begin FUNCTION OVR_AndExport57 "Group /ByModelHeirarchy/Gasoline/4.Engine_Control/ELM/Ventilador ZF/OVR_AndExport4" /begin LOC_MEASUREMENT OUT_b_VentiladorZF /end LOC_MEASUREMENT /begin REF_CHARACTERISTIC OUTc_b_VentiladorZF OUTc_o_VentiladorZF /end REF_CHARACTERISTIC /end FUNCTION
/begin FUNCTION Ventilador_ZF "Group /ByModelHeirarchy/Gasoline/4.Engine_Control/ELM/Ventilador ZF" /begin SUB_FUNCTION OVR_AndExport56 OVR_AndExport57 /end SUB_FUNCTION /begin REF_CHARACTERISTIC OUTc_C_TempZF_off OUTc_C_TempZF_on OUTc_Hz_CompBypassFrq /end REF_CHARACTERISTIC /end FUNCTION
/begin FUNCTION ELM "Group /ByModelHeirarchy/Gasoline/4.Engine_Control/ELM" /begin SUB_FUNCTION OVR_AndExport95 Ventilador_ZF /end SUB_FUNCTION
 /begin LOC_MEASUREMENT ELM_Nm_FrictionTq ELM_Nm_HVAC_Tq ELM_Nm_PwrStrTq ELM_Nm_ZFFAN_Tq /end LOC_MEASUREMENT
 /begin REF_CHARACTERISTIC ELMm_NU_Alternator_Tq_x ELMm_NU_Alternator_Tq_z ELMm_NU_FrictionTq_x ELMm_NU_FrictionTq_y ELMm_NU_FrictionTq_z ELMm_NU_HVAC_Tq_x ELMm_NU_HVAC_Tq_z ELMm_NU_PwrStrTq_x ELMm_NU_PwrStrTq_z ELMm_NU_ZFFAN_Tq_x ELMm_NU_ZFFAN_Tq_z /end REF_CHARACTERISTIC
/end FUNCTION
/begin FUNCTION ERL "Group /ByModelHeirarchy/Gasoline/4.Engine_Control/ERL"
 /begin LOC_MEASUREMENT ERL_RPM_HardLim ERL_RPM_Overspd ERL_b_HardLimReached ERL_pct_PTerm /end LOC_MEASUREMENT
 /begin REF_CHARACTERISTIC ERLc_NU_PGain ERLc_RPM_HardLimOfst ERLc_RPM_SoftLim ERLc_pct_HardLim ERLm_NU_SparkRetard_x ERLm_NU_SparkRetard_z /end REF_CHARACTERISTIC
/end FUNCTION
/begin FUNCTION CalcRunningMode "Group /ByModelHeirarchy/Gasoline/4.Engine_Control/ERM/CalcRunningMode"
 /begin REF_CHARACTERISTIC ERMc_RPM_EnterCranking ERMc_RPM_EnterRunning ERMc_RPM_ExitCranking ERMc_RPM_ExitRunning /end REF_CHARACTERISTIC
/end FUNCTION
/begin FUNCTION ERM "Group /ByModelHeirarchy/Gasoline/4.Engine_Control/ERM" /begin SUB_FUNCTION CalcRunningMode /end SUB_FUNCTION /end FUNCTION
/begin FUNCTION LogEnable14 "Group /ByModelHeirarchy/Gasoline/4.Engine_Control/ET1_OK/LogEnable1" /begin REF_CHARACTERISTIC LOGc_b_EnableCanLog /end REF_CHARACTERISTIC /end FUNCTION
/begin FUNCTION ET1_OK "Group /ByModelHeirarchy/Gasoline/4.Engine_Control/ET1_OK" /begin SUB_FUNCTION LogEnable14 /end SUB_FUNCTION /end FUNCTION
/begin FUNCTION Continuous_duty_limit "Group /ByModelHeirarchy/Gasoline/4.Engine_Control/ETC1/Continuous duty limit"
 /begin REF_CHARACTERISTIC ETCc_pct_ContinuousDutyMax ETCc_pct_ContinuousDutyMin ETCc_s_ContinuousDutyDbnc /end REF_CHARACTERISTIC
/end FUNCTION
/begin FUNCTION OVR_AndExport393 "Group /ByModelHeirarchy/Gasoline/4.Engine_Control/ETC1/OVR_AndExport39" /begin LOC_MEASUREMENT ETC_pct_MotorCmdVb /end LOC_MEASUREMENT /begin REF_CHARACTERISTIC ETCc_o_MotorCmdVb ETCc_pct_MotorCmdVb /end REF_CHARACTERISTIC /end FUNCTION
/begin FUNCTION OVR_AndExport58 "Group /ByModelHeirarchy/Gasoline/4.Engine_Control/ETC1/OVR_AndExport4" /begin LOC_MEASUREMENT ETC_deg_ThRqstFiltd /end LOC_MEASUREMENT /begin REF_CHARACTERISTIC ETCc_deg_ThRqstFiltd ETCc_o_ThRqstFiltd /end REF_CHARACTERISTIC /end FUNCTION
/begin FUNCTION OVR_AndExport59 "Group /ByModelHeirarchy/Gasoline/4.Engine_Control/ETC1/Powerup range check and redundant TP handling/ETC travel learning/Apply xfr/OVR_AndExport1" /begin LOC_MEASUREMENT ETC_NU_TP1_FullPos /end LOC_MEASUREMENT /begin REF_CHARACTERISTIC ETCc_NU_TP1_FullPos ETCc_o_TP1_FullPos /end REF_CHARACTERISTIC /end FUNCTION
/begin FUNCTION OVR_AndExport60 "Group /ByModelHeirarchy/Gasoline/4.Engine_Control/ETC1/Powerup range check and redundant TP handling/ETC travel learning/Apply xfr/OVR_AndExport4" /begin LOC_MEASUREMENT ETC_NU_TP1_ZeroPos /end LOC_MEASUREMENT /begin REF_CHARACTERISTIC ETCc_NU_TP1_ZeroPos ETCc_o_TP1_ZeroPos /end REF_CHARACTERISTIC /end FUNCTION
/begin FUNCTION Apply_xfr "Group /ByModelHeirarchy/Gasoline/4.Engine_Control/ETC1/Powerup range check and redundant TP handling/ETC travel learning/Apply xfr" /begin SUB_FUNCTION OVR_AndExport59 OVR_AndExport60 /end SUB_FUNCTION /begin LOC_MEASUREMENT ETC_pct_TP1 /end LOC_MEASUREMENT /end FUNCTION
/begin FUNCTION OVR_AndExport61 "Group /ByModelHeirarchy/Gasoline/4.Engine_Control/ETC1/Powerup range check and redundant TP handling/ETC travel learning/Apply xfr2/OVR_AndExport1" /begin LOC_MEASUREMENT ETC_NU_TP2_FullPos /end LOC_MEASUREMENT /begin REF_CHARACTERISTIC ETCc_NU_TP2_FullPos ETCc_o_TP2_FullPos /end REF_CHARACTERISTIC /end FUNCTION
/begin FUNCTION OVR_AndExport62 "Group /ByModelHeirarchy/Gasoline/4.Engine_Control/ETC1/Powerup range check and redundant TP handling/ETC travel learning/Apply xfr2/OVR_AndExport4" /begin LOC_MEASUREMENT ETC_NU_TP2_ZeroPos /end LOC_MEASUREMENT /begin REF_CHARACTERISTIC ETCc_NU_TP2_ZeroPos ETCc_o_TP2_ZeroPos /end REF_CHARACTERISTIC /end FUNCTION
/begin FUNCTION Apply_xfr2 "Group /ByModelHeirarchy/Gasoline/4.Engine_Control/ETC1/Powerup range check and redundant TP handling/ETC travel learning/Apply xfr2" /begin SUB_FUNCTION OVR_AndExport61 OVR_AndExport62 /end SUB_FUNCTION /begin LOC_MEASUREMENT ETC_pct_TP2 /end LOC_MEASUREMENT /end FUNCTION
/begin FUNCTION OVR_AndExport321 "Group /ByModelHeirarchy/Gasoline/4.Engine_Control/ETC1/Powerup range check and redundant TP handling/ETC travel learning/DTC134/OVR_AndExport34" /begin LOC_MEASUREMENT DTC_b_ETC_MotorFLT /end LOC_MEASUREMENT /begin REF_CHARACTERISTIC DTCc_b_ETC_MotorFLT DTCc_o_ETC_MotorFLT /end REF_CHARACTERISTIC /end FUNCTION
/begin FUNCTION DTC134 "Group /ByModelHeirarchy/Gasoline/4.Engine_Control/ETC1/Powerup range check and redundant TP handling/ETC travel learning/DTC134" /begin SUB_FUNCTION OVR_AndExport321 /end SUB_FUNCTION /begin REF_CHARACTERISTIC AINc_Hz_ETC_fail_FR AINc_Hz_ETC_fail_RR /end REF_CHARACTERISTIC /end FUNCTION
/begin FUNCTION LearnFull "Group /ByModelHeirarchy/Gasoline/4.Engine_Control/ETC1/Powerup range check and redundant TP handling/ETC travel learning/LearnFull" /begin LOC_MEASUREMENT ETC_b_TP1_FullPosOOR ETC_b_TP2_FullPosOOR /end LOC_MEASUREMENT
 /begin REF_CHARACTERISTIC ETCc_NU_FullLearnDfltTP1 ETCc_NU_FullLearnDfltTP2 ETCc_NU_FullLearnHiLimTP1 ETCc_NU_FullLearnHiLimTP2 ETCc_NU_FullLearnLoLimTP1 ETCc_NU_FullLearnLoLimTP2 ETCc_b_ResetNVM ETCca_NU_FullLearnDfltTP1 ETCca_NU_FullLearnDfltTP2 /end REF_CHARACTERISTIC
/end FUNCTION
/begin FUNCTION LearnZero "Group /ByModelHeirarchy/Gasoline/4.Engine_Control/ETC1/Powerup range check and redundant TP handling/ETC travel learning/LearnZero" /begin LOC_MEASUREMENT ETC_b_TP1_ZeroPosOOR ETC_b_TP2_ZeroPosOOR /end LOC_MEASUREMENT
 /begin REF_CHARACTERISTIC ETCc_NU_ZeroLearnDfltTP1 ETCc_NU_ZeroLearnDfltTP2 ETCc_NU_ZeroLearnHiLimTP1 ETCc_NU_ZeroLearnHiLimTP2 ETCc_NU_ZeroLearnLoLimTP1 ETCc_NU_ZeroLearnLoLimTP2 ETCc_b_ResetNVM ETCca_NU_ZeroLearnDfltTP1 ETCca_NU_ZeroLearnDfltTP2 /end REF_CHARACTERISTIC
/end FUNCTION
/begin FUNCTION Detect_steady_state "Group /ByModelHeirarchy/Gasoline/4.Engine_Control/ETC1/Powerup range check and redundant TP handling/ETC travel learning/Learning Commands/Detect steady-state"
 /begin LOC_MEASUREMENT ETC_NU_TPRate ETC_NU_TP_Dot ETC_b_Stable ETC_b_StoppedClosing ETC_b_StoppedOpening /end LOC_MEASUREMENT
 /begin REF_CHARACTERISTIC ETCc_NU_TP_DotThrsh ETCc_NU_TP_FallRateThrsh ETCc_NU_TP_RiseRateThrsh ETCc_s_TP_FallDelay ETCc_s_TP_RiseDelay ETCc_s_TP_StableDelay /end REF_CHARACTERISTIC
/end FUNCTION
/begin FUNCTION Learning_Commands "Group /ByModelHeirarchy/Gasoline/4.Engine_Control/ETC1/Powerup range check and redundant TP handling/ETC travel learning/Learning Commands" /begin SUB_FUNCTION Detect_steady_state /end SUB_FUNCTION
 /begin LOC_MEASUREMENT ETC_b_CloseComplete ETC_b_Expired ETC_b_ForceClosed ETC_b_ForceOpen ETC_b_LearnReady ETC_b_LearnRest ETC_b_LearnSequenceFailed ETC_b_LearnSequenceSuccess ETC_b_OpenComplete ETC_b_TP1_LearnFull ETC_b_TP1_LearnZero ETC_b_TP2_LearnFull ETC_b_TP2_LearnZero /end LOC_MEASUREMENT
 /begin REF_CHARACTERISTIC ETCc_NU_LFallRate ETCc_NU_LRiseRate ETCc_b_ManualRangeRetry ETCc_b_RangeLearnEnbl ETCc_pct_ForceClosedCmd ETCc_pct_ForceOpenCmd ETCc_s_PowerupDelay ETCc_s_RangeCheckExpire /end REF_CHARACTERISTIC
/end FUNCTION
/begin FUNCTION ETC_travel_learning "Group /ByModelHeirarchy/Gasoline/4.Engine_Control/ETC1/Powerup range check and redundant TP handling/ETC travel learning"
 /begin SUB_FUNCTION Apply_xfr Apply_xfr2 DTC134 LearnFull LearnZero Learning_Commands /end SUB_FUNCTION
 /begin LOC_MEASUREMENT ETC_NU_TP1_Slow ETC_NU_TP2_Slow ETC_b_RangeCheckFailed /end LOC_MEASUREMENT
 /begin REF_CHARACTERISTIC ETCc_Hz_TP1_LPF ETCc_Hz_TP2_LPF /end REF_CHARACTERISTIC
/end FUNCTION
/begin FUNCTION LearnRest "Group /ByModelHeirarchy/Gasoline/4.Engine_Control/ETC1/Powerup range check and redundant TP handling/LearnRest" /begin LOC_MEASUREMENT ETC_b_RestPosOOR /end LOC_MEASUREMENT
 /begin REF_CHARACTERISTIC ETCc_b_ResetNVM ETCc_deg_RestLearnDflt ETCc_deg_RestMax ETCc_deg_RestMin ETCca_deg_RestLearnDflt /end REF_CHARACTERISTIC
/end FUNCTION
/begin FUNCTION OVR_AndExport63 "Group /ByModelHeirarchy/Gasoline/4.Engine_Control/ETC1/Powerup range check and redundant TP handling/OVR_AndExport4" /begin LOC_MEASUREMENT ETC_deg_RestPos /end LOC_MEASUREMENT /begin REF_CHARACTERISTIC ETCc_deg_RestPos ETCc_o_RestPos /end REF_CHARACTERISTIC /end FUNCTION
/begin FUNCTION OVR_AndExport322 "Group /ByModelHeirarchy/Gasoline/4.Engine_Control/ETC1/Powerup range check and redundant TP handling/Redundant sensor arbitration/DTC128/OVR_AndExport34" /begin LOC_MEASUREMENT DTC_b_TP_CorrFLT /end LOC_MEASUREMENT /begin REF_CHARACTERISTIC DTCc_b_TP_CorrFLT DTCc_o_TP_CorrFLT /end REF_CHARACTERISTIC /end FUNCTION
/begin FUNCTION DTC128 "Group /ByModelHeirarchy/Gasoline/4.Engine_Control/ETC1/Powerup range check and redundant TP handling/Redundant sensor arbitration/DTC128" /begin SUB_FUNCTION OVR_AndExport322 /end SUB_FUNCTION /end FUNCTION
/begin FUNCTION Fault_Determination "Group /ByModelHeirarchy/Gasoline/4.Engine_Control/ETC1/Powerup range check and redundant TP handling/Redundant sensor arbitration/Fault Determination" /begin LOC_MEASUREMENT ETC_pct_TP_Delta /end LOC_MEASUREMENT /begin REF_CHARACTERISTIC ETCc_pct_TP_DeltaMax ETCc_s_TP_FltDbnc /end REF_CHARACTERISTIC /end FUNCTION
/begin FUNCTION Redundant_sensor_arbitration "Group /ByModelHeirarchy/Gasoline/4.Engine_Control/ETC1/Powerup range check and redundant TP handling/Redundant sensor arbitration" /begin SUB_FUNCTION DTC128 Fault_Determination /end SUB_FUNCTION /begin LOC_MEASUREMENT ETC_b_TP_CorrFlt /end LOC_MEASUREMENT /end FUNCTION
/begin FUNCTION Powerup_range_check_and_redund0 "Group /ByModelHeirarchy/Gasoline/4.Engine_Control/ETC1/Powerup range check and redundant TP handling"
 /begin SUB_FUNCTION ETC_travel_learning LearnRest OVR_AndExport63 Redundant_sensor_arbitration /end SUB_FUNCTION
 /begin LOC_MEASUREMENT ETC_deg_VlvPos /end LOC_MEASUREMENT
 /begin REF_CHARACTERISTIC ETCc_b_TP1_Inverted ETCc_b_TP2_Inverted /end REF_CHARACTERISTIC
/end FUNCTION
/begin FUNCTION Target_arbitration "Group /ByModelHeirarchy/Gasoline/4.Engine_Control/ETC1/Target arbitration"
 /begin REF_CHARACTERISTIC ETCc_b_RestDuringCranking ETCc_b_RestWhenStopped ETCc_b_UseCrankingPos ETCc_b_UsePedalDirectly ETCc_deg_ControlClosedCmd ETCc_deg_ControlOpenCmd ETCc_o_MotorCmd ETCc_s_RestCrankingExpiration ETCm_deg_CrankAmbTemp_x ETCm_deg_CrankAmbTemp_z /end REF_CHARACTERISTIC
/end FUNCTION
/begin FUNCTION Magnitude_Of_Kick "Group /ByModelHeirarchy/Gasoline/4.Engine_Control/ETC1/Valve position control/Actuator kick1/Magnitude_Of_Kick" /begin LOC_MEASUREMENT ETC_deg_ThRqstHPF /end LOC_MEASUREMENT /begin REF_CHARACTERISTIC ETCc_NU_KickHPF_Tc ETCc_NU_KickHPF_Thrsh ETCc_pct_KickDuty /end REF_CHARACTERISTIC /end FUNCTION
/begin FUNCTION Sign_Of_Kick "Group /ByModelHeirarchy/Gasoline/4.Engine_Control/ETC1/Valve position control/Actuator kick1/Sign_Of_Kick" /begin REF_CHARACTERISTIC ETCc_s_KickSignDbnc /end REF_CHARACTERISTIC /end FUNCTION
/begin FUNCTION Actuator_kick1 "Group /ByModelHeirarchy/Gasoline/4.Engine_Control/ETC1/Valve position control/Actuator kick1" /begin SUB_FUNCTION Magnitude_Of_Kick Sign_Of_Kick /end SUB_FUNCTION /begin LOC_MEASUREMENT ETC_pct_Kick /end LOC_MEASUREMENT /end FUNCTION
/begin FUNCTION Error_Kick "Group /ByModelHeirarchy/Gasoline/4.Engine_Control/ETC1/Valve position control/Error Kick" /begin LOC_MEASUREMENT ETC_NU_Error_Int ETC_pct_Kick_error /end LOC_MEASUREMENT
 /begin REF_CHARACTERISTIC ETCc_NU_Int_thd ETCc_deg_Reset_thd ETCc_pct_Kick_Error ETCc_s_Kick_hold /end REF_CHARACTERISTIC
/end FUNCTION
/begin FUNCTION Latch_ITerm_at_valve_end_stops "Group /ByModelHeirarchy/Gasoline/4.Engine_Control/ETC1/Valve position control/Feedback/ITerm handling/Latch ITerm at valve end stops" /begin REF_CHARACTERISTIC ETCc_deg_FullClosedErrorThrsh ETCc_deg_FullOpenErrorThrsh /end REF_CHARACTERISTIC /end FUNCTION
/begin FUNCTION ITerm_handling "Group /ByModelHeirarchy/Gasoline/4.Engine_Control/ETC1/Valve position control/Feedback/ITerm handling" /begin SUB_FUNCTION Latch_ITerm_at_valve_end_stops /end SUB_FUNCTION
 /begin REF_CHARACTERISTIC ETCc_deg_FreezeITermDbnd ETCc_deg_FullClosed ETCc_deg_FullOpen ETCc_deg_RestPosITermDbnd ETCc_deg_RestPosThrsh /end REF_CHARACTERISTIC
/end FUNCTION
/begin FUNCTION OVR_AndExport64 "Group /ByModelHeirarchy/Gasoline/4.Engine_Control/ETC1/Valve position control/Feedback/OVR_AndExport5" /begin LOC_MEASUREMENT ETC_pct_FB /end LOC_MEASUREMENT /begin REF_CHARACTERISTIC ETCc_o_FB ETCc_pct_FB /end REF_CHARACTERISTIC /end FUNCTION
/begin FUNCTION PID "Group /ByModelHeirarchy/Gasoline/4.Engine_Control/ETC1/Valve position control/Feedback/PID" /begin LOC_MEASUREMENT PID_NU_DTerm PID_NU_ITerm PID_NU_PTerm /end LOC_MEASUREMENT /begin REF_CHARACTERISTIC ETCc_pct_DMax ETCc_pct_DMin ETCc_pct_EMax ETCc_pct_EMin /end REF_CHARACTERISTIC /end FUNCTION
/begin FUNCTION Feedback "Group /ByModelHeirarchy/Gasoline/4.Engine_Control/ETC1/Valve position control/Feedback" /begin SUB_FUNCTION ITerm_handling OVR_AndExport64 PID /end SUB_FUNCTION /begin LOC_MEASUREMENT ETC_NU_DTerm ETC_NU_ITerm ETC_NU_PTerm ETC_deg_Error /end LOC_MEASUREMENT
 /begin REF_CHARACTERISTIC ETCc_b_AW_Enbl ETCc_deg_AW_Thrsh ETCc_pct_FB_Dbnd ETCc_pct_FB_Max ETCc_pct_FB_Min ETCc_pct_IMax ETCc_pct_IMin ETCm_NU_DGain_x ETCm_NU_DGain_y ETCm_NU_DGain_z ETCm_NU_IGain_x ETCm_NU_IGain_y ETCm_NU_IGain_z ETCm_NU_IRest_x ETCm_NU_IRest_y ETCm_NU_IRest_z ETCm_NU_PGain_x ETCm_NU_PGain_y ETCm_NU_PGain_z ETCm_NU_PRest_x ETCm_NU_PRest_y ETCm_NU_PRest_z /end REF_CHARACTERISTIC
/end FUNCTION
/begin FUNCTION Valve_position_control "Group /ByModelHeirarchy/Gasoline/4.Engine_Control/ETC1/Valve position control" /begin SUB_FUNCTION Actuator_kick1 Error_Kick Feedback /end SUB_FUNCTION
 /begin LOC_MEASUREMENT ETC_deg_RelativeThRqst ETC_pct_Effort ETC_pct_FF ETC_pct_Hyst /end LOC_MEASUREMENT
 /begin REF_CHARACTERISTIC ETCc_b_HystAxisStrategy ETCc_b_HystStrategy ETCm_NU_DutyCycle_x ETCm_NU_DutyCycle_z ETCm_NU_FF_x ETCm_NU_FF_y ETCm_NU_FF_z ETCm_NU_Hyst_x ETCm_NU_Hyst_y ETCm_NU_Hyst_z /end REF_CHARACTERISTIC
/end FUNCTION
/begin FUNCTION ETC1 "Group /ByModelHeirarchy/Gasoline/4.Engine_Control/ETC1"
 /begin SUB_FUNCTION Continuous_duty_limit OVR_AndExport393 OVR_AndExport58 Powerup_range_check_and_redund0 Target_arbitration Valve_position_control /end SUB_FUNCTION
 /begin REF_CHARACTERISTIC ETCc_NU_FallRate ETCc_NU_RiseRate ETCm_NU_VbCorr_x ETCm_NU_VbCorr_z /end REF_CHARACTERISTIC
/end FUNCTION
/begin FUNCTION ETH1 "Group /ByModelHeirarchy/Gasoline/4.Engine_Control/ETH/ETH" /begin REF_CHARACTERISTIC AINc_NU_EngPower AINc_Nm_EngTor /end REF_CHARACTERISTIC /end FUNCTION
/begin FUNCTION ETH "Group /ByModelHeirarchy/Gasoline/4.Engine_Control/ETH" /begin SUB_FUNCTION ETH1 /end SUB_FUNCTION /end FUNCTION
/begin FUNCTION FCA_2.0 "Group /ByModelHeirarchy/Gasoline/4.Engine_Control/FCA_2.0"
 /begin LOC_MEASUREMENT FCA_Km_AcumDistance FCA_L_AcumFuelComsuption FCA_L_TotalFuelFlow FCA_kps_VhSpd /end LOC_MEASUREMENT
 /begin REF_CHARACTERISTIC FCAc_L_AcumFuelConsumption FCAc_b_ResetFuelAcum FCAc_b_ResetKmAcum FCAc_km_AcumDistance FCAca_L_AcumFuelConsumption FCAca_km_AcumDistance /end REF_CHARACTERISTIC
/end FUNCTION
/begin FUNCTION LogEnable106 "Group /ByModelHeirarchy/Gasoline/4.Engine_Control/HOURS/LogEnable10" /begin REF_CHARACTERISTIC LOGc_b_EnableCanLog /end REF_CHARACTERISTIC /end FUNCTION
/begin FUNCTION HOURS "Group /ByModelHeirarchy/Gasoline/4.Engine_Control/HOURS" /begin SUB_FUNCTION LogEnable106 /end SUB_FUNCTION /end FUNCTION
/begin FUNCTION LogEnable107 "Group /ByModelHeirarchy/Gasoline/4.Engine_Control/IC1_OK/LogEnable10" /begin REF_CHARACTERISTIC LOGc_b_EnableCanLog /end REF_CHARACTERISTIC /end FUNCTION
/begin FUNCTION IC1_OK "Group /ByModelHeirarchy/Gasoline/4.Engine_Control/IC1_OK" /begin SUB_FUNCTION LogEnable107 /end SUB_FUNCTION /end FUNCTION
/begin FUNCTION Active_Flag "Group /ByModelHeirarchy/Gasoline/4.Engine_Control/IDL/Active Flag"
 /begin REF_CHARACTERISTIC IDLc_RPM_ErrorActivationThrsh IDLc_RPM_LimitErrorActThrsh IDLc_s_Hold IDLc_s_StartupDelay /end REF_CHARACTERISTIC
/end FUNCTION
/begin FUNCTION D_Term "Group /ByModelHeirarchy/Gasoline/4.Engine_Control/IDL/Air control/D_Term" /begin REF_CHARACTERISTIC IDLc_NU_AirErrorROCThrsh /end REF_CHARACTERISTIC /end FUNCTION
/begin FUNCTION Integral_term "Group /ByModelHeirarchy/Gasoline/4.Engine_Control/IDL/Air control/Integral term"
 /begin REF_CHARACTERISTIC IDLc_NU_AirIMax IDLc_NU_AirIMin IDLc_RPM_AirErrorDbnd IDLc_RPM_ITermMaxError IDLc_RPM_ITermMinError /end REF_CHARACTERISTIC
/end FUNCTION
/begin FUNCTION Air_control "Group /ByModelHeirarchy/Gasoline/4.Engine_Control/IDL/Air control" /begin SUB_FUNCTION D_Term Integral_term /end SUB_FUNCTION
 /begin LOC_MEASUREMENT IDL_NU_AirDTerm IDL_NU_AirITerm IDL_NU_AirPIDEffort IDL_NU_AirPTerm IDL_NU_IdlAirGEAR_FF IDL_gps_IdlAC_FF IDL_gps_IdlAir_FF IDL_gps_IdlAir_PID /end LOC_MEASUREMENT
 /begin REF_CHARACTERISTIC IDLc_NU_AirPID_Dbnd IDLc_NU_AirPID_Max IDLc_NU_AirPID_Min IDLc_b_ITermAutoReset IDLc_pct_AirGainScale IDLm_NU_AirDGainNeg_x IDLm_NU_AirDGainNeg_z IDLm_NU_AirDGainPos_x IDLm_NU_AirDGainPos_z IDLm_NU_AirIGainNeg_x IDLm_NU_AirIGainNeg_z IDLm_NU_AirIGainPos_x IDLm_NU_AirIGainPos_z IDLm_NU_AirPGainNeg_x IDLm_NU_AirPGainNeg_z IDLm_NU_AirPGainPos_x IDLm_NU_AirPGainPos_z IDLm_NU_EffortToAir_x IDLm_NU_EffortToAir_z IDLm_NU_IdlAC_FF_x IDLm_NU_IdlAC_FF_z IDLm_NU_IdlAir_FF_x IDLm_NU_IdlAir_FF_y IDLm_NU_IdlAir_FF_z IDLm_gps_IdlAirGEAR_FF_x IDLm_gps_IdlAirGEAR_FF_y IDLm_gps_IdlAirGEAR_FF_z /end REF_CHARACTERISTIC
/end FUNCTION
/begin FUNCTION D_Term1 "Group /ByModelHeirarchy/Gasoline/4.Engine_Control/IDL/Spark control/D_Term" /begin REF_CHARACTERISTIC IDLc_NU_SparkErrorROCThrsh /end REF_CHARACTERISTIC /end FUNCTION
/begin FUNCTION Integral_term1 "Group /ByModelHeirarchy/Gasoline/4.Engine_Control/IDL/Spark control/Integral term"
 /begin REF_CHARACTERISTIC IDLc_NU_SparkIMax IDLc_NU_SparkIMin IDLc_RPM_SparkErrorDbnd IDLc_RPM_SparkITermMaxError IDLc_RPM_SparkITermMinError /end REF_CHARACTERISTIC
/end FUNCTION
/begin FUNCTION Spark_control "Group /ByModelHeirarchy/Gasoline/4.Engine_Control/IDL/Spark control" /begin SUB_FUNCTION D_Term1 Integral_term1 /end SUB_FUNCTION
 /begin LOC_MEASUREMENT IDL_NU_SparkDTerm IDL_NU_SparkITerm IDL_NU_SparkPID_Effort IDL_NU_SparkPTerm /end LOC_MEASUREMENT
 /begin REF_CHARACTERISTIC IDLc_NU_SparkPID_Dbnd IDLc_NU_SparkPID_Max IDLc_NU_SparkPID_Min IDLc_pct_SparkGainScale IDLm_NU_EffortToSpark_x IDLm_NU_EffortToSpark_z IDLm_NU_SparkDGainNeg_x IDLm_NU_SparkDGainNeg_z IDLm_NU_SparkDGainPos_x IDLm_NU_SparkDGainPos_z IDLm_NU_SparkIGainNeg_x IDLm_NU_SparkIGainNeg_z IDLm_NU_SparkIGainPos_x IDLm_NU_SparkIGainPos_z IDLm_NU_SparkPGainNeg_x IDLm_NU_SparkPGainNeg_z IDLm_NU_SparkPGainPos_x IDLm_NU_SparkPGainPos_z /end REF_CHARACTERISTIC
/end FUNCTION
/begin FUNCTION Subsystem2 "Group /ByModelHeirarchy/Gasoline/4.Engine_Control/IDL/Subsystem" /begin LOC_MEASUREMENT IDL_RPM_Added /end LOC_MEASUREMENT /begin REF_CHARACTERISTIC IDLc_RPM_ExitRPMAdder IDLc_s_HoldRPMAdder /end REF_CHARACTERISTIC /end FUNCTION
/begin FUNCTION AC_raised_idle "Group /ByModelHeirarchy/Gasoline/4.Engine_Control/IDL/Target Speed/AC raised idle" /begin REF_CHARACTERISTIC IDLc_RPM_AC_Adder IDLc_s_AC_Dbnc /end REF_CHARACTERISTIC /end FUNCTION
/begin FUNCTION Alternator_raised_idle "Group /ByModelHeirarchy/Gasoline/4.Engine_Control/IDL/Target Speed/Alternator raised idle" /begin LOC_MEASUREMENT IDL_RPM_AlternatorTermRaw /end LOC_MEASUREMENT
 /begin REF_CHARACTERISTIC IDLc_Hz_AlternatorTermLPF IDLc_NU_AlternatorFallRate IDLc_NU_AlternatorRiseRate IDLm_NU_Alternator_x IDLm_NU_Alternator_z /end REF_CHARACTERISTIC
/end FUNCTION
/begin FUNCTION OVR_AndExport65 "Group /ByModelHeirarchy/Gasoline/4.Engine_Control/IDL/Target Speed/OVR_AndExport5" /begin LOC_MEASUREMENT IDL_RPM_Trgt /end LOC_MEASUREMENT /begin REF_CHARACTERISTIC IDLc_RPM_Trgt IDLc_o_Trgt /end REF_CHARACTERISTIC /end FUNCTION
/begin FUNCTION Target_Speed "Group /ByModelHeirarchy/Gasoline/4.Engine_Control/IDL/Target Speed" /begin SUB_FUNCTION AC_raised_idle Alternator_raised_idle OVR_AndExport65 /end SUB_FUNCTION
 /begin LOC_MEASUREMENT IDL_RPM_AC_Term IDL_RPM_AlternatorTerm IDL_RPM_Base IDL_RPM_DrivingTerm /end LOC_MEASUREMENT
 /begin REF_CHARACTERISTIC IDLc_C_AmbTemp IDLc_RPM_DrivingAdder IDLc_RPM_MaxIdlSpd IDLc_kph_DrivingThrsh IDLm_NU_EngineTemp_x IDLm_NU_EngineTemp_z IDLm_NU_TimeSinceStart_x IDLm_NU_TimeSinceStart_z /end REF_CHARACTERISTIC
/end FUNCTION
/begin FUNCTION IDL "Group /ByModelHeirarchy/Gasoline/4.Engine_Control/IDL"
 /begin SUB_FUNCTION Active_Flag Air_control Spark_control Subsystem2 Target_Speed /end SUB_FUNCTION
 /begin LOC_MEASUREMENT IDL_NU_ErrorROC IDL_RPM_Error IDL_RPM_ErrorLPF IDL_RPM_Trgt_trt /end LOC_MEASUREMENT
 /begin REF_CHARACTERISTIC IDLc_Hz_ErrorLPF IDLc_b_IgnoreTransGear /end REF_CHARACTERISTIC
/end FUNCTION
/begin FUNCTION OVR_AndExport66 "Group /ByModelHeirarchy/Gasoline/4.Engine_Control/IJT DisplayablesPFI/OVR_AndExport1" /begin LOC_MEASUREMENT IJT_adv_SOC_Inj2 /end LOC_MEASUREMENT /begin REF_CHARACTERISTIC IJTc_adv_SOC_Inj2 IJTc_o_SOC_Inj2 /end REF_CHARACTERISTIC /end FUNCTION
/begin FUNCTION OVR_AndExport163 "Group /ByModelHeirarchy/Gasoline/4.Engine_Control/IJT DisplayablesPFI/OVR_AndExport16" /begin LOC_MEASUREMENT IJT_ms_OpeningDelayInj1 /end LOC_MEASUREMENT /begin REF_CHARACTERISTIC IJTc_ms_OpeningDelayInj1 IJTc_o_OpeningDelayInj1 /end REF_CHARACTERISTIC /end FUNCTION
/begin FUNCTION OVR_AndExport173 "Group /ByModelHeirarchy/Gasoline/4.Engine_Control/IJT DisplayablesPFI/OVR_AndExport17" /begin LOC_MEASUREMENT IJT_ms_OpeningDelayInj2 /end LOC_MEASUREMENT /begin REF_CHARACTERISTIC IJTc_ms_OpeningDelayInj2 IJTc_o_OpeningDelayInj2 /end REF_CHARACTERISTIC /end FUNCTION
/begin FUNCTION OVR_AndExport183 "Group /ByModelHeirarchy/Gasoline/4.Engine_Control/IJT DisplayablesPFI/OVR_AndExport18" /begin LOC_MEASUREMENT IJT_ms_OpeningDelayInj3 /end LOC_MEASUREMENT /begin REF_CHARACTERISTIC IJTc_ms_OpeningDelayInj3 IJTc_o_OpeningDelayInj3 /end REF_CHARACTERISTIC /end FUNCTION
/begin FUNCTION OVR_AndExport194 "Group /ByModelHeirarchy/Gasoline/4.Engine_Control/IJT DisplayablesPFI/OVR_AndExport19" /begin LOC_MEASUREMENT IJT_ms_OpeningDelayInj4 /end LOC_MEASUREMENT /begin REF_CHARACTERISTIC IJTc_ms_OpeningDelayInj4 IJTc_o_OpeningDelayInj4 /end REF_CHARACTERISTIC /end FUNCTION
/begin FUNCTION OVR_AndExport67 "Group /ByModelHeirarchy/Gasoline/4.Engine_Control/IJT DisplayablesPFI/OVR_AndExport2" /begin LOC_MEASUREMENT IJT_adv_SOC_Inj3 /end LOC_MEASUREMENT /begin REF_CHARACTERISTIC IJTc_adv_SOC_Inj3 IJTc_o_SOC_Inj3 /end REF_CHARACTERISTIC /end FUNCTION
/begin FUNCTION OVR_AndExport222 "Group /ByModelHeirarchy/Gasoline/4.Engine_Control/IJT DisplayablesPFI/OVR_AndExport22" /begin LOC_MEASUREMENT IJT_adv_SOC_Inj1 /end LOC_MEASUREMENT /begin REF_CHARACTERISTIC IJTc_adv_SOC_Inj1 IJTc_o_SOC_Inj1 /end REF_CHARACTERISTIC /end FUNCTION
/begin FUNCTION OVR_AndExport253 "Group /ByModelHeirarchy/Gasoline/4.Engine_Control/IJT DisplayablesPFI/OVR_AndExport25" /begin LOC_MEASUREMENT IJT_b_Inj1_InjectionSent /end LOC_MEASUREMENT /begin REF_CHARACTERISTIC IJTc_b_Inj1_InjectionSent IJTc_o_Inj1_InjectionSent /end REF_CHARACTERISTIC /end FUNCTION
/begin FUNCTION OVR_AndExport262 "Group /ByModelHeirarchy/Gasoline/4.Engine_Control/IJT DisplayablesPFI/OVR_AndExport26" /begin LOC_MEASUREMENT IJT_b_Inj2_InjectionSent /end LOC_MEASUREMENT /begin REF_CHARACTERISTIC IJTc_b_Inj2_InjectionSent IJTc_o_Inj2_InjectionSent /end REF_CHARACTERISTIC /end FUNCTION
/begin FUNCTION OVR_AndExport272 "Group /ByModelHeirarchy/Gasoline/4.Engine_Control/IJT DisplayablesPFI/OVR_AndExport27" /begin LOC_MEASUREMENT IJT_b_Inj3_InjectionSent /end LOC_MEASUREMENT /begin REF_CHARACTERISTIC IJTc_b_Inj3_InjectionSent IJTc_o_Inj3_InjectionSent /end REF_CHARACTERISTIC /end FUNCTION
/begin FUNCTION OVR_AndExport282 "Group /ByModelHeirarchy/Gasoline/4.Engine_Control/IJT DisplayablesPFI/OVR_AndExport28" /begin LOC_MEASUREMENT IJT_b_Inj4_InjectionSent /end LOC_MEASUREMENT /begin REF_CHARACTERISTIC IJTc_b_Inj4_InjectionSent IJTc_o_Inj4_InjectionSent /end REF_CHARACTERISTIC /end FUNCTION
/begin FUNCTION OVR_AndExport68 "Group /ByModelHeirarchy/Gasoline/4.Engine_Control/IJT DisplayablesPFI/OVR_AndExport3" /begin LOC_MEASUREMENT IJT_adv_SOC_Inj4 /end LOC_MEASUREMENT /begin REF_CHARACTERISTIC IJTc_adv_SOC_Inj4 IJTc_o_SOC_Inj4 /end REF_CHARACTERISTIC /end FUNCTION
/begin FUNCTION IJT_DisplayablesPFI "Group /ByModelHeirarchy/Gasoline/4.Engine_Control/IJT DisplayablesPFI"
 /begin SUB_FUNCTION OVR_AndExport66 OVR_AndExport163 OVR_AndExport173 OVR_AndExport183 OVR_AndExport194 OVR_AndExport67 OVR_AndExport222 OVR_AndExport253 OVR_AndExport262 OVR_AndExport272 OVR_AndExport282 OVR_AndExport68 /end SUB_FUNCTION
 /begin LOC_MEASUREMENT IJT_ms_Inj1 IJT_ms_Inj2 IJT_ms_Inj3 IJT_ms_Inj4 /end LOC_MEASUREMENT
/end FUNCTION
/begin FUNCTION Cylinder_Angles "Group /ByModelHeirarchy/Gasoline/4.Engine_Control/IJT_PFI/Injector activation monitor/Cylinder Angles" /begin REF_CHARACTERISTIC SYSv_deg_TDC_Angles /end REF_CHARACTERISTIC /end FUNCTION
/begin FUNCTION Injector_activation_monitor "Group /ByModelHeirarchy/Gasoline/4.Engine_Control/IJT_PFI/Injector activation monitor" /begin SUB_FUNCTION Cylinder_Angles /end SUB_FUNCTION /begin LOC_MEASUREMENT IJT_s_Slack /end LOC_MEASUREMENT /begin REF_CHARACTERISTIC IJTc_s_MinCalculationSlack /end REF_CHARACTERISTIC /end FUNCTION
/begin FUNCTION MakeVisible11 "Group /ByModelHeirarchy/Gasoline/4.Engine_Control/IJT_PFI/MakeVisible1/MakeVisible1" /begin LOC_MEASUREMENT IJT_deg_Inj1 /end LOC_MEASUREMENT /end FUNCTION
/begin FUNCTION MakeVisible2 "Group /ByModelHeirarchy/Gasoline/4.Engine_Control/IJT_PFI/MakeVisible1/MakeVisible2" /begin LOC_MEASUREMENT IJT_deg_Inj2 /end LOC_MEASUREMENT /end FUNCTION
/begin FUNCTION MakeVisible3 "Group /ByModelHeirarchy/Gasoline/4.Engine_Control/IJT_PFI/MakeVisible1/MakeVisible3" /begin LOC_MEASUREMENT IJT_deg_Inj3 /end LOC_MEASUREMENT /end FUNCTION
/begin FUNCTION MakeVisible4 "Group /ByModelHeirarchy/Gasoline/4.Engine_Control/IJT_PFI/MakeVisible1/MakeVisible4" /begin LOC_MEASUREMENT IJT_deg_Inj4 /end LOC_MEASUREMENT /end FUNCTION
/begin FUNCTION MakeVisible1 "Group /ByModelHeirarchy/Gasoline/4.Engine_Control/IJT_PFI/MakeVisible1" /begin SUB_FUNCTION MakeVisible11 MakeVisible2 MakeVisible3 MakeVisible4 /end SUB_FUNCTION /end FUNCTION
/begin FUNCTION MakeVisible12 "Group /ByModelHeirarchy/Gasoline/4.Engine_Control/IJT_PFI/MakeVisible2/MakeVisible1" /begin LOC_MEASUREMENT IJT_mg_Inj1 /end LOC_MEASUREMENT /end FUNCTION
/begin FUNCTION MakeVisible22 "Group /ByModelHeirarchy/Gasoline/4.Engine_Control/IJT_PFI/MakeVisible2/MakeVisible2" /begin LOC_MEASUREMENT IJT_mg_Inj2 /end LOC_MEASUREMENT /end FUNCTION
/begin FUNCTION MakeVisible31 "Group /ByModelHeirarchy/Gasoline/4.Engine_Control/IJT_PFI/MakeVisible2/MakeVisible3" /begin LOC_MEASUREMENT IJT_mg_Inj3 /end LOC_MEASUREMENT /end FUNCTION
/begin FUNCTION MakeVisible41 "Group /ByModelHeirarchy/Gasoline/4.Engine_Control/IJT_PFI/MakeVisible2/MakeVisible4" /begin LOC_MEASUREMENT IJT_mg_Inj4 /end LOC_MEASUREMENT /end FUNCTION
/begin FUNCTION MakeVisible21 "Group /ByModelHeirarchy/Gasoline/4.Engine_Control/IJT_PFI/MakeVisible2" /begin SUB_FUNCTION MakeVisible12 MakeVisible22 MakeVisible31 MakeVisible41 /end SUB_FUNCTION /end FUNCTION
/begin FUNCTION Opening_Delay "Group /ByModelHeirarchy/Gasoline/4.Engine_Control/IJT_PFI/Opening Delay" /begin LOC_MEASUREMENT IJT_ms_OpeningDelay /end LOC_MEASUREMENT
 /begin REF_CHARACTERISTIC IJTc_adv_SOC_Max IJTc_adv_SOC_Min IJTm_NU_OpeningDelayPFI_x IJTm_NU_OpeningDelayPFI_z SYSc_ret_InjDropDeadAng /end REF_CHARACTERISTIC
/end FUNCTION
/begin FUNCTION Priming_Pulse_Logic "Group /ByModelHeirarchy/Gasoline/4.Engine_Control/IJT_PFI/Priming Pulse Logic"
 /begin LOC_MEASUREMENT IJT_b_PrimingPulseActiveCyl1 IJT_b_PrimingPulseActiveCyl2 IJT_b_PrimingPulseActiveCyl3 IJT_b_PrimingPulseActiveCyl4 IJT_cnt_PrimingPulsesCyl1 IJT_cnt_PrimingPulsesCyl2 IJT_cnt_PrimingPulsesCyl3 IJT_cnt_PrimingPulsesCyl4 /end LOC_MEASUREMENT
 /begin REF_CHARACTERISTIC IJTc_b_PrimingPulseEnable IJTc_cnt_PrimingPulses IJTc_s_PrimingPulseTimeout /end REF_CHARACTERISTIC
/end FUNCTION
/begin FUNCTION Injector1 "Group /ByModelHeirarchy/Gasoline/4.Engine_Control/IJT_PFI/Quanitity/Per-Injector Compensation  Cylinder balancing/Injector1" /begin REF_CHARACTERISTIC IJTc_pct_Inj1_Balancing /end REF_CHARACTERISTIC /end FUNCTION
/begin FUNCTION Injector2 "Group /ByModelHeirarchy/Gasoline/4.Engine_Control/IJT_PFI/Quanitity/Per-Injector Compensation  Cylinder balancing/Injector2" /begin REF_CHARACTERISTIC IJTc_pct_Inj2_Balancing /end REF_CHARACTERISTIC /end FUNCTION
/begin FUNCTION Injector3 "Group /ByModelHeirarchy/Gasoline/4.Engine_Control/IJT_PFI/Quanitity/Per-Injector Compensation  Cylinder balancing/Injector3" /begin REF_CHARACTERISTIC IJTc_pct_Inj3_Balancing /end REF_CHARACTERISTIC /end FUNCTION
/begin FUNCTION Injector4 "Group /ByModelHeirarchy/Gasoline/4.Engine_Control/IJT_PFI/Quanitity/Per-Injector Compensation  Cylinder balancing/Injector4" /begin REF_CHARACTERISTIC IJTc_pct_Inj4_Balancing /end REF_CHARACTERISTIC /end FUNCTION
/begin FUNCTION Per_Injector_Compensation__Cyl0 "Group /ByModelHeirarchy/Gasoline/4.Engine_Control/IJT_PFI/Quanitity/Per-Injector Compensation  Cylinder balancing" /begin SUB_FUNCTION Injector1 Injector2 Injector3 Injector4 /end SUB_FUNCTION /end FUNCTION
/begin FUNCTION Range_Limit "Group /ByModelHeirarchy/Gasoline/4.Engine_Control/IJT_PFI/Quanitity/Range Limit" /begin REF_CHARACTERISTIC IJTc_mg_MaxInj IJTc_mg_MinInj /end REF_CHARACTERISTIC /end FUNCTION
/begin FUNCTION Temperature_Compensation "Group /ByModelHeirarchy/Gasoline/4.Engine_Control/IJT_PFI/Quanitity/Temperature Compensation" /begin LOC_MEASUREMENT IJT_pct_FuelTempCF /end LOC_MEASUREMENT /begin REF_CHARACTERISTIC IJTm_NU_FuelTempCF_x IJTm_NU_FuelTempCF_z /end REF_CHARACTERISTIC /end FUNCTION
/begin FUNCTION Quanitity "Group /ByModelHeirarchy/Gasoline/4.Engine_Control/IJT_PFI/Quanitity"
 /begin SUB_FUNCTION Per_Injector_Compensation__Cyl0 Range_Limit Temperature_Compensation /end SUB_FUNCTION
/end FUNCTION
/begin FUNCTION Detect_overlap "Group /ByModelHeirarchy/Gasoline/4.Engine_Control/IJT_PFI/QuantityToDuration/Detect overlap" /begin LOC_MEASUREMENT IJT_b_InjectorOverlap IJT_ms_OverlapThrsh /end LOC_MEASUREMENT /begin REF_CHARACTERISTIC IJTc_ms_OverlapOfst SYSc_cnt_NumOfCyls /end REF_CHARACTERISTIC /end FUNCTION
/begin FUNCTION QuantityToDuration "Group /ByModelHeirarchy/Gasoline/4.Engine_Control/IJT_PFI/QuantityToDuration" /begin SUB_FUNCTION Detect_overlap /end SUB_FUNCTION /begin LOC_MEASUREMENT IJT_bar_EffectivePress IJT_gps_InjectorFlowRatePFI /end LOC_MEASUREMENT
 /begin REF_CHARACTERISTIC IJTc_NU_FlowRateConstant IJTc_b_UseFlowRateTable IJTc_ms_ClosingDelayNoOverlap IJTc_ms_ClosingDelayWithOverlap IJTc_ms_Inj1 IJTc_ms_Inj2 IJTc_ms_Inj3 IJTc_ms_Inj4 IJTc_o_Inj1_PulseDur IJTc_o_Inj2_PulseDur IJTc_o_Inj3_PulseDur IJTc_o_Inj4_PulseDur IJTm_NU_FuelFlowOffset_x IJTm_NU_FuelFlowOffset_y IJTm_NU_FuelFlowOffset_z IJTm_NU_InjectorFlowMapPFI_x IJTm_NU_InjectorFlowMapPFI_y IJTm_NU_InjectorFlowMapPFI_z /end REF_CHARACTERISTIC
/end FUNCTION
/begin FUNCTION Cranking "Group /ByModelHeirarchy/Gasoline/4.Engine_Control/IJT_PFI/Timing/Cranking" /begin LOC_MEASUREMENT IJT_adv_CrankingSOI /end LOC_MEASUREMENT
 /begin REF_CHARACTERISTIC IJTm_NU_CrankingSOI_Pulse1_x IJTm_NU_CrankingSOI_Pulse1_y IJTm_NU_CrankingSOI_Pulse1_z /end REF_CHARACTERISTIC
/end FUNCTION
/begin FUNCTION Running "Group /ByModelHeirarchy/Gasoline/4.Engine_Control/IJT_PFI/Timing/Running" /begin LOC_MEASUREMENT IJT_adv_RunningSOI /end LOC_MEASUREMENT
 /begin REF_CHARACTERISTIC IJTm_NU_RunningSOI_Pulse1_x IJTm_NU_RunningSOI_Pulse1_y IJTm_NU_RunningSOI_Pulse1_z /end REF_CHARACTERISTIC
/end FUNCTION
/begin FUNCTION Timing "Group /ByModelHeirarchy/Gasoline/4.Engine_Control/IJT_PFI/Timing" /begin SUB_FUNCTION Cranking Running /end SUB_FUNCTION /end FUNCTION
/begin FUNCTION Total_Fuel_Flow "Group /ByModelHeirarchy/Gasoline/4.Engine_Control/IJT_PFI/Total Fuel Flow" /begin LOC_MEASUREMENT IJT_NU_TotalFuelFlowKgPerHr IJT_gps_TotalFuelFlow /end LOC_MEASUREMENT /end FUNCTION
/begin FUNCTION IJT_PFI "Group /ByModelHeirarchy/Gasoline/4.Engine_Control/IJT_PFI"
 /begin SUB_FUNCTION Injector_activation_monitor MakeVisible1 MakeVisible21 Opening_Delay Priming_Pulse_Logic Quanitity QuantityToDuration Timing Total_Fuel_Flow /end SUB_FUNCTION
 /begin REF_CHARACTERISTIC IJTc_ms_PrimingPulseFlowTime /end REF_CHARACTERISTIC
/end FUNCTION
/begin FUNCTION OVR_AndExport323 "Group /ByModelHeirarchy/Gasoline/4.Engine_Control/KNK/KnockFlag/KNOCKFLT_Cyl1_DTC152/OVR_AndExport34" /begin LOC_MEASUREMENT DTC_b_KNOCK_Cyl1 /end LOC_MEASUREMENT /begin REF_CHARACTERISTIC DTCc_b_KNOCK_Cyl1 DTCc_o_KNOCK_Cyl1 /end REF_CHARACTERISTIC /end FUNCTION
/begin FUNCTION KNOCKFLT_Cyl1_DTC152 "Group /ByModelHeirarchy/Gasoline/4.Engine_Control/KNK/KnockFlag/KNOCKFLT_Cyl1_DTC152" /begin SUB_FUNCTION OVR_AndExport323 /end SUB_FUNCTION /end FUNCTION
/begin FUNCTION OVR_AndExport324 "Group /ByModelHeirarchy/Gasoline/4.Engine_Control/KNK/KnockFlag/KNOCKFLT_Cyl2_DTC153/OVR_AndExport34" /begin LOC_MEASUREMENT DTC_b_KNOCK_Cyl2 /end LOC_MEASUREMENT /begin REF_CHARACTERISTIC DTCc_b_KNOCK_Cyl2 DTCc_o_KNOCK_Cyl2 /end REF_CHARACTERISTIC /end FUNCTION
/begin FUNCTION KNOCKFLT_Cyl2_DTC153 "Group /ByModelHeirarchy/Gasoline/4.Engine_Control/KNK/KnockFlag/KNOCKFLT_Cyl2_DTC153" /begin SUB_FUNCTION OVR_AndExport324 /end SUB_FUNCTION /end FUNCTION
/begin FUNCTION OVR_AndExport325 "Group /ByModelHeirarchy/Gasoline/4.Engine_Control/KNK/KnockFlag/KNOCKFLT_Cyl3_DTC154/OVR_AndExport34" /begin LOC_MEASUREMENT DTC_b_KNOCK_Cyl3 /end LOC_MEASUREMENT /begin REF_CHARACTERISTIC DTCc_b_KNOCK_Cyl3 DTCc_o_KNOCK_Cyl3 /end REF_CHARACTERISTIC /end FUNCTION
/begin FUNCTION KNOCKFLT_Cyl3_DTC154 "Group /ByModelHeirarchy/Gasoline/4.Engine_Control/KNK/KnockFlag/KNOCKFLT_Cyl3_DTC154" /begin SUB_FUNCTION OVR_AndExport325 /end SUB_FUNCTION /end FUNCTION
/begin FUNCTION OVR_AndExport326 "Group /ByModelHeirarchy/Gasoline/4.Engine_Control/KNK/KnockFlag/KNOCKFLT_Cyl4_DTC155/OVR_AndExport34" /begin LOC_MEASUREMENT DTC_b_KNOCK_Cyl4 /end LOC_MEASUREMENT /begin REF_CHARACTERISTIC DTCc_b_KNOCK_Cyl4 DTCc_o_KNOCK_Cyl4 /end REF_CHARACTERISTIC /end FUNCTION
/begin FUNCTION KNOCKFLT_Cyl4_DTC155 "Group /ByModelHeirarchy/Gasoline/4.Engine_Control/KNK/KnockFlag/KNOCKFLT_Cyl4_DTC155" /begin SUB_FUNCTION OVR_AndExport326 /end SUB_FUNCTION /end FUNCTION
/begin FUNCTION LogEnable31 "Group /ByModelHeirarchy/Gasoline/4.Engine_Control/KNK/KnockFlag/LogEnable3" /begin REF_CHARACTERISTIC LOGc_b_EnableCanLog /end REF_CHARACTERISTIC /end FUNCTION
/begin FUNCTION OVR_AndExport45 "Group /ByModelHeirarchy/Gasoline/4.Engine_Control/KNK/KnockFlag/OVR_AndExport45" /begin LOC_MEASUREMENT DTC_NU_KNKButaneThr /end LOC_MEASUREMENT /begin REF_CHARACTERISTIC DTCc_NU_KNKButaneThr DTCc_o_KNKButaneThr /end REF_CHARACTERISTIC /end FUNCTION
/begin FUNCTION KnockFlag "Group /ByModelHeirarchy/Gasoline/4.Engine_Control/KNK/KnockFlag"
 /begin SUB_FUNCTION KNOCKFLT_Cyl1_DTC152 KNOCKFLT_Cyl2_DTC153 KNOCKFLT_Cyl3_DTC154 KNOCKFLT_Cyl4_DTC155 LogEnable31 OVR_AndExport45 /end SUB_FUNCTION
 /begin REF_CHARACTERISTIC DTCc_NU_KNKButaneAlarm DTCc_b_ResetKnockCounters DTCc_cnt_KnockHIT DTCc_s_ResetKnockPeriodic KNKc_pct_LoadDetectionThers KNKm_pct_DetectionThresh_x KNKm_pct_DetectionThresh_z /end REF_CHARACTERISTIC
/end FUNCTION
/begin FUNCTION RetardFromSensor "Group /ByModelHeirarchy/Gasoline/4.Engine_Control/KNK/RetardFromSensor"
 /begin REF_CHARACTERISTIC KNKc_adv_AdvanceStep KNKc_ret_SensorBasedMax KNKc_s_RetardHoldTime KNKm_NU_RetardStep_x KNKm_NU_RetardStep_z /end REF_CHARACTERISTIC
/end FUNCTION
/begin FUNCTION KNK "Group /ByModelHeirarchy/Gasoline/4.Engine_Control/KNK" /begin SUB_FUNCTION KnockFlag RetardFromSensor /end SUB_FUNCTION
 /begin LOC_MEASUREMENT KNK_NU_EngSpdCorr KNK_b_EnrichFuel KNK_b_NewKnockEvent KNK_ret_SensorBased KNK_ret_TempBased /end LOC_MEASUREMENT
 /begin REF_CHARACTERISTIC KNKc_b_Enbl KNKc_lam_AntiKnock KNKc_ret_SparkModMax KNKm_NU_EngSpdCorr_x KNKm_NU_EngSpdCorr_z KNKm_NU_SparkRetard_x KNKm_NU_SparkRetard_y KNKm_NU_SparkRetard_z /end REF_CHARACTERISTIC
/end FUNCTION
/begin FUNCTION LogEnable108 "Group /ByModelHeirarchy/Gasoline/4.Engine_Control/LFE/LogEnable10" /begin REF_CHARACTERISTIC LOGc_b_EnableCanLog /end REF_CHARACTERISTIC /end FUNCTION
/begin FUNCTION LFE "Group /ByModelHeirarchy/Gasoline/4.Engine_Control/LFE" /begin SUB_FUNCTION LogEnable108 /end SUB_FUNCTION /end FUNCTION
/begin FUNCTION LogEnable109 "Group /ByModelHeirarchy/Gasoline/4.Engine_Control/LFE1_OK/LogEnable10" /begin REF_CHARACTERISTIC LOGc_b_EnableCanLog /end REF_CHARACTERISTIC /end FUNCTION
/begin FUNCTION LFE1_OK "Group /ByModelHeirarchy/Gasoline/4.Engine_Control/LFE1_OK" /begin SUB_FUNCTION LogEnable109 /end SUB_FUNCTION /end FUNCTION
/begin FUNCTION _38A00Cx "Group /ByModelHeirarchy/Gasoline/4.Engine_Control/Manual/38A00Cx" /begin LOC_MEASUREMENT SYS_cnt_LoopCounter /end LOC_MEASUREMENT /end FUNCTION
/begin FUNCTION LogEnable15 "Group /ByModelHeirarchy/Gasoline/4.Engine_Control/Manual/LogEnable1" /begin REF_CHARACTERISTIC LOGc_b_EnableCanLog /end REF_CHARACTERISTIC /end FUNCTION
/begin FUNCTION LogEnable21 "Group /ByModelHeirarchy/Gasoline/4.Engine_Control/Manual/LogEnable2" /begin REF_CHARACTERISTIC LOGc_b_EnableCanLog /end REF_CHARACTERISTIC /end FUNCTION
/begin FUNCTION LogEnable32 "Group /ByModelHeirarchy/Gasoline/4.Engine_Control/Manual/LogEnable3" /begin REF_CHARACTERISTIC LOGc_b_EnableCanLog /end REF_CHARACTERISTIC /end FUNCTION
/begin FUNCTION LogEnable42 "Group /ByModelHeirarchy/Gasoline/4.Engine_Control/Manual/LogEnable4" /begin REF_CHARACTERISTIC LOGc_b_EnableCanLog /end REF_CHARACTERISTIC /end FUNCTION
/begin FUNCTION LogEnable51 "Group /ByModelHeirarchy/Gasoline/4.Engine_Control/Manual/LogEnable5" /begin REF_CHARACTERISTIC LOGc_b_EnableCanLog /end REF_CHARACTERISTIC /end FUNCTION
/begin FUNCTION LogEnable63 "Group /ByModelHeirarchy/Gasoline/4.Engine_Control/Manual/LogEnable6" /begin REF_CHARACTERISTIC LOGc_b_EnableCanLog /end REF_CHARACTERISTIC /end FUNCTION
/begin FUNCTION LogEnable72 "Group /ByModelHeirarchy/Gasoline/4.Engine_Control/Manual/LogEnable7" /begin REF_CHARACTERISTIC LOGc_b_EnableCanLog /end REF_CHARACTERISTIC /end FUNCTION
/begin FUNCTION LogEnable84 "Group /ByModelHeirarchy/Gasoline/4.Engine_Control/Manual/LogEnable8" /begin REF_CHARACTERISTIC LOGc_b_EnableCanLog /end REF_CHARACTERISTIC /end FUNCTION
/begin FUNCTION LogEnable92 "Group /ByModelHeirarchy/Gasoline/4.Engine_Control/Manual/LogEnable9" /begin REF_CHARACTERISTIC LOGc_b_EnableCanLog /end REF_CHARACTERISTIC /end FUNCTION
/begin FUNCTION x0810A000OK "Group /ByModelHeirarchy/Gasoline/4.Engine_Control/Manual/x0810A000OK" /begin LOC_MEASUREMENT SYS_cnt_LoopCounter /end LOC_MEASUREMENT /end FUNCTION
/begin FUNCTION Manual "Group /ByModelHeirarchy/Gasoline/4.Engine_Control/Manual"
 /begin SUB_FUNCTION _38A00Cx LogEnable15 LogEnable21 LogEnable32 LogEnable42 LogEnable51 LogEnable63 LogEnable72 LogEnable84 LogEnable92 x0810A000OK /end SUB_FUNCTION
 /begin REF_CHARACTERISTIC LOGc_b_ZF_man_ena /end REF_CHARACTERISTIC
/end FUNCTION
/begin FUNCTION OVR_AndExport69 "Group /ByModelHeirarchy/Gasoline/4.Engine_Control/OVR_AndExport1" /begin LOC_MEASUREMENT AFR_lam_FinalTrgt1 /end LOC_MEASUREMENT /begin REF_CHARACTERISTIC AFRc_lam_FinalTrgt1 AFRc_o_FinalTrgt1 /end REF_CHARACTERISTIC /end FUNCTION
/begin FUNCTION OVR_AndExport104 "Group /ByModelHeirarchy/Gasoline/4.Engine_Control/OVR_AndExport10" /begin LOC_MEASUREMENT ERM_e_RunningMode /end LOC_MEASUREMENT /begin REF_CHARACTERISTIC ERMc_e_RunningMode ERMc_o_RunningMode /end REF_CHARACTERISTIC /end FUNCTION
/begin FUNCTION OVR_AndExport125 "Group /ByModelHeirarchy/Gasoline/4.Engine_Control/OVR_AndExport12" /begin LOC_MEASUREMENT DRL_gps_DynoAirRqst /end LOC_MEASUREMENT /begin REF_CHARACTERISTIC DRLc_gps_DynoAirRqst DRLc_o_DynoAirRqst /end REF_CHARACTERISTIC /end FUNCTION
/begin FUNCTION OVR_AndExport133 "Group /ByModelHeirarchy/Gasoline/4.Engine_Control/OVR_AndExport13" /begin LOC_MEASUREMENT ERM_s_TimeSinceStart /end LOC_MEASUREMENT /begin REF_CHARACTERISTIC ERMc_o_TimeSinceStart ERMc_s_TimeSinceStart /end REF_CHARACTERISTIC /end FUNCTION
/begin FUNCTION OVR_AndExport145 "Group /ByModelHeirarchy/Gasoline/4.Engine_Control/OVR_AndExport14" /begin LOC_MEASUREMENT IDL_gps_Air /end LOC_MEASUREMENT /begin REF_CHARACTERISTIC IDLc_gps_Air IDLc_o_Air /end REF_CHARACTERISTIC /end FUNCTION
/begin FUNCTION OVR_AndExport153 "Group /ByModelHeirarchy/Gasoline/4.Engine_Control/OVR_AndExport15" /begin LOC_MEASUREMENT IDL_ret_Spark /end LOC_MEASUREMENT /begin REF_CHARACTERISTIC IDLc_o_Spark IDLc_ret_Spark /end REF_CHARACTERISTIC /end FUNCTION
/begin FUNCTION OVR_AndExport164 "Group /ByModelHeirarchy/Gasoline/4.Engine_Control/OVR_AndExport16" /begin LOC_MEASUREMENT TAR_Nm_TqRqst /end LOC_MEASUREMENT /begin REF_CHARACTERISTIC TARc_Nm_TqRqst TARc_o_TqRqst /end REF_CHARACTERISTIC /end FUNCTION
/begin FUNCTION OVR_AndExport174 "Group /ByModelHeirarchy/Gasoline/4.Engine_Control/OVR_AndExport17" /begin LOC_MEASUREMENT BAS_adv_BaseSpark /end LOC_MEASUREMENT /begin REF_CHARACTERISTIC BASc_adv_BaseSpark BASc_o_BaseSpark /end REF_CHARACTERISTIC /end FUNCTION
/begin FUNCTION OVR_AndExport184 "Group /ByModelHeirarchy/Gasoline/4.Engine_Control/OVR_AndExport18" /begin LOC_MEASUREMENT ERL_b_Active /end LOC_MEASUREMENT /begin REF_CHARACTERISTIC ERLc_b_Active ERLc_o_Active /end REF_CHARACTERISTIC /end FUNCTION
/begin FUNCTION OVR_AndExport195 "Group /ByModelHeirarchy/Gasoline/4.Engine_Control/OVR_AndExport19" /begin LOC_MEASUREMENT ERL_pct_TqMult /end LOC_MEASUREMENT /begin REF_CHARACTERISTIC ERLc_o_TqMult ERLc_pct_TqMult /end REF_CHARACTERISTIC /end FUNCTION
/begin FUNCTION OVR_AndExport70 "Group /ByModelHeirarchy/Gasoline/4.Engine_Control/OVR_AndExport2" /begin LOC_MEASUREMENT APP_Nm_DrvrDmndTq /end LOC_MEASUREMENT /begin REF_CHARACTERISTIC APPc_Nm_DrvrDmndTq APPc_o_DrvrDmndTq /end REF_CHARACTERISTIC /end FUNCTION
/begin FUNCTION OVR_AndExport203 "Group /ByModelHeirarchy/Gasoline/4.Engine_Control/OVR_AndExport20" /begin LOC_MEASUREMENT ERL_ret_SparkRetard /end LOC_MEASUREMENT /begin REF_CHARACTERISTIC ERLc_o_SparkRetard ERLc_ret_SparkRetard /end REF_CHARACTERISTIC /end FUNCTION
/begin FUNCTION OVR_AndExport213 "Group /ByModelHeirarchy/Gasoline/4.Engine_Control/OVR_AndExport21" /begin LOC_MEASUREMENT ERL_b_CutSpark /end LOC_MEASUREMENT /begin REF_CHARACTERISTIC ERLc_b_CutSpark ERLc_o_CutSpark /end REF_CHARACTERISTIC /end FUNCTION
/begin FUNCTION OVR_AndExport223 "Group /ByModelHeirarchy/Gasoline/4.Engine_Control/OVR_AndExport22" /begin LOC_MEASUREMENT SAR_adv_SparkAng /end LOC_MEASUREMENT /begin REF_CHARACTERISTIC SARc_adv_SparkAng SARc_o_SparkAng /end REF_CHARACTERISTIC /end FUNCTION
/begin FUNCTION OVR_AndExport231 "Group /ByModelHeirarchy/Gasoline/4.Engine_Control/OVR_AndExport23" /begin LOC_MEASUREMENT SPT_adv_CoilOnAng /end LOC_MEASUREMENT /begin REF_CHARACTERISTIC SPTc_adv_CoilOnAng SPTc_o_CoilOnAng /end REF_CHARACTERISTIC /end FUNCTION
/begin FUNCTION OVR_AndExport242 "Group /ByModelHeirarchy/Gasoline/4.Engine_Control/OVR_AndExport24" /begin LOC_MEASUREMENT SPT_adv_CoilOffAng /end LOC_MEASUREMENT /begin REF_CHARACTERISTIC SPTc_adv_CoilOffAng SPTc_o_CoilOffAng /end REF_CHARACTERISTIC /end FUNCTION
/begin FUNCTION OVR_AndExport263 "Group /ByModelHeirarchy/Gasoline/4.Engine_Control/OVR_AndExport26" /begin LOC_MEASUREMENT TUR_b_AtMinBoost /end LOC_MEASUREMENT /begin REF_CHARACTERISTIC TURc_b_AtMinBoost TURc_o_AtMinBoost /end REF_CHARACTERISTIC /end FUNCTION
/begin FUNCTION OVR_AndExport273 "Group /ByModelHeirarchy/Gasoline/4.Engine_Control/OVR_AndExport27" /begin LOC_MEASUREMENT AME_pct_Load /end LOC_MEASUREMENT /begin REF_CHARACTERISTIC AMEc_o_Load AMEc_pct_Load /end REF_CHARACTERISTIC /end FUNCTION
/begin FUNCTION OVR_AndExport283 "Group /ByModelHeirarchy/Gasoline/4.Engine_Control/OVR_AndExport28" /begin LOC_MEASUREMENT ADM_ret_VCP_Trgt /end LOC_MEASUREMENT /begin REF_CHARACTERISTIC ADMc_o_VCP_Trgt ADMc_ret_VCP_Trgt /end REF_CHARACTERISTIC /end FUNCTION
/begin FUNCTION OVR_AndExport292 "Group /ByModelHeirarchy/Gasoline/4.Engine_Control/OVR_AndExport29" /begin LOC_MEASUREMENT ADM_deg_ThrottleTrgt /end LOC_MEASUREMENT /begin REF_CHARACTERISTIC ADMc_deg_ThrottleTrgt ADMc_o_ThrottleTrgt /end REF_CHARACTERISTIC /end FUNCTION
/begin FUNCTION OVR_AndExport71 "Group /ByModelHeirarchy/Gasoline/4.Engine_Control/OVR_AndExport3" /begin LOC_MEASUREMENT APP_pct_Dmnd /end LOC_MEASUREMENT /begin REF_CHARACTERISTIC APPc_o_Dmnd APPc_pct_Dmnd /end REF_CHARACTERISTIC /end FUNCTION
/begin FUNCTION OVR_AndExport302 "Group /ByModelHeirarchy/Gasoline/4.Engine_Control/OVR_AndExport30" /begin LOC_MEASUREMENT ADM_b_TurOverspeed /end LOC_MEASUREMENT /begin REF_CHARACTERISTIC ADMc_b_TurOverspeed ADMc_o_TurOverspeed /end REF_CHARACTERISTIC /end FUNCTION
/begin FUNCTION OVR_AndExport312 "Group /ByModelHeirarchy/Gasoline/4.Engine_Control/OVR_AndExport31" /begin LOC_MEASUREMENT ADM_kPa_BoostPressTrgt /end LOC_MEASUREMENT /begin REF_CHARACTERISTIC ADMc_kPa_BoostPressTrgt ADMc_o_BoostPressTrgt /end REF_CHARACTERISTIC /end FUNCTION
/begin FUNCTION OVR_AndExport322 "Group /ByModelHeirarchy/Gasoline/4.Engine_Control/OVR_AndExport32" /begin LOC_MEASUREMENT IDL_b_Actv /end LOC_MEASUREMENT /begin REF_CHARACTERISTIC IDLc_b_Actv IDLc_o_Actv /end REF_CHARACTERISTIC /end FUNCTION
/begin FUNCTION OVR_AndExport332 "Group /ByModelHeirarchy/Gasoline/4.Engine_Control/OVR_AndExport33" /begin LOC_MEASUREMENT VCP_pct_CamDC /end LOC_MEASUREMENT /begin REF_CHARACTERISTIC VCPc_o_CamDC VCPc_pct_CamDC /end REF_CHARACTERISTIC /end FUNCTION
/begin FUNCTION OVR_AndExport327 "Group /ByModelHeirarchy/Gasoline/4.Engine_Control/OVR_AndExport34" /begin LOC_MEASUREMENT TUR_b_AtMaxBoost /end LOC_MEASUREMENT /begin REF_CHARACTERISTIC TURc_b_AtMaxBoost TURc_o_AtMaxBoost /end REF_CHARACTERISTIC /end FUNCTION
/begin FUNCTION OVR_AndExport352 "Group /ByModelHeirarchy/Gasoline/4.Engine_Control/OVR_AndExport35" /begin LOC_MEASUREMENT CLF_lam_FB1_Ctrl /end LOC_MEASUREMENT /begin REF_CHARACTERISTIC CLFc_lam_FB1_Ctrl CLFc_o_FB1_Ctrl /end REF_CHARACTERISTIC /end FUNCTION
/begin FUNCTION OVR_AndExport362 "Group /ByModelHeirarchy/Gasoline/4.Engine_Control/OVR_AndExport36" /begin LOC_MEASUREMENT CLF_lam_LTFT1 /end LOC_MEASUREMENT /begin REF_CHARACTERISTIC CLFc_lam_LTFT1 CLFc_o_LTFT1 /end REF_CHARACTERISTIC /end FUNCTION
/begin FUNCTION OVR_AndExport373 "Group /ByModelHeirarchy/Gasoline/4.Engine_Control/OVR_AndExport37" /begin LOC_MEASUREMENT TUR_pct_TurCtrlDC /end LOC_MEASUREMENT /begin REF_CHARACTERISTIC TURc_o_TurCtrlDC TURc_pct_TurCtrlDC /end REF_CHARACTERISTIC /end FUNCTION
/begin FUNCTION OVR_AndExport384 "Group /ByModelHeirarchy/Gasoline/4.Engine_Control/OVR_AndExport38" /begin LOC_MEASUREMENT ADM_gps_AirDemandRAW /end LOC_MEASUREMENT /begin REF_CHARACTERISTIC ADMc_gps_AirDemandRAW ADMc_o_AirDemandRAW /end REF_CHARACTERISTIC /end FUNCTION
/begin FUNCTION OVR_AndExport394 "Group /ByModelHeirarchy/Gasoline/4.Engine_Control/OVR_AndExport39" /begin LOC_MEASUREMENT ETC_pct_MotorCmd /end LOC_MEASUREMENT /begin REF_CHARACTERISTIC ETCc_o_MotorCmd ETCc_pct_MotorCmd /end REF_CHARACTERISTIC /end FUNCTION
/begin FUNCTION OVR_AndExport72 "Group /ByModelHeirarchy/Gasoline/4.Engine_Control/OVR_AndExport4" /begin LOC_MEASUREMENT APP_e_PdlMode /end LOC_MEASUREMENT /begin REF_CHARACTERISTIC APPc_e_PdlMode APPc_o_PdlMode /end REF_CHARACTERISTIC /end FUNCTION
/begin FUNCTION OVR_AndExport401 "Group /ByModelHeirarchy/Gasoline/4.Engine_Control/OVR_AndExport40" /begin LOC_MEASUREMENT CTC_lam_FuelOfst /end LOC_MEASUREMENT /begin REF_CHARACTERISTIC CTCc_lam_FuelOfst CTCc_o_FuelOfst /end REF_CHARACTERISTIC /end FUNCTION
/begin FUNCTION OVR_AndExport411 "Group /ByModelHeirarchy/Gasoline/4.Engine_Control/OVR_AndExport41" /begin LOC_MEASUREMENT CTC_ret_SparkRqst /end LOC_MEASUREMENT /begin REF_CHARACTERISTIC CTCc_o_SparkRqst CTCc_ret_SparkRqst /end REF_CHARACTERISTIC /end FUNCTION
/begin FUNCTION OVR_AndExport421 "Group /ByModelHeirarchy/Gasoline/4.Engine_Control/OVR_AndExport42" /begin LOC_MEASUREMENT FCA_lpk_AverageFuelConsumption /end LOC_MEASUREMENT
 /begin REF_CHARACTERISTIC FCAc_lpk_AverageFuelConsumption FCAc_o_AverageFuelConsumption /end REF_CHARACTERISTIC
/end FUNCTION
/begin FUNCTION OVR_AndExport43 "Group /ByModelHeirarchy/Gasoline/4.Engine_Control/OVR_AndExport43" /begin LOC_MEASUREMENT AME_kPa_Baro /end LOC_MEASUREMENT /begin REF_CHARACTERISTIC AMEc_kPa_Baro AMEc_o_Baro /end REF_CHARACTERISTIC /end FUNCTION
/begin FUNCTION OVR_AndExport451 "Group /ByModelHeirarchy/Gasoline/4.Engine_Control/OVR_AndExport45" /begin LOC_MEASUREMENT KNK_lam_AFR_Lim /end LOC_MEASUREMENT /begin REF_CHARACTERISTIC KNKc_lam_AFR_Lim KNKc_o_AFR_Lim /end REF_CHARACTERISTIC /end FUNCTION
/begin FUNCTION OVR_AndExport46 "Group /ByModelHeirarchy/Gasoline/4.Engine_Control/OVR_AndExport46" /begin LOC_MEASUREMENT KNK_ret_SparkMod /end LOC_MEASUREMENT /begin REF_CHARACTERISTIC KNKc_o_SparkMod KNKc_ret_SparkMod /end REF_CHARACTERISTIC /end FUNCTION
/begin FUNCTION OVR_AndExport47 "Group /ByModelHeirarchy/Gasoline/4.Engine_Control/OVR_AndExport47" /begin LOC_MEASUREMENT TRF_lam_Trim /end LOC_MEASUREMENT /begin REF_CHARACTERISTIC TRFc_lam_Trim TRFc_o_Trim /end REF_CHARACTERISTIC /end FUNCTION
/begin FUNCTION OVR_AndExport481 "Group /ByModelHeirarchy/Gasoline/4.Engine_Control/OVR_AndExport48" /begin LOC_MEASUREMENT ETC_pct_AvgTP /end LOC_MEASUREMENT /begin REF_CHARACTERISTIC ETCc_o_AvgTP ETCc_pct_AvgTP /end REF_CHARACTERISTIC /end FUNCTION
/begin FUNCTION OVR_AndExport491 "Group /ByModelHeirarchy/Gasoline/4.Engine_Control/OVR_AndExport49" /begin LOC_MEASUREMENT ETC_b_AuthorityReduced /end LOC_MEASUREMENT /begin REF_CHARACTERISTIC ETCc_b_AuthorityReduced ETCc_o_AuthorityReduced /end REF_CHARACTERISTIC /end FUNCTION
/begin FUNCTION OVR_AndExport73 "Group /ByModelHeirarchy/Gasoline/4.Engine_Control/OVR_AndExport5" /begin LOC_MEASUREMENT APP_b_Fault /end LOC_MEASUREMENT /begin REF_CHARACTERISTIC APPc_b_Fault APPc_o_Fault /end REF_CHARACTERISTIC /end FUNCTION
/begin FUNCTION OVR_AndExport50 "Group /ByModelHeirarchy/Gasoline/4.Engine_Control/OVR_AndExport50" /begin LOC_MEASUREMENT ERL_b_CutFuel /end LOC_MEASUREMENT /begin REF_CHARACTERISTIC ERLc_b_CutFuel ERLc_o_CutFuel /end REF_CHARACTERISTIC /end FUNCTION
/begin FUNCTION OVR_AndExport51 "Group /ByModelHeirarchy/Gasoline/4.Engine_Control/OVR_AndExport51" /begin LOC_MEASUREMENT CLF_lam_O2_Dither1 /end LOC_MEASUREMENT /begin REF_CHARACTERISTIC CLFc_lam_O2_Dither1 CLFc_o_O2_Dither1 /end REF_CHARACTERISTIC /end FUNCTION
/begin FUNCTION OVR_AndExport52 "Group /ByModelHeirarchy/Gasoline/4.Engine_Control/OVR_AndExport52" /begin LOC_MEASUREMENT AME_mg_FreshAirMass /end LOC_MEASUREMENT /begin REF_CHARACTERISTIC AMEc_mg_FreshAirMass AMEc_o_FreshAirMass /end REF_CHARACTERISTIC /end FUNCTION
/begin FUNCTION OVR_AndExport541 "Group /ByModelHeirarchy/Gasoline/4.Engine_Control/OVR_AndExport54" /begin LOC_MEASUREMENT TUR_b_CompBypassValve /end LOC_MEASUREMENT /begin REF_CHARACTERISTIC TURc_b_CompBypassValve TURc_o_CompBypassValve /end REF_CHARACTERISTIC /end FUNCTION
/begin FUNCTION OVR_AndExport55 "Group /ByModelHeirarchy/Gasoline/4.Engine_Control/OVR_AndExport55" /begin LOC_MEASUREMENT CPL_ret_SparkRetardRqst /end LOC_MEASUREMENT /begin REF_CHARACTERISTIC CPLc_o_SparkRetardRqst CPLc_ret_SparkRetardRqst /end REF_CHARACTERISTIC /end FUNCTION
/begin FUNCTION OVR_AndExport56 "Group /ByModelHeirarchy/Gasoline/4.Engine_Control/OVR_AndExport56" /begin LOC_MEASUREMENT CPL_b_CutSpark /end LOC_MEASUREMENT /begin REF_CHARACTERISTIC CPLc_b_CutSpark CPLc_o_CutSpark /end REF_CHARACTERISTIC /end FUNCTION
/begin FUNCTION OVR_AndExport57 "Group /ByModelHeirarchy/Gasoline/4.Engine_Control/OVR_AndExport57" /begin LOC_MEASUREMENT ADM_pct_AirDemand /end LOC_MEASUREMENT /begin REF_CHARACTERISTIC ADMc_o_AirDemand ADMc_pct_AirDemand /end REF_CHARACTERISTIC /end FUNCTION
/begin FUNCTION OVR_AndExport58 "Group /ByModelHeirarchy/Gasoline/4.Engine_Control/OVR_AndExport58" /begin LOC_MEASUREMENT TRS_ret_SparkRqst /end LOC_MEASUREMENT /begin REF_CHARACTERISTIC TRSc_o_SparkRqst TRSc_ret_SparkRqst /end REF_CHARACTERISTIC /end FUNCTION
/begin FUNCTION OVR_AndExport68 "Group /ByModelHeirarchy/Gasoline/4.Engine_Control/OVR_AndExport6" /begin LOC_MEASUREMENT BAF_mg_FuelRqst1 /end LOC_MEASUREMENT /begin REF_CHARACTERISTIC BAFc_mg_FuelRqst1 BAFc_o_FuelRqst1 /end REF_CHARACTERISTIC /end FUNCTION
/begin FUNCTION OVR_AndExport60 "Group /ByModelHeirarchy/Gasoline/4.Engine_Control/OVR_AndExport60" /begin LOC_MEASUREMENT CLF_b_FB1_Active /end LOC_MEASUREMENT /begin REF_CHARACTERISTIC CLFc_b_FB1_Active CLFc_o_FB1_Active /end REF_CHARACTERISTIC /end FUNCTION
/begin FUNCTION OVR_AndExport63 "Group /ByModelHeirarchy/Gasoline/4.Engine_Control/OVR_AndExport63" /begin LOC_MEASUREMENT CLF_b_FB2_Active /end LOC_MEASUREMENT /begin REF_CHARACTERISTIC CLFc_b_FB2_Active CLFc_o_FB2_Active /end REF_CHARACTERISTIC /end FUNCTION
/begin FUNCTION OVR_AndExport64 "Group /ByModelHeirarchy/Gasoline/4.Engine_Control/OVR_AndExport64" /begin LOC_MEASUREMENT CLF_lam_LTFT2 /end LOC_MEASUREMENT /begin REF_CHARACTERISTIC CLFc_lam_LTFT2 CLFc_o_LTFT2 /end REF_CHARACTERISTIC /end FUNCTION
/begin FUNCTION OVR_AndExport65 "Group /ByModelHeirarchy/Gasoline/4.Engine_Control/OVR_AndExport65" /begin LOC_MEASUREMENT CLF_lam_FB2_Ctrl /end LOC_MEASUREMENT /begin REF_CHARACTERISTIC CLFc_lam_FB2_Ctrl CLFc_o_FB2_Ctrl /end REF_CHARACTERISTIC /end FUNCTION
/begin FUNCTION OVR_AndExport66 "Group /ByModelHeirarchy/Gasoline/4.Engine_Control/OVR_AndExport66" /begin LOC_MEASUREMENT CLF_lam_O2_Dither2 /end LOC_MEASUREMENT /begin REF_CHARACTERISTIC CLFc_lam_O2_Dither2 CLFc_o_O2_Dither2 /end REF_CHARACTERISTIC /end FUNCTION
/begin FUNCTION OVR_AndExport67 "Group /ByModelHeirarchy/Gasoline/4.Engine_Control/OVR_AndExport67" /begin LOC_MEASUREMENT AFR_lam_FinalTrgt2 /end LOC_MEASUREMENT /begin REF_CHARACTERISTIC AFRc_lam_FinalTrgt2 AFRc_o_FinalTrgt2 /end REF_CHARACTERISTIC /end FUNCTION
/begin FUNCTION OVR_AndExport77 "Group /ByModelHeirarchy/Gasoline/4.Engine_Control/OVR_AndExport7" /begin LOC_MEASUREMENT DFC_ret_SparkRetard /end LOC_MEASUREMENT /begin REF_CHARACTERISTIC DFCc_o_SparkRetard DFCc_ret_SparkRetard /end REF_CHARACTERISTIC /end FUNCTION
/begin FUNCTION OVR_AndExport86 "Group /ByModelHeirarchy/Gasoline/4.Engine_Control/OVR_AndExport8" /begin LOC_MEASUREMENT DFC_b_FuelCut /end LOC_MEASUREMENT /begin REF_CHARACTERISTIC DFCc_b_FuelCut DFCc_o_FuelCut /end REF_CHARACTERISTIC /end FUNCTION
/begin FUNCTION OVR_AndExport96 "Group /ByModelHeirarchy/Gasoline/4.Engine_Control/OVR_AndExport9" /begin LOC_MEASUREMENT ELM_Nm_Tq /end LOC_MEASUREMENT /begin REF_CHARACTERISTIC ELMc_Nm_Tq ELMc_o_Tq /end REF_CHARACTERISTIC /end FUNCTION
/begin FUNCTION ACC1 "Group /ByModelHeirarchy/Gasoline/4.Engine_Control/Powertrain_Can.ZF/GeneratedMsgs/ACC1" /begin REF_CHARACTERISTIC LOGc_b_ACC1_gen /end REF_CHARACTERISTIC /end FUNCTION
/begin FUNCTION AEBS1 "Group /ByModelHeirarchy/Gasoline/4.Engine_Control/Powertrain_Can.ZF/GeneratedMsgs/AEBS1" /begin REF_CHARACTERISTIC LOGc_b_AEBS1_gen /end REF_CHARACTERISTIC /end FUNCTION
/begin FUNCTION ML "Group /ByModelHeirarchy/Gasoline/4.Engine_Control/Powertrain_Can.ZF/GeneratedMsgs/ML" /begin REF_CHARACTERISTIC LOGc_b_ML_gen /end REF_CHARACTERISTIC /end FUNCTION
/begin FUNCTION VDC1 "Group /ByModelHeirarchy/Gasoline/4.Engine_Control/Powertrain_Can.ZF/GeneratedMsgs/VDC1" /begin REF_CHARACTERISTIC LOGc_b_VDC1_gen /end REF_CHARACTERISTIC /end FUNCTION
/begin FUNCTION VDC2 "Group /ByModelHeirarchy/Gasoline/4.Engine_Control/Powertrain_Can.ZF/GeneratedMsgs/VDC2" /begin REF_CHARACTERISTIC LOGc_b_VDC2_gen /end REF_CHARACTERISTIC /end FUNCTION
/begin FUNCTION VDHR_generated "Group /ByModelHeirarchy/Gasoline/4.Engine_Control/Powertrain_Can.ZF/GeneratedMsgs/VHDR/VDHR_generated" /begin REF_CHARACTERISTIC OUTc_km_Totaldistance /end REF_CHARACTERISTIC /end FUNCTION
/begin FUNCTION VHDR "Group /ByModelHeirarchy/Gasoline/4.Engine_Control/Powertrain_Can.ZF/GeneratedMsgs/VHDR" /begin SUB_FUNCTION VDHR_generated /end SUB_FUNCTION /begin REF_CHARACTERISTIC LOGc_b_VDHR_gen /end REF_CHARACTERISTIC /end FUNCTION
/begin FUNCTION GeneratedMsgs "Group /ByModelHeirarchy/Gasoline/4.Engine_Control/Powertrain_Can.ZF/GeneratedMsgs" /begin SUB_FUNCTION ACC1 AEBS1 ML VDC1 VDC2 VHDR /end SUB_FUNCTION /end FUNCTION
/begin FUNCTION LogEnable16 "Group /ByModelHeirarchy/Gasoline/4.Engine_Control/Powertrain_Can.ZF/LogEnable1" /begin REF_CHARACTERISTIC LOGc_b_EnableCanLog /end REF_CHARACTERISTIC /end FUNCTION
/begin FUNCTION LogEnable107 "Group /ByModelHeirarchy/Gasoline/4.Engine_Control/Powertrain_Can.ZF/LogEnable10" /begin REF_CHARACTERISTIC LOGc_b_EnableCanLog /end REF_CHARACTERISTIC /end FUNCTION
/begin FUNCTION LogEnable22 "Group /ByModelHeirarchy/Gasoline/4.Engine_Control/Powertrain_Can.ZF/LogEnable2" /begin REF_CHARACTERISTIC LOGc_b_EnableCanLog /end REF_CHARACTERISTIC /end FUNCTION
/begin FUNCTION LogEnable33 "Group /ByModelHeirarchy/Gasoline/4.Engine_Control/Powertrain_Can.ZF/LogEnable3" /begin REF_CHARACTERISTIC LOGc_b_EnableCanLog /end REF_CHARACTERISTIC /end FUNCTION
/begin FUNCTION LogEnable43 "Group /ByModelHeirarchy/Gasoline/4.Engine_Control/Powertrain_Can.ZF/LogEnable4" /begin REF_CHARACTERISTIC LOGc_b_EnableCanLog /end REF_CHARACTERISTIC /end FUNCTION
/begin FUNCTION LogEnable52 "Group /ByModelHeirarchy/Gasoline/4.Engine_Control/Powertrain_Can.ZF/LogEnable5" /begin REF_CHARACTERISTIC LOGc_b_EnableCanLog /end REF_CHARACTERISTIC /end FUNCTION
/begin FUNCTION OVR_AndExport74 "Group /ByModelHeirarchy/Gasoline/4.Engine_Control/Powertrain_Can.ZF/OVR_AndExport1" /begin LOC_MEASUREMENT OUT_b_18FDC40B_ena /end LOC_MEASUREMENT /begin REF_CHARACTERISTIC OUTc_b_18FDC40B_ena OUTc_o_18FDC40B_ena /end REF_CHARACTERISTIC /end FUNCTION
/begin FUNCTION OVR_AndExport165 "Group /ByModelHeirarchy/Gasoline/4.Engine_Control/Powertrain_Can.ZF/OVR_AndExport16" /begin LOC_MEASUREMENT OUT_b_18F0010B_ena /end LOC_MEASUREMENT /begin REF_CHARACTERISTIC OUTc_b_18F0010B_ena OUTc_o_18F0010B_ena /end REF_CHARACTERISTIC /end FUNCTION
/begin FUNCTION OVR_AndExport75 "Group /ByModelHeirarchy/Gasoline/4.Engine_Control/Powertrain_Can.ZF/OVR_AndExport2" /begin LOC_MEASUREMENT OUT_b_18FEEE00_ena /end LOC_MEASUREMENT /begin REF_CHARACTERISTIC OUTc_b_18FEEE00_ena OUTc_o_18FEEE00_ena /end REF_CHARACTERISTIC /end FUNCTION
/begin FUNCTION OVR_AndExport76 "Group /ByModelHeirarchy/Gasoline/4.Engine_Control/Powertrain_Can.ZF/OVR_AndExport3" /begin LOC_MEASUREMENT OUT_b_18FEE600_ena /end LOC_MEASUREMENT /begin REF_CHARACTERISTIC OUTc_b_18FEE600_ena OUTc_o_18FEE600_ena /end REF_CHARACTERISTIC /end FUNCTION
/begin FUNCTION OVR_AndExport77 "Group /ByModelHeirarchy/Gasoline/4.Engine_Control/Powertrain_Can.ZF/OVR_AndExport4" /begin LOC_MEASUREMENT OUT_b_18F00000_ena /end LOC_MEASUREMENT /begin REF_CHARACTERISTIC OUTc_b_18F00000_ena OUTc_o_18F00000_ena /end REF_CHARACTERISTIC /end FUNCTION
/begin FUNCTION OVR_AndExport78 "Group /ByModelHeirarchy/Gasoline/4.Engine_Control/Powertrain_Can.ZF/OVR_AndExport5" /begin LOC_MEASUREMENT OUT_b_18FEE100_ena /end LOC_MEASUREMENT /begin REF_CHARACTERISTIC OUTc_b_18FEE100_ena OUTc_o_18FEE100_ena /end REF_CHARACTERISTIC /end FUNCTION
/begin FUNCTION OVR_AndExport69 "Group /ByModelHeirarchy/Gasoline/4.Engine_Control/Powertrain_Can.ZF/OVR_AndExport6" /begin LOC_MEASUREMENT OUT_b_18FE6E00_ena /end LOC_MEASUREMENT /begin REF_CHARACTERISTIC OUTc_b_18FE6E00_ena OUTc_o_18FE6E00_ena /end REF_CHARACTERISTIC /end FUNCTION
/begin FUNCTION OVR_AndExport78 "Group /ByModelHeirarchy/Gasoline/4.Engine_Control/Powertrain_Can.ZF/OVR_AndExport7" /begin LOC_MEASUREMENT OUT_b_TCO_ena /end LOC_MEASUREMENT /begin REF_CHARACTERISTIC OUTc_b_TCO_ena OUTc_o_TCO_ena /end REF_CHARACTERISTIC /end FUNCTION
/begin FUNCTION Powertrain_Can.ZF "Group /ByModelHeirarchy/Gasoline/4.Engine_Control/Powertrain_Can.ZF"
 /begin SUB_FUNCTION GeneratedMsgs LogEnable16 LogEnable107 LogEnable22 LogEnable33 LogEnable43 LogEnable52 OVR_AndExport74 OVR_AndExport165 OVR_AndExport75 OVR_AndExport76 OVR_AndExport77 OVR_AndExport78 OVR_AndExport69 OVR_AndExport78 /end SUB_FUNCTION
 /begin REF_CHARACTERISTIC HRWc_NU_VehSpeed_Gain HRWc_NU_VehSpeed_Ofst OUTc_b_18F00000 OUTc_b_18F0010B OUTc_b_18FDC40B OUTc_b_18FE6E00 OUTc_b_18FEE100 OUTc_b_18FEE600 OUTc_b_18FEEE00 OUTc_b_TCO TCOc_NU_VehSpeed_Gain TCOc_NU_VehSpeed_Ofst /end REF_CHARACTERISTIC
/end FUNCTION
/begin FUNCTION Displayables2 "Group /ByModelHeirarchy/Gasoline/4.Engine_Control/RFC/Fuelpath Model/Displayables"
 /begin LOC_MEASUREMENT RFC_pct_PfInvCyl1 RFC_pct_PfInvCyl2 RFC_pct_PfInvCyl3 RFC_pct_PfInvCyl4 /end LOC_MEASUREMENT
/end FUNCTION
/begin FUNCTION Fuelpath_Model "Group /ByModelHeirarchy/Gasoline/4.Engine_Control/RFC/Fuelpath Model" /begin SUB_FUNCTION Displayables2 /end SUB_FUNCTION /begin LOC_MEASUREMENT RFC_pct_WallWetFraction RFC_s_PuddleVapTime /end LOC_MEASUREMENT
 /begin REF_CHARACTERISTIC RFCc_pct_MaxEnlean RFCc_pct_MaxEnrich RFCm_NU_PuddleVapTime_x RFCm_NU_PuddleVapTime_y RFCm_NU_PuddleVapTime_z RFCm_NU_WallWetFraction_x RFCm_NU_WallWetFraction_y RFCm_NU_WallWetFraction_z SYSv_cnt_CylIndex /end REF_CHARACTERISTIC
/end FUNCTION
/begin FUNCTION RFC "Group /ByModelHeirarchy/Gasoline/4.Engine_Control/RFC" /begin SUB_FUNCTION Fuelpath_Model /end SUB_FUNCTION
 /begin LOC_MEASUREMENT RFC_b_Active RFC_mg_FuelRqstDelta RFC_pct_RelativePfInv RFC_s_DbncTimer RFC_s_ExpTimer /end LOC_MEASUREMENT
 /begin REF_CHARACTERISTIC RFCc_b_Enable RFCc_mg_FuelRqstDeltaThrsh RFCc_pct_PfInvThrsh RFCc_s_DbncTimer RFCc_s_ExpTimer SYSv_cnt_CylIndex /end REF_CHARACTERISTIC
/end FUNCTION
/begin FUNCTION SAR "Group /ByModelHeirarchy/Gasoline/4.Engine_Control/SAR" /begin LOC_MEASUREMENT SAR_ret_ArbitratedRetardRqst /end LOC_MEASUREMENT
 /begin REF_CHARACTERISTIC SARc_NU_MBT_RiseRate SARc_adv_RunningSparkMax SARc_adv_RunningSparkMin /end REF_CHARACTERISTIC
/end FUNCTION
/begin FUNCTION LogEnable108 "Group /ByModelHeirarchy/Gasoline/4.Engine_Control/SHUTDN/LogEnable10" /begin REF_CHARACTERISTIC LOGc_b_EnableCanLog /end REF_CHARACTERISTIC /end FUNCTION
/begin FUNCTION SHUTDN "Group /ByModelHeirarchy/Gasoline/4.Engine_Control/SHUTDN" /begin SUB_FUNCTION LogEnable108 /end SUB_FUNCTION /end FUNCTION
/begin FUNCTION _512 "Group /ByModelHeirarchy/Gasoline/4.Engine_Control/SPN 544 /unnamed/ 512" /begin REF_CHARACTERISTIC TARc_Nm_EngReferenceTorque /end REF_CHARACTERISTIC /end FUNCTION
/begin FUNCTION unnamed "Group /ByModelHeirarchy/Gasoline/4.Engine_Control/SPN 544 /unnamed" /begin SUB_FUNCTION _512 /end SUB_FUNCTION /end FUNCTION
/begin FUNCTION SPN_544_ "Group /ByModelHeirarchy/Gasoline/4.Engine_Control/SPN 544 " /begin SUB_FUNCTION unnamed /end SUB_FUNCTION /end FUNCTION
/begin FUNCTION _1 "Group /ByModelHeirarchy/Gasoline/4.Engine_Control/SPN 544/unnamed/1"
 /begin LOC_MEASUREMENT TAR_Nm_EEC1Tq TAR_Nm_EEC1Tqt TAR_Nm_TqFromAir TAR_Nm_TqFromMAP TAR_Nm_TqFromMAP_Idle TAR_Nm_TqiFromMAP_Idle TAR_Nm_TqiFromModel TAR_b_TqFromMAP_act /end LOC_MEASUREMENT
 /begin REF_CHARACTERISTIC TARc_Hz_IdlAirToTqLPF TARc_b_EnableIdl_ELM TARc_b_TqModelSelect TARc_s_EEC1TimeTqSmooth TARm_Nm_AirToTq_x TARm_Nm_AirToTq_y TARm_Nm_AirToTq_z TARm_Nm_IdlMAPToTq_x TARm_Nm_IdlMAPToTq_y TARm_Nm_IdlMAPToTq_z TARm_Nm_MAPToTq_x TARm_Nm_MAPToTq_y TARm_Nm_MAPToTq_z /end REF_CHARACTERISTIC
/end FUNCTION
/begin FUNCTION unnamed1 "Group /ByModelHeirarchy/Gasoline/4.Engine_Control/SPN 544/unnamed" /begin SUB_FUNCTION _1 /end SUB_FUNCTION /end FUNCTION
/begin FUNCTION SPN_544 "Group /ByModelHeirarchy/Gasoline/4.Engine_Control/SPN 544" /begin SUB_FUNCTION unnamed1 /end SUB_FUNCTION /end FUNCTION
/begin FUNCTION SPT "Group /ByModelHeirarchy/Gasoline/4.Engine_Control/SPT"
 /begin LOC_MEASUREMENT SPT_deg_DwellTime SPT_ms_DwellTime SPT_ms_DwellTimeRaw SPT_ms_MaxDwellTime /end LOC_MEASUREMENT
 /begin REF_CHARACTERISTIC SPTc_b_UseHalfVBatt SPTc_ms_MinDwellTime SPTc_ms_MinOffTime SPTm_NU_DwellTime_x SPTm_NU_DwellTime_z /end REF_CHARACTERISTIC
/end FUNCTION
/begin FUNCTION OVR_AndExport166 "Group /ByModelHeirarchy/Gasoline/4.Engine_Control/TAR/ESP  tq management /Subsystem/OVR_AndExport16" /begin LOC_MEASUREMENT TAR_b_DTC_TqLimit /end LOC_MEASUREMENT /begin REF_CHARACTERISTIC TARc_b_DTC_TqLimit TARc_o_DTC_TqLimit /end REF_CHARACTERISTIC /end FUNCTION
/begin FUNCTION Subsystem3 "Group /ByModelHeirarchy/Gasoline/4.Engine_Control/TAR/ESP  tq management /Subsystem" /begin SUB_FUNCTION OVR_AndExport166 /end SUB_FUNCTION /begin REF_CHARACTERISTIC TARc_Nm_DTC_LimitTq TARc_s_DTC_LimitTime /end REF_CHARACTERISTIC /end FUNCTION
/begin FUNCTION ESP__tq_management_ "Group /ByModelHeirarchy/Gasoline/4.Engine_Control/TAR/ESP  tq management " /begin SUB_FUNCTION Subsystem3 /end SUB_FUNCTION /end FUNCTION
/begin FUNCTION ESP__tq_management "Group /ByModelHeirarchy/Gasoline/4.Engine_Control/TAR/ESP  tq management" /begin LOC_MEASUREMENT CIN_Nm_TqCtrRq_ESP /end LOC_MEASUREMENT /begin REF_CHARACTERISTIC TARc_Nm_EngReferenceTorque /end REF_CHARACTERISTIC /end FUNCTION
/begin FUNCTION ESP_CAN_DrvrDmnd "Group /ByModelHeirarchy/Gasoline/4.Engine_Control/TAR/ESP_CAN_DrvrDmnd" /begin REF_CHARACTERISTIC TARc_Hz_IdlAirToTqLPF /end REF_CHARACTERISTIC /end FUNCTION
/begin FUNCTION GEAR_tq_management "Group /ByModelHeirarchy/Gasoline/4.Engine_Control/TAR/GEAR tq management" /begin LOC_MEASUREMENT CIN_Nm_TqCtrRq_TCM /end LOC_MEASUREMENT /begin REF_CHARACTERISTIC TARc_Nm_EngReferenceTorque /end REF_CHARACTERISTIC /end FUNCTION
/begin FUNCTION OVR_AndExport79 "Group /ByModelHeirarchy/Gasoline/4.Engine_Control/TAR/OVR_AndExport1" /begin LOC_MEASUREMENT TAR_b_LimpHome /end LOC_MEASUREMENT /begin REF_CHARACTERISTIC TARc_b_LimpHome TARc_o_LimpHome /end REF_CHARACTERISTIC /end FUNCTION
/begin FUNCTION Anti_Clunk_Rate_Limit "Group /ByModelHeirarchy/Gasoline/4.Engine_Control/TAR/Torque Smoothing/Anti-Clunk Rate Limit"
 /begin REF_CHARACTERISTIC TARc_NU_ClunkTqFallRate TARc_NU_ClunkTqRiseRate TARc_NU_TqFallRate TARc_NU_TqRiseRate TARc_Nm_ClunkRegionMax TARc_Nm_ClunkRegionMin TARc_kph_ClunkEnblVehSpd /end REF_CHARACTERISTIC
/end FUNCTION
/begin FUNCTION Torque_Smoothing "Group /ByModelHeirarchy/Gasoline/4.Engine_Control/TAR/Torque Smoothing" /begin SUB_FUNCTION Anti_Clunk_Rate_Limit /end SUB_FUNCTION /begin REF_CHARACTERISTIC TARc_Hz_BrakeTqLPF /end REF_CHARACTERISTIC /end FUNCTION
/begin FUNCTION TAR "Group /ByModelHeirarchy/Gasoline/4.Engine_Control/TAR"
 /begin SUB_FUNCTION ESP__tq_management_ ESP__tq_management ESP_CAN_DrvrDmnd GEAR_tq_management OVR_AndExport79 Torque_Smoothing /end SUB_FUNCTION
 /begin LOC_MEASUREMENT TAR_Nm_EngDmnd TAR_Nm_MaxTqTable TAR_Nm_RawArbTqRqst /end LOC_MEASUREMENT
 /begin REF_CHARACTERISTIC ADMm_C_ExahustTemplimp_x ADMm_C_ExahustTemplimp_z TARc_Nm_DFCTorque TARc_Nm_Max TARm_Nm_MaxTqTable_x TARm_Nm_MaxTqTable_y TARm_Nm_MaxTqTable_z /end REF_CHARACTERISTIC
/end FUNCTION
/begin FUNCTION LogEnable109 "Group /ByModelHeirarchy/Gasoline/4.Engine_Control/TC1/LogEnable10" /begin REF_CHARACTERISTIC LOGc_b_EnableCanLog /end REF_CHARACTERISTIC /end FUNCTION
/begin FUNCTION TC1 "Group /ByModelHeirarchy/Gasoline/4.Engine_Control/TC1" /begin SUB_FUNCTION LogEnable109 /end SUB_FUNCTION /end FUNCTION
/begin FUNCTION TRF "Group /ByModelHeirarchy/Gasoline/4.Engine_Control/TRF"
 /begin LOC_MEASUREMENT TRF_Nm_TqHPF TRF_b_Actv TRF_b_Transient TRF_lam_EnrichmentRqst /end LOC_MEASUREMENT
 /begin REF_CHARACTERISTIC TRFc_NU_TqHPF_TC TRFc_Nm_FallingTransientThrsh TRFc_Nm_RisingTransientThrsh TRFc_RPM_CoolantTempEnblThrsh TRFc_RPM_EngSpdEnblThrsh TRFc_b_IdlDisable TRFc_lam_MaxEnrichment TRFc_lam_MinEnrichment TRFm_NU_EnrichmentRqst_x TRFm_NU_EnrichmentRqst_y TRFm_NU_EnrichmentRqst_z /end REF_CHARACTERISTIC
/end FUNCTION
/begin FUNCTION TRS "Group /ByModelHeirarchy/Gasoline/4.Engine_Control/TRS"
 /begin LOC_MEASUREMENT TRS_Nm_TqHPF TRS_Nm_TqHPF_Peak TRS_b_Transient TRS_ret_SparkRqstRaw /end LOC_MEASUREMENT
 /begin REF_CHARACTERISTIC TRSc_NU_SparkFallRate TRSc_NU_TqHPF_TC TRSc_Nm_TqHPF_Thrsh TRSc_lam_AFR_EnblThrsh TRSc_s_AFR_EnblDelay TRSm_NU_SparkRqst_x TRSm_NU_SparkRqst_y TRSm_NU_SparkRqst_z /end REF_CHARACTERISTIC
/end FUNCTION
/begin FUNCTION Derivative_Control "Group /ByModelHeirarchy/Gasoline/4.Engine_Control/TUR/Derivative Control" /begin LOC_MEASUREMENT TUR_NU_BoostPressErrROC TUR_pct_DTerm /end LOC_MEASUREMENT /begin REF_CHARACTERISTIC TURc_NU_BoostPressErrROC_Thrsh TURc_NU_DGain /end REF_CHARACTERISTIC /end FUNCTION
/begin FUNCTION Enable_WG "Group /ByModelHeirarchy/Gasoline/4.Engine_Control/TUR/Enable WG" /begin REF_CHARACTERISTIC TURc_kPa_MechanicalSetpoint /end REF_CHARACTERISTIC /end FUNCTION
/begin FUNCTION Integral_Control "Group /ByModelHeirarchy/Gasoline/4.Engine_Control/TUR/Integral Control" /begin LOC_MEASUREMENT TUR_pct_ITerm /end LOC_MEASUREMENT
 /begin REF_CHARACTERISTIC TURc_NU_IGain TURc_b_ResetITerm TURc_kPa_DbndLatchI TURc_pct_ITermMax TURc_pct_ITermMin /end REF_CHARACTERISTIC
/end FUNCTION
/begin FUNCTION OVR_AndExport363 "Group /ByModelHeirarchy/Gasoline/4.Engine_Control/TUR/OVR_AndExport36" /begin LOC_MEASUREMENT DTC_b_TurboError /end LOC_MEASUREMENT /begin REF_CHARACTERISTIC DTCc_b_TurboError DTCc_o_TurboError /end REF_CHARACTERISTIC /end FUNCTION
/begin FUNCTION Proportional_Control "Group /ByModelHeirarchy/Gasoline/4.Engine_Control/TUR/Proportional Control" /begin LOC_MEASUREMENT TUR_pct_PTerm /end LOC_MEASUREMENT /begin REF_CHARACTERISTIC TURc_NU_PGain /end REF_CHARACTERISTIC /end FUNCTION
/begin FUNCTION TUR "Group /ByModelHeirarchy/Gasoline/4.Engine_Control/TUR"
 /begin SUB_FUNCTION Derivative_Control Enable_WG Integral_Control OVR_AndExport363 Proportional_Control /end SUB_FUNCTION
 /begin LOC_MEASUREMENT TUR_NU_FB_DC TUR_NU_FF_DC TUR_NU_PressRatioTrgt TUR_kPa_BoostPressErr TUR_pct_FB_Effort TUR_pct_FB_EffortRaw TUR_pct_FF_Effort TUR_pct_TotalEffort TUR_pct_TotalEffortRaw /end LOC_MEASUREMENT
 /begin REF_CHARACTERISTIC AINc_Hz_FR_TurboErr AINc_Hz_RT_TurboErr TURc_b_FBTableUse TURc_b_UsePrRatioForCtrl TURc_kPa_TurboErroThr TURc_pct_FB_EffortDbndMax TURc_pct_FB_EffortDbndMin TURm_NU_EffortToDuty_x TURm_NU_EffortToDuty_z TURm_NU_FF1_x TURm_NU_FF1_y TURm_NU_FF1_z TURm_NU_FF_x TURm_NU_FF_y TURm_NU_FF_z /end REF_CHARACTERISTIC
/end FUNCTION
/begin FUNCTION VCT_Derivative_Controller "Group /ByModelHeirarchy/Gasoline/4.Engine_Control/VCP/Variable cam phaser control/feedback controller/VCT_Derivative_Controller" /begin LOC_MEASUREMENT VCP_NU_CamErrROC VCP_pct_CamDTerm /end LOC_MEASUREMENT /begin REF_CHARACTERISTIC VCPc_NU_CamDGain VCPc_NU_CamErrROCThrsh /end REF_CHARACTERISTIC /end FUNCTION
/begin FUNCTION Latch_ITerm_at_end_stops "Group /ByModelHeirarchy/Gasoline/4.Engine_Control/VCP/Variable cam phaser control/feedback controller/VCT_Integral_Controller/Latch ITerm at end stops" /begin REF_CHARACTERISTIC VCPc_deg_CamHiLatchI VCPc_deg_CamLoLatchI /end REF_CHARACTERISTIC /end FUNCTION
/begin FUNCTION VCT_Integral_Controller "Group /ByModelHeirarchy/Gasoline/4.Engine_Control/VCP/Variable cam phaser control/feedback controller/VCT_Integral_Controller" /begin SUB_FUNCTION Latch_ITerm_at_end_stops /end SUB_FUNCTION /begin LOC_MEASUREMENT VCP_pct_CamITerm /end LOC_MEASUREMENT
 /begin REF_CHARACTERISTIC VCPc_NU_CamIGain VCPc_adv_CamHiStop VCPc_adv_CamLoStop VCPc_deg_CamDbndLatchI VCPc_pct_CamITermMax VCPc_pct_CamITermMin /end REF_CHARACTERISTIC
/end FUNCTION
/begin FUNCTION feedback_controller "Group /ByModelHeirarchy/Gasoline/4.Engine_Control/VCP/Variable cam phaser control/feedback controller" /begin SUB_FUNCTION VCT_Derivative_Controller VCT_Integral_Controller /end SUB_FUNCTION /begin LOC_MEASUREMENT VCP_pct_CamPIDRaw VCP_pct_CamPTerm /end LOC_MEASUREMENT
 /begin REF_CHARACTERISTIC VCPc_NU_CamPGain VCPc_b_CamResetITerm VCPc_pct_CamPID_Dbnd VCPc_pct_CamPID_Max VCPc_pct_CamPID_Min /end REF_CHARACTERISTIC
/end FUNCTION
/begin FUNCTION Variable_cam_phaser_control "Group /ByModelHeirarchy/Gasoline/4.Engine_Control/VCP/Variable cam phaser control" /begin SUB_FUNCTION feedback_controller /end SUB_FUNCTION /begin LOC_MEASUREMENT VCP_deg_CamErr VCP_pct_CamDC_FF VCP_pct_CamDC_PID /end LOC_MEASUREMENT
 /begin REF_CHARACTERISTIC VCPm_NU_CamDC_FF_x VCPm_NU_CamDC_FF_y VCPm_NU_CamDC_FF_z VCPm_NU_DutyCycle_x VCPm_NU_DutyCycle_z /end REF_CHARACTERISTIC
/end FUNCTION
/begin FUNCTION VCP "Group /ByModelHeirarchy/Gasoline/4.Engine_Control/VCP" /begin SUB_FUNCTION Variable_cam_phaser_control /end SUB_FUNCTION /begin LOC_MEASUREMENT VCP_adv_CamTrgt /end LOC_MEASUREMENT /begin REF_CHARACTERISTIC VCPc_NU_TrgtFallRate VCPc_NU_TrgtRiseRate /end REF_CHARACTERISTIC /end FUNCTION
/begin FUNCTION LogEnable34 "Group /ByModelHeirarchy/Gasoline/4.Engine_Control/VEP1_OK/LogEnable3" /begin REF_CHARACTERISTIC LOGc_b_EnableCanLog /end REF_CHARACTERISTIC /end FUNCTION
/begin FUNCTION VEP1_OK "Group /ByModelHeirarchy/Gasoline/4.Engine_Control/VEP1_OK" /begin SUB_FUNCTION LogEnable34 /end SUB_FUNCTION /end FUNCTION
/end MODULE
/end PROJECT
