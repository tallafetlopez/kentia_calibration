ASAP2_VERSION 1 31
/begin PROJECT M670_Engine_Control_1.2.0_M670_000 "BeGas B430LG Turbocharged engine"
/begin HEADER "Begas Motor 2017-2022 (c)" VERSION "1_2_0" /end HEADER
/begin MODULE OpenECU_M670_000 ""
/* Scalar calibration for DDE 'DTCc_o_MAPAfterThr_LV'. */
/begin CHARACTERISTIC DTCc_o_MAPAfterThr_LV "Override value" VALUE 0x8c030 RL_DTCC_O_MAPAFTERTHR_LV 1.000000 CU_DTCC_O_MAPAFTERTHR_LV 0.000000 1.000000 BYTE_ORDER MSB_FIRST /end CHARACTERISTIC
/begin RECORD_LAYOUT RL_DTCC_O_MAPAFTERTHR_LV FNC_VALUES 1 UBYTE COLUMN_DIR DIRECT /end RECORD_LAYOUT
/begin COMPU_METHOD CU_DTCC_O_MAPAFTERTHR_LV "Conversion method for DTCc_o_MAPAfterThr_LV" RAT_FUNC "%10.0" "o" COEFFS 0.000000 1.000000 0.000000 0.000000 0.000000 1.000000 /end COMPU_METHOD
/* Scalar calibration for DDE 'DTCc_o_MAPAftrThr_HV'. */
/begin CHARACTERISTIC DTCc_o_MAPAftrThr_HV "Override value" VALUE 0x8c020 RL_DTCC_O_MAPAFTRTHR_HV 1.000000 CU_DTCC_O_MAPAFTRTHR_HV 0.000000 1.000000 BYTE_ORDER MSB_FIRST /end CHARACTERISTIC
/begin RECORD_LAYOUT RL_DTCC_O_MAPAFTRTHR_HV FNC_VALUES 1 UBYTE COLUMN_DIR DIRECT /end RECORD_LAYOUT
/begin COMPU_METHOD CU_DTCC_O_MAPAFTRTHR_HV "Conversion method for DTCc_o_MAPAftrThr_HV" RAT_FUNC "%10.0" "o" COEFFS 0.000000 1.000000 0.000000 0.000000 0.000000 1.000000 /end COMPU_METHOD
/* Scalar calibration for DDE 'DTCc_o_MAPBefThroHV'. */
/begin CHARACTERISTIC DTCc_o_MAPBefThroHV "Override value" VALUE 0x8c39e RL_DTCC_O_MAPBEFTHROHV 1.000000 CU_DTCC_O_MAPBEFTHROHV 0.000000 1.000000 BYTE_ORDER MSB_FIRST /end CHARACTERISTIC
/begin RECORD_LAYOUT RL_DTCC_O_MAPBEFTHROHV FNC_VALUES 1 UBYTE COLUMN_DIR DIRECT /end RECORD_LAYOUT
/begin COMPU_METHOD CU_DTCC_O_MAPBEFTHROHV "Conversion method for DTCc_o_MAPBefThroHV" RAT_FUNC "%10.0" "o" COEFFS 0.000000 1.000000 0.000000 0.000000 0.000000 1.000000 /end COMPU_METHOD
/* Scalar calibration for DDE 'DTCc_o_MAPBefThroOL'. */
/begin CHARACTERISTIC DTCc_o_MAPBefThroOL "Override value" VALUE 0x8c39c RL_DTCC_O_MAPBEFTHROOL 1.000000 CU_DTCC_O_MAPBEFTHROOL 0.000000 1.000000 BYTE_ORDER MSB_FIRST /end CHARACTERISTIC
/begin RECORD_LAYOUT RL_DTCC_O_MAPBEFTHROOL FNC_VALUES 1 UBYTE COLUMN_DIR DIRECT /end RECORD_LAYOUT
/begin COMPU_METHOD CU_DTCC_O_MAPBEFTHROOL "Conversion method for DTCc_o_MAPBefThroOL" RAT_FUNC "%10.0" "o" COEFFS 0.000000 1.000000 0.000000 0.000000 0.000000 1.000000 /end COMPU_METHOD
/* Scalar calibration for DDE 'DTCc_o_MAPBeforeThroHPress'. */
/begin CHARACTERISTIC DTCc_o_MAPBeforeThroHPress "Override value" VALUE 0x8c3a1 RL_DTCC_O_MAPBEFORETHROHPRESS 1.000000 CU_DTCC_O_MAPBEFORETHROHPRESS 0.000000 1.000000 BYTE_ORDER MSB_FIRST /end CHARACTERISTIC
/begin RECORD_LAYOUT RL_DTCC_O_MAPBEFORETHROHPRESS FNC_VALUES 1 UBYTE COLUMN_DIR DIRECT /end RECORD_LAYOUT
/begin COMPU_METHOD CU_DTCC_O_MAPBEFORETHROHPRESS "Conversion method for DTCc_o_MAPBeforeThroHPress" RAT_FUNC "%10.0" "o" COEFFS 0.000000 1.000000 0.000000 0.000000 0.000000 1.000000 /end COMPU_METHOD
/* Scalar calibration for DDE 'DTCc_o_MAPBeforeThroLPress'. */
/begin CHARACTERISTIC DTCc_o_MAPBeforeThroLPress "Override value" VALUE 0x8d2a9 RL_DTCC_O_MAPBEFORETHROLPRESS 1.000000 CU_DTCC_O_MAPBEFORETHROLPRESS 0.000000 1.000000 BYTE_ORDER MSB_FIRST /end CHARACTERISTIC
/begin RECORD_LAYOUT RL_DTCC_O_MAPBEFORETHROLPRESS FNC_VALUES 1 UBYTE COLUMN_DIR DIRECT /end RECORD_LAYOUT
/begin COMPU_METHOD CU_DTCC_O_MAPBEFORETHROLPRESS "Conversion method for DTCc_o_MAPBeforeThroLPress" RAT_FUNC "%10.0" "o" COEFFS 0.000000 1.000000 0.000000 0.000000 0.000000 1.000000 /end COMPU_METHOD
/* Scalar calibration for DDE 'DTCc_o_Misfire_Bancada'. */
/begin CHARACTERISTIC DTCc_o_Misfire_Bancada "Override value" VALUE 0x8c4c5 RL_DTCC_O_MISFIRE_BANCADA 1.000000 CU_DTCC_O_MISFIRE_BANCADA 0.000000 1.000000 BYTE_ORDER MSB_FIRST /end CHARACTERISTIC
/begin RECORD_LAYOUT RL_DTCC_O_MISFIRE_BANCADA FNC_VALUES 1 UBYTE COLUMN_DIR DIRECT /end RECORD_LAYOUT
/begin COMPU_METHOD CU_DTCC_O_MISFIRE_BANCADA "Conversion method for DTCc_o_Misfire_Bancada" RAT_FUNC "%10.0" "o" COEFFS 0.000000 1.000000 0.000000 0.000000 0.000000 1.000000 /end COMPU_METHOD
/* Scalar calibration for DDE 'DTCc_o_Misfire_Cylinder_1'. */
/begin CHARACTERISTIC DTCc_o_Misfire_Cylinder_1 "Override value" VALUE 0x8c4bd RL_DTCC_O_MISFIRE_CYLINDER_1 1.000000 CU_DTCC_O_MISFIRE_CYLINDER_1 0.000000 1.000000 BYTE_ORDER MSB_FIRST /end CHARACTERISTIC
/begin RECORD_LAYOUT RL_DTCC_O_MISFIRE_CYLINDER_1 FNC_VALUES 1 UBYTE COLUMN_DIR DIRECT /end RECORD_LAYOUT
/begin COMPU_METHOD CU_DTCC_O_MISFIRE_CYLINDER_1 "Conversion method for DTCc_o_Misfire_Cylinder_1" RAT_FUNC "%10.0" "o" COEFFS 0.000000 1.000000 0.000000 0.000000 0.000000 1.000000 /end COMPU_METHOD
/* Scalar calibration for DDE 'DTCc_o_Misfire_Cylinder_2'. */
/begin CHARACTERISTIC DTCc_o_Misfire_Cylinder_2 "Override value" VALUE 0x8c4bf RL_DTCC_O_MISFIRE_CYLINDER_2 1.000000 CU_DTCC_O_MISFIRE_CYLINDER_2 0.000000 1.000000 BYTE_ORDER MSB_FIRST /end CHARACTERISTIC
/begin RECORD_LAYOUT RL_DTCC_O_MISFIRE_CYLINDER_2 FNC_VALUES 1 UBYTE COLUMN_DIR DIRECT /end RECORD_LAYOUT
/begin COMPU_METHOD CU_DTCC_O_MISFIRE_CYLINDER_2 "Conversion method for DTCc_o_Misfire_Cylinder_2" RAT_FUNC "%10.0" "o" COEFFS 0.000000 1.000000 0.000000 0.000000 0.000000 1.000000 /end COMPU_METHOD
/* Scalar calibration for DDE 'DTCc_o_Misfire_Cylinder_3'. */
/begin CHARACTERISTIC DTCc_o_Misfire_Cylinder_3 "Override value" VALUE 0x8c4c1 RL_DTCC_O_MISFIRE_CYLINDER_3 1.000000 CU_DTCC_O_MISFIRE_CYLINDER_3 0.000000 1.000000 BYTE_ORDER MSB_FIRST /end CHARACTERISTIC
/begin RECORD_LAYOUT RL_DTCC_O_MISFIRE_CYLINDER_3 FNC_VALUES 1 UBYTE COLUMN_DIR DIRECT /end RECORD_LAYOUT
/begin COMPU_METHOD CU_DTCC_O_MISFIRE_CYLINDER_3 "Conversion method for DTCc_o_Misfire_Cylinder_3" RAT_FUNC "%10.0" "o" COEFFS 0.000000 1.000000 0.000000 0.000000 0.000000 1.000000 /end COMPU_METHOD
/* Scalar calibration for DDE 'DTCc_o_Misfire_Cylinder_4'. */
/begin CHARACTERISTIC DTCc_o_Misfire_Cylinder_4 "Override value" VALUE 0x8c4c3 RL_DTCC_O_MISFIRE_CYLINDER_4 1.000000 CU_DTCC_O_MISFIRE_CYLINDER_4 0.000000 1.000000 BYTE_ORDER MSB_FIRST /end CHARACTERISTIC
/begin RECORD_LAYOUT RL_DTCC_O_MISFIRE_CYLINDER_4 FNC_VALUES 1 UBYTE COLUMN_DIR DIRECT /end RECORD_LAYOUT
/begin COMPU_METHOD CU_DTCC_O_MISFIRE_CYLINDER_4 "Conversion method for DTCc_o_Misfire_Cylinder_4" RAT_FUNC "%10.0" "o" COEFFS 0.000000 1.000000 0.000000 0.000000 0.000000 1.000000 /end COMPU_METHOD
/* Scalar calibration for DDE 'DTCc_o_NBValid'. */
/begin CHARACTERISTIC DTCc_o_NBValid "Override value" VALUE 0x8c0c4 RL_DTCC_O_NBVALID 1.000000 CU_DTCC_O_NBVALID 0.000000 1.000000 BYTE_ORDER MSB_FIRST /end CHARACTERISTIC
/begin RECORD_LAYOUT RL_DTCC_O_NBVALID FNC_VALUES 1 UBYTE COLUMN_DIR DIRECT /end RECORD_LAYOUT
/begin COMPU_METHOD CU_DTCC_O_NBVALID "Conversion method for DTCc_o_NBValid" RAT_FUNC "%10.0" "o" COEFFS 0.000000 1.000000 0.000000 0.000000 0.000000 1.000000 /end COMPU_METHOD
/* Scalar calibration for DDE 'DTCc_o_OIL_LPress'. */
/begin CHARACTERISTIC DTCc_o_OIL_LPress "Override value" VALUE 0x8c854 RL_DTCC_O_OIL_LPRESS 1.000000 CU_DTCC_O_OIL_LPRESS 0.000000 1.000000 BYTE_ORDER MSB_FIRST /end CHARACTERISTIC
/begin RECORD_LAYOUT RL_DTCC_O_OIL_LPRESS FNC_VALUES 1 UBYTE COLUMN_DIR DIRECT /end RECORD_LAYOUT
/begin COMPU_METHOD CU_DTCC_O_OIL_LPRESS "Conversion method for DTCc_o_OIL_LPress" RAT_FUNC "%10.0" "o" COEFFS 0.000000 1.000000 0.000000 0.000000 0.000000 1.000000 /end COMPU_METHOD
/* Scalar calibration for DDE 'DTCc_o_OIL_Sensor'. */
/begin CHARACTERISTIC DTCc_o_OIL_Sensor "Override value" VALUE 0x8c848 RL_DTCC_O_OIL_SENSOR 1.000000 CU_DTCC_O_OIL_SENSOR 0.000000 1.000000 BYTE_ORDER MSB_FIRST /end CHARACTERISTIC
/begin RECORD_LAYOUT RL_DTCC_O_OIL_SENSOR FNC_VALUES 1 UBYTE COLUMN_DIR DIRECT /end RECORD_LAYOUT
/begin COMPU_METHOD CU_DTCC_O_OIL_SENSOR "Conversion method for DTCc_o_OIL_Sensor" RAT_FUNC "%10.0" "o" COEFFS 0.000000 1.000000 0.000000 0.000000 0.000000 1.000000 /end COMPU_METHOD
/* Scalar calibration for DDE 'DTCc_o_OIL_SensorOL'. */
/begin CHARACTERISTIC DTCc_o_OIL_SensorOL "Override value" VALUE 0x8c84a RL_DTCC_O_OIL_SENSOROL 1.000000 CU_DTCC_O_OIL_SENSOROL 0.000000 1.000000 BYTE_ORDER MSB_FIRST /end CHARACTERISTIC
/begin RECORD_LAYOUT RL_DTCC_O_OIL_SENSOROL FNC_VALUES 1 UBYTE COLUMN_DIR DIRECT /end RECORD_LAYOUT
/begin COMPU_METHOD CU_DTCC_O_OIL_SENSOROL "Conversion method for DTCc_o_OIL_SensorOL" RAT_FUNC "%10.0" "o" COEFFS 0.000000 1.000000 0.000000 0.000000 0.000000 1.000000 /end COMPU_METHOD
/* Scalar calibration for DDE 'DTCc_o_Readiness'. */
/begin CHARACTERISTIC DTCc_o_Readiness "(not defined)" VALUE 0x8ce6c RL_DTCC_O_READINESS 1.000000 CU_DTCC_O_READINESS 0.000000 1.000000 BYTE_ORDER MSB_FIRST /end CHARACTERISTIC
/begin RECORD_LAYOUT RL_DTCC_O_READINESS FNC_VALUES 1 UBYTE COLUMN_DIR DIRECT /end RECORD_LAYOUT
/begin COMPU_METHOD CU_DTCC_O_READINESS "Conversion method for DTCc_o_Readiness" RAT_FUNC "%10.0" "o" COEFFS 0.000000 1.000000 0.000000 0.000000 0.000000 1.000000 /end COMPU_METHOD
/* Scalar calibration for DDE 'DTCc_o_ShutOffValveEngine_OL'. */
/begin CHARACTERISTIC DTCc_o_ShutOffValveEngine_OL "Override value" VALUE 0x8d280 RL_DTCC_O_SHUTOFFVALVEENGINE_OL 1.000000 CU_DTCC_O_SHUTOFFVALVEENGINE_OL 0.000000 1.000000 BYTE_ORDER MSB_FIRST /end CHARACTERISTIC
/begin RECORD_LAYOUT RL_DTCC_O_SHUTOFFVALVEENGINE_OL FNC_VALUES 1 UBYTE COLUMN_DIR DIRECT /end RECORD_LAYOUT
/begin COMPU_METHOD CU_DTCC_O_SHUTOFFVALVEENGINE_OL "Conversion method for DTCc_o_ShutOffValveEngine_OL" RAT_FUNC "%10.0" "o" COEFFS 0.000000 1.000000 0.000000 0.000000 0.000000 1.000000 /end COMPU_METHOD
/* Scalar calibration for DDE 'DTCc_o_ShutOffValveEngine_SG'. */
/begin CHARACTERISTIC DTCc_o_ShutOffValveEngine_SG "Override value" VALUE 0x8c098 RL_DTCC_O_SHUTOFFVALVEENGINE_SG 1.000000 CU_DTCC_O_SHUTOFFVALVEENGINE_SG 0.000000 1.000000 BYTE_ORDER MSB_FIRST /end CHARACTERISTIC
/begin RECORD_LAYOUT RL_DTCC_O_SHUTOFFVALVEENGINE_SG FNC_VALUES 1 UBYTE COLUMN_DIR DIRECT /end RECORD_LAYOUT
/begin COMPU_METHOD CU_DTCC_O_SHUTOFFVALVEENGINE_SG "Conversion method for DTCc_o_ShutOffValveEngine_SG" RAT_FUNC "%10.0" "o" COEFFS 0.000000 1.000000 0.000000 0.000000 0.000000 1.000000 /end COMPU_METHOD
/* Scalar calibration for DDE 'DTCc_o_Supply_VRefA'. */
/begin CHARACTERISTIC DTCc_o_Supply_VRefA "Override value" VALUE 0x8cce0 RL_DTCC_O_SUPPLY_VREFA 1.000000 CU_DTCC_O_SUPPLY_VREFA 0.000000 1.000000 BYTE_ORDER MSB_FIRST /end CHARACTERISTIC
/begin RECORD_LAYOUT RL_DTCC_O_SUPPLY_VREFA FNC_VALUES 1 UBYTE COLUMN_DIR DIRECT /end RECORD_LAYOUT
/begin COMPU_METHOD CU_DTCC_O_SUPPLY_VREFA "Conversion method for DTCc_o_Supply_VRefA" RAT_FUNC "%10.0" "o" COEFFS 0.000000 1.000000 0.000000 0.000000 0.000000 1.000000 /end COMPU_METHOD
/* Scalar calibration for DDE 'DTCc_o_Supply_VRefB'. */
/begin CHARACTERISTIC DTCc_o_Supply_VRefB "Override value" VALUE 0x8ccd4 RL_DTCC_O_SUPPLY_VREFB 1.000000 CU_DTCC_O_SUPPLY_VREFB 0.000000 1.000000 BYTE_ORDER MSB_FIRST /end CHARACTERISTIC
/begin RECORD_LAYOUT RL_DTCC_O_SUPPLY_VREFB FNC_VALUES 1 UBYTE COLUMN_DIR DIRECT /end RECORD_LAYOUT
/begin COMPU_METHOD CU_DTCC_O_SUPPLY_VREFB "Conversion method for DTCc_o_Supply_VRefB" RAT_FUNC "%10.0" "o" COEFFS 0.000000 1.000000 0.000000 0.000000 0.000000 1.000000 /end COMPU_METHOD
/* Scalar calibration for DDE 'DTCc_o_Supply_VRefC'. */
/begin CHARACTERISTIC DTCc_o_Supply_VRefC "Override value" VALUE 0x8cce2 RL_DTCC_O_SUPPLY_VREFC 1.000000 CU_DTCC_O_SUPPLY_VREFC 0.000000 1.000000 BYTE_ORDER MSB_FIRST /end CHARACTERISTIC
/begin RECORD_LAYOUT RL_DTCC_O_SUPPLY_VREFC FNC_VALUES 1 UBYTE COLUMN_DIR DIRECT /end RECORD_LAYOUT
/begin COMPU_METHOD CU_DTCC_O_SUPPLY_VREFC "Conversion method for DTCc_o_Supply_VRefC" RAT_FUNC "%10.0" "o" COEFFS 0.000000 1.000000 0.000000 0.000000 0.000000 1.000000 /end COMPU_METHOD
/* Scalar calibration for DDE 'DTCc_o_Supply_VRefD'. */
/begin CHARACTERISTIC DTCc_o_Supply_VRefD "Override value" VALUE 0x8cce4 RL_DTCC_O_SUPPLY_VREFD 1.000000 CU_DTCC_O_SUPPLY_VREFD 0.000000 1.000000 BYTE_ORDER MSB_FIRST /end CHARACTERISTIC
/begin RECORD_LAYOUT RL_DTCC_O_SUPPLY_VREFD FNC_VALUES 1 UBYTE COLUMN_DIR DIRECT /end RECORD_LAYOUT
/begin COMPU_METHOD CU_DTCC_O_SUPPLY_VREFD "Conversion method for DTCc_o_Supply_VRefD" RAT_FUNC "%10.0" "o" COEFFS 0.000000 1.000000 0.000000 0.000000 0.000000 1.000000 /end COMPU_METHOD
/* Scalar calibration for DDE 'DTCc_o_THR_Motor_Fail'. */
/begin CHARACTERISTIC DTCc_o_THR_Motor_Fail "Override value" VALUE 0x8c36c RL_DTCC_O_THR_MOTOR_FAIL 1.000000 CU_DTCC_O_THR_MOTOR_FAIL 0.000000 1.000000 BYTE_ORDER MSB_FIRST /end CHARACTERISTIC
/begin RECORD_LAYOUT RL_DTCC_O_THR_MOTOR_FAIL FNC_VALUES 1 UBYTE COLUMN_DIR DIRECT /end RECORD_LAYOUT
/begin COMPU_METHOD CU_DTCC_O_THR_MOTOR_FAIL "Conversion method for DTCc_o_THR_Motor_Fail" RAT_FUNC "%10.0" "o" COEFFS 0.000000 1.000000 0.000000 0.000000 0.000000 1.000000 /end COMPU_METHOD
/* Scalar calibration for DDE 'DTCc_o_TP1_SensorHV'. */
/begin CHARACTERISTIC DTCc_o_TP1_SensorHV "Override value" VALUE 0x8c362 RL_DTCC_O_TP1_SENSORHV 1.000000 CU_DTCC_O_TP1_SENSORHV 0.000000 1.000000 BYTE_ORDER MSB_FIRST /end CHARACTERISTIC
/begin RECORD_LAYOUT RL_DTCC_O_TP1_SENSORHV FNC_VALUES 1 UBYTE COLUMN_DIR DIRECT /end RECORD_LAYOUT
/begin COMPU_METHOD CU_DTCC_O_TP1_SENSORHV "Conversion method for DTCc_o_TP1_SensorHV" RAT_FUNC "%10.0" "o" COEFFS 0.000000 1.000000 0.000000 0.000000 0.000000 1.000000 /end COMPU_METHOD
/* Scalar calibration for DDE 'DTCc_o_TP1_SensorLV'. */
/begin CHARACTERISTIC DTCc_o_TP1_SensorLV "Override value" VALUE 0x8c360 RL_DTCC_O_TP1_SENSORLV 1.000000 CU_DTCC_O_TP1_SENSORLV 0.000000 1.000000 BYTE_ORDER MSB_FIRST /end CHARACTERISTIC
/begin RECORD_LAYOUT RL_DTCC_O_TP1_SENSORLV FNC_VALUES 1 UBYTE COLUMN_DIR DIRECT /end RECORD_LAYOUT
/begin COMPU_METHOD CU_DTCC_O_TP1_SENSORLV "Conversion method for DTCc_o_TP1_SensorLV" RAT_FUNC "%10.0" "o" COEFFS 0.000000 1.000000 0.000000 0.000000 0.000000 1.000000 /end COMPU_METHOD
/* Scalar calibration for DDE 'DTCc_o_TP2_SensorHV'. */
/begin CHARACTERISTIC DTCc_o_TP2_SensorHV "Override value" VALUE 0x8c37a RL_DTCC_O_TP2_SENSORHV 1.000000 CU_DTCC_O_TP2_SENSORHV 0.000000 1.000000 BYTE_ORDER MSB_FIRST /end CHARACTERISTIC
/begin RECORD_LAYOUT RL_DTCC_O_TP2_SENSORHV FNC_VALUES 1 UBYTE COLUMN_DIR DIRECT /end RECORD_LAYOUT
/begin COMPU_METHOD CU_DTCC_O_TP2_SENSORHV "Conversion method for DTCc_o_TP2_SensorHV" RAT_FUNC "%10.0" "o" COEFFS 0.000000 1.000000 0.000000 0.000000 0.000000 1.000000 /end COMPU_METHOD
/* Scalar calibration for DDE 'DTCc_o_TP2_SensorLV'. */
/begin CHARACTERISTIC DTCc_o_TP2_SensorLV "Override value" VALUE 0x8c378 RL_DTCC_O_TP2_SENSORLV 1.000000 CU_DTCC_O_TP2_SENSORLV 0.000000 1.000000 BYTE_ORDER MSB_FIRST /end CHARACTERISTIC
/begin RECORD_LAYOUT RL_DTCC_O_TP2_SENSORLV FNC_VALUES 1 UBYTE COLUMN_DIR DIRECT /end RECORD_LAYOUT
/begin COMPU_METHOD CU_DTCC_O_TP2_SENSORLV "Conversion method for DTCc_o_TP2_SensorLV" RAT_FUNC "%10.0" "o" COEFFS 0.000000 1.000000 0.000000 0.000000 0.000000 1.000000 /end COMPU_METHOD
/* Scalar calibration for DDE 'DTCc_o_TP_CorrFLT'. */
/begin CHARACTERISTIC DTCc_o_TP_CorrFLT "Override value" VALUE 0x87a38 RL_DTCC_O_TP_CORRFLT 1.000000 CU_DTCC_O_TP_CORRFLT 0.000000 1.000000 BYTE_ORDER MSB_FIRST /end CHARACTERISTIC
/begin RECORD_LAYOUT RL_DTCC_O_TP_CORRFLT FNC_VALUES 1 UBYTE COLUMN_DIR DIRECT /end RECORD_LAYOUT
/begin COMPU_METHOD CU_DTCC_O_TP_CORRFLT "Conversion method for DTCc_o_TP_CorrFLT" RAT_FUNC "%10.0" "o" COEFFS 0.000000 1.000000 0.000000 0.000000 0.000000 1.000000 /end COMPU_METHOD
/* Scalar calibration for DDE 'DTCc_o_TestTime'. */
/begin CHARACTERISTIC DTCc_o_TestTime "(not defined)" VALUE 0x8c0e2 RL_DTCC_O_TESTTIME 1.000000 CU_DTCC_O_TESTTIME 0.000000 1.000000 BYTE_ORDER MSB_FIRST /end CHARACTERISTIC
/begin RECORD_LAYOUT RL_DTCC_O_TESTTIME FNC_VALUES 1 UBYTE COLUMN_DIR DIRECT /end RECORD_LAYOUT
/begin COMPU_METHOD CU_DTCC_O_TESTTIME "Conversion method for DTCc_o_TestTime" RAT_FUNC "%10.0" "b" COEFFS 0.000000 1.000000 0.000000 0.000000 0.000000 1.000000 /end COMPU_METHOD
/* Scalar calibration for DDE 'DTCc_o_TurboError'. */
/begin CHARACTERISTIC DTCc_o_TurboError "Override value" VALUE 0x8b878 RL_DTCC_O_TURBOERROR 1.000000 CU_DTCC_O_TURBOERROR 0.000000 1.000000 BYTE_ORDER MSB_FIRST /end CHARACTERISTIC
/begin RECORD_LAYOUT RL_DTCC_O_TURBOERROR FNC_VALUES 1 UBYTE COLUMN_DIR DIRECT /end RECORD_LAYOUT
/begin COMPU_METHOD CU_DTCC_O_TURBOERROR "Conversion method for DTCc_o_TurboError" RAT_FUNC "%10.0" "o" COEFFS 0.000000 1.000000 0.000000 0.000000 0.000000 1.000000 /end COMPU_METHOD
/* Scalar calibration for DDE 'DTCc_s_BegasTime'. */
/begin CHARACTERISTIC DTCc_s_BegasTime "(not defined)" VALUE 0x8bfa8 RL_DTCC_S_BEGASTIME 1000000.000000 CU_DTCC_S_BEGASTIME 0.000000 1000000.000000 BYTE_ORDER MSB_FIRST /end CHARACTERISTIC
/begin RECORD_LAYOUT RL_DTCC_S_BEGASTIME FNC_VALUES 1 FLOAT32_IEEE COLUMN_DIR DIRECT /end RECORD_LAYOUT
/begin COMPU_METHOD CU_DTCC_S_BEGASTIME "Conversion method for DTCc_s_BegasTime" RAT_FUNC "%10.0" "s" COEFFS 0.000000 1.000000 0.000000 0.000000 0.000000 1.000000 /end COMPU_METHOD
/* Scalar calibration for DDE 'DTCc_s_DiagCataActv_IdlDelay'. */
/begin CHARACTERISTIC DTCc_s_DiagCataActv_IdlDelay "(not defined)" VALUE 0x8c0c8 RL_DTCC_S_DIAGCATAACTV_IDLDELAY 1000000.000000 CU_DTCC_S_DIAGCATAACTV_IDLDELAY 0.000000 1000000.000000 BYTE_ORDER MSB_FIRST /end CHARACTERISTIC
/begin RECORD_LAYOUT RL_DTCC_S_DIAGCATAACTV_IDLDELAY FNC_VALUES 1 FLOAT32_IEEE COLUMN_DIR DIRECT /end RECORD_LAYOUT
/begin COMPU_METHOD CU_DTCC_S_DIAGCATAACTV_IDLDELAY "Conversion method for DTCc_s_DiagCataActv_IdlDelay" RAT_FUNC "%10.0" "s" COEFFS 0.000000 1.000000 0.000000 0.000000 0.000000 1.000000 /end COMPU_METHOD
/* Scalar calibration for DDE 'DTCc_s_DiagCata_RstDelay'. */
/begin CHARACTERISTIC DTCc_s_DiagCata_RstDelay "Give stability to the signals" VALUE 0x8c0dc RL_DTCC_S_DIAGCATA_RSTDELAY 1000.000000 CU_DTCC_S_DIAGCATA_RSTDELAY 0.000000 1000.000000 BYTE_ORDER MSB_FIRST /end CHARACTERISTIC
/begin RECORD_LAYOUT RL_DTCC_S_DIAGCATA_RSTDELAY FNC_VALUES 1 FLOAT32_IEEE COLUMN_DIR DIRECT /end RECORD_LAYOUT
/begin COMPU_METHOD CU_DTCC_S_DIAGCATA_RSTDELAY "Conversion method for DTCc_s_DiagCata_RstDelay" RAT_FUNC "%10.2" "s" COEFFS 0.000000 1.000000 0.000000 0.000000 0.000000 1.000000 /end COMPU_METHOD
/* Scalar calibration for DDE 'DTCc_s_ResetKnockPeriodic'. */
/begin CHARACTERISTIC DTCc_s_ResetKnockPeriodic "(not defined)" VALUE 0x8ad7c RL_DTCC_S_RESETKNOCKPERIODIC 1000000.000000 CU_DTCC_S_RESETKNOCKPERIODIC 0.000000 1000000.000000 BYTE_ORDER MSB_FIRST /end CHARACTERISTIC
/begin RECORD_LAYOUT RL_DTCC_S_RESETKNOCKPERIODIC FNC_VALUES 1 FLOAT32_IEEE COLUMN_DIR DIRECT /end RECORD_LAYOUT
/begin COMPU_METHOD CU_DTCC_S_RESETKNOCKPERIODIC "Conversion method for DTCc_s_ResetKnockPeriodic" RAT_FUNC "%10.0" "s" COEFFS 0.000000 1.000000 0.000000 0.000000 0.000000 1.000000 /end COMPU_METHOD
/* Map (2d) calibration for DDE 'DTCm_NU_TherMisfire_z'. */
/begin CHARACTERISTIC DTCm_NU_TherMisfire_z "DELTAMAP=MAP-BARO" MAP 0x8c910 RL_DTCM_NU_THERMISFIRE_Z 2500.000000 CU_DTCM_NU_THERMISFIRE_Z -500.000000 2000.000000
 /begin AXIS_DESCR COM_AXIS NO_INPUT_QUANTITY CU_DTCM_NU_THERMISFIRE_X 20 0.000000 2.000000 AXIS_PTS_REF APD_DTCM_NU_THERMISFIRE_X /end AXIS_DESCR
 /begin AXIS_DESCR COM_AXIS NO_INPUT_QUANTITY CU_DTCM_NU_THERMISFIRE_Y 12 0.000000 8000.000000 AXIS_PTS_REF APD_DTCM_NU_THERMISFIRE_Y /end AXIS_DESCR
 BYTE_ORDER MSB_FIRST /end CHARACTERISTIC
/begin RECORD_LAYOUT RL_DTCM_NU_THERMISFIRE_Z FNC_VALUES 1 FLOAT32_IEEE COLUMN_DIR DIRECT /end RECORD_LAYOUT
/begin COMPU_METHOD CU_DTCM_NU_THERMISFIRE_Z "Conversion method for DTCm_NU_TherMisfire_z" RAT_FUNC "%10.1" "kPa" COEFFS 0.000000 1.000000 0.000000 0.000000 0.000000 1.000000 /end COMPU_METHOD
/begin AXIS_PTS APD_DTCM_NU_THERMISFIRE_X "pct of load" 0x8c890 NO_INPUT_QUANTITY RL_DTCM_NU_THERMISFIRE_X 2.000000 CU_DTCM_NU_THERMISFIRE_X 20 0.0 2.0 BYTE_ORDER MSB_FIRST /end AXIS_PTS
/begin RECORD_LAYOUT RL_DTCM_NU_THERMISFIRE_X AXIS_PTS_X 1 FLOAT32_IEEE INDEX_INCR DIRECT /end RECORD_LAYOUT
/begin COMPU_METHOD CU_DTCM_NU_THERMISFIRE_X "Conversion method for DTCm_NU_TherMisfire_x" RAT_FUNC "%10.2" "pct" COEFFS 0.000000 1.000000 0.000000 0.000000 0.000000 1.000000 /end COMPU_METHOD
/begin AXIS_PTS APD_DTCM_NU_THERMISFIRE_Y "RPM" 0x8c8e0 NO_INPUT_QUANTITY RL_DTCM_NU_THERMISFIRE_Y 8000.000000 CU_DTCM_NU_THERMISFIRE_Y 12 0.0 8000.0 BYTE_ORDER MSB_FIRST /end AXIS_PTS
/begin RECORD_LAYOUT RL_DTCM_NU_THERMISFIRE_Y AXIS_PTS_X 1 FLOAT32_IEEE INDEX_INCR DIRECT /end RECORD_LAYOUT
/begin COMPU_METHOD CU_DTCM_NU_THERMISFIRE_Y "Conversion method for DTCm_NU_TherMisfire_y" RAT_FUNC "%10.0" "RPM" COEFFS 0.000000 1.000000 0.000000 0.000000 0.000000 1.000000 /end COMPU_METHOD
/* Vector/array calibration for DDE 'DTCv_NU_CALID'. */
/begin CHARACTERISTIC DTCv_NU_CALID "220721010200" VAL_BLK 0x8d5c0 RL_DTCV_NU_CALID 255.000000 CU_DTCV_NU_CALID 0.000000 255.000000 NUMBER 12 BYTE_ORDER MSB_FIRST /end CHARACTERISTIC
/begin RECORD_LAYOUT RL_DTCV_NU_CALID FNC_VALUES 1 ULONG COLUMN_DIR DIRECT /end RECORD_LAYOUT
/begin COMPU_METHOD CU_DTCV_NU_CALID "Conversion method for DTCv_NU_CALID" RAT_FUNC "%10.0" "NU" COEFFS 0.000000 1.000000 0.000000 0.000000 0.000000 1.000000 /end COMPU_METHOD
/* Vector/array calibration for DDE 'DTCv_NU_ESN'. */
/begin CHARACTERISTIC DTCv_NU_ESN "Engine Serial Number" VAL_BLK 0x8d588 RL_DTCV_NU_ESN 10000.000000 CU_DTCV_NU_ESN 0.000000 10000.000000 NUMBER 14 BYTE_ORDER MSB_FIRST /end CHARACTERISTIC
/begin RECORD_LAYOUT RL_DTCV_NU_ESN FNC_VALUES 1 ULONG COLUMN_DIR DIRECT /end RECORD_LAYOUT
/begin COMPU_METHOD CU_DTCV_NU_ESN "Conversion method for DTCv_NU_ESN" RAT_FUNC "%10.0" "NU" COEFFS 0.000000 1.000000 0.000000 0.000000 0.000000 1.000000 /end COMPU_METHOD
/* Vector/array calibration for DDE 'DTCv_NU_VIN'. */
/begin CHARACTERISTIC DTCv_NU_VIN "XMQ6127G/A1A1/2A2" VAL_BLK 0x8d544 RL_DTCV_NU_VIN 255.000000 CU_DTCV_NU_VIN 0.000000 255.000000 NUMBER 17 BYTE_ORDER MSB_FIRST /end CHARACTERISTIC
/begin RECORD_LAYOUT RL_DTCV_NU_VIN FNC_VALUES 1 ULONG COLUMN_DIR DIRECT /end RECORD_LAYOUT
/begin COMPU_METHOD CU_DTCV_NU_VIN "Conversion method for DTCv_NU_VIN" RAT_FUNC "%10.0" "NU" COEFFS 0.000000 1.000000 0.000000 0.000000 0.000000 1.000000 /end COMPU_METHOD
/* Scalar calibration for DDE 'EFPc_NU_FuelPumpDGain'. */
/begin CHARACTERISTIC EFPc_NU_FuelPumpDGain "Differential Gain for EFP Controller" VALUE 0x8d020 RL_EFPC_NU_FUELPUMPDGAIN 10.000000 CU_EFPC_NU_FUELPUMPDGAIN 0.000000 10.000000 BYTE_ORDER MSB_FIRST /end CHARACTERISTIC
/begin RECORD_LAYOUT RL_EFPC_NU_FUELPUMPDGAIN FNC_VALUES 1 FLOAT32_IEEE COLUMN_DIR DIRECT /end RECORD_LAYOUT
/begin COMPU_METHOD CU_EFPC_NU_FUELPUMPDGAIN "Conversion method for EFPc_NU_FuelPumpDGain" RAT_FUNC "%10.4" "NU" COEFFS 0.000000 1.000000 0.000000 0.000000 0.000000 1.000000 /end COMPU_METHOD
/* Scalar calibration for DDE 'EFPc_NU_FuelPumpErrROCThrsh'. */
/begin CHARACTERISTIC EFPc_NU_FuelPumpErrROCThrsh "(bar/s) D-term will become inactive for rate of change below this threshold" VALUE 0x8d01c RL_EFPC_NU_FUELPUMPERRROCTHRSH 1000.000000 CU_EFPC_NU_FUELPUMPERRROCTHRSH 0.000000 1000.000000 BYTE_ORDER MSB_FIRST /end CHARACTERISTIC
/begin RECORD_LAYOUT RL_EFPC_NU_FUELPUMPERRROCTHRSH FNC_VALUES 1 FLOAT32_IEEE COLUMN_DIR DIRECT /end RECORD_LAYOUT
/begin COMPU_METHOD CU_EFPC_NU_FUELPUMPERRROCTHRSH "Conversion method for EFPc_NU_FuelPumpErrROCThrsh" RAT_FUNC "%10.2" "NU" COEFFS 0.000000 1.000000 0.000000 0.000000 0.000000 1.000000 /end COMPU_METHOD
/* Scalar calibration for DDE 'EFPc_NU_FuelPumpIGain'. */
/begin CHARACTERISTIC EFPc_NU_FuelPumpIGain "Integral Gain" VALUE 0x8d010 RL_EFPC_NU_FUELPUMPIGAIN 10.000000 CU_EFPC_NU_FUELPUMPIGAIN 0.000000 10.000000 BYTE_ORDER MSB_FIRST /end CHARACTERISTIC
/begin RECORD_LAYOUT RL_EFPC_NU_FUELPUMPIGAIN FNC_VALUES 1 FLOAT32_IEEE COLUMN_DIR DIRECT /end RECORD_LAYOUT
/begin COMPU_METHOD CU_EFPC_NU_FUELPUMPIGAIN "Conversion method for EFPc_NU_FuelPumpIGain" RAT_FUNC "%10.3" "NU" COEFFS 0.000000 1.000000 0.000000 0.000000 0.000000 1.000000 /end COMPU_METHOD
/* Scalar calibration for DDE 'EFPc_NU_FuelPumpPGain'. */
/begin CHARACTERISTIC EFPc_NU_FuelPumpPGain "(pct/bar) Proportional Controller Gain" VALUE 0x8d004 RL_EFPC_NU_FUELPUMPPGAIN 10.000000 CU_EFPC_NU_FUELPUMPPGAIN 0.000000 10.000000 BYTE_ORDER MSB_FIRST /end CHARACTERISTIC
/begin RECORD_LAYOUT RL_EFPC_NU_FUELPUMPPGAIN FNC_VALUES 1 FLOAT32_IEEE COLUMN_DIR DIRECT /end RECORD_LAYOUT
/begin COMPU_METHOD CU_EFPC_NU_FUELPUMPPGAIN "Conversion method for EFPc_NU_FuelPumpPGain" RAT_FUNC "%10.3" "NU" COEFFS 0.000000 1.000000 0.000000 0.000000 0.000000 1.000000 /end COMPU_METHOD
/* Scalar calibration for DDE 'EFPc_b_FuelPumpDC'. */
/begin CHARACTERISTIC EFPc_b_FuelPumpDC "PWM Signal Override Value" VALUE 0x8d084 RL_EFPC_B_FUELPUMPDC 1.000000 CU_EFPC_B_FUELPUMPDC 0.000000 1.000000 BYTE_ORDER MSB_FIRST /end CHARACTERISTIC
/begin RECORD_LAYOUT RL_EFPC_B_FUELPUMPDC FNC_VALUES 1 FLOAT32_IEEE COLUMN_DIR DIRECT /end RECORD_LAYOUT
/begin COMPU_METHOD CU_EFPC_B_FUELPUMPDC "Conversion method for EFPc_b_FuelPumpDC" RAT_FUNC "%10.2" "pct" COEFFS 0.000000 1.000000 0.000000 0.000000 0.000000 1.000000 /end COMPU_METHOD
/* Scalar calibration for DDE 'EFPc_b_FuelPumpResetITerm'. */
/begin CHARACTERISTIC EFPc_b_FuelPumpResetITerm "Reset PID Signal" VALUE 0x8d008 RL_EFPC_B_FUELPUMPRESETITERM 1.000000 CU_EFPC_B_FUELPUMPRESETITERM 0.000000 1.000000 BYTE_ORDER MSB_FIRST /end CHARACTERISTIC
/begin RECORD_LAYOUT RL_EFPC_B_FUELPUMPRESETITERM FNC_VALUES 1 UBYTE COLUMN_DIR DIRECT /end RECORD_LAYOUT
/begin COMPU_METHOD CU_EFPC_B_FUELPUMPRESETITERM "Conversion method for EFPc_b_FuelPumpResetITerm" RAT_FUNC "%10.0" "b" COEFFS 0.000000 1.000000 0.000000 0.000000 0.000000 1.000000 /end COMPU_METHOD
/* Scalar calibration for DDE 'EFPc_b_NotStalled'. */
/begin CHARACTERISTIC EFPc_b_NotStalled "Override value" VALUE 0x8d06d RL_EFPC_B_NOTSTALLED 1.000000 CU_EFPC_B_NOTSTALLED 0.000000 1.000000 BYTE_ORDER MSB_FIRST /end CHARACTERISTIC
/begin RECORD_LAYOUT RL_EFPC_B_NOTSTALLED FNC_VALUES 1 UBYTE COLUMN_DIR DIRECT /end RECORD_LAYOUT
/begin COMPU_METHOD CU_EFPC_B_NOTSTALLED "Conversion method for EFPc_b_NotStalled" RAT_FUNC "%10.0" "b" COEFFS 0.000000 1.000000 0.000000 0.000000 0.000000 1.000000 /end COMPU_METHOD
/* Scalar calibration for DDE 'EFPc_b_RunFuelPump'. */
/begin CHARACTERISTIC EFPc_b_RunFuelPump "Override value" VALUE 0x8d099 RL_EFPC_B_RUNFUELPUMP 1.000000 CU_EFPC_B_RUNFUELPUMP 0.000000 1.000000 BYTE_ORDER MSB_FIRST /end CHARACTERISTIC
/begin RECORD_LAYOUT RL_EFPC_B_RUNFUELPUMP FNC_VALUES 1 UBYTE COLUMN_DIR DIRECT /end RECORD_LAYOUT
/begin COMPU_METHOD CU_EFPC_B_RUNFUELPUMP "Conversion method for EFPc_b_RunFuelPump" RAT_FUNC "%10.0" "b" COEFFS 0.000000 1.000000 0.000000 0.000000 0.000000 1.000000 /end COMPU_METHOD
/* Scalar calibration for DDE 'EFPc_bar_FRP_Trgt'. */
/begin CHARACTERISTIC EFPc_bar_FRP_Trgt "Target Fuel Rail Pressure" VALUE 0x8cff8 RL_EFPC_BAR_FRP_TRGT 25.000000 CU_EFPC_BAR_FRP_TRGT 0.000000 25.000000 BYTE_ORDER MSB_FIRST /end CHARACTERISTIC
/begin RECORD_LAYOUT RL_EFPC_BAR_FRP_TRGT FNC_VALUES 1 FLOAT32_IEEE COLUMN_DIR DIRECT /end RECORD_LAYOUT
/begin COMPU_METHOD CU_EFPC_BAR_FRP_TRGT "Conversion method for EFPc_bar_FRP_Trgt" RAT_FUNC "%10.2" "bar" COEFFS 0.000000 1.000000 0.000000 0.000000 0.000000 1.000000 /end COMPU_METHOD
/* Scalar calibration for DDE 'EFPc_bar_FuelPressMax'. */
/begin CHARACTERISTIC EFPc_bar_FuelPressMax "Target Fuel pressure max" VALUE 0x8cffc RL_EFPC_BAR_FUELPRESSMAX 25.000000 CU_EFPC_BAR_FUELPRESSMAX 0.000000 25.000000 BYTE_ORDER MSB_FIRST /end CHARACTERISTIC
/begin RECORD_LAYOUT RL_EFPC_BAR_FUELPRESSMAX FNC_VALUES 1 FLOAT32_IEEE COLUMN_DIR DIRECT /end RECORD_LAYOUT
/begin COMPU_METHOD CU_EFPC_BAR_FUELPRESSMAX "Conversion method for EFPc_bar_FuelPressMax" RAT_FUNC "%10.2" "bar" COEFFS 0.000000 1.000000 0.000000 0.000000 0.000000 1.000000 /end COMPU_METHOD
/* Scalar calibration for DDE 'EFPc_bar_FuelPressMin'. */
/begin CHARACTERISTIC EFPc_bar_FuelPressMin "Target Fuel pressure min" VALUE 0x8d000 RL_EFPC_BAR_FUELPRESSMIN 25.000000 CU_EFPC_BAR_FUELPRESSMIN 0.000000 25.000000 BYTE_ORDER MSB_FIRST /end CHARACTERISTIC
/begin RECORD_LAYOUT RL_EFPC_BAR_FUELPRESSMIN FNC_VALUES 1 FLOAT32_IEEE COLUMN_DIR DIRECT /end RECORD_LAYOUT
/begin COMPU_METHOD CU_EFPC_BAR_FUELPRESSMIN "Conversion method for EFPc_bar_FuelPressMin" RAT_FUNC "%10.2" "bar" COEFFS 0.000000 1.000000 0.000000 0.000000 0.000000 1.000000 /end COMPU_METHOD
/* Scalar calibration for DDE 'EFPc_bar_FuelPumpDbndLatchI'. */
/begin CHARACTERISTIC EFPc_bar_FuelPumpDbndLatchI "Iterm will become frozen whenever error is less than this magnitude" VALUE 0x8d00c RL_EFPC_BAR_FUELPUMPDBNDLATCHI 200.000000 CU_EFPC_BAR_FUELPUMPDBNDLATCHI 0.000000 200.000000 BYTE_ORDER MSB_FIRST /end CHARACTERISTIC
/begin RECORD_LAYOUT RL_EFPC_BAR_FUELPUMPDBNDLATCHI FNC_VALUES 1 FLOAT32_IEEE COLUMN_DIR DIRECT /end RECORD_LAYOUT
/begin COMPU_METHOD CU_EFPC_BAR_FUELPUMPDBNDLATCHI "Conversion method for EFPc_bar_FuelPumpDbndLatchI" RAT_FUNC "%10.1" "bar" COEFFS 0.000000 1.000000 0.000000 0.000000 0.000000 1.000000 /end COMPU_METHOD
/* Scalar calibration for DDE 'EFPc_o_FuelPumpDC'. */
/begin CHARACTERISTIC EFPc_o_FuelPumpDC "PWM Signal Override" VALUE 0x8d080 RL_EFPC_O_FUELPUMPDC 1.000000 CU_EFPC_O_FUELPUMPDC 0.000000 1.000000 BYTE_ORDER MSB_FIRST /end CHARACTERISTIC
/begin RECORD_LAYOUT RL_EFPC_O_FUELPUMPDC FNC_VALUES 1 UBYTE COLUMN_DIR DIRECT /end RECORD_LAYOUT
/begin COMPU_METHOD CU_EFPC_O_FUELPUMPDC "Conversion method for EFPc_o_FuelPumpDC" RAT_FUNC "%10.0" "o" COEFFS 0.000000 1.000000 0.000000 0.000000 0.000000 1.000000 /end COMPU_METHOD
/* Scalar calibration for DDE 'EFPc_o_NotStalled'. */
/begin CHARACTERISTIC EFPc_o_NotStalled "Override flag" VALUE 0x8d06c RL_EFPC_O_NOTSTALLED 1.000000 CU_EFPC_O_NOTSTALLED 0.000000 1.000000 BYTE_ORDER MSB_FIRST /end CHARACTERISTIC
/begin RECORD_LAYOUT RL_EFPC_O_NOTSTALLED FNC_VALUES 1 UBYTE COLUMN_DIR DIRECT /end RECORD_LAYOUT
/begin COMPU_METHOD CU_EFPC_O_NOTSTALLED "Conversion method for EFPc_o_NotStalled" RAT_FUNC "%10.0" "o" COEFFS 0.000000 1.000000 0.000000 0.000000 0.000000 1.000000 /end COMPU_METHOD
/* Scalar calibration for DDE 'EFPc_o_RunFuelPump'. */
/begin CHARACTERISTIC EFPc_o_RunFuelPump "Override flag" VALUE 0x8d098 RL_EFPC_O_RUNFUELPUMP 1.000000 CU_EFPC_O_RUNFUELPUMP 0.000000 1.000000 BYTE_ORDER MSB_FIRST /end CHARACTERISTIC
/begin RECORD_LAYOUT RL_EFPC_O_RUNFUELPUMP FNC_VALUES 1 UBYTE COLUMN_DIR DIRECT /end RECORD_LAYOUT
/begin COMPU_METHOD CU_EFPC_O_RUNFUELPUMP "Conversion method for EFPc_o_RunFuelPump" RAT_FUNC "%10.0" "o" COEFFS 0.000000 1.000000 0.000000 0.000000 0.000000 1.000000 /end COMPU_METHOD
/* Scalar calibration for DDE 'EFPc_pct_FuelPumpITermMax'. */
/begin CHARACTERISTIC EFPc_pct_FuelPumpITermMax "Max I term" VALUE 0x8d018 RL_EFPC_PCT_FUELPUMPITERMMAX 1.000000 CU_EFPC_PCT_FUELPUMPITERMMAX 0.000000 1.000000 BYTE_ORDER MSB_FIRST /end CHARACTERISTIC
/begin RECORD_LAYOUT RL_EFPC_PCT_FUELPUMPITERMMAX FNC_VALUES 1 FLOAT32_IEEE COLUMN_DIR DIRECT /end RECORD_LAYOUT
/begin COMPU_METHOD CU_EFPC_PCT_FUELPUMPITERMMAX "Conversion method for EFPc_pct_FuelPumpITermMax" RAT_FUNC "%10.2" "NU" COEFFS 0.000000 1.000000 0.000000 0.000000 0.000000 1.000000 /end COMPU_METHOD
/* Scalar calibration for DDE 'EFPc_pct_FuelPumpITermMin'. */
/begin CHARACTERISTIC EFPc_pct_FuelPumpITermMin "Min I term" VALUE 0x8d014 RL_EFPC_PCT_FUELPUMPITERMMIN 1.000000 CU_EFPC_PCT_FUELPUMPITERMMIN -1.000000 0.000000 BYTE_ORDER MSB_FIRST /end CHARACTERISTIC
/begin RECORD_LAYOUT RL_EFPC_PCT_FUELPUMPITERMMIN FNC_VALUES 1 FLOAT32_IEEE COLUMN_DIR DIRECT /end RECORD_LAYOUT
/begin COMPU_METHOD CU_EFPC_PCT_FUELPUMPITERMMIN "Conversion method for EFPc_pct_FuelPumpITermMin" RAT_FUNC "%10.2" "NU" COEFFS 0.000000 1.000000 0.000000 0.000000 0.000000 1.000000 /end COMPU_METHOD
/* Scalar calibration for DDE 'EFPc_pct_FuelPumpPID_Dbnd'. */
/begin CHARACTERISTIC EFPc_pct_FuelPumpPID_Dbnd "PID controller output effort deadband" VALUE 0x8d024 RL_EFPC_PCT_FUELPUMPPID_DBND 1.000000 CU_EFPC_PCT_FUELPUMPPID_DBND 0.000000 1.000000 BYTE_ORDER MSB_FIRST /end CHARACTERISTIC
/begin RECORD_LAYOUT RL_EFPC_PCT_FUELPUMPPID_DBND FNC_VALUES 1 FLOAT32_IEEE COLUMN_DIR DIRECT /end RECORD_LAYOUT
/begin COMPU_METHOD CU_EFPC_PCT_FUELPUMPPID_DBND "Conversion method for EFPc_pct_FuelPumpPID_Dbnd" RAT_FUNC "%10.2" "NU" COEFFS 0.000000 1.000000 0.000000 0.000000 0.000000 1.000000 /end COMPU_METHOD
/* Scalar calibration for DDE 'EFPc_pct_FuelPumpPID_Max'. */
/begin CHARACTERISTIC EFPc_pct_FuelPumpPID_Max "PID Controller Upper Saturation Limit" VALUE 0x8d028 RL_EFPC_PCT_FUELPUMPPID_MAX 1.000000 CU_EFPC_PCT_FUELPUMPPID_MAX 0.000000 1.000000 BYTE_ORDER MSB_FIRST /end CHARACTERISTIC
/begin RECORD_LAYOUT RL_EFPC_PCT_FUELPUMPPID_MAX FNC_VALUES 1 FLOAT32_IEEE COLUMN_DIR DIRECT /end RECORD_LAYOUT
/begin COMPU_METHOD CU_EFPC_PCT_FUELPUMPPID_MAX "Conversion method for EFPc_pct_FuelPumpPID_Max" RAT_FUNC "%10.2" "NU" COEFFS 0.000000 1.000000 0.000000 0.000000 0.000000 1.000000 /end COMPU_METHOD
/* Scalar calibration for DDE 'EFPc_pct_FuelPumpPID_Min'. */
/begin CHARACTERISTIC EFPc_pct_FuelPumpPID_Min "PID Controller Upper Lower Limit" VALUE 0x8d02c RL_EFPC_PCT_FUELPUMPPID_MIN 1.000000 CU_EFPC_PCT_FUELPUMPPID_MIN -1.000000 0.000000 BYTE_ORDER MSB_FIRST /end CHARACTERISTIC
/begin RECORD_LAYOUT RL_EFPC_PCT_FUELPUMPPID_MIN FNC_VALUES 1 FLOAT32_IEEE COLUMN_DIR DIRECT /end RECORD_LAYOUT
/begin COMPU_METHOD CU_EFPC_PCT_FUELPUMPPID_MIN "Conversion method for EFPc_pct_FuelPumpPID_Min" RAT_FUNC "%10.2" "NU" COEFFS 0.000000 1.000000 0.000000 0.000000 0.000000 1.000000 /end COMPU_METHOD
/* Map (2d) calibration for DDE 'EFPm_NU_FuelPumpDC_FF_z'. */
/begin CHARACTERISTIC EFPm_NU_FuelPumpDC_FF_z "EFP FF Term z-axis" MAP 0x8cef0 RL_EFPM_NU_FUELPUMPDC_FF_Z 1.000000 CU_EFPM_NU_FUELPUMPDC_FF_Z 0.000000 1.000000
 /begin AXIS_DESCR COM_AXIS NO_INPUT_QUANTITY CU_EFPM_NU_FUELPUMPDC_FF_X 11 0.000000 8000.000000 AXIS_PTS_REF APD_EFPM_NU_FUELPUMPDC_FF_X /end AXIS_DESCR
 /begin AXIS_DESCR COM_AXIS NO_INPUT_QUANTITY CU_EFPM_NU_FUELPUMPDC_FF_Y 6 0.000000 2.000000 AXIS_PTS_REF APD_EFPM_NU_FUELPUMPDC_FF_Y /end AXIS_DESCR
 BYTE_ORDER MSB_FIRST /end CHARACTERISTIC
/begin RECORD_LAYOUT RL_EFPM_NU_FUELPUMPDC_FF_Z FNC_VALUES 1 FLOAT32_IEEE COLUMN_DIR DIRECT /end RECORD_LAYOUT
/begin COMPU_METHOD CU_EFPM_NU_FUELPUMPDC_FF_Z "Conversion method for EFPm_NU_FuelPumpDC_FF_z" RAT_FUNC "%10.3" "NU" COEFFS 0.000000 1.000000 0.000000 0.000000 0.000000 1.000000 /end COMPU_METHOD
/begin AXIS_PTS APD_EFPM_NU_FUELPUMPDC_FF_X "(Eng RPM) EFP FF Term x-axis" 0x8ceac NO_INPUT_QUANTITY RL_EFPM_NU_FUELPUMPDC_FF_X 8000.000000 CU_EFPM_NU_FUELPUMPDC_FF_X 11 0.0 8000.0 BYTE_ORDER MSB_FIRST /end AXIS_PTS
/begin RECORD_LAYOUT RL_EFPM_NU_FUELPUMPDC_FF_X AXIS_PTS_X 1 FLOAT32_IEEE INDEX_INCR DIRECT /end RECORD_LAYOUT
/begin COMPU_METHOD CU_EFPM_NU_FUELPUMPDC_FF_X "Conversion method for EFPm_NU_FuelPumpDC_FF_x" RAT_FUNC "%10.0" "RPM" COEFFS 0.000000 1.000000 0.000000 0.000000 0.000000 1.000000 /end COMPU_METHOD
/begin AXIS_PTS APD_EFPM_NU_FUELPUMPDC_FF_Y "(Eng Load Pct) EFP FF Term y-axis" 0x8ced8 NO_INPUT_QUANTITY RL_EFPM_NU_FUELPUMPDC_FF_Y 2.000000 CU_EFPM_NU_FUELPUMPDC_FF_Y 6 0.0 2.0 BYTE_ORDER MSB_FIRST /end AXIS_PTS
/begin RECORD_LAYOUT RL_EFPM_NU_FUELPUMPDC_FF_Y AXIS_PTS_X 1 FLOAT32_IEEE INDEX_INCR DIRECT /end RECORD_LAYOUT
/begin COMPU_METHOD CU_EFPM_NU_FUELPUMPDC_FF_Y "Conversion method for EFPm_NU_FuelPumpDC_FF_y" RAT_FUNC "%10.2" "pct" COEFFS 0.000000 1.000000 0.000000 0.000000 0.000000 1.000000 /end COMPU_METHOD
/* Scalar calibration for DDE 'ELMc_Nm_AlternatorTq'. */
/begin CHARACTERISTIC ELMc_Nm_AlternatorTq "override value" VALUE 0x82530 RL_ELMC_NM_ALTERNATORTQ 200.000000 CU_ELMC_NM_ALTERNATORTQ 0.000000 200.000000 BYTE_ORDER MSB_FIRST /end CHARACTERISTIC
/begin RECORD_LAYOUT RL_ELMC_NM_ALTERNATORTQ FNC_VALUES 1 FLOAT32_IEEE COLUMN_DIR DIRECT /end RECORD_LAYOUT
/begin COMPU_METHOD CU_ELMC_NM_ALTERNATORTQ "Conversion method for ELMc_Nm_AlternatorTq" RAT_FUNC "%10.2" "Nm" COEFFS 0.000000 1.000000 0.000000 0.000000 0.000000 1.000000 /end COMPU_METHOD
/* Scalar calibration for DDE 'ELMc_Nm_Tq'. */
/begin CHARACTERISTIC ELMc_Nm_Tq "Engine load torque override value" VALUE 0x83444 RL_ELMC_NM_TQ 200.000000 CU_ELMC_NM_TQ 0.000000 200.000000 BYTE_ORDER MSB_FIRST /end CHARACTERISTIC
/begin RECORD_LAYOUT RL_ELMC_NM_TQ FNC_VALUES 1 FLOAT32_IEEE COLUMN_DIR DIRECT /end RECORD_LAYOUT
/begin COMPU_METHOD CU_ELMC_NM_TQ "Conversion method for ELMc_Nm_Tq" RAT_FUNC "%10.2" "Nm" COEFFS 0.000000 1.000000 0.000000 0.000000 0.000000 1.000000 /end COMPU_METHOD
/* Scalar calibration for DDE 'ELMc_o_AlternatorTq'. */
/begin CHARACTERISTIC ELMc_o_AlternatorTq "override flag" VALUE 0x8252c RL_ELMC_O_ALTERNATORTQ 1.000000 CU_ELMC_O_ALTERNATORTQ 0.000000 1.000000 BYTE_ORDER MSB_FIRST /end CHARACTERISTIC
/begin RECORD_LAYOUT RL_ELMC_O_ALTERNATORTQ FNC_VALUES 1 UBYTE COLUMN_DIR DIRECT /end RECORD_LAYOUT
/begin COMPU_METHOD CU_ELMC_O_ALTERNATORTQ "Conversion method for ELMc_o_AlternatorTq" RAT_FUNC "%10.0" "o" COEFFS 0.000000 1.000000 0.000000 0.000000 0.000000 1.000000 /end COMPU_METHOD
/* Scalar calibration for DDE 'ELMc_o_Tq'. */
/begin CHARACTERISTIC ELMc_o_Tq "Engine load torque override flag" VALUE 0x83441 RL_ELMC_O_TQ 1.000000 CU_ELMC_O_TQ 0.000000 1.000000 BYTE_ORDER MSB_FIRST /end CHARACTERISTIC
/begin RECORD_LAYOUT RL_ELMC_O_TQ FNC_VALUES 1 UBYTE COLUMN_DIR DIRECT /end RECORD_LAYOUT
/begin COMPU_METHOD CU_ELMC_O_TQ "Conversion method for ELMc_o_Tq" RAT_FUNC "%10.0" "o" COEFFS 0.000000 1.000000 0.000000 0.000000 0.000000 1.000000 /end COMPU_METHOD
/* Map (1d) calibration for DDE 'ELMm_NU_Alternator_Tq_z'. */
/begin CHARACTERISTIC ELMm_NU_Alternator_Tq_z "HVAC load torque map data" CURVE 0x82518 RL_ELMM_NU_ALTERNATOR_TQ_Z 200.000000 CU_ELMM_NU_ALTERNATOR_TQ_Z 0.000000 200.000000
 /begin AXIS_DESCR COM_AXIS NO_INPUT_QUANTITY CU_ELMM_NU_ALTERNATOR_TQ_X 5 0.000000 10000.000000 AXIS_PTS_REF APD_ELMM_NU_ALTERNATOR_TQ_X /end AXIS_DESCR
 BYTE_ORDER MSB_FIRST /end CHARACTERISTIC
/begin RECORD_LAYOUT RL_ELMM_NU_ALTERNATOR_TQ_Z FNC_VALUES 1 FLOAT32_IEEE COLUMN_DIR DIRECT /end RECORD_LAYOUT
/begin COMPU_METHOD CU_ELMM_NU_ALTERNATOR_TQ_Z "Conversion method for ELMm_NU_Alternator_Tq_z" RAT_FUNC "%10.2" "Nm" COEFFS 0.000000 1.000000 0.000000 0.000000 0.000000 1.000000 /end COMPU_METHOD
/begin AXIS_PTS APD_ELMM_NU_ALTERNATOR_TQ_X "HVAC load torque map engine speed axis" 0x82504 NO_INPUT_QUANTITY RL_ELMM_NU_ALTERNATOR_TQ_X 10000.000000 CU_ELMM_NU_ALTERNATOR_TQ_X 5 0.0 10000.0 BYTE_ORDER MSB_FIRST /end AXIS_PTS
/begin RECORD_LAYOUT RL_ELMM_NU_ALTERNATOR_TQ_X AXIS_PTS_X 1 FLOAT32_IEEE INDEX_INCR DIRECT /end RECORD_LAYOUT
/begin COMPU_METHOD CU_ELMM_NU_ALTERNATOR_TQ_X "Conversion method for ELMm_NU_Alternator_Tq_x" RAT_FUNC "%10.0" "RPM" COEFFS 0.000000 1.000000 0.000000 0.000000 0.000000 1.000000 /end COMPU_METHOD
/* Map (2d) calibration for DDE 'ELMm_NU_FrictionTq_z'. */
/begin CHARACTERISTIC ELMm_NU_FrictionTq_z "Friction torque map data" MAP 0x832a0 RL_ELMM_NU_FRICTIONTQ_Z 200.000000 CU_ELMM_NU_FRICTIONTQ_Z 0.000000 200.000000
 /begin AXIS_DESCR COM_AXIS NO_INPUT_QUANTITY CU_ELMM_NU_FRICTIONTQ_X 10 0.000000 10000.000000 AXIS_PTS_REF APD_ELMM_NU_FRICTIONTQ_X /end AXIS_DESCR
 /begin AXIS_DESCR COM_AXIS NO_INPUT_QUANTITY CU_ELMM_NU_FRICTIONTQ_Y 9 -100.000000 1000.000000 AXIS_PTS_REF APD_ELMM_NU_FRICTIONTQ_Y /end AXIS_DESCR
 BYTE_ORDER MSB_FIRST /end CHARACTERISTIC
/begin RECORD_LAYOUT RL_ELMM_NU_FRICTIONTQ_Z FNC_VALUES 1 FLOAT32_IEEE COLUMN_DIR DIRECT /end RECORD_LAYOUT
/begin COMPU_METHOD CU_ELMM_NU_FRICTIONTQ_Z "Conversion method for ELMm_NU_FrictionTq_z" RAT_FUNC "%10.2" "Nm" COEFFS 0.000000 1.000000 0.000000 0.000000 0.000000 1.000000 /end COMPU_METHOD
/begin AXIS_PTS APD_ELMM_NU_FRICTIONTQ_X "Friction torque map engine speed axis" 0x83254 NO_INPUT_QUANTITY RL_ELMM_NU_FRICTIONTQ_X 10000.000000 CU_ELMM_NU_FRICTIONTQ_X 10 0.0 10000.0 BYTE_ORDER MSB_FIRST /end AXIS_PTS
/begin RECORD_LAYOUT RL_ELMM_NU_FRICTIONTQ_X AXIS_PTS_X 1 FLOAT32_IEEE INDEX_INCR DIRECT /end RECORD_LAYOUT
/begin COMPU_METHOD CU_ELMM_NU_FRICTIONTQ_X "Conversion method for ELMm_NU_FrictionTq_x" RAT_FUNC "%10.0" "RPM" COEFFS 0.000000 1.000000 0.000000 0.000000 0.000000 1.000000 /end COMPU_METHOD
/begin AXIS_PTS APD_ELMM_NU_FRICTIONTQ_Y "Friction torque map engine speed axis" 0x8327c NO_INPUT_QUANTITY RL_ELMM_NU_FRICTIONTQ_Y 1100.000000 CU_ELMM_NU_FRICTIONTQ_Y 9 -100.0 1000.0 BYTE_ORDER MSB_FIRST /end AXIS_PTS
/begin RECORD_LAYOUT RL_ELMM_NU_FRICTIONTQ_Y AXIS_PTS_X 1 FLOAT32_IEEE INDEX_INCR DIRECT /end RECORD_LAYOUT
/begin COMPU_METHOD CU_ELMM_NU_FRICTIONTQ_Y "Conversion method for ELMm_NU_FrictionTq_y" RAT_FUNC "%10.0" "RPM" COEFFS 0.000000 1.000000 0.000000 0.000000 0.000000 1.000000 /end COMPU_METHOD
/* Map (1d) calibration for DDE 'ELMm_NU_HVAC_Tq_z'. */
/begin CHARACTERISTIC ELMm_NU_HVAC_Tq_z "HVAC load torque map data" CURVE 0x831f8 RL_ELMM_NU_HVAC_TQ_Z 200.000000 CU_ELMM_NU_HVAC_TQ_Z 0.000000 200.000000
 /begin AXIS_DESCR COM_AXIS NO_INPUT_QUANTITY CU_ELMM_NU_HVAC_TQ_X 13 0.000000 10000.000000 AXIS_PTS_REF APD_ELMM_NU_HVAC_TQ_X /end AXIS_DESCR
 BYTE_ORDER MSB_FIRST /end CHARACTERISTIC
/begin RECORD_LAYOUT RL_ELMM_NU_HVAC_TQ_Z FNC_VALUES 1 FLOAT32_IEEE COLUMN_DIR DIRECT /end RECORD_LAYOUT
/begin COMPU_METHOD CU_ELMM_NU_HVAC_TQ_Z "Conversion method for ELMm_NU_HVAC_Tq_z" RAT_FUNC "%10.2" "Nm" COEFFS 0.000000 1.000000 0.000000 0.000000 0.000000 1.000000 /end COMPU_METHOD
/begin AXIS_PTS APD_ELMM_NU_HVAC_TQ_X "HVAC load torque map engine speed axis" 0x831c4 NO_INPUT_QUANTITY RL_ELMM_NU_HVAC_TQ_X 10000.000000 CU_ELMM_NU_HVAC_TQ_X 13 0.0 10000.0 BYTE_ORDER MSB_FIRST /end AXIS_PTS
/begin RECORD_LAYOUT RL_ELMM_NU_HVAC_TQ_X AXIS_PTS_X 1 FLOAT32_IEEE INDEX_INCR DIRECT /end RECORD_LAYOUT
/begin COMPU_METHOD CU_ELMM_NU_HVAC_TQ_X "Conversion method for ELMm_NU_HVAC_Tq_x" RAT_FUNC "%10.0" "RPM" COEFFS 0.000000 1.000000 0.000000 0.000000 0.000000 1.000000 /end COMPU_METHOD
/* Map (1d) calibration for DDE 'ELMm_NU_PwrStrTq_z'. */
/begin CHARACTERISTIC ELMm_NU_PwrStrTq_z "Power steering load torque map data" CURVE 0x83240 RL_ELMM_NU_PWRSTRTQ_Z 200.000000 CU_ELMM_NU_PWRSTRTQ_Z 0.000000 200.000000
 /begin AXIS_DESCR COM_AXIS NO_INPUT_QUANTITY CU_ELMM_NU_PWRSTRTQ_X 5 0.000000 10000.000000 AXIS_PTS_REF APD_ELMM_NU_PWRSTRTQ_X /end AXIS_DESCR
 BYTE_ORDER MSB_FIRST /end CHARACTERISTIC
/begin RECORD_LAYOUT RL_ELMM_NU_PWRSTRTQ_Z FNC_VALUES 1 FLOAT32_IEEE COLUMN_DIR DIRECT /end RECORD_LAYOUT
/begin COMPU_METHOD CU_ELMM_NU_PWRSTRTQ_Z "Conversion method for ELMm_NU_PwrStrTq_z" RAT_FUNC "%10.2" "Nm" COEFFS 0.000000 1.000000 0.000000 0.000000 0.000000 1.000000 /end COMPU_METHOD
/begin AXIS_PTS APD_ELMM_NU_PWRSTRTQ_X "Power steering load torque map engine speed axis" 0x8322c NO_INPUT_QUANTITY RL_ELMM_NU_PWRSTRTQ_X 10000.000000 CU_ELMM_NU_PWRSTRTQ_X 5 0.0 10000.0 BYTE_ORDER MSB_FIRST /end AXIS_PTS
/begin RECORD_LAYOUT RL_ELMM_NU_PWRSTRTQ_X AXIS_PTS_X 1 FLOAT32_IEEE INDEX_INCR DIRECT /end RECORD_LAYOUT
/begin COMPU_METHOD CU_ELMM_NU_PWRSTRTQ_X "Conversion method for ELMm_NU_PwrStrTq_x" RAT_FUNC "%10.0" "RPM" COEFFS 0.000000 1.000000 0.000000 0.000000 0.000000 1.000000 /end COMPU_METHOD
/* Map (1d) calibration for DDE 'ELMm_NU_ZFFAN_Tq_z'. */
/begin CHARACTERISTIC ELMm_NU_ZFFAN_Tq_z "Fuel pump load torque map data" CURVE 0x8341c RL_ELMM_NU_ZFFAN_TQ_Z 200.000000 CU_ELMM_NU_ZFFAN_TQ_Z 0.000000 200.000000
 /begin AXIS_DESCR COM_AXIS NO_INPUT_QUANTITY CU_ELMM_NU_ZFFAN_TQ_X 5 0.000000 10000.000000 AXIS_PTS_REF APD_ELMM_NU_ZFFAN_TQ_X /end AXIS_DESCR
 BYTE_ORDER MSB_FIRST /end CHARACTERISTIC
/begin RECORD_LAYOUT RL_ELMM_NU_ZFFAN_TQ_Z FNC_VALUES 1 FLOAT32_IEEE COLUMN_DIR DIRECT /end RECORD_LAYOUT
/begin COMPU_METHOD CU_ELMM_NU_ZFFAN_TQ_Z "Conversion method for ELMm_NU_ZFFAN_Tq_z" RAT_FUNC "%10.2" "Nm" COEFFS 0.000000 1.000000 0.000000 0.000000 0.000000 1.000000 /end COMPU_METHOD
/begin AXIS_PTS APD_ELMM_NU_ZFFAN_TQ_X "Fuel pump load torque map engine speed axis" 0x83408 NO_INPUT_QUANTITY RL_ELMM_NU_ZFFAN_TQ_X 10000.000000 CU_ELMM_NU_ZFFAN_TQ_X 5 0.0 10000.0 BYTE_ORDER MSB_FIRST /end AXIS_PTS
/begin RECORD_LAYOUT RL_ELMM_NU_ZFFAN_TQ_X AXIS_PTS_X 1 FLOAT32_IEEE INDEX_INCR DIRECT /end RECORD_LAYOUT
/begin COMPU_METHOD CU_ELMM_NU_ZFFAN_TQ_X "Conversion method for ELMm_NU_ZFFAN_Tq_x" RAT_FUNC "%10.0" "RPM" COEFFS 0.000000 1.000000 0.000000 0.000000 0.000000 1.000000 /end COMPU_METHOD
/* Scalar calibration for DDE 'ERLc_NU_PGain'. */
/begin CHARACTERISTIC ERLc_NU_PGain "Proportional gain for engine speed limiting" VALUE 0x83454 RL_ERLC_NU_PGAIN 1.000000 CU_ERLC_NU_PGAIN 0.000000 1.000000 BYTE_ORDER MSB_FIRST /end CHARACTERISTIC
/begin RECORD_LAYOUT RL_ERLC_NU_PGAIN FNC_VALUES 1 FLOAT32_IEEE COLUMN_DIR DIRECT /end RECORD_LAYOUT
/begin COMPU_METHOD CU_ERLC_NU_PGAIN "Conversion method for ERLc_NU_PGain" RAT_FUNC "%10.4" "NU" COEFFS 0.000000 1.000000 0.000000 0.000000 0.000000 1.000000 /end COMPU_METHOD
/* Scalar calibration for DDE 'ERLc_RPM_HardLimOfst'. */
/begin CHARACTERISTIC ERLc_RPM_HardLimOfst "The hard limit equals the soft limit plus this amount" VALUE 0x8344c RL_ERLC_RPM_HARDLIMOFST 2000.000000 CU_ERLC_RPM_HARDLIMOFST 0.000000 2000.000000 BYTE_ORDER MSB_FIRST /end CHARACTERISTIC
/begin RECORD_LAYOUT RL_ERLC_RPM_HARDLIMOFST FNC_VALUES 1 FLOAT32_IEEE COLUMN_DIR DIRECT /end RECORD_LAYOUT
/begin COMPU_METHOD CU_ERLC_RPM_HARDLIMOFST "Conversion method for ERLc_RPM_HardLimOfst" RAT_FUNC "%10.0" "RPM" COEFFS 0.000000 1.000000 0.000000 0.000000 0.000000 1.000000 /end COMPU_METHOD
/* Scalar calibration for DDE 'ERLc_RPM_SoftLim'. */
/begin CHARACTERISTIC ERLc_RPM_SoftLim "Lower or soft engine speed limit calibration" VALUE 0x83450 RL_ERLC_RPM_SOFTLIM 10000.000000 CU_ERLC_RPM_SOFTLIM 0.000000 10000.000000 BYTE_ORDER MSB_FIRST /end CHARACTERISTIC
/begin RECORD_LAYOUT RL_ERLC_RPM_SOFTLIM FNC_VALUES 1 FLOAT32_IEEE COLUMN_DIR DIRECT /end RECORD_LAYOUT
/begin COMPU_METHOD CU_ERLC_RPM_SOFTLIM "Conversion method for ERLc_RPM_SoftLim" RAT_FUNC "%10.0" "RPM" COEFFS 0.000000 1.000000 0.000000 0.000000 0.000000 1.000000 /end COMPU_METHOD
/* Scalar calibration for DDE 'ERLc_b_Active'. */
/begin CHARACTERISTIC ERLc_b_Active "Engine rev limiter active override value" VALUE 0x835cf RL_ERLC_B_ACTIVE 1.000000 CU_ERLC_B_ACTIVE 0.000000 1.000000 BYTE_ORDER MSB_FIRST /end CHARACTERISTIC
/begin RECORD_LAYOUT RL_ERLC_B_ACTIVE FNC_VALUES 1 UBYTE COLUMN_DIR DIRECT /end RECORD_LAYOUT
/begin COMPU_METHOD CU_ERLC_B_ACTIVE "Conversion method for ERLc_b_Active" RAT_FUNC "%10.0" "b" COEFFS 0.000000 1.000000 0.000000 0.000000 0.000000 1.000000 /end COMPU_METHOD
/* Scalar calibration for DDE 'ERLc_b_CutFuel'. */
/begin CHARACTERISTIC ERLc_b_CutFuel "Engine rev limiter cut fuel override value" VALUE 0x8351f RL_ERLC_B_CUTFUEL 1.000000 CU_ERLC_B_CUTFUEL 0.000000 1.000000 BYTE_ORDER MSB_FIRST /end CHARACTERISTIC
/begin RECORD_LAYOUT RL_ERLC_B_CUTFUEL FNC_VALUES 1 UBYTE COLUMN_DIR DIRECT /end RECORD_LAYOUT
/begin COMPU_METHOD CU_ERLC_B_CUTFUEL "Conversion method for ERLc_b_CutFuel" RAT_FUNC "%10.0" "b" COEFFS 0.000000 1.000000 0.000000 0.000000 0.000000 1.000000 /end COMPU_METHOD
/* Scalar calibration for DDE 'ERLc_b_CutSpark'. */
/begin CHARACTERISTIC ERLc_b_CutSpark "Engine rev limiter cut spark override value" VALUE 0x8b855 RL_ERLC_B_CUTSPARK 1.000000 CU_ERLC_B_CUTSPARK 0.000000 1.000000 BYTE_ORDER MSB_FIRST /end CHARACTERISTIC
/begin RECORD_LAYOUT RL_ERLC_B_CUTSPARK FNC_VALUES 1 UBYTE COLUMN_DIR DIRECT /end RECORD_LAYOUT
/begin COMPU_METHOD CU_ERLC_B_CUTSPARK "Conversion method for ERLc_b_CutSpark" RAT_FUNC "%10.0" "b" COEFFS 0.000000 1.000000 0.000000 0.000000 0.000000 1.000000 /end COMPU_METHOD
/* Scalar calibration for DDE 'ERLc_o_Active'. */
/begin CHARACTERISTIC ERLc_o_Active "Engine rev limiter active override flag" VALUE 0x835ce RL_ERLC_O_ACTIVE 1.000000 CU_ERLC_O_ACTIVE 0.000000 1.000000 BYTE_ORDER MSB_FIRST /end CHARACTERISTIC
/begin RECORD_LAYOUT RL_ERLC_O_ACTIVE FNC_VALUES 1 UBYTE COLUMN_DIR DIRECT /end RECORD_LAYOUT
/begin COMPU_METHOD CU_ERLC_O_ACTIVE "Conversion method for ERLc_o_Active" RAT_FUNC "%10.0" "o" COEFFS 0.000000 1.000000 0.000000 0.000000 0.000000 1.000000 /end COMPU_METHOD
/* Scalar calibration for DDE 'ERLc_o_CutFuel'. */
/begin CHARACTERISTIC ERLc_o_CutFuel "Engine rev limiter cut fuel override flag" VALUE 0x8351e RL_ERLC_O_CUTFUEL 1.000000 CU_ERLC_O_CUTFUEL 0.000000 1.000000 BYTE_ORDER MSB_FIRST /end CHARACTERISTIC
/begin RECORD_LAYOUT RL_ERLC_O_CUTFUEL FNC_VALUES 1 UBYTE COLUMN_DIR DIRECT /end RECORD_LAYOUT
/begin COMPU_METHOD CU_ERLC_O_CUTFUEL "Conversion method for ERLc_o_CutFuel" RAT_FUNC "%10.0" "o" COEFFS 0.000000 1.000000 0.000000 0.000000 0.000000 1.000000 /end COMPU_METHOD
/* Scalar calibration for DDE 'ERLc_o_CutSpark'. */
/begin CHARACTERISTIC ERLc_o_CutSpark "Engine rev limiter cut spark override flag" VALUE 0x8b854 RL_ERLC_O_CUTSPARK 1.000000 CU_ERLC_O_CUTSPARK 0.000000 1.000000 BYTE_ORDER MSB_FIRST /end CHARACTERISTIC
/begin RECORD_LAYOUT RL_ERLC_O_CUTSPARK FNC_VALUES 1 UBYTE COLUMN_DIR DIRECT /end RECORD_LAYOUT
/begin COMPU_METHOD CU_ERLC_O_CUTSPARK "Conversion method for ERLc_o_CutSpark" RAT_FUNC "%10.0" "o" COEFFS 0.000000 1.000000 0.000000 0.000000 0.000000 1.000000 /end COMPU_METHOD
/* Scalar calibration for DDE 'ERLc_o_SparkRetard'. */
/begin CHARACTERISTIC ERLc_o_SparkRetard "Engine rev limiter spark retard override flag" VALUE 0x84f74 RL_ERLC_O_SPARKRETARD 1.000000 CU_ERLC_O_SPARKRETARD 0.000000 1.000000 BYTE_ORDER MSB_FIRST /end CHARACTERISTIC
/begin RECORD_LAYOUT RL_ERLC_O_SPARKRETARD FNC_VALUES 1 UBYTE COLUMN_DIR DIRECT /end RECORD_LAYOUT
/begin COMPU_METHOD CU_ERLC_O_SPARKRETARD "Conversion method for ERLc_o_SparkRetard" RAT_FUNC "%10.0" "o" COEFFS 0.000000 1.000000 0.000000 0.000000 0.000000 1.000000 /end COMPU_METHOD
/* Scalar calibration for DDE 'ERLc_o_TqMult'. */
/begin CHARACTERISTIC ERLc_o_TqMult "Engine rev limiter torque multiplier override flag" VALUE 0x83458 RL_ERLC_O_TQMULT 1.000000 CU_ERLC_O_TQMULT 0.000000 1.000000 BYTE_ORDER MSB_FIRST /end CHARACTERISTIC
/begin RECORD_LAYOUT RL_ERLC_O_TQMULT FNC_VALUES 1 UBYTE COLUMN_DIR DIRECT /end RECORD_LAYOUT
/begin COMPU_METHOD CU_ERLC_O_TQMULT "Conversion method for ERLc_o_TqMult" RAT_FUNC "%10.0" "o" COEFFS 0.000000 1.000000 0.000000 0.000000 0.000000 1.000000 /end COMPU_METHOD
/* Scalar calibration for DDE 'ERLc_pct_HardLim'. */
/begin CHARACTERISTIC ERLc_pct_HardLim "Torque demand multiplier if hard limit is reached" VALUE 0x83460 RL_ERLC_PCT_HARDLIM 1.000000 CU_ERLC_PCT_HARDLIM 0.000000 1.000000 BYTE_ORDER MSB_FIRST /end CHARACTERISTIC
/begin RECORD_LAYOUT RL_ERLC_PCT_HARDLIM FNC_VALUES 1 FLOAT32_IEEE COLUMN_DIR DIRECT /end RECORD_LAYOUT
/begin COMPU_METHOD CU_ERLC_PCT_HARDLIM "Conversion method for ERLc_pct_HardLim" RAT_FUNC "%10.2" "pct" COEFFS 0.000000 1.000000 0.000000 0.000000 0.000000 1.000000 /end COMPU_METHOD
/* Scalar calibration for DDE 'ERLc_pct_TqMult'. */
/begin CHARACTERISTIC ERLc_pct_TqMult "Engine rev limiter torque multiplier override value" VALUE 0x8345c RL_ERLC_PCT_TQMULT 1.000000 CU_ERLC_PCT_TQMULT 0.000000 1.000000 BYTE_ORDER MSB_FIRST /end CHARACTERISTIC
/begin RECORD_LAYOUT RL_ERLC_PCT_TQMULT FNC_VALUES 1 FLOAT32_IEEE COLUMN_DIR DIRECT /end RECORD_LAYOUT
/begin COMPU_METHOD CU_ERLC_PCT_TQMULT "Conversion method for ERLc_pct_TqMult" RAT_FUNC "%10.2" "pct" COEFFS 0.000000 1.000000 0.000000 0.000000 0.000000 1.000000 /end COMPU_METHOD
/* Scalar calibration for DDE 'ERLc_ret_SparkRetard'. */
/begin CHARACTERISTIC ERLc_ret_SparkRetard "Engine rev limiter spark retard override value" VALUE 0x84f78 RL_ERLC_RET_SPARKRETARD 90.000000 CU_ERLC_RET_SPARKRETARD 0.000000 90.000000 BYTE_ORDER MSB_FIRST /end CHARACTERISTIC
/begin RECORD_LAYOUT RL_ERLC_RET_SPARKRETARD FNC_VALUES 1 FLOAT32_IEEE COLUMN_DIR DIRECT /end RECORD_LAYOUT
/begin COMPU_METHOD CU_ERLC_RET_SPARKRETARD "Conversion method for ERLc_ret_SparkRetard" RAT_FUNC "%10.0" "ret" COEFFS 0.000000 1.000000 0.000000 0.000000 0.000000 1.000000 /end COMPU_METHOD
/* Map (1d) calibration for DDE 'ERLm_NU_SparkRetard_z'. */
/begin CHARACTERISTIC ERLm_NU_SparkRetard_z "Engine speed limiting spark retard map data" CURVE 0x84f60 RL_ERLM_NU_SPARKRETARD_Z 90.000000 CU_ERLM_NU_SPARKRETARD_Z 0.000000 90.000000
 /begin AXIS_DESCR COM_AXIS ERL_RPM_Overspd CU_ERLM_NU_SPARKRETARD_X 5 0.000000 10000.000000 AXIS_PTS_REF APD_ERLM_NU_SPARKRETARD_X /end AXIS_DESCR
 BYTE_ORDER MSB_FIRST /end CHARACTERISTIC
/begin RECORD_LAYOUT RL_ERLM_NU_SPARKRETARD_Z FNC_VALUES 1 FLOAT32_IEEE COLUMN_DIR DIRECT /end RECORD_LAYOUT
/begin COMPU_METHOD CU_ERLM_NU_SPARKRETARD_Z "Conversion method for ERLm_NU_SparkRetard_z" RAT_FUNC "%10.0" "deg" COEFFS 0.000000 1.000000 0.000000 0.000000 0.000000 1.000000 /end COMPU_METHOD
/begin AXIS_PTS APD_ERLM_NU_SPARKRETARD_X "Engine speed limiting spark retard map engine speed axis" 0x84f4c ERL_RPM_Overspd RL_ERLM_NU_SPARKRETARD_X 10000.000000 CU_ERLM_NU_SPARKRETARD_X 5 0.0 10000.0 BYTE_ORDER MSB_FIRST /end AXIS_PTS
/begin RECORD_LAYOUT RL_ERLM_NU_SPARKRETARD_X AXIS_PTS_X 1 FLOAT32_IEEE INDEX_INCR DIRECT /end RECORD_LAYOUT
/begin COMPU_METHOD CU_ERLM_NU_SPARKRETARD_X "Conversion method for ERLm_NU_SparkRetard_x" RAT_FUNC "%10.0" "RPM" COEFFS 0.000000 1.000000 0.000000 0.000000 0.000000 1.000000 /end COMPU_METHOD
/* Scalar calibration for DDE 'ERMc_RPM_EnterCranking'. */
/begin CHARACTERISTIC ERMc_RPM_EnterCranking "ERM becomes _Cranking_ once this speed is exceeded" VALUE 0x80514 RL_ERMC_RPM_ENTERCRANKING 999.000000 CU_ERMC_RPM_ENTERCRANKING 1.000000 1000.000000 BYTE_ORDER MSB_FIRST /end CHARACTERISTIC
/begin RECORD_LAYOUT RL_ERMC_RPM_ENTERCRANKING FNC_VALUES 1 FLOAT32_IEEE COLUMN_DIR DIRECT /end RECORD_LAYOUT
/begin COMPU_METHOD CU_ERMC_RPM_ENTERCRANKING "Conversion method for ERMc_RPM_EnterCranking" RAT_FUNC "%10.0" "RPM" COEFFS 0.000000 1.000000 0.000000 0.000000 0.000000 1.000000 /end COMPU_METHOD
/* Scalar calibration for DDE 'ERMc_RPM_EnterRunning'. */
/begin CHARACTERISTIC ERMc_RPM_EnterRunning "ERM becomes _Running_ once this speed is exceeded" VALUE 0x8051c RL_ERMC_RPM_ENTERRUNNING 1000.000000 CU_ERMC_RPM_ENTERRUNNING 0.000000 1000.000000 BYTE_ORDER MSB_FIRST /end CHARACTERISTIC
/begin RECORD_LAYOUT RL_ERMC_RPM_ENTERRUNNING FNC_VALUES 1 FLOAT32_IEEE COLUMN_DIR DIRECT /end RECORD_LAYOUT
/begin COMPU_METHOD CU_ERMC_RPM_ENTERRUNNING "Conversion method for ERMc_RPM_EnterRunning" RAT_FUNC "%10.0" "RPM" COEFFS 0.000000 1.000000 0.000000 0.000000 0.000000 1.000000 /end COMPU_METHOD
/* Scalar calibration for DDE 'ERMc_RPM_ExitCranking'. */
/begin CHARACTERISTIC ERMc_RPM_ExitCranking "ERM becomes _Stopped_ when below this speed" VALUE 0x80518 RL_ERMC_RPM_EXITCRANKING 1000.000000 CU_ERMC_RPM_EXITCRANKING 0.000000 1000.000000 BYTE_ORDER MSB_FIRST /end CHARACTERISTIC
/begin RECORD_LAYOUT RL_ERMC_RPM_EXITCRANKING FNC_VALUES 1 FLOAT32_IEEE COLUMN_DIR DIRECT /end RECORD_LAYOUT
/begin COMPU_METHOD CU_ERMC_RPM_EXITCRANKING "Conversion method for ERMc_RPM_ExitCranking" RAT_FUNC "%10.0" "RPM" COEFFS 0.000000 1.000000 0.000000 0.000000 0.000000 1.000000 /end COMPU_METHOD
/* Scalar calibration for DDE 'ERMc_RPM_ExitRunning'. */
/begin CHARACTERISTIC ERMc_RPM_ExitRunning "ERM becomes _Cranking_ when below this speed" VALUE 0x80520 RL_ERMC_RPM_EXITRUNNING 1000.000000 CU_ERMC_RPM_EXITRUNNING 0.000000 1000.000000 BYTE_ORDER MSB_FIRST /end CHARACTERISTIC
/begin RECORD_LAYOUT RL_ERMC_RPM_EXITRUNNING FNC_VALUES 1 FLOAT32_IEEE COLUMN_DIR DIRECT /end RECORD_LAYOUT
/begin COMPU_METHOD CU_ERMC_RPM_EXITRUNNING "Conversion method for ERMc_RPM_ExitRunning" RAT_FUNC "%10.0" "RPM" COEFFS 0.000000 1.000000 0.000000 0.000000 0.000000 1.000000 /end COMPU_METHOD
/* Scalar calibration for DDE 'ERMc_e_RunningMode'. */
/begin CHARACTERISTIC ERMc_e_RunningMode "Override value" VALUE 0x80525 RL_ERMC_E_RUNNINGMODE 4.000000 CU_ERMC_E_RUNNINGMODE 1.000000 5.000000 BYTE_ORDER MSB_FIRST /end CHARACTERISTIC
/begin RECORD_LAYOUT RL_ERMC_E_RUNNINGMODE FNC_VALUES 1 UBYTE COLUMN_DIR DIRECT /end RECORD_LAYOUT
/begin COMPU_METHOD CU_ERMC_E_RUNNINGMODE "Conversion method for ERMc_e_RunningMode" TAB_VERB "%12.0" "e" COMPU_TAB_REF CT_ERMC_E_RUNNINGMODE /end COMPU_METHOD
/begin COMPU_VTAB CT_ERMC_E_RUNNINGMODE "Conversion method for ERMc_e_RunningMode" TAB_VERB 5 0 "ERMk_e_Stopped" 1 "ERMk_e_Stalled" 2 "ERMk_e_Cranking" 3 "ERMk_e_360_Mode" 4 "ERMk_e_Running" /end COMPU_VTAB
/* Scalar calibration for DDE 'ERMc_o_RunningMode'. */
/begin CHARACTERISTIC ERMc_o_RunningMode "Override flag" VALUE 0x80524 RL_ERMC_O_RUNNINGMODE 1.000000 CU_ERMC_O_RUNNINGMODE 0.000000 1.000000 BYTE_ORDER MSB_FIRST /end CHARACTERISTIC
/begin RECORD_LAYOUT RL_ERMC_O_RUNNINGMODE FNC_VALUES 1 UBYTE COLUMN_DIR DIRECT /end RECORD_LAYOUT
/begin COMPU_METHOD CU_ERMC_O_RUNNINGMODE "Conversion method for ERMc_o_RunningMode" RAT_FUNC "%10.0" "o" COEFFS 0.000000 1.000000 0.000000 0.000000 0.000000 1.000000 /end COMPU_METHOD
/* Scalar calibration for DDE 'ERMc_o_TimeSinceStart'. */
/begin CHARACTERISTIC ERMc_o_TimeSinceStart "Override flag" VALUE 0x824a8 RL_ERMC_O_TIMESINCESTART 1.000000 CU_ERMC_O_TIMESINCESTART 0.000000 1.000000 BYTE_ORDER MSB_FIRST /end CHARACTERISTIC
/begin RECORD_LAYOUT RL_ERMC_O_TIMESINCESTART FNC_VALUES 1 UBYTE COLUMN_DIR DIRECT /end RECORD_LAYOUT
/begin COMPU_METHOD CU_ERMC_O_TIMESINCESTART "Conversion method for ERMc_o_TimeSinceStart" RAT_FUNC "%10.0" "o" COEFFS 0.000000 1.000000 0.000000 0.000000 0.000000 1.000000 /end COMPU_METHOD
/* Scalar calibration for DDE 'ERMc_s_TimeSinceStart'. */
/begin CHARACTERISTIC ERMc_s_TimeSinceStart "Override value" VALUE 0x824ac RL_ERMC_S_TIMESINCESTART 600.000000 CU_ERMC_S_TIMESINCESTART 0.000000 600.000000 BYTE_ORDER MSB_FIRST /end CHARACTERISTIC
/begin RECORD_LAYOUT RL_ERMC_S_TIMESINCESTART FNC_VALUES 1 FLOAT32_IEEE COLUMN_DIR DIRECT /end RECORD_LAYOUT
/begin COMPU_METHOD CU_ERMC_S_TIMESINCESTART "Conversion method for ERMc_s_TimeSinceStart" RAT_FUNC "%10.0" "s" COEFFS 0.000000 1.000000 0.000000 0.000000 0.000000 1.000000 /end COMPU_METHOD
/* Scalar calibration for DDE 'ETCc_Hz_TP1_LPF'. */
/begin CHARACTERISTIC ETCc_Hz_TP1_LPF "Lowspeed filter for TP endstop learning" VALUE 0x879b4 RL_ETCC_HZ_TP1_LPF 99.900000 CU_ETCC_HZ_TP1_LPF 0.100000 100.000000 BYTE_ORDER MSB_FIRST /end CHARACTERISTIC
/begin RECORD_LAYOUT RL_ETCC_HZ_TP1_LPF FNC_VALUES 1 FLOAT32_IEEE COLUMN_DIR DIRECT /end RECORD_LAYOUT
/begin COMPU_METHOD CU_ETCC_HZ_TP1_LPF "Conversion method for ETCc_Hz_TP1_LPF" RAT_FUNC "%10.2" "Hz" COEFFS 0.000000 1.000000 0.000000 0.000000 0.000000 1.000000 /end COMPU_METHOD
/* Scalar calibration for DDE 'ETCc_Hz_TP2_LPF'. */
/begin CHARACTERISTIC ETCc_Hz_TP2_LPF "Lowspeed filter for TP endstop learning" VALUE 0x8799c RL_ETCC_HZ_TP2_LPF 99.900000 CU_ETCC_HZ_TP2_LPF 0.100000 100.000000 BYTE_ORDER MSB_FIRST /end CHARACTERISTIC
/begin RECORD_LAYOUT RL_ETCC_HZ_TP2_LPF FNC_VALUES 1 FLOAT32_IEEE COLUMN_DIR DIRECT /end RECORD_LAYOUT
/begin COMPU_METHOD CU_ETCC_HZ_TP2_LPF "Conversion method for ETCc_Hz_TP2_LPF" RAT_FUNC "%10.2" "Hz" COEFFS 0.000000 1.000000 0.000000 0.000000 0.000000 1.000000 /end COMPU_METHOD
/* Scalar calibration for DDE 'ETCc_NU_FallRate'. */
/begin CHARACTERISTIC ETCc_NU_FallRate "Falling Rate Limiter at Input for ETC" VALUE 0x87aa8 RL_ETCC_NU_FALLRATE 10000.000000 CU_ETCC_NU_FALLRATE -10000.000000 0.000000 BYTE_ORDER MSB_FIRST /end CHARACTERISTIC
/begin RECORD_LAYOUT RL_ETCC_NU_FALLRATE FNC_VALUES 1 FLOAT32_IEEE COLUMN_DIR DIRECT /end RECORD_LAYOUT
/begin COMPU_METHOD CU_ETCC_NU_FALLRATE "Conversion method for ETCc_NU_FallRate" RAT_FUNC "%10.2" "NU" COEFFS 0.000000 1.000000 0.000000 0.000000 0.000000 1.000000 /end COMPU_METHOD
/* Scalar calibration for DDE 'ETCc_NU_FullLearnDfltTP1'. */
/begin CHARACTERISTIC ETCc_NU_FullLearnDfltTP1 "Full position learn default value for throttle position sensor 1" VALUE 0x918e8 RL_ETCC_NU_FULLLEARNDFLTTP1 400.000000 CU_ETCC_NU_FULLLEARNDFLTTP1 -200.000000 200.000000 BYTE_ORDER MSB_FIRST /end CHARACTERISTIC
/begin RECORD_LAYOUT RL_ETCC_NU_FULLLEARNDFLTTP1 FNC_VALUES 1 FLOAT32_IEEE COLUMN_DIR DIRECT /end RECORD_LAYOUT
/begin COMPU_METHOD CU_ETCC_NU_FULLLEARNDFLTTP1 "Conversion method for ETCc_NU_FullLearnDfltTP1" RAT_FUNC "%10.3" "NU" COEFFS 0.000000 1.000000 0.000000 0.000000 0.000000 1.000000 /end COMPU_METHOD
/* Scalar calibration for DDE 'ETCc_NU_FullLearnDfltTP2'. */
/begin CHARACTERISTIC ETCc_NU_FullLearnDfltTP2 "Full position learn default value for throttle position sensor 2" VALUE 0x918ec RL_ETCC_NU_FULLLEARNDFLTTP2 400.000000 CU_ETCC_NU_FULLLEARNDFLTTP2 -200.000000 200.000000 BYTE_ORDER MSB_FIRST /end CHARACTERISTIC
/begin RECORD_LAYOUT RL_ETCC_NU_FULLLEARNDFLTTP2 FNC_VALUES 1 FLOAT32_IEEE COLUMN_DIR DIRECT /end RECORD_LAYOUT
/begin COMPU_METHOD CU_ETCC_NU_FULLLEARNDFLTTP2 "Conversion method for ETCc_NU_FullLearnDfltTP2" RAT_FUNC "%10.3" "NU" COEFFS 0.000000 1.000000 0.000000 0.000000 0.000000 1.000000 /end COMPU_METHOD
/* Scalar calibration for DDE 'ETCc_NU_FullLearnHiLimTP1'. */
/begin CHARACTERISTIC ETCc_NU_FullLearnHiLimTP1 "Expected range of values for full-open" VALUE 0x879cc RL_ETCC_NU_FULLLEARNHILIMTP1 400.000000 CU_ETCC_NU_FULLLEARNHILIMTP1 -200.000000 200.000000 BYTE_ORDER MSB_FIRST /end CHARACTERISTIC
/begin RECORD_LAYOUT RL_ETCC_NU_FULLLEARNHILIMTP1 FNC_VALUES 1 FLOAT32_IEEE COLUMN_DIR DIRECT /end RECORD_LAYOUT
/begin COMPU_METHOD CU_ETCC_NU_FULLLEARNHILIMTP1 "Conversion method for ETCc_NU_FullLearnHiLimTP1" RAT_FUNC "%10.3" "NU" COEFFS 0.000000 1.000000 0.000000 0.000000 0.000000 1.000000 /end COMPU_METHOD
/* Scalar calibration for DDE 'ETCc_NU_FullLearnHiLimTP2'. */
/begin CHARACTERISTIC ETCc_NU_FullLearnHiLimTP2 "Expected range of values for full-open" VALUE 0x879c4 RL_ETCC_NU_FULLLEARNHILIMTP2 400.000000 CU_ETCC_NU_FULLLEARNHILIMTP2 -200.000000 200.000000 BYTE_ORDER MSB_FIRST /end CHARACTERISTIC
/begin RECORD_LAYOUT RL_ETCC_NU_FULLLEARNHILIMTP2 FNC_VALUES 1 FLOAT32_IEEE COLUMN_DIR DIRECT /end RECORD_LAYOUT
/begin COMPU_METHOD CU_ETCC_NU_FULLLEARNHILIMTP2 "Conversion method for ETCc_NU_FullLearnHiLimTP2" RAT_FUNC "%10.3" "NU" COEFFS 0.000000 1.000000 0.000000 0.000000 0.000000 1.000000 /end COMPU_METHOD
/* Scalar calibration for DDE 'ETCc_NU_FullLearnLoLimTP1'. */
/begin CHARACTERISTIC ETCc_NU_FullLearnLoLimTP1 "Expected range of values for full-open" VALUE 0x879c8 RL_ETCC_NU_FULLLEARNLOLIMTP1 400.000000 CU_ETCC_NU_FULLLEARNLOLIMTP1 -200.000000 200.000000 BYTE_ORDER MSB_FIRST /end CHARACTERISTIC
/begin RECORD_LAYOUT RL_ETCC_NU_FULLLEARNLOLIMTP1 FNC_VALUES 1 FLOAT32_IEEE COLUMN_DIR DIRECT /end RECORD_LAYOUT
/begin COMPU_METHOD CU_ETCC_NU_FULLLEARNLOLIMTP1 "Conversion method for ETCc_NU_FullLearnLoLimTP1" RAT_FUNC "%10.3" "NU" COEFFS 0.000000 1.000000 0.000000 0.000000 0.000000 1.000000 /end COMPU_METHOD
/* Scalar calibration for DDE 'ETCc_NU_FullLearnLoLimTP2'. */
/begin CHARACTERISTIC ETCc_NU_FullLearnLoLimTP2 "Expected range of values for full-open" VALUE 0x879c0 RL_ETCC_NU_FULLLEARNLOLIMTP2 400.000000 CU_ETCC_NU_FULLLEARNLOLIMTP2 -200.000000 200.000000 BYTE_ORDER MSB_FIRST /end CHARACTERISTIC
/begin RECORD_LAYOUT RL_ETCC_NU_FULLLEARNLOLIMTP2 FNC_VALUES 1 FLOAT32_IEEE COLUMN_DIR DIRECT /end RECORD_LAYOUT
/begin COMPU_METHOD CU_ETCC_NU_FULLLEARNLOLIMTP2 "Conversion method for ETCc_NU_FullLearnLoLimTP2" RAT_FUNC "%10.3" "NU" COEFFS 0.000000 1.000000 0.000000 0.000000 0.000000 1.000000 /end COMPU_METHOD
/* Scalar calibration for DDE 'ETCc_NU_Int_thd'. */
/begin CHARACTERISTIC ETCc_NU_Int_thd "(not defined)" VALUE 0x8a160 RL_ETCC_NU_INT_THD 2000.000000 CU_ETCC_NU_INT_THD -1000.000000 1000.000000 BYTE_ORDER MSB_FIRST /end CHARACTERISTIC
/begin RECORD_LAYOUT RL_ETCC_NU_INT_THD FNC_VALUES 1 FLOAT32_IEEE COLUMN_DIR DIRECT /end RECORD_LAYOUT
/begin COMPU_METHOD CU_ETCC_NU_INT_THD "Conversion method for ETCc_NU_Int_thd" RAT_FUNC "%10.2" "NU" COEFFS 0.000000 1.000000 0.000000 0.000000 0.000000 1.000000 /end COMPU_METHOD
/* Scalar calibration for DDE 'ETCc_NU_KickHPF_Tc'. */
/begin CHARACTERISTIC ETCc_NU_KickHPF_Tc "Time constant for high-pass filter on throttle request used for kick command" VALUE 0x87ac4 RL_ETCC_NU_KICKHPF_TC 1.000000 CU_ETCC_NU_KICKHPF_TC 0.000000 1.000000 BYTE_ORDER MSB_FIRST /end CHARACTERISTIC
/begin RECORD_LAYOUT RL_ETCC_NU_KICKHPF_TC FNC_VALUES 1 FLOAT32_IEEE COLUMN_DIR DIRECT /end RECORD_LAYOUT
/begin COMPU_METHOD CU_ETCC_NU_KICKHPF_TC "Conversion method for ETCc_NU_KickHPF_Tc" RAT_FUNC "%10.2" "NU" COEFFS 0.000000 1.000000 0.000000 0.000000 0.000000 1.000000 /end COMPU_METHOD
/* Scalar calibration for DDE 'ETCc_NU_KickHPF_Thrsh'. */
/begin CHARACTERISTIC ETCc_NU_KickHPF_Thrsh "Throttle request HPF result that triggers a motor kick" VALUE 0x8a154 RL_ETCC_NU_KICKHPF_THRSH 2000.000000 CU_ETCC_NU_KICKHPF_THRSH -1000.000000 1000.000000 BYTE_ORDER MSB_FIRST /end CHARACTERISTIC
/begin RECORD_LAYOUT RL_ETCC_NU_KICKHPF_THRSH FNC_VALUES 1 FLOAT32_IEEE COLUMN_DIR DIRECT /end RECORD_LAYOUT
/begin COMPU_METHOD CU_ETCC_NU_KICKHPF_THRSH "Conversion method for ETCc_NU_KickHPF_Thrsh" RAT_FUNC "%10.2" "deg" COEFFS 0.000000 1.000000 0.000000 0.000000 0.000000 1.000000 /end COMPU_METHOD
/* Scalar calibration for DDE 'ETCc_NU_LFallRate'. */
/begin CHARACTERISTIC ETCc_NU_LFallRate "(Nm/s) Normal fall rate limit applied to brake tq" VALUE 0x87a24 RL_ETCC_NU_LFALLRATE 1.000000 CU_ETCC_NU_LFALLRATE -1.000000 0.000000 BYTE_ORDER MSB_FIRST /end CHARACTERISTIC
/begin RECORD_LAYOUT RL_ETCC_NU_LFALLRATE FNC_VALUES 1 FLOAT32_IEEE COLUMN_DIR DIRECT /end RECORD_LAYOUT
/begin COMPU_METHOD CU_ETCC_NU_LFALLRATE "Conversion method for ETCc_NU_LFallRate" RAT_FUNC "%10.2" "NU" COEFFS 0.000000 1.000000 0.000000 0.000000 0.000000 1.000000 /end COMPU_METHOD
/* Scalar calibration for DDE 'ETCc_NU_LRiseRate'. */
/begin CHARACTERISTIC ETCc_NU_LRiseRate "(Nm/s) Normal rise rate limit applied to brake tq" VALUE 0x87a20 RL_ETCC_NU_LRISERATE 1.000000 CU_ETCC_NU_LRISERATE 0.000000 1.000000 BYTE_ORDER MSB_FIRST /end CHARACTERISTIC
/begin RECORD_LAYOUT RL_ETCC_NU_LRISERATE FNC_VALUES 1 FLOAT32_IEEE COLUMN_DIR DIRECT /end RECORD_LAYOUT
/begin COMPU_METHOD CU_ETCC_NU_LRISERATE "Conversion method for ETCc_NU_LRiseRate" RAT_FUNC "%10.2" "NU" COEFFS 0.000000 1.000000 0.000000 0.000000 0.000000 1.000000 /end COMPU_METHOD
/* Scalar calibration for DDE 'ETCc_NU_RiseRate'. */
/begin CHARACTERISTIC ETCc_NU_RiseRate "Rising Rate Limiter at Input for ETC" VALUE 0x87aac RL_ETCC_NU_RISERATE 10000.000000 CU_ETCC_NU_RISERATE 0.000000 10000.000000 BYTE_ORDER MSB_FIRST /end CHARACTERISTIC
/begin RECORD_LAYOUT RL_ETCC_NU_RISERATE FNC_VALUES 1 FLOAT32_IEEE COLUMN_DIR DIRECT /end RECORD_LAYOUT
/begin COMPU_METHOD CU_ETCC_NU_RISERATE "Conversion method for ETCc_NU_RiseRate" RAT_FUNC "%10.2" "NU" COEFFS 0.000000 1.000000 0.000000 0.000000 0.000000 1.000000 /end COMPU_METHOD
/* Scalar calibration for DDE 'ETCc_NU_TP1_FullPos'. */
/begin CHARACTERISTIC ETCc_NU_TP1_FullPos "Override value" VALUE 0x87a00 RL_ETCC_NU_TP1_FULLPOS 400.000000 CU_ETCC_NU_TP1_FULLPOS -200.000000 200.000000 BYTE_ORDER MSB_FIRST /end CHARACTERISTIC
/begin RECORD_LAYOUT RL_ETCC_NU_TP1_FULLPOS FNC_VALUES 1 FLOAT32_IEEE COLUMN_DIR DIRECT /end RECORD_LAYOUT
/begin COMPU_METHOD CU_ETCC_NU_TP1_FULLPOS "Conversion method for ETCc_NU_TP1_FullPos" RAT_FUNC "%10.3" "NU" COEFFS 0.000000 1.000000 0.000000 0.000000 0.000000 1.000000 /end COMPU_METHOD
/* Scalar calibration for DDE 'ETCc_NU_TP1_ZeroPos'. */
/begin CHARACTERISTIC ETCc_NU_TP1_ZeroPos "Override value" VALUE 0x879f8 RL_ETCC_NU_TP1_ZEROPOS 400.000000 CU_ETCC_NU_TP1_ZEROPOS -200.000000 200.000000 BYTE_ORDER MSB_FIRST /end CHARACTERISTIC
/begin RECORD_LAYOUT RL_ETCC_NU_TP1_ZEROPOS FNC_VALUES 1 FLOAT32_IEEE COLUMN_DIR DIRECT /end RECORD_LAYOUT
/begin COMPU_METHOD CU_ETCC_NU_TP1_ZEROPOS "Conversion method for ETCc_NU_TP1_ZeroPos" RAT_FUNC "%10.3" "NU" COEFFS 0.000000 1.000000 0.000000 0.000000 0.000000 1.000000 /end COMPU_METHOD
/* Scalar calibration for DDE 'ETCc_NU_TP2_FullPos'. */
/begin CHARACTERISTIC ETCc_NU_TP2_FullPos "Override value" VALUE 0x87a10 RL_ETCC_NU_TP2_FULLPOS 400.000000 CU_ETCC_NU_TP2_FULLPOS -200.000000 200.000000 BYTE_ORDER MSB_FIRST /end CHARACTERISTIC
/begin RECORD_LAYOUT RL_ETCC_NU_TP2_FULLPOS FNC_VALUES 1 FLOAT32_IEEE COLUMN_DIR DIRECT /end RECORD_LAYOUT
/begin COMPU_METHOD CU_ETCC_NU_TP2_FULLPOS "Conversion method for ETCc_NU_TP2_FullPos" RAT_FUNC "%10.3" "NU" COEFFS 0.000000 1.000000 0.000000 0.000000 0.000000 1.000000 /end COMPU_METHOD
/* Scalar calibration for DDE 'ETCc_NU_TP2_ZeroPos'. */
/begin CHARACTERISTIC ETCc_NU_TP2_ZeroPos "Override value" VALUE 0x87a08 RL_ETCC_NU_TP2_ZEROPOS 400.000000 CU_ETCC_NU_TP2_ZEROPOS -200.000000 200.000000 BYTE_ORDER MSB_FIRST /end CHARACTERISTIC
/begin RECORD_LAYOUT RL_ETCC_NU_TP2_ZEROPOS FNC_VALUES 1 FLOAT32_IEEE COLUMN_DIR DIRECT /end RECORD_LAYOUT
/begin COMPU_METHOD CU_ETCC_NU_TP2_ZEROPOS "Conversion method for ETCc_NU_TP2_ZeroPos" RAT_FUNC "%10.3" "NU" COEFFS 0.000000 1.000000 0.000000 0.000000 0.000000 1.000000 /end COMPU_METHOD
/* Scalar calibration for DDE 'ETCc_NU_TP_DotThrsh'. */
/begin CHARACTERISTIC ETCc_NU_TP_DotThrsh "(V/s) TPS rate of change below this magnitude is considered steady-state" VALUE 0x879ac RL_ETCC_NU_TP_DOTTHRSH 14.900000 CU_ETCC_NU_TP_DOTTHRSH 0.100000 15.000000 BYTE_ORDER MSB_FIRST /end CHARACTERISTIC
/begin RECORD_LAYOUT RL_ETCC_NU_TP_DOTTHRSH FNC_VALUES 1 FLOAT32_IEEE COLUMN_DIR DIRECT /end RECORD_LAYOUT
/begin COMPU_METHOD CU_ETCC_NU_TP_DOTTHRSH "Conversion method for ETCc_NU_TP_DotThrsh" RAT_FUNC "%10.2" "NU" COEFFS 0.000000 1.000000 0.000000 0.000000 0.000000 1.000000 /end COMPU_METHOD
/* Scalar calibration for DDE 'ETCc_NU_TP_FallRateThrsh'. */
/begin CHARACTERISTIC ETCc_NU_TP_FallRateThrsh "(V/s) Raw TPS rate of change threshold to declare throttle has stopped moving closed" VALUE 0x879e0 RL_ETCC_NU_TP_FALLRATETHRSH 5.000000 CU_ETCC_NU_TP_FALLRATETHRSH -5.000000 0.000000 BYTE_ORDER MSB_FIRST /end CHARACTERISTIC
/begin RECORD_LAYOUT RL_ETCC_NU_TP_FALLRATETHRSH FNC_VALUES 1 FLOAT32_IEEE COLUMN_DIR DIRECT /end RECORD_LAYOUT
/begin COMPU_METHOD CU_ETCC_NU_TP_FALLRATETHRSH "Conversion method for ETCc_NU_TP_FallRateThrsh" RAT_FUNC "%10.2" "NU" COEFFS 0.000000 1.000000 0.000000 0.000000 0.000000 1.000000 /end COMPU_METHOD
/* Scalar calibration for DDE 'ETCc_NU_TP_RiseRateThrsh'. */
/begin CHARACTERISTIC ETCc_NU_TP_RiseRateThrsh "(V/s) Raw TPS rate of change threshold to declare throttle has stopped moving open" VALUE 0x879d8 RL_ETCC_NU_TP_RISERATETHRSH 5.000000 CU_ETCC_NU_TP_RISERATETHRSH 0.000000 5.000000 BYTE_ORDER MSB_FIRST /end CHARACTERISTIC
/begin RECORD_LAYOUT RL_ETCC_NU_TP_RISERATETHRSH FNC_VALUES 1 FLOAT32_IEEE COLUMN_DIR DIRECT /end RECORD_LAYOUT
/begin COMPU_METHOD CU_ETCC_NU_TP_RISERATETHRSH "Conversion method for ETCc_NU_TP_RiseRateThrsh" RAT_FUNC "%10.2" "NU" COEFFS 0.000000 1.000000 0.000000 0.000000 0.000000 1.000000 /end COMPU_METHOD
/* Scalar calibration for DDE 'ETCc_NU_ZeroLearnDfltTP1'. */
/begin CHARACTERISTIC ETCc_NU_ZeroLearnDfltTP1 "Zero position learn default value for throttle position sensor 1" VALUE 0x918f0 RL_ETCC_NU_ZEROLEARNDFLTTP1 400.000000 CU_ETCC_NU_ZEROLEARNDFLTTP1 -200.000000 200.000000 BYTE_ORDER MSB_FIRST /end CHARACTERISTIC
/begin RECORD_LAYOUT RL_ETCC_NU_ZEROLEARNDFLTTP1 FNC_VALUES 1 FLOAT32_IEEE COLUMN_DIR DIRECT /end RECORD_LAYOUT
/begin COMPU_METHOD CU_ETCC_NU_ZEROLEARNDFLTTP1 "Conversion method for ETCc_NU_ZeroLearnDfltTP1" RAT_FUNC "%10.3" "NU" COEFFS 0.000000 1.000000 0.000000 0.000000 0.000000 1.000000 /end COMPU_METHOD
/* Scalar calibration for DDE 'ETCc_NU_ZeroLearnDfltTP2'. */
/begin CHARACTERISTIC ETCc_NU_ZeroLearnDfltTP2 "Zero position learn default value for throttle position sensor 2" VALUE 0x918f4 RL_ETCC_NU_ZEROLEARNDFLTTP2 400.000000 CU_ETCC_NU_ZEROLEARNDFLTTP2 -200.000000 200.000000 BYTE_ORDER MSB_FIRST /end CHARACTERISTIC
/begin RECORD_LAYOUT RL_ETCC_NU_ZEROLEARNDFLTTP2 FNC_VALUES 1 FLOAT32_IEEE COLUMN_DIR DIRECT /end RECORD_LAYOUT
/begin COMPU_METHOD CU_ETCC_NU_ZEROLEARNDFLTTP2 "Conversion method for ETCc_NU_ZeroLearnDfltTP2" RAT_FUNC "%10.3" "NU" COEFFS 0.000000 1.000000 0.000000 0.000000 0.000000 1.000000 /end COMPU_METHOD
/* Scalar calibration for DDE 'ETCc_NU_ZeroLearnHiLimTP1'. */
/begin CHARACTERISTIC ETCc_NU_ZeroLearnHiLimTP1 "Expected range of values for full-closed" VALUE 0x879bc RL_ETCC_NU_ZEROLEARNHILIMTP1 400.000000 CU_ETCC_NU_ZEROLEARNHILIMTP1 -200.000000 200.000000 BYTE_ORDER MSB_FIRST /end CHARACTERISTIC
/begin RECORD_LAYOUT RL_ETCC_NU_ZEROLEARNHILIMTP1 FNC_VALUES 1 FLOAT32_IEEE COLUMN_DIR DIRECT /end RECORD_LAYOUT
/begin COMPU_METHOD CU_ETCC_NU_ZEROLEARNHILIMTP1 "Conversion method for ETCc_NU_ZeroLearnHiLimTP1" RAT_FUNC "%10.3" "NU" COEFFS 0.000000 1.000000 0.000000 0.000000 0.000000 1.000000 /end COMPU_METHOD
/* Scalar calibration for DDE 'ETCc_NU_ZeroLearnHiLimTP2'. */
/begin CHARACTERISTIC ETCc_NU_ZeroLearnHiLimTP2 "Expected range of values for full-closed" VALUE 0x879a4 RL_ETCC_NU_ZEROLEARNHILIMTP2 400.000000 CU_ETCC_NU_ZEROLEARNHILIMTP2 -200.000000 200.000000 BYTE_ORDER MSB_FIRST /end CHARACTERISTIC
/begin RECORD_LAYOUT RL_ETCC_NU_ZEROLEARNHILIMTP2 FNC_VALUES 1 FLOAT32_IEEE COLUMN_DIR DIRECT /end RECORD_LAYOUT
/begin COMPU_METHOD CU_ETCC_NU_ZEROLEARNHILIMTP2 "Conversion method for ETCc_NU_ZeroLearnHiLimTP2" RAT_FUNC "%10.3" "NU" COEFFS 0.000000 1.000000 0.000000 0.000000 0.000000 1.000000 /end COMPU_METHOD
/* Scalar calibration for DDE 'ETCc_NU_ZeroLearnLoLimTP1'. */
/begin CHARACTERISTIC ETCc_NU_ZeroLearnLoLimTP1 "Expected range of values for full-closed" VALUE 0x879b8 RL_ETCC_NU_ZEROLEARNLOLIMTP1 400.000000 CU_ETCC_NU_ZEROLEARNLOLIMTP1 -200.000000 200.000000 BYTE_ORDER MSB_FIRST /end CHARACTERISTIC
/begin RECORD_LAYOUT RL_ETCC_NU_ZEROLEARNLOLIMTP1 FNC_VALUES 1 FLOAT32_IEEE COLUMN_DIR DIRECT /end RECORD_LAYOUT
/begin COMPU_METHOD CU_ETCC_NU_ZEROLEARNLOLIMTP1 "Conversion method for ETCc_NU_ZeroLearnLoLimTP1" RAT_FUNC "%10.3" "NU" COEFFS 0.000000 1.000000 0.000000 0.000000 0.000000 1.000000 /end COMPU_METHOD
/* Scalar calibration for DDE 'ETCc_NU_ZeroLearnLoLimTP2'. */
/begin CHARACTERISTIC ETCc_NU_ZeroLearnLoLimTP2 "Expected range of values for full-closed" VALUE 0x879a0 RL_ETCC_NU_ZEROLEARNLOLIMTP2 400.000000 CU_ETCC_NU_ZEROLEARNLOLIMTP2 -200.000000 200.000000 BYTE_ORDER MSB_FIRST /end CHARACTERISTIC
/begin RECORD_LAYOUT RL_ETCC_NU_ZEROLEARNLOLIMTP2 FNC_VALUES 1 FLOAT32_IEEE COLUMN_DIR DIRECT /end RECORD_LAYOUT
/begin COMPU_METHOD CU_ETCC_NU_ZEROLEARNLOLIMTP2 "Conversion method for ETCc_NU_ZeroLearnLoLimTP2" RAT_FUNC "%10.3" "NU" COEFFS 0.000000 1.000000 0.000000 0.000000 0.000000 1.000000 /end COMPU_METHOD
/* Scalar calibration for DDE 'ETCc_b_AW_Enbl'. */
/begin CHARACTERISTIC ETCc_b_AW_Enbl "Anti-windup logic enablement" VALUE 0x88c30 RL_ETCC_B_AW_ENBL 1.000000 CU_ETCC_B_AW_ENBL 0.000000 1.000000 BYTE_ORDER MSB_FIRST /end CHARACTERISTIC
/begin RECORD_LAYOUT RL_ETCC_B_AW_ENBL FNC_VALUES 1 UBYTE COLUMN_DIR DIRECT /end RECORD_LAYOUT
/begin COMPU_METHOD CU_ETCC_B_AW_ENBL "Conversion method for ETCc_b_AW_Enbl" RAT_FUNC "%10.0" "b" COEFFS 0.000000 1.000000 0.000000 0.000000 0.000000 1.000000 /end COMPU_METHOD
/* Scalar calibration for DDE 'ETCc_b_AuthorityReduced'. */
/begin CHARACTERISTIC ETCc_b_AuthorityReduced "Override value" VALUE 0x8be61 RL_ETCC_B_AUTHORITYREDUCED 1.000000 CU_ETCC_B_AUTHORITYREDUCED 0.000000 1.000000 BYTE_ORDER MSB_FIRST /end CHARACTERISTIC
/begin RECORD_LAYOUT RL_ETCC_B_AUTHORITYREDUCED FNC_VALUES 1 UBYTE COLUMN_DIR DIRECT /end RECORD_LAYOUT
/begin COMPU_METHOD CU_ETCC_B_AUTHORITYREDUCED "Conversion method for ETCc_b_AuthorityReduced" RAT_FUNC "%10.0" "b" COEFFS 0.000000 1.000000 0.000000 0.000000 0.000000 1.000000 /end COMPU_METHOD
/* Scalar calibration for DDE 'ETCc_b_HystAxisStrategy'. */
/begin CHARACTERISTIC ETCc_b_HystAxisStrategy "Displayable" VALUE 0x87ac8 RL_ETCC_B_HYSTAXISSTRATEGY 1.000000 CU_ETCC_B_HYSTAXISSTRATEGY 0.000000 1.000000 BYTE_ORDER MSB_FIRST /end CHARACTERISTIC
/begin RECORD_LAYOUT RL_ETCC_B_HYSTAXISSTRATEGY FNC_VALUES 1 UBYTE COLUMN_DIR DIRECT /end RECORD_LAYOUT
/begin COMPU_METHOD CU_ETCC_B_HYSTAXISSTRATEGY "Conversion method for ETCc_b_HystAxisStrategy" RAT_FUNC "%10.0" "b" COEFFS 0.000000 1.000000 0.000000 0.000000 0.000000 1.000000 /end COMPU_METHOD
/* Scalar calibration for DDE 'ETCc_b_HystStrategy'. */
/begin CHARACTERISTIC ETCc_b_HystStrategy "Displayable" VALUE 0x8933c RL_ETCC_B_HYSTSTRATEGY 1.000000 CU_ETCC_B_HYSTSTRATEGY 0.000000 1.000000 BYTE_ORDER MSB_FIRST /end CHARACTERISTIC
/begin RECORD_LAYOUT RL_ETCC_B_HYSTSTRATEGY FNC_VALUES 1 UBYTE COLUMN_DIR DIRECT /end RECORD_LAYOUT
/begin COMPU_METHOD CU_ETCC_B_HYSTSTRATEGY "Conversion method for ETCc_b_HystStrategy" RAT_FUNC "%10.0" "b" COEFFS 0.000000 1.000000 0.000000 0.000000 0.000000 1.000000 /end COMPU_METHOD
/* Scalar calibration for DDE 'ETCc_b_ManualRangeRetry'. */
/begin CHARACTERISTIC ETCc_b_ManualRangeRetry "Cal flag to restart the range learning procedure (clears RangeCheckFailed)" VALUE 0x8bf78 RL_ETCC_B_MANUALRANGERETRY 1.000000 CU_ETCC_B_MANUALRANGERETRY 0.000000 1.000000 BYTE_ORDER MSB_FIRST /end CHARACTERISTIC
/begin RECORD_LAYOUT RL_ETCC_B_MANUALRANGERETRY FNC_VALUES 1 UBYTE COLUMN_DIR DIRECT /end RECORD_LAYOUT
/begin COMPU_METHOD CU_ETCC_B_MANUALRANGERETRY "Conversion method for ETCc_b_ManualRangeRetry" RAT_FUNC "%10.0" "b" COEFFS 0.000000 1.000000 0.000000 0.000000 0.000000 1.000000 /end COMPU_METHOD
/* Scalar calibration for DDE 'ETCc_b_RangeLearnEnbl'. */
/begin CHARACTERISTIC ETCc_b_RangeLearnEnbl "Enable engine-stopped range learning movement" VALUE 0x879d4 RL_ETCC_B_RANGELEARNENBL 1.000000 CU_ETCC_B_RANGELEARNENBL 0.000000 1.000000 BYTE_ORDER MSB_FIRST /end CHARACTERISTIC
/begin RECORD_LAYOUT RL_ETCC_B_RANGELEARNENBL FNC_VALUES 1 UBYTE COLUMN_DIR DIRECT /end RECORD_LAYOUT
/begin COMPU_METHOD CU_ETCC_B_RANGELEARNENBL "Conversion method for ETCc_b_RangeLearnEnbl" RAT_FUNC "%10.0" "b" COEFFS 0.000000 1.000000 0.000000 0.000000 0.000000 1.000000 /end COMPU_METHOD
/* Scalar calibration for DDE 'ETCc_b_ResetNVM'. */
/begin CHARACTERISTIC ETCc_b_ResetNVM "Reset the TP sensor endstop values to their defaults" VALUE 0x879f4 RL_ETCC_B_RESETNVM 1.000000 CU_ETCC_B_RESETNVM 0.000000 1.000000 BYTE_ORDER MSB_FIRST /end CHARACTERISTIC
/begin RECORD_LAYOUT RL_ETCC_B_RESETNVM FNC_VALUES 1 UBYTE COLUMN_DIR DIRECT /end RECORD_LAYOUT
/begin COMPU_METHOD CU_ETCC_B_RESETNVM "Conversion method for ETCc_b_ResetNVM" RAT_FUNC "%10.0" "b" COEFFS 0.000000 1.000000 0.000000 0.000000 0.000000 1.000000 /end COMPU_METHOD
/* Scalar calibration for DDE 'ETCc_b_RestDuringCranking'. */
/begin CHARACTERISTIC ETCc_b_RestDuringCranking "Option to disable the throttle motor output during cranking" VALUE 0x87a88 RL_ETCC_B_RESTDURINGCRANKING 1.000000 CU_ETCC_B_RESTDURINGCRANKING 0.000000 1.000000 BYTE_ORDER MSB_FIRST /end CHARACTERISTIC
/begin RECORD_LAYOUT RL_ETCC_B_RESTDURINGCRANKING FNC_VALUES 1 UBYTE COLUMN_DIR DIRECT /end RECORD_LAYOUT
/begin COMPU_METHOD CU_ETCC_B_RESTDURINGCRANKING "Conversion method for ETCc_b_RestDuringCranking" RAT_FUNC "%10.0" "b" COEFFS 0.000000 1.000000 0.000000 0.000000 0.000000 1.000000 /end COMPU_METHOD
/* Scalar calibration for DDE 'ETCc_b_RestWhenStopped'. */
/begin CHARACTERISTIC ETCc_b_RestWhenStopped "Option to disable the throttle motor output when the engine is stopped and range check is not running" VALUE 0x87a91 RL_ETCC_B_RESTWHENSTOPPED 1.000000 CU_ETCC_B_RESTWHENSTOPPED 0.000000 1.000000 BYTE_ORDER MSB_FIRST /end CHARACTERISTIC
/begin RECORD_LAYOUT RL_ETCC_B_RESTWHENSTOPPED FNC_VALUES 1 UBYTE COLUMN_DIR DIRECT /end RECORD_LAYOUT
/begin COMPU_METHOD CU_ETCC_B_RESTWHENSTOPPED "Conversion method for ETCc_b_RestWhenStopped" RAT_FUNC "%10.0" "b" COEFFS 0.000000 1.000000 0.000000 0.000000 0.000000 1.000000 /end COMPU_METHOD
/* Scalar calibration for DDE 'ETCc_b_TP1_Inverted'. */
/begin CHARACTERISTIC ETCc_b_TP1_Inverted "throttle position 1 inverted flag" VALUE 0x879a8 RL_ETCC_B_TP1_INVERTED 1.000000 CU_ETCC_B_TP1_INVERTED 0.000000 1.000000 BYTE_ORDER MSB_FIRST /end CHARACTERISTIC
/begin RECORD_LAYOUT RL_ETCC_B_TP1_INVERTED FNC_VALUES 1 UBYTE COLUMN_DIR DIRECT /end RECORD_LAYOUT
/begin COMPU_METHOD CU_ETCC_B_TP1_INVERTED "Conversion method for ETCc_b_TP1_Inverted" RAT_FUNC "%10.0" "b" COEFFS 0.000000 1.000000 0.000000 0.000000 0.000000 1.000000 /end COMPU_METHOD
/* Scalar calibration for DDE 'ETCc_b_TP2_Inverted'. */
/begin CHARACTERISTIC ETCc_b_TP2_Inverted "throttle position 1 inverted flag" VALUE 0x87998 RL_ETCC_B_TP2_INVERTED 1.000000 CU_ETCC_B_TP2_INVERTED 0.000000 1.000000 BYTE_ORDER MSB_FIRST /end CHARACTERISTIC
/begin RECORD_LAYOUT RL_ETCC_B_TP2_INVERTED FNC_VALUES 1 UBYTE COLUMN_DIR DIRECT /end RECORD_LAYOUT
/begin COMPU_METHOD CU_ETCC_B_TP2_INVERTED "Conversion method for ETCc_b_TP2_Inverted" RAT_FUNC "%10.0" "b" COEFFS 0.000000 1.000000 0.000000 0.000000 0.000000 1.000000 /end COMPU_METHOD
/* Scalar calibration for DDE 'ETCc_b_UseCrankingPos'. */
/begin CHARACTERISTIC ETCc_b_UseCrankingPos "Enable constant-throttle-position during cranking" VALUE 0x87ac0 RL_ETCC_B_USECRANKINGPOS 1.000000 CU_ETCC_B_USECRANKINGPOS 0.000000 1.000000 BYTE_ORDER MSB_FIRST /end CHARACTERISTIC
/begin RECORD_LAYOUT RL_ETCC_B_USECRANKINGPOS FNC_VALUES 1 UBYTE COLUMN_DIR DIRECT /end RECORD_LAYOUT
/begin COMPU_METHOD CU_ETCC_B_USECRANKINGPOS "Conversion method for ETCc_b_UseCrankingPos" RAT_FUNC "%10.0" "b" COEFFS 0.000000 1.000000 0.000000 0.000000 0.000000 1.000000 /end COMPU_METHOD
/* Scalar calibration for DDE 'ETCc_b_UsePedalDirectly'. */
/begin CHARACTERISTIC ETCc_b_UsePedalDirectly "BYPASS TORQUE DOMAIN (use for dyno testing only- this will defeat idle control and any other torque features)" VALUE 0x87ac1 RL_ETCC_B_USEPEDALDIRECTLY 1.000000 CU_ETCC_B_USEPEDALDIRECTLY 0.000000 1.000000 BYTE_ORDER MSB_FIRST /end CHARACTERISTIC
/begin RECORD_LAYOUT RL_ETCC_B_USEPEDALDIRECTLY FNC_VALUES 1 UBYTE COLUMN_DIR DIRECT /end RECORD_LAYOUT
/begin COMPU_METHOD CU_ETCC_B_USEPEDALDIRECTLY "Conversion method for ETCc_b_UsePedalDirectly" RAT_FUNC "%10.0" "b" COEFFS 0.000000 1.000000 0.000000 0.000000 0.000000 1.000000 /end COMPU_METHOD
/* Scalar calibration for DDE 'ETCc_deg_AW_Thrsh'. */
/begin CHARACTERISTIC ETCc_deg_AW_Thrsh "Reset ITerm if error exceeds this magnitude" VALUE 0x88c34 RL_ETCC_DEG_AW_THRSH 90.000000 CU_ETCC_DEG_AW_THRSH 0.000000 90.000000 BYTE_ORDER MSB_FIRST /end CHARACTERISTIC
/begin RECORD_LAYOUT RL_ETCC_DEG_AW_THRSH FNC_VALUES 1 FLOAT32_IEEE COLUMN_DIR DIRECT /end RECORD_LAYOUT
/begin COMPU_METHOD CU_ETCC_DEG_AW_THRSH "Conversion method for ETCc_deg_AW_Thrsh" RAT_FUNC "%10.2" "deg" COEFFS 0.000000 1.000000 0.000000 0.000000 0.000000 1.000000 /end COMPU_METHOD
/* Scalar calibration for DDE 'ETCc_deg_ControlClosedCmd'. */
/begin CHARACTERISTIC ETCc_deg_ControlClosedCmd "Min throttle angle" VALUE 0x87ab8 RL_ETCC_DEG_CONTROLCLOSEDCMD 20.000000 CU_ETCC_DEG_CONTROLCLOSEDCMD -10.000000 10.000000 BYTE_ORDER MSB_FIRST /end CHARACTERISTIC
/begin RECORD_LAYOUT RL_ETCC_DEG_CONTROLCLOSEDCMD FNC_VALUES 1 FLOAT32_IEEE COLUMN_DIR DIRECT /end RECORD_LAYOUT
/begin COMPU_METHOD CU_ETCC_DEG_CONTROLCLOSEDCMD "Conversion method for ETCc_deg_ControlClosedCmd" RAT_FUNC "%10.2" "deg" COEFFS 0.000000 1.000000 0.000000 0.000000 0.000000 1.000000 /end COMPU_METHOD
/* Scalar calibration for DDE 'ETCc_deg_ControlOpenCmd'. */
/begin CHARACTERISTIC ETCc_deg_ControlOpenCmd "Max throttle angle" VALUE 0x87abc RL_ETCC_DEG_CONTROLOPENCMD 100.000000 CU_ETCC_DEG_CONTROLOPENCMD 0.000000 100.000000 BYTE_ORDER MSB_FIRST /end CHARACTERISTIC
/begin RECORD_LAYOUT RL_ETCC_DEG_CONTROLOPENCMD FNC_VALUES 1 FLOAT32_IEEE COLUMN_DIR DIRECT /end RECORD_LAYOUT
/begin COMPU_METHOD CU_ETCC_DEG_CONTROLOPENCMD "Conversion method for ETCc_deg_ControlOpenCmd" RAT_FUNC "%10.2" "deg" COEFFS 0.000000 1.000000 0.000000 0.000000 0.000000 1.000000 /end COMPU_METHOD
/* Scalar calibration for DDE 'ETCc_deg_FreezeITermDbnd'. */
/begin CHARACTERISTIC ETCc_deg_FreezeITermDbnd "Iterm will freeze whenever position error falls below this value" VALUE 0x8a14c RL_ETCC_DEG_FREEZEITERMDBND 5.000000 CU_ETCC_DEG_FREEZEITERMDBND 0.000000 5.000000 BYTE_ORDER MSB_FIRST /end CHARACTERISTIC
/begin RECORD_LAYOUT RL_ETCC_DEG_FREEZEITERMDBND FNC_VALUES 1 FLOAT32_IEEE COLUMN_DIR DIRECT /end RECORD_LAYOUT
/begin COMPU_METHOD CU_ETCC_DEG_FREEZEITERMDBND "Conversion method for ETCc_deg_FreezeITermDbnd" RAT_FUNC "%10.2" "deg" COEFFS 0.000000 1.000000 0.000000 0.000000 0.000000 1.000000 /end COMPU_METHOD
/* Scalar calibration for DDE 'ETCc_deg_FullClosed'. */
/begin CHARACTERISTIC ETCc_deg_FullClosed "Request is considered FullClosed below this threshold" VALUE 0x8a148 RL_ETCC_DEG_FULLCLOSED 10.000000 CU_ETCC_DEG_FULLCLOSED 0.000000 10.000000 BYTE_ORDER MSB_FIRST /end CHARACTERISTIC
/begin RECORD_LAYOUT RL_ETCC_DEG_FULLCLOSED FNC_VALUES 1 FLOAT32_IEEE COLUMN_DIR DIRECT /end RECORD_LAYOUT
/begin COMPU_METHOD CU_ETCC_DEG_FULLCLOSED "Conversion method for ETCc_deg_FullClosed" RAT_FUNC "%10.1" "deg" COEFFS 0.000000 1.000000 0.000000 0.000000 0.000000 1.000000 /end COMPU_METHOD
/* Scalar calibration for DDE 'ETCc_deg_FullClosedErrorThrsh'. */
/begin CHARACTERISTIC ETCc_deg_FullClosedErrorThrsh "Iterm will freeze for a full-closed command once position error falls below this value" VALUE 0x8a144 RL_ETCC_DEG_FULLCLOSEDERRORTHR0 5.000000 CU_ETCC_DEG_FULLCLOSEDERRORTHR0 0.000000 5.000000 BYTE_ORDER MSB_FIRST /end CHARACTERISTIC
/begin RECORD_LAYOUT RL_ETCC_DEG_FULLCLOSEDERRORTHR0 FNC_VALUES 1 FLOAT32_IEEE COLUMN_DIR DIRECT /end RECORD_LAYOUT
/begin COMPU_METHOD CU_ETCC_DEG_FULLCLOSEDERRORTHR0 "Conversion method for ETCc_deg_FullClosedErrorThrsh" RAT_FUNC "%10.2" "deg" COEFFS 0.000000 1.000000 0.000000 0.000000 0.000000 1.000000 /end COMPU_METHOD
/* Scalar calibration for DDE 'ETCc_deg_FullOpen'. */
/begin CHARACTERISTIC ETCc_deg_FullOpen "Request is considered FullOpen above this threshold" VALUE 0x8a13c RL_ETCC_DEG_FULLOPEN 45.000000 CU_ETCC_DEG_FULLOPEN 45.000000 90.000000 BYTE_ORDER MSB_FIRST /end CHARACTERISTIC
/begin RECORD_LAYOUT RL_ETCC_DEG_FULLOPEN FNC_VALUES 1 FLOAT32_IEEE COLUMN_DIR DIRECT /end RECORD_LAYOUT
/begin COMPU_METHOD CU_ETCC_DEG_FULLOPEN "Conversion method for ETCc_deg_FullOpen" RAT_FUNC "%10.1" "deg" COEFFS 0.000000 1.000000 0.000000 0.000000 0.000000 1.000000 /end COMPU_METHOD
/* Scalar calibration for DDE 'ETCc_deg_FullOpenErrorThrsh'. */
/begin CHARACTERISTIC ETCc_deg_FullOpenErrorThrsh "Iterm will freeze for a full-open command once position error falls below this value" VALUE 0x8a140 RL_ETCC_DEG_FULLOPENERRORTHRSH 5.000000 CU_ETCC_DEG_FULLOPENERRORTHRSH 0.000000 5.000000 BYTE_ORDER MSB_FIRST /end CHARACTERISTIC
/begin RECORD_LAYOUT RL_ETCC_DEG_FULLOPENERRORTHRSH FNC_VALUES 1 FLOAT32_IEEE COLUMN_DIR DIRECT /end RECORD_LAYOUT
/begin COMPU_METHOD CU_ETCC_DEG_FULLOPENERRORTHRSH "Conversion method for ETCc_deg_FullOpenErrorThrsh" RAT_FUNC "%10.2" "deg" COEFFS 0.000000 1.000000 0.000000 0.000000 0.000000 1.000000 /end COMPU_METHOD
/* Scalar calibration for DDE 'ETCc_deg_Reset_thd'. */
/begin CHARACTERISTIC ETCc_deg_Reset_thd "(not defined)" VALUE 0x8a15c RL_ETCC_DEG_RESET_THD 2000.000000 CU_ETCC_DEG_RESET_THD -1000.000000 1000.000000 BYTE_ORDER MSB_FIRST /end CHARACTERISTIC
/begin RECORD_LAYOUT RL_ETCC_DEG_RESET_THD FNC_VALUES 1 FLOAT32_IEEE COLUMN_DIR DIRECT /end RECORD_LAYOUT
/begin COMPU_METHOD CU_ETCC_DEG_RESET_THD "Conversion method for ETCc_deg_Reset_thd" RAT_FUNC "%10.2" "pct" COEFFS 0.000000 1.000000 0.000000 0.000000 0.000000 1.000000 /end COMPU_METHOD
/* Scalar calibration for DDE 'ETCc_deg_RestLearnDflt'. */
/begin CHARACTERISTIC ETCc_deg_RestLearnDflt "Rest position learn default value" VALUE 0x918f8 RL_ETCC_DEG_RESTLEARNDFLT 50.000000 CU_ETCC_DEG_RESTLEARNDFLT 0.000000 50.000000 BYTE_ORDER MSB_FIRST /end CHARACTERISTIC
/begin RECORD_LAYOUT RL_ETCC_DEG_RESTLEARNDFLT FNC_VALUES 1 FLOAT32_IEEE COLUMN_DIR DIRECT /end RECORD_LAYOUT
/begin COMPU_METHOD CU_ETCC_DEG_RESTLEARNDFLT "Conversion method for ETCc_deg_RestLearnDflt" RAT_FUNC "%10.1" "deg" COEFFS 0.000000 1.000000 0.000000 0.000000 0.000000 1.000000 /end COMPU_METHOD
/* Scalar calibration for DDE 'ETCc_deg_RestMax'. */
/begin CHARACTERISTIC ETCc_deg_RestMax "Expected range of values for rest position" VALUE 0x87a34 RL_ETCC_DEG_RESTMAX 50.000000 CU_ETCC_DEG_RESTMAX 0.000000 50.000000 BYTE_ORDER MSB_FIRST /end CHARACTERISTIC
/begin RECORD_LAYOUT RL_ETCC_DEG_RESTMAX FNC_VALUES 1 FLOAT32_IEEE COLUMN_DIR DIRECT /end RECORD_LAYOUT
/begin COMPU_METHOD CU_ETCC_DEG_RESTMAX "Conversion method for ETCc_deg_RestMax" RAT_FUNC "%10.1" "deg" COEFFS 0.000000 1.000000 0.000000 0.000000 0.000000 1.000000 /end COMPU_METHOD
/* Scalar calibration for DDE 'ETCc_deg_RestMin'. */
/begin CHARACTERISTIC ETCc_deg_RestMin "Expected range of values for rest position" VALUE 0x87a30 RL_ETCC_DEG_RESTMIN 50.000000 CU_ETCC_DEG_RESTMIN 0.000000 50.000000 BYTE_ORDER MSB_FIRST /end CHARACTERISTIC
/begin RECORD_LAYOUT RL_ETCC_DEG_RESTMIN FNC_VALUES 1 FLOAT32_IEEE COLUMN_DIR DIRECT /end RECORD_LAYOUT
/begin COMPU_METHOD CU_ETCC_DEG_RESTMIN "Conversion method for ETCc_deg_RestMin" RAT_FUNC "%10.1" "deg" COEFFS 0.000000 1.000000 0.000000 0.000000 0.000000 1.000000 /end COMPU_METHOD
/* Scalar calibration for DDE 'ETCc_deg_RestPos'. */
/begin CHARACTERISTIC ETCc_deg_RestPos "Override value" VALUE 0x87a3c RL_ETCC_DEG_RESTPOS 90.000000 CU_ETCC_DEG_RESTPOS 0.000000 90.000000 BYTE_ORDER MSB_FIRST /end CHARACTERISTIC
/begin RECORD_LAYOUT RL_ETCC_DEG_RESTPOS FNC_VALUES 1 FLOAT32_IEEE COLUMN_DIR DIRECT /end RECORD_LAYOUT
/begin COMPU_METHOD CU_ETCC_DEG_RESTPOS "Conversion method for ETCc_deg_RestPos" RAT_FUNC "%10.2" "deg" COEFFS 0.000000 1.000000 0.000000 0.000000 0.000000 1.000000 /end COMPU_METHOD
/* Scalar calibration for DDE 'ETCc_deg_RestPosITermDbnd'. */
/begin CHARACTERISTIC ETCc_deg_RestPosITermDbnd "Iterm will freeze whenever position error falls below this value" VALUE 0x8bf6c RL_ETCC_DEG_RESTPOSITERMDBND 5.000000 CU_ETCC_DEG_RESTPOSITERMDBND 0.000000 5.000000 BYTE_ORDER MSB_FIRST /end CHARACTERISTIC
/begin RECORD_LAYOUT RL_ETCC_DEG_RESTPOSITERMDBND FNC_VALUES 1 FLOAT32_IEEE COLUMN_DIR DIRECT /end RECORD_LAYOUT
/begin COMPU_METHOD CU_ETCC_DEG_RESTPOSITERMDBND "Conversion method for ETCc_deg_RestPosITermDbnd" RAT_FUNC "%10.2" "deg" COEFFS 0.000000 1.000000 0.000000 0.000000 0.000000 1.000000 /end COMPU_METHOD
/* Scalar calibration for DDE 'ETCc_deg_RestPosThrsh'. */
/begin CHARACTERISTIC ETCc_deg_RestPosThrsh "Threshold on [position request proximity to rest position] at which wider error deadband will be used" VALUE 0x8a138 RL_ETCC_DEG_RESTPOSTHRSH 5.000000 CU_ETCC_DEG_RESTPOSTHRSH 0.000000 5.000000 BYTE_ORDER MSB_FIRST /end CHARACTERISTIC
/begin RECORD_LAYOUT RL_ETCC_DEG_RESTPOSTHRSH FNC_VALUES 1 FLOAT32_IEEE COLUMN_DIR DIRECT /end RECORD_LAYOUT
/begin COMPU_METHOD CU_ETCC_DEG_RESTPOSTHRSH "Conversion method for ETCc_deg_RestPosThrsh" RAT_FUNC "%10.2" "deg" COEFFS 0.000000 1.000000 0.000000 0.000000 0.000000 1.000000 /end COMPU_METHOD
/* Scalar calibration for DDE 'ETCc_deg_ThRqstFiltd'. */
/begin CHARACTERISTIC ETCc_deg_ThRqstFiltd "Override value" VALUE 0x87ab4 RL_ETCC_DEG_THRQSTFILTD 90.000000 CU_ETCC_DEG_THRQSTFILTD 0.000000 90.000000 BYTE_ORDER MSB_FIRST /end CHARACTERISTIC
/begin RECORD_LAYOUT RL_ETCC_DEG_THRQSTFILTD FNC_VALUES 1 FLOAT32_IEEE COLUMN_DIR DIRECT /end RECORD_LAYOUT
/begin COMPU_METHOD CU_ETCC_DEG_THRQSTFILTD "Conversion method for ETCc_deg_ThRqstFiltd" RAT_FUNC "%10.2" "deg" COEFFS 0.000000 1.000000 0.000000 0.000000 0.000000 1.000000 /end COMPU_METHOD
/* Scalar calibration for DDE 'ETCc_o_AuthorityReduced'. */
/begin CHARACTERISTIC ETCc_o_AuthorityReduced "Override flag" VALUE 0x8be60 RL_ETCC_O_AUTHORITYREDUCED 1.000000 CU_ETCC_O_AUTHORITYREDUCED 0.000000 1.000000 BYTE_ORDER MSB_FIRST /end CHARACTERISTIC
/begin RECORD_LAYOUT RL_ETCC_O_AUTHORITYREDUCED FNC_VALUES 1 UBYTE COLUMN_DIR DIRECT /end RECORD_LAYOUT
/begin COMPU_METHOD CU_ETCC_O_AUTHORITYREDUCED "Conversion method for ETCc_o_AuthorityReduced" RAT_FUNC "%10.0" "o" COEFFS 0.000000 1.000000 0.000000 0.000000 0.000000 1.000000 /end COMPU_METHOD
/* Scalar calibration for DDE 'ETCc_o_AvgTP'. */
/begin CHARACTERISTIC ETCc_o_AvgTP "Override flag" VALUE 0x8bdb4 RL_ETCC_O_AVGTP 1.000000 CU_ETCC_O_AVGTP 0.000000 1.000000 BYTE_ORDER MSB_FIRST /end CHARACTERISTIC
/begin RECORD_LAYOUT RL_ETCC_O_AVGTP FNC_VALUES 1 UBYTE COLUMN_DIR DIRECT /end RECORD_LAYOUT
/begin COMPU_METHOD CU_ETCC_O_AVGTP "Conversion method for ETCc_o_AvgTP" RAT_FUNC "%10.0" "b" COEFFS 0.000000 1.000000 0.000000 0.000000 0.000000 1.000000 /end COMPU_METHOD
/* Scalar calibration for DDE 'ETCc_o_FB'. */
/begin CHARACTERISTIC ETCc_o_FB "Override flag" VALUE 0x89320 RL_ETCC_O_FB 1.000000 CU_ETCC_O_FB 0.000000 1.000000 BYTE_ORDER MSB_FIRST /end CHARACTERISTIC
/begin RECORD_LAYOUT RL_ETCC_O_FB FNC_VALUES 1 UBYTE COLUMN_DIR DIRECT /end RECORD_LAYOUT
/begin COMPU_METHOD CU_ETCC_O_FB "Conversion method for ETCc_o_FB" RAT_FUNC "%10.0" "o" COEFFS 0.000000 1.000000 0.000000 0.000000 0.000000 1.000000 /end COMPU_METHOD
/* Scalar calibration for DDE 'ETCc_o_MotorCmd'. */
/begin CHARACTERISTIC ETCc_o_MotorCmd "Override flag" VALUE 0x87a90 RL_ETCC_O_MOTORCMD 1.000000 CU_ETCC_O_MOTORCMD 0.000000 1.000000 BYTE_ORDER MSB_FIRST /end CHARACTERISTIC
/begin RECORD_LAYOUT RL_ETCC_O_MOTORCMD FNC_VALUES 1 UBYTE COLUMN_DIR DIRECT /end RECORD_LAYOUT
/begin COMPU_METHOD CU_ETCC_O_MOTORCMD "Conversion method for ETCc_o_MotorCmd" RAT_FUNC "%10.0" "b" COEFFS 0.000000 1.000000 0.000000 0.000000 0.000000 1.000000 /end COMPU_METHOD
/* Scalar calibration for DDE 'ETCc_o_MotorCmdVb'. */
/begin CHARACTERISTIC ETCc_o_MotorCmdVb "Override flag" VALUE 0x8a178 RL_ETCC_O_MOTORCMDVB 1.000000 CU_ETCC_O_MOTORCMDVB 0.000000 1.000000 BYTE_ORDER MSB_FIRST /end CHARACTERISTIC
/begin RECORD_LAYOUT RL_ETCC_O_MOTORCMDVB FNC_VALUES 1 UBYTE COLUMN_DIR DIRECT /end RECORD_LAYOUT
/begin COMPU_METHOD CU_ETCC_O_MOTORCMDVB "Conversion method for ETCc_o_MotorCmdVb" RAT_FUNC "%10.0" "b" COEFFS 0.000000 1.000000 0.000000 0.000000 0.000000 1.000000 /end COMPU_METHOD
/* Scalar calibration for DDE 'ETCc_o_RestPos'. */
/begin CHARACTERISTIC ETCc_o_RestPos "Override flag" VALUE 0x87a3a RL_ETCC_O_RESTPOS 1.000000 CU_ETCC_O_RESTPOS 0.000000 1.000000 BYTE_ORDER MSB_FIRST /end CHARACTERISTIC
/begin RECORD_LAYOUT RL_ETCC_O_RESTPOS FNC_VALUES 1 UBYTE COLUMN_DIR DIRECT /end RECORD_LAYOUT
/begin COMPU_METHOD CU_ETCC_O_RESTPOS "Conversion method for ETCc_o_RestPos" RAT_FUNC "%10.0" "o" COEFFS 0.000000 1.000000 0.000000 0.000000 0.000000 1.000000 /end COMPU_METHOD
/* Scalar calibration for DDE 'ETCc_o_TP1_FullPos'. */
/begin CHARACTERISTIC ETCc_o_TP1_FullPos "Override flag" VALUE 0x879fc RL_ETCC_O_TP1_FULLPOS 1.000000 CU_ETCC_O_TP1_FULLPOS 0.000000 1.000000 BYTE_ORDER MSB_FIRST /end CHARACTERISTIC
/begin RECORD_LAYOUT RL_ETCC_O_TP1_FULLPOS FNC_VALUES 1 UBYTE COLUMN_DIR DIRECT /end RECORD_LAYOUT
/begin COMPU_METHOD CU_ETCC_O_TP1_FULLPOS "Conversion method for ETCc_o_TP1_FullPos" RAT_FUNC "%10.0" "o" COEFFS 0.000000 1.000000 0.000000 0.000000 0.000000 1.000000 /end COMPU_METHOD
/* Scalar calibration for DDE 'ETCc_o_TP1_ZeroPos'. */
/begin CHARACTERISTIC ETCc_o_TP1_ZeroPos "Override flag" VALUE 0x879f5 RL_ETCC_O_TP1_ZEROPOS 1.000000 CU_ETCC_O_TP1_ZEROPOS 0.000000 1.000000 BYTE_ORDER MSB_FIRST /end CHARACTERISTIC
/begin RECORD_LAYOUT RL_ETCC_O_TP1_ZEROPOS FNC_VALUES 1 UBYTE COLUMN_DIR DIRECT /end RECORD_LAYOUT
/begin COMPU_METHOD CU_ETCC_O_TP1_ZEROPOS "Conversion method for ETCc_o_TP1_ZeroPos" RAT_FUNC "%10.0" "o" COEFFS 0.000000 1.000000 0.000000 0.000000 0.000000 1.000000 /end COMPU_METHOD
/* Scalar calibration for DDE 'ETCc_o_TP2_FullPos'. */
/begin CHARACTERISTIC ETCc_o_TP2_FullPos "Override flag" VALUE 0x87a0c RL_ETCC_O_TP2_FULLPOS 1.000000 CU_ETCC_O_TP2_FULLPOS 0.000000 1.000000 BYTE_ORDER MSB_FIRST /end CHARACTERISTIC
/begin RECORD_LAYOUT RL_ETCC_O_TP2_FULLPOS FNC_VALUES 1 UBYTE COLUMN_DIR DIRECT /end RECORD_LAYOUT
/begin COMPU_METHOD CU_ETCC_O_TP2_FULLPOS "Conversion method for ETCc_o_TP2_FullPos" RAT_FUNC "%10.0" "o" COEFFS 0.000000 1.000000 0.000000 0.000000 0.000000 1.000000 /end COMPU_METHOD
/* Scalar calibration for DDE 'ETCc_o_TP2_ZeroPos'. */
/begin CHARACTERISTIC ETCc_o_TP2_ZeroPos "Override flag" VALUE 0x87a04 RL_ETCC_O_TP2_ZEROPOS 1.000000 CU_ETCC_O_TP2_ZEROPOS 0.000000 1.000000 BYTE_ORDER MSB_FIRST /end CHARACTERISTIC
/begin RECORD_LAYOUT RL_ETCC_O_TP2_ZEROPOS FNC_VALUES 1 UBYTE COLUMN_DIR DIRECT /end RECORD_LAYOUT
/begin COMPU_METHOD CU_ETCC_O_TP2_ZEROPOS "Conversion method for ETCc_o_TP2_ZeroPos" RAT_FUNC "%10.0" "o" COEFFS 0.000000 1.000000 0.000000 0.000000 0.000000 1.000000 /end COMPU_METHOD
/* Scalar calibration for DDE 'ETCc_o_ThRqstFiltd'. */
/begin CHARACTERISTIC ETCc_o_ThRqstFiltd "Override flag" VALUE 0x87ab0 RL_ETCC_O_THRQSTFILTD 1.000000 CU_ETCC_O_THRQSTFILTD 0.000000 1.000000 BYTE_ORDER MSB_FIRST /end CHARACTERISTIC
/begin RECORD_LAYOUT RL_ETCC_O_THRQSTFILTD FNC_VALUES 1 UBYTE COLUMN_DIR DIRECT /end RECORD_LAYOUT
/begin COMPU_METHOD CU_ETCC_O_THRQSTFILTD "Conversion method for ETCc_o_ThRqstFiltd" RAT_FUNC "%10.0" "o" COEFFS 0.000000 1.000000 0.000000 0.000000 0.000000 1.000000 /end COMPU_METHOD
/* Scalar calibration for DDE 'ETCc_pct_AvgTP'. */
/begin CHARACTERISTIC ETCc_pct_AvgTP "Override value" VALUE 0x8bdb8 RL_ETCC_PCT_AVGTP 1.000000 CU_ETCC_PCT_AVGTP 0.000000 1.000000 BYTE_ORDER MSB_FIRST /end CHARACTERISTIC
/begin RECORD_LAYOUT RL_ETCC_PCT_AVGTP FNC_VALUES 1 FLOAT32_IEEE COLUMN_DIR DIRECT /end RECORD_LAYOUT
/begin COMPU_METHOD CU_ETCC_PCT_AVGTP "Conversion method for ETCc_pct_AvgTP" RAT_FUNC "%10.2" "pct" COEFFS 0.000000 1.000000 0.000000 0.000000 0.000000 1.000000 /end COMPU_METHOD
/* Scalar calibration for DDE 'ETCc_pct_ContinuousDutyMax'. */
/begin CHARACTERISTIC ETCc_pct_ContinuousDutyMax "Clip motor command to this range" VALUE 0x8a170 RL_ETCC_PCT_CONTINUOUSDUTYMAX 1.000000 CU_ETCC_PCT_CONTINUOUSDUTYMAX 0.000000 1.000000 BYTE_ORDER MSB_FIRST /end CHARACTERISTIC
/begin RECORD_LAYOUT RL_ETCC_PCT_CONTINUOUSDUTYMAX FNC_VALUES 1 FLOAT32_IEEE COLUMN_DIR DIRECT /end RECORD_LAYOUT
/begin COMPU_METHOD CU_ETCC_PCT_CONTINUOUSDUTYMAX "Conversion method for ETCc_pct_ContinuousDutyMax" RAT_FUNC "%10.2" "pct" COEFFS 0.000000 1.000000 0.000000 0.000000 0.000000 1.000000 /end COMPU_METHOD
/* Scalar calibration for DDE 'ETCc_pct_ContinuousDutyMin'. */
/begin CHARACTERISTIC ETCc_pct_ContinuousDutyMin "Clip motor command to this range" VALUE 0x8a16c RL_ETCC_PCT_CONTINUOUSDUTYMIN 1.000000 CU_ETCC_PCT_CONTINUOUSDUTYMIN -1.000000 0.000000 BYTE_ORDER MSB_FIRST /end CHARACTERISTIC
/begin RECORD_LAYOUT RL_ETCC_PCT_CONTINUOUSDUTYMIN FNC_VALUES 1 FLOAT32_IEEE COLUMN_DIR DIRECT /end RECORD_LAYOUT
/begin COMPU_METHOD CU_ETCC_PCT_CONTINUOUSDUTYMIN "Conversion method for ETCc_pct_ContinuousDutyMin" RAT_FUNC "%10.2" "pct" COEFFS 0.000000 1.000000 0.000000 0.000000 0.000000 1.000000 /end COMPU_METHOD
/* Scalar calibration for DDE 'ETCc_pct_DMax'. */
/begin CHARACTERISTIC ETCc_pct_DMax "Integral Effort Upper Limit" VALUE 0x89328 RL_ETCC_PCT_DMAX 1.000000 CU_ETCC_PCT_DMAX 0.000000 1.000000 BYTE_ORDER MSB_FIRST /end CHARACTERISTIC
/begin RECORD_LAYOUT RL_ETCC_PCT_DMAX FNC_VALUES 1 FLOAT32_IEEE COLUMN_DIR DIRECT /end RECORD_LAYOUT
/begin COMPU_METHOD CU_ETCC_PCT_DMAX "Conversion method for ETCc_pct_DMax" RAT_FUNC "%10.2" "pct" COEFFS 0.000000 1.000000 0.000000 0.000000 0.000000 1.000000 /end COMPU_METHOD
/* Scalar calibration for DDE 'ETCc_pct_DMin'. */
/begin CHARACTERISTIC ETCc_pct_DMin "Integral Effort Lower Limit" VALUE 0x8932c RL_ETCC_PCT_DMIN 1.000000 CU_ETCC_PCT_DMIN -1.000000 0.000000 BYTE_ORDER MSB_FIRST /end CHARACTERISTIC
/begin RECORD_LAYOUT RL_ETCC_PCT_DMIN FNC_VALUES 1 FLOAT32_IEEE COLUMN_DIR DIRECT /end RECORD_LAYOUT
/begin COMPU_METHOD CU_ETCC_PCT_DMIN "Conversion method for ETCc_pct_DMin" RAT_FUNC "%10.2" "pct" COEFFS 0.000000 1.000000 0.000000 0.000000 0.000000 1.000000 /end COMPU_METHOD
/* Scalar calibration for DDE 'ETCc_pct_EMax'. */
/begin CHARACTERISTIC ETCc_pct_EMax "Integral Effort Upper Limit" VALUE 0x89318 RL_ETCC_PCT_EMAX 1.000000 CU_ETCC_PCT_EMAX 0.000000 1.000000 BYTE_ORDER MSB_FIRST /end CHARACTERISTIC
/begin RECORD_LAYOUT RL_ETCC_PCT_EMAX FNC_VALUES 1 FLOAT32_IEEE COLUMN_DIR DIRECT /end RECORD_LAYOUT
/begin COMPU_METHOD CU_ETCC_PCT_EMAX "Conversion method for ETCc_pct_EMax" RAT_FUNC "%10.2" "pct" COEFFS 0.000000 1.000000 0.000000 0.000000 0.000000 1.000000 /end COMPU_METHOD
/* Scalar calibration for DDE 'ETCc_pct_EMin'. */
/begin CHARACTERISTIC ETCc_pct_EMin "Integral Effort Lower Limit" VALUE 0x8931c RL_ETCC_PCT_EMIN 1.000000 CU_ETCC_PCT_EMIN -1.000000 0.000000 BYTE_ORDER MSB_FIRST /end CHARACTERISTIC
/begin RECORD_LAYOUT RL_ETCC_PCT_EMIN FNC_VALUES 1 FLOAT32_IEEE COLUMN_DIR DIRECT /end RECORD_LAYOUT
/begin COMPU_METHOD CU_ETCC_PCT_EMIN "Conversion method for ETCc_pct_EMin" RAT_FUNC "%10.2" "pct" COEFFS 0.000000 1.000000 0.000000 0.000000 0.000000 1.000000 /end COMPU_METHOD
/* Scalar calibration for DDE 'ETCc_pct_FB'. */
/begin CHARACTERISTIC ETCc_pct_FB "Override value" VALUE 0x89324 RL_ETCC_PCT_FB 2.200000 CU_ETCC_PCT_FB -1.100000 1.100000 BYTE_ORDER MSB_FIRST /end CHARACTERISTIC
/begin RECORD_LAYOUT RL_ETCC_PCT_FB FNC_VALUES 1 FLOAT32_IEEE COLUMN_DIR DIRECT /end RECORD_LAYOUT
/begin COMPU_METHOD CU_ETCC_PCT_FB "Conversion method for ETCc_pct_FB" RAT_FUNC "%10.2" "pct" COEFFS 0.000000 1.000000 0.000000 0.000000 0.000000 1.000000 /end COMPU_METHOD
/* Scalar calibration for DDE 'ETCc_pct_FB_Dbnd'. */
/begin CHARACTERISTIC ETCc_pct_FB_Dbnd "Dead Band limit on PI Controller Effort in ETC" VALUE 0x89330 RL_ETCC_PCT_FB_DBND 2.000000 CU_ETCC_PCT_FB_DBND -1.000000 1.000000 BYTE_ORDER MSB_FIRST /end CHARACTERISTIC
/begin RECORD_LAYOUT RL_ETCC_PCT_FB_DBND FNC_VALUES 1 FLOAT32_IEEE COLUMN_DIR DIRECT /end RECORD_LAYOUT
/begin COMPU_METHOD CU_ETCC_PCT_FB_DBND "Conversion method for ETCc_pct_FB_Dbnd" RAT_FUNC "%10.3" "pct" COEFFS 0.000000 1.000000 0.000000 0.000000 0.000000 1.000000 /end COMPU_METHOD
/* Scalar calibration for DDE 'ETCc_pct_FB_Max'. */
/begin CHARACTERISTIC ETCc_pct_FB_Max "PI Controller Upper Limit Saturation" VALUE 0x89334 RL_ETCC_PCT_FB_MAX 2.000000 CU_ETCC_PCT_FB_MAX 0.000000 2.000000 BYTE_ORDER MSB_FIRST /end CHARACTERISTIC
/begin RECORD_LAYOUT RL_ETCC_PCT_FB_MAX FNC_VALUES 1 FLOAT32_IEEE COLUMN_DIR DIRECT /end RECORD_LAYOUT
/begin COMPU_METHOD CU_ETCC_PCT_FB_MAX "Conversion method for ETCc_pct_FB_Max" RAT_FUNC "%10.2" "pct" COEFFS 0.000000 1.000000 0.000000 0.000000 0.000000 1.000000 /end COMPU_METHOD
/* Scalar calibration for DDE 'ETCc_pct_FB_Min'. */
/begin CHARACTERISTIC ETCc_pct_FB_Min "PI Controller Lower Limit Saturation" VALUE 0x89338 RL_ETCC_PCT_FB_MIN 2.000000 CU_ETCC_PCT_FB_MIN -2.000000 0.000000 BYTE_ORDER MSB_FIRST /end CHARACTERISTIC
/begin RECORD_LAYOUT RL_ETCC_PCT_FB_MIN FNC_VALUES 1 FLOAT32_IEEE COLUMN_DIR DIRECT /end RECORD_LAYOUT
/begin COMPU_METHOD CU_ETCC_PCT_FB_MIN "Conversion method for ETCc_pct_FB_Min" RAT_FUNC "%10.2" "pct" COEFFS 0.000000 1.000000 0.000000 0.000000 0.000000 1.000000 /end COMPU_METHOD
/* Scalar calibration for DDE 'ETCc_pct_ForceClosedCmd'. */
/begin CHARACTERISTIC ETCc_pct_ForceClosedCmd "Constant motor duty to fully close throttle valve" VALUE 0x87a1c RL_ETCC_PCT_FORCECLOSEDCMD 0.800000 CU_ETCC_PCT_FORCECLOSEDCMD -0.800000 0.000000 BYTE_ORDER MSB_FIRST /end CHARACTERISTIC
/begin RECORD_LAYOUT RL_ETCC_PCT_FORCECLOSEDCMD FNC_VALUES 1 FLOAT32_IEEE COLUMN_DIR DIRECT /end RECORD_LAYOUT
/begin COMPU_METHOD CU_ETCC_PCT_FORCECLOSEDCMD "Conversion method for ETCc_pct_ForceClosedCmd" RAT_FUNC "%10.2" "pct" COEFFS 0.000000 1.000000 0.000000 0.000000 0.000000 1.000000 /end COMPU_METHOD
/* Scalar calibration for DDE 'ETCc_pct_ForceOpenCmd'. */
/begin CHARACTERISTIC ETCc_pct_ForceOpenCmd "Constant motor duty to fully open throttle valve" VALUE 0x87a18 RL_ETCC_PCT_FORCEOPENCMD 0.800000 CU_ETCC_PCT_FORCEOPENCMD 0.000000 0.800000 BYTE_ORDER MSB_FIRST /end CHARACTERISTIC
/begin RECORD_LAYOUT RL_ETCC_PCT_FORCEOPENCMD FNC_VALUES 1 FLOAT32_IEEE COLUMN_DIR DIRECT /end RECORD_LAYOUT
/begin COMPU_METHOD CU_ETCC_PCT_FORCEOPENCMD "Conversion method for ETCc_pct_ForceOpenCmd" RAT_FUNC "%10.2" "pct" COEFFS 0.000000 1.000000 0.000000 0.000000 0.000000 1.000000 /end COMPU_METHOD
/* Scalar calibration for DDE 'ETCc_pct_IMax'. */
/begin CHARACTERISTIC ETCc_pct_IMax "Integral Effort Upper Limit" VALUE 0x80448 RL_ETCC_PCT_IMAX 1.000000 CU_ETCC_PCT_IMAX 0.000000 1.000000 BYTE_ORDER MSB_FIRST /end CHARACTERISTIC
/begin RECORD_LAYOUT RL_ETCC_PCT_IMAX FNC_VALUES 1 FLOAT32_IEEE COLUMN_DIR DIRECT /end RECORD_LAYOUT
/begin COMPU_METHOD CU_ETCC_PCT_IMAX "Conversion method for ETCc_pct_IMax" RAT_FUNC "%10.2" "pct" COEFFS 0.000000 1.000000 0.000000 0.000000 0.000000 1.000000 /end COMPU_METHOD
/* Scalar calibration for DDE 'ETCc_pct_IMin'. */
/begin CHARACTERISTIC ETCc_pct_IMin "Integral Effort Lower Limit" VALUE 0x8044c RL_ETCC_PCT_IMIN 1.000000 CU_ETCC_PCT_IMIN -1.000000 0.000000 BYTE_ORDER MSB_FIRST /end CHARACTERISTIC
/begin RECORD_LAYOUT RL_ETCC_PCT_IMIN FNC_VALUES 1 FLOAT32_IEEE COLUMN_DIR DIRECT /end RECORD_LAYOUT
/begin COMPU_METHOD CU_ETCC_PCT_IMIN "Conversion method for ETCc_pct_IMin" RAT_FUNC "%10.2" "pct" COEFFS 0.000000 1.000000 0.000000 0.000000 0.000000 1.000000 /end COMPU_METHOD
/* Scalar calibration for DDE 'ETCc_pct_KickDuty'. */
/begin CHARACTERISTIC ETCc_pct_KickDuty "Constant-magnitude kick duty command" VALUE 0x8a158 RL_ETCC_PCT_KICKDUTY 1.000000 CU_ETCC_PCT_KICKDUTY 0.000000 1.000000 BYTE_ORDER MSB_FIRST /end CHARACTERISTIC
/begin RECORD_LAYOUT RL_ETCC_PCT_KICKDUTY FNC_VALUES 1 FLOAT32_IEEE COLUMN_DIR DIRECT /end RECORD_LAYOUT
/begin COMPU_METHOD CU_ETCC_PCT_KICKDUTY "Conversion method for ETCc_pct_KickDuty" RAT_FUNC "%10.2" "pct" COEFFS 0.000000 1.000000 0.000000 0.000000 0.000000 1.000000 /end COMPU_METHOD
/* Scalar calibration for DDE 'ETCc_pct_Kick_Error'. */
/begin CHARACTERISTIC ETCc_pct_Kick_Error "(not defined)" VALUE 0x8a168 RL_ETCC_PCT_KICK_ERROR 2000.000000 CU_ETCC_PCT_KICK_ERROR -1000.000000 1000.000000 BYTE_ORDER MSB_FIRST /end CHARACTERISTIC
/begin RECORD_LAYOUT RL_ETCC_PCT_KICK_ERROR FNC_VALUES 1 FLOAT32_IEEE COLUMN_DIR DIRECT /end RECORD_LAYOUT
/begin COMPU_METHOD CU_ETCC_PCT_KICK_ERROR "Conversion method for ETCc_pct_Kick_Error" RAT_FUNC "%10.2" "pct" COEFFS 0.000000 1.000000 0.000000 0.000000 0.000000 1.000000 /end COMPU_METHOD
/* Scalar calibration for DDE 'ETCc_pct_MotorCmd'. */
/begin CHARACTERISTIC ETCc_pct_MotorCmd "Override value" VALUE 0x8be40 RL_ETCC_PCT_MOTORCMD 1.200000 CU_ETCC_PCT_MOTORCMD -0.600000 0.600000 BYTE_ORDER MSB_FIRST /end CHARACTERISTIC
/begin RECORD_LAYOUT RL_ETCC_PCT_MOTORCMD FNC_VALUES 1 FLOAT32_IEEE COLUMN_DIR DIRECT /end RECORD_LAYOUT
/begin COMPU_METHOD CU_ETCC_PCT_MOTORCMD "Conversion method for ETCc_pct_MotorCmd" RAT_FUNC "%10.2" "pct" COEFFS 0.000000 1.000000 0.000000 0.000000 0.000000 1.000000 /end COMPU_METHOD
/* Scalar calibration for DDE 'ETCc_pct_MotorCmdVb'. */
/begin CHARACTERISTIC ETCc_pct_MotorCmdVb "Override value" VALUE 0x8a17c RL_ETCC_PCT_MOTORCMDVB 1.200000 CU_ETCC_PCT_MOTORCMDVB -0.600000 0.600000 BYTE_ORDER MSB_FIRST /end CHARACTERISTIC
/begin RECORD_LAYOUT RL_ETCC_PCT_MOTORCMDVB FNC_VALUES 1 FLOAT32_IEEE COLUMN_DIR DIRECT /end RECORD_LAYOUT
/begin COMPU_METHOD CU_ETCC_PCT_MOTORCMDVB "Conversion method for ETCc_pct_MotorCmdVb" RAT_FUNC "%10.2" "pct" COEFFS 0.000000 1.000000 0.000000 0.000000 0.000000 1.000000 /end COMPU_METHOD
/* Scalar calibration for DDE 'ETCc_pct_TP_DeltaMax'. */
/begin CHARACTERISTIC ETCc_pct_TP_DeltaMax "(TP raw units) fault will set if TP1 and TP2 differ by this amount" VALUE 0x87a28 RL_ETCC_PCT_TP_DELTAMAX 1.000000 CU_ETCC_PCT_TP_DELTAMAX 0.000000 1.000000 BYTE_ORDER MSB_FIRST /end CHARACTERISTIC
/begin RECORD_LAYOUT RL_ETCC_PCT_TP_DELTAMAX FNC_VALUES 1 FLOAT32_IEEE COLUMN_DIR DIRECT /end RECORD_LAYOUT
/begin COMPU_METHOD CU_ETCC_PCT_TP_DELTAMAX "Conversion method for ETCc_pct_TP_DeltaMax" RAT_FUNC "%10.2" "pct" COEFFS 0.000000 1.000000 0.000000 0.000000 0.000000 1.000000 /end COMPU_METHOD
/* Scalar calibration for DDE 'ETCc_s_ContinuousDutyDbnc'. */
/begin CHARACTERISTIC ETCc_s_ContinuousDutyDbnc "Duty will be clipped after this time duration (allows transients to exceed the limit)" VALUE 0x8a174 RL_ETCC_S_CONTINUOUSDUTYDBNC 10.000000 CU_ETCC_S_CONTINUOUSDUTYDBNC 0.000000 10.000000 BYTE_ORDER MSB_FIRST /end CHARACTERISTIC
/begin RECORD_LAYOUT RL_ETCC_S_CONTINUOUSDUTYDBNC FNC_VALUES 1 FLOAT32_IEEE COLUMN_DIR DIRECT /end RECORD_LAYOUT
/begin COMPU_METHOD CU_ETCC_S_CONTINUOUSDUTYDBNC "Conversion method for ETCc_s_ContinuousDutyDbnc" RAT_FUNC "%10.1" "s" COEFFS 0.000000 1.000000 0.000000 0.000000 0.000000 1.000000 /end COMPU_METHOD
/* Scalar calibration for DDE 'ETCc_s_KickSignDbnc'. */
/begin CHARACTERISTIC ETCc_s_KickSignDbnc "Kick sign-change debounce" VALUE 0x8a150 RL_ETCC_S_KICKSIGNDBNC 0.100000 CU_ETCC_S_KICKSIGNDBNC 0.000000 0.100000 BYTE_ORDER MSB_FIRST /end CHARACTERISTIC
/begin RECORD_LAYOUT RL_ETCC_S_KICKSIGNDBNC FNC_VALUES 1 FLOAT32_IEEE COLUMN_DIR DIRECT /end RECORD_LAYOUT
/begin COMPU_METHOD CU_ETCC_S_KICKSIGNDBNC "Conversion method for ETCc_s_KickSignDbnc" RAT_FUNC "%10.2" "s" COEFFS 0.000000 1.000000 0.000000 0.000000 0.000000 1.000000 /end COMPU_METHOD
/* Scalar calibration for DDE 'ETCc_s_Kick_hold'. */
/begin CHARACTERISTIC ETCc_s_Kick_hold "(not defined)" VALUE 0x8a164 RL_ETCC_S_KICK_HOLD 100.000000 CU_ETCC_S_KICK_HOLD 0.000000 100.000000 BYTE_ORDER MSB_FIRST /end CHARACTERISTIC
/begin RECORD_LAYOUT RL_ETCC_S_KICK_HOLD FNC_VALUES 1 FLOAT32_IEEE COLUMN_DIR DIRECT /end RECORD_LAYOUT
/begin COMPU_METHOD CU_ETCC_S_KICK_HOLD "Conversion method for ETCc_s_Kick_hold" RAT_FUNC "%10.2" "s" COEFFS 0.000000 1.000000 0.000000 0.000000 0.000000 1.000000 /end COMPU_METHOD
/* Scalar calibration for DDE 'ETCc_s_PowerupDelay'. */
/begin CHARACTERISTIC ETCc_s_PowerupDelay "ETC range learning will begin this duration after ECU powerup (with engine stopped)" VALUE 0x879d0 RL_ETCC_S_POWERUPDELAY 10.000000 CU_ETCC_S_POWERUPDELAY 0.000000 10.000000 BYTE_ORDER MSB_FIRST /end CHARACTERISTIC
/begin RECORD_LAYOUT RL_ETCC_S_POWERUPDELAY FNC_VALUES 1 FLOAT32_IEEE COLUMN_DIR DIRECT /end RECORD_LAYOUT
/begin COMPU_METHOD CU_ETCC_S_POWERUPDELAY "Conversion method for ETCc_s_PowerupDelay" RAT_FUNC "%10.2" "s" COEFFS 0.000000 1.000000 0.000000 0.000000 0.000000 1.000000 /end COMPU_METHOD
/* Scalar calibration for DDE 'ETCc_s_RangeCheckExpire'. */
/begin CHARACTERISTIC ETCc_s_RangeCheckExpire "If range check is active longer than this duration it will automatically abort" VALUE 0x87a14 RL_ETCC_S_RANGECHECKEXPIRE 10.000000 CU_ETCC_S_RANGECHECKEXPIRE 0.000000 10.000000 BYTE_ORDER MSB_FIRST /end CHARACTERISTIC
/begin RECORD_LAYOUT RL_ETCC_S_RANGECHECKEXPIRE FNC_VALUES 1 FLOAT32_IEEE COLUMN_DIR DIRECT /end RECORD_LAYOUT
/begin COMPU_METHOD CU_ETCC_S_RANGECHECKEXPIRE "Conversion method for ETCc_s_RangeCheckExpire" RAT_FUNC "%10.2" "s" COEFFS 0.000000 1.000000 0.000000 0.000000 0.000000 1.000000 /end COMPU_METHOD
/* Scalar calibration for DDE 'ETCc_s_RestCrankingExpiration'. */
/begin CHARACTERISTIC ETCc_s_RestCrankingExpiration "If cranking lasts longer than this duration enable running-mode throttle controls" VALUE 0x87a8c RL_ETCC_S_RESTCRANKINGEXPIRATI0 10.000000 CU_ETCC_S_RESTCRANKINGEXPIRATI0 0.000000 10.000000 BYTE_ORDER MSB_FIRST /end CHARACTERISTIC
/begin RECORD_LAYOUT RL_ETCC_S_RESTCRANKINGEXPIRATI0 FNC_VALUES 1 FLOAT32_IEEE COLUMN_DIR DIRECT /end RECORD_LAYOUT
/begin COMPU_METHOD CU_ETCC_S_RESTCRANKINGEXPIRATI0 "Conversion method for ETCc_s_RestCrankingExpiration" RAT_FUNC "%10.2" "s" COEFFS 0.000000 1.000000 0.000000 0.000000 0.000000 1.000000 /end COMPU_METHOD
/* Scalar calibration for DDE 'ETCc_s_TP_FallDelay'. */
/begin CHARACTERISTIC ETCc_s_TP_FallDelay "TP fall rate must be below the cal threshold for this duration before proceeding" VALUE 0x879e4 RL_ETCC_S_TP_FALLDELAY 0.990000 CU_ETCC_S_TP_FALLDELAY 0.010000 1.000000 BYTE_ORDER MSB_FIRST /end CHARACTERISTIC
/begin RECORD_LAYOUT RL_ETCC_S_TP_FALLDELAY FNC_VALUES 1 FLOAT32_IEEE COLUMN_DIR DIRECT /end RECORD_LAYOUT
/begin COMPU_METHOD CU_ETCC_S_TP_FALLDELAY "Conversion method for ETCc_s_TP_FallDelay" RAT_FUNC "%10.2" "s" COEFFS 0.000000 1.000000 0.000000 0.000000 0.000000 1.000000 /end COMPU_METHOD
/* Scalar calibration for DDE 'ETCc_s_TP_FltDbnc'. */
/begin CHARACTERISTIC ETCc_s_TP_FltDbnc "Fault set-clear debounce time" VALUE 0x87a2c RL_ETCC_S_TP_FLTDBNC 10.000000 CU_ETCC_S_TP_FLTDBNC 0.000000 10.000000 BYTE_ORDER MSB_FIRST /end CHARACTERISTIC
/begin RECORD_LAYOUT RL_ETCC_S_TP_FLTDBNC FNC_VALUES 1 FLOAT32_IEEE COLUMN_DIR DIRECT /end RECORD_LAYOUT
/begin COMPU_METHOD CU_ETCC_S_TP_FLTDBNC "Conversion method for ETCc_s_TP_FltDbnc" RAT_FUNC "%10.2" "s" COEFFS 0.000000 1.000000 0.000000 0.000000 0.000000 1.000000 /end COMPU_METHOD
/* Scalar calibration for DDE 'ETCc_s_TP_RiseDelay'. */
/begin CHARACTERISTIC ETCc_s_TP_RiseDelay "TP rise rate must be below the cal threshold for this duration before proceeding" VALUE 0x879dc RL_ETCC_S_TP_RISEDELAY 0.990000 CU_ETCC_S_TP_RISEDELAY 0.010000 1.000000 BYTE_ORDER MSB_FIRST /end CHARACTERISTIC
/begin RECORD_LAYOUT RL_ETCC_S_TP_RISEDELAY FNC_VALUES 1 FLOAT32_IEEE COLUMN_DIR DIRECT /end RECORD_LAYOUT
/begin COMPU_METHOD CU_ETCC_S_TP_RISEDELAY "Conversion method for ETCc_s_TP_RiseDelay" RAT_FUNC "%10.2" "s" COEFFS 0.000000 1.000000 0.000000 0.000000 0.000000 1.000000 /end COMPU_METHOD
/* Scalar calibration for DDE 'ETCc_s_TP_StableDelay'. */
/begin CHARACTERISTIC ETCc_s_TP_StableDelay "TP_Dot must be below the cal threshold for this duration before TP signal is used for endstop learning" VALUE 0x879b0 RL_ETCC_S_TP_STABLEDELAY 0.990000 CU_ETCC_S_TP_STABLEDELAY 0.010000 1.000000 BYTE_ORDER MSB_FIRST /end CHARACTERISTIC
/begin RECORD_LAYOUT RL_ETCC_S_TP_STABLEDELAY FNC_VALUES 1 FLOAT32_IEEE COLUMN_DIR DIRECT /end RECORD_LAYOUT
/begin COMPU_METHOD CU_ETCC_S_TP_STABLEDELAY "Conversion method for ETCc_s_TP_StableDelay" RAT_FUNC "%10.2" "s" COEFFS 0.000000 1.000000 0.000000 0.000000 0.000000 1.000000 /end COMPU_METHOD
/* Scalar calibration for DDE 'ETCca_NU_FullLearnDfltTP1'. */
/begin CHARACTERISTIC ETCca_NU_FullLearnDfltTP1 "Full position learn default value for throttle position sensor 1" VALUE 0x4000f474 RL_ETCCA_NU_FULLLEARNDFLTTP1 400.000000 CU_ETCCA_NU_FULLLEARNDFLTTP1 -200.000000 200.000000 BYTE_ORDER MSB_FIRST /end CHARACTERISTIC
/begin RECORD_LAYOUT RL_ETCCA_NU_FULLLEARNDFLTTP1 FNC_VALUES 1 FLOAT32_IEEE COLUMN_DIR DIRECT /end RECORD_LAYOUT
/begin COMPU_METHOD CU_ETCCA_NU_FULLLEARNDFLTTP1 "Conversion method for ETCca_NU_FullLearnDfltTP1" RAT_FUNC "%10.3" "NU" COEFFS 0.000000 1.000000 0.000000 0.000000 0.000000 1.000000 /end COMPU_METHOD
/* Scalar calibration for DDE 'ETCca_NU_FullLearnDfltTP2'. */
/begin CHARACTERISTIC ETCca_NU_FullLearnDfltTP2 "Full position learn default value for throttle position sensor 2" VALUE 0x4000f478 RL_ETCCA_NU_FULLLEARNDFLTTP2 400.000000 CU_ETCCA_NU_FULLLEARNDFLTTP2 -200.000000 200.000000 BYTE_ORDER MSB_FIRST /end CHARACTERISTIC
/begin RECORD_LAYOUT RL_ETCCA_NU_FULLLEARNDFLTTP2 FNC_VALUES 1 FLOAT32_IEEE COLUMN_DIR DIRECT /end RECORD_LAYOUT
/begin COMPU_METHOD CU_ETCCA_NU_FULLLEARNDFLTTP2 "Conversion method for ETCca_NU_FullLearnDfltTP2" RAT_FUNC "%10.3" "NU" COEFFS 0.000000 1.000000 0.000000 0.000000 0.000000 1.000000 /end COMPU_METHOD
/* Scalar calibration for DDE 'ETCca_NU_ZeroLearnDfltTP1'. */
/begin CHARACTERISTIC ETCca_NU_ZeroLearnDfltTP1 "Zero position learn default value for throttle position sensor 1" VALUE 0x4000f47c RL_ETCCA_NU_ZEROLEARNDFLTTP1 400.000000 CU_ETCCA_NU_ZEROLEARNDFLTTP1 -200.000000 200.000000 BYTE_ORDER MSB_FIRST /end CHARACTERISTIC
/begin RECORD_LAYOUT RL_ETCCA_NU_ZEROLEARNDFLTTP1 FNC_VALUES 1 FLOAT32_IEEE COLUMN_DIR DIRECT /end RECORD_LAYOUT
/begin COMPU_METHOD CU_ETCCA_NU_ZEROLEARNDFLTTP1 "Conversion method for ETCca_NU_ZeroLearnDfltTP1" RAT_FUNC "%10.3" "NU" COEFFS 0.000000 1.000000 0.000000 0.000000 0.000000 1.000000 /end COMPU_METHOD
/* Scalar calibration for DDE 'ETCca_NU_ZeroLearnDfltTP2'. */
/begin CHARACTERISTIC ETCca_NU_ZeroLearnDfltTP2 "Zero position learn default value for throttle position sensor 2" VALUE 0x4000f480 RL_ETCCA_NU_ZEROLEARNDFLTTP2 400.000000 CU_ETCCA_NU_ZEROLEARNDFLTTP2 -200.000000 200.000000 BYTE_ORDER MSB_FIRST /end CHARACTERISTIC
/begin RECORD_LAYOUT RL_ETCCA_NU_ZEROLEARNDFLTTP2 FNC_VALUES 1 FLOAT32_IEEE COLUMN_DIR DIRECT /end RECORD_LAYOUT
/begin COMPU_METHOD CU_ETCCA_NU_ZEROLEARNDFLTTP2 "Conversion method for ETCca_NU_ZeroLearnDfltTP2" RAT_FUNC "%10.3" "NU" COEFFS 0.000000 1.000000 0.000000 0.000000 0.000000 1.000000 /end COMPU_METHOD
/* Scalar calibration for DDE 'ETCca_deg_RestLearnDflt'. */
/begin CHARACTERISTIC ETCca_deg_RestLearnDflt "Rest position learn default value" VALUE 0x4000f484 RL_ETCCA_DEG_RESTLEARNDFLT 50.000000 CU_ETCCA_DEG_RESTLEARNDFLT 0.000000 50.000000 BYTE_ORDER MSB_FIRST /end CHARACTERISTIC
/begin RECORD_LAYOUT RL_ETCCA_DEG_RESTLEARNDFLT FNC_VALUES 1 FLOAT32_IEEE COLUMN_DIR DIRECT /end RECORD_LAYOUT
/begin COMPU_METHOD CU_ETCCA_DEG_RESTLEARNDFLT "Conversion method for ETCca_deg_RestLearnDflt" RAT_FUNC "%10.1" "deg" COEFFS 0.000000 1.000000 0.000000 0.000000 0.000000 1.000000 /end COMPU_METHOD
/* Map (2d) calibration for DDE 'ETCm_NU_DGain_z'. */
/begin CHARACTERISTIC ETCm_NU_DGain_z "(pct) ETC FF Term z-axis" MAP 0x88cd8 RL_ETCM_NU_DGAIN_Z 2.000000 CU_ETCM_NU_DGAIN_Z -1.000000 1.000000
 /begin AXIS_DESCR COM_AXIS NO_INPUT_QUANTITY CU_ETCM_NU_DGAIN_X 20 0.000000 10000.000000 AXIS_PTS_REF APD_ETCM_NU_DGAIN_X /end AXIS_DESCR
 /begin AXIS_DESCR COM_AXIS NO_INPUT_QUANTITY CU_ETCM_NU_DGAIN_Y 20 -50.000000 100.000000 AXIS_PTS_REF APD_ETCM_NU_DGAIN_Y /end AXIS_DESCR
 BYTE_ORDER MSB_FIRST /end CHARACTERISTIC
/begin RECORD_LAYOUT RL_ETCM_NU_DGAIN_Z FNC_VALUES 1 FLOAT32_IEEE COLUMN_DIR DIRECT /end RECORD_LAYOUT
/begin COMPU_METHOD CU_ETCM_NU_DGAIN_Z "Conversion method for ETCm_NU_DGain_z" RAT_FUNC "%10.3" "pct" COEFFS 0.000000 1.000000 0.000000 0.000000 0.000000 1.000000 /end COMPU_METHOD
/begin AXIS_PTS APD_ETCM_NU_DGAIN_X "(gps MAF) ETC FF Term x-axis" 0x88c38 NO_INPUT_QUANTITY RL_ETCM_NU_DGAIN_X 10000.000000 CU_ETCM_NU_DGAIN_X 20 0.0 10000.0 BYTE_ORDER MSB_FIRST /end AXIS_PTS
/begin RECORD_LAYOUT RL_ETCM_NU_DGAIN_X AXIS_PTS_X 1 FLOAT32_IEEE INDEX_INCR DIRECT /end RECORD_LAYOUT
/begin COMPU_METHOD CU_ETCM_NU_DGAIN_X "Conversion method for ETCm_NU_DGain_x" RAT_FUNC "%10.0" "gps" COEFFS 0.000000 1.000000 0.000000 0.000000 0.000000 1.000000 /end COMPU_METHOD
/begin AXIS_PTS APD_ETCM_NU_DGAIN_Y "(deg RelativeThRqst) ETC FF Term y-axis" 0x88c88 NO_INPUT_QUANTITY RL_ETCM_NU_DGAIN_Y 150.000000 CU_ETCM_NU_DGAIN_Y 20 -50.0 100.0 BYTE_ORDER MSB_FIRST /end AXIS_PTS
/begin RECORD_LAYOUT RL_ETCM_NU_DGAIN_Y AXIS_PTS_X 1 FLOAT32_IEEE INDEX_INCR DIRECT /end RECORD_LAYOUT
/begin COMPU_METHOD CU_ETCM_NU_DGAIN_Y "Conversion method for ETCm_NU_DGain_y" RAT_FUNC "%10.2" "deg" COEFFS 0.000000 1.000000 0.000000 0.000000 0.000000 1.000000 /end COMPU_METHOD
/* Map (1d) calibration for DDE 'ETCm_NU_DutyCycle_z'. */
/begin CHARACTERISTIC ETCm_NU_DutyCycle_z "ETC Duty Cycle z-axis" CURVE 0x8935c RL_ETCM_NU_DUTYCYCLE_Z 4.000000 CU_ETCM_NU_DUTYCYCLE_Z -2.000000 2.000000
 /begin AXIS_DESCR COM_AXIS ETC_pct_Effort CU_ETCM_NU_DUTYCYCLE_X 7 -2.000000 2.000000 AXIS_PTS_REF APD_ETCM_NU_DUTYCYCLE_X /end AXIS_DESCR
 BYTE_ORDER MSB_FIRST /end CHARACTERISTIC
/begin RECORD_LAYOUT RL_ETCM_NU_DUTYCYCLE_Z FNC_VALUES 1 FLOAT32_IEEE COLUMN_DIR DIRECT /end RECORD_LAYOUT
/begin COMPU_METHOD CU_ETCM_NU_DUTYCYCLE_Z "Conversion method for ETCm_NU_DutyCycle_z" RAT_FUNC "%10.2" "pct" COEFFS 0.000000 1.000000 0.000000 0.000000 0.000000 1.000000 /end COMPU_METHOD
/begin AXIS_PTS APD_ETCM_NU_DUTYCYCLE_X "ETC Duty Cycle x-axis" 0x89340 ETC_pct_Effort RL_ETCM_NU_DUTYCYCLE_X 4.000000 CU_ETCM_NU_DUTYCYCLE_X 7 -2.0 2.0 BYTE_ORDER MSB_FIRST /end AXIS_PTS
/begin RECORD_LAYOUT RL_ETCM_NU_DUTYCYCLE_X AXIS_PTS_X 1 FLOAT32_IEEE INDEX_INCR DIRECT /end RECORD_LAYOUT
/begin COMPU_METHOD CU_ETCM_NU_DUTYCYCLE_X "Conversion method for ETCm_NU_DutyCycle_x" RAT_FUNC "%10.2" "pct" COEFFS 0.000000 1.000000 0.000000 0.000000 0.000000 1.000000 /end COMPU_METHOD
/* Map (2d) calibration for DDE 'ETCm_NU_FF_z'. */
/begin CHARACTERISTIC ETCm_NU_FF_z "(pct) ETC FF Term z-axis" MAP 0x87d70 RL_ETCM_NU_FF_Z 2.000000 CU_ETCM_NU_FF_Z -1.000000 1.000000
 /begin AXIS_DESCR COM_AXIS AME_gps_FreshMassAirFlow CU_ETCM_NU_FF_X 8 0.000000 10000.000000 AXIS_PTS_REF APD_ETCM_NU_FF_X /end AXIS_DESCR
 /begin AXIS_DESCR COM_AXIS ETC_deg_RelativeThRqst CU_ETCM_NU_FF_Y 8 -50.000000 100.000000 AXIS_PTS_REF APD_ETCM_NU_FF_Y /end AXIS_DESCR
 BYTE_ORDER MSB_FIRST /end CHARACTERISTIC
/begin RECORD_LAYOUT RL_ETCM_NU_FF_Z FNC_VALUES 1 FLOAT32_IEEE COLUMN_DIR DIRECT /end RECORD_LAYOUT
/begin COMPU_METHOD CU_ETCM_NU_FF_Z "Conversion method for ETCm_NU_FF_z" RAT_FUNC "%10.2" "pct" COEFFS 0.000000 1.000000 0.000000 0.000000 0.000000 1.000000 /end COMPU_METHOD
/begin AXIS_PTS APD_ETCM_NU_FF_X "(gps MAF) ETC FF Term x-axis" 0x87d30 AME_gps_FreshMassAirFlow RL_ETCM_NU_FF_X 10000.000000 CU_ETCM_NU_FF_X 8 0.0 10000.0 BYTE_ORDER MSB_FIRST /end AXIS_PTS
/begin RECORD_LAYOUT RL_ETCM_NU_FF_X AXIS_PTS_X 1 FLOAT32_IEEE INDEX_INCR DIRECT /end RECORD_LAYOUT
/begin COMPU_METHOD CU_ETCM_NU_FF_X "Conversion method for ETCm_NU_FF_x" RAT_FUNC "%10.0" "gps" COEFFS 0.000000 1.000000 0.000000 0.000000 0.000000 1.000000 /end COMPU_METHOD
/begin AXIS_PTS APD_ETCM_NU_FF_Y "(deg RelativeThRqst) ETC FF Term y-axis" 0x87d50 ETC_deg_RelativeThRqst RL_ETCM_NU_FF_Y 150.000000 CU_ETCM_NU_FF_Y 8 -50.0 100.0 BYTE_ORDER MSB_FIRST /end AXIS_PTS
/begin RECORD_LAYOUT RL_ETCM_NU_FF_Y AXIS_PTS_X 1 FLOAT32_IEEE INDEX_INCR DIRECT /end RECORD_LAYOUT
/begin COMPU_METHOD CU_ETCM_NU_FF_Y "Conversion method for ETCm_NU_FF_y" RAT_FUNC "%10.2" "deg" COEFFS 0.000000 1.000000 0.000000 0.000000 0.000000 1.000000 /end COMPU_METHOD
/* Map (2d) calibration for DDE 'ETCm_NU_Hyst_z'. */
/begin CHARACTERISTIC ETCm_NU_Hyst_z "(pct) ETC FF Term z-axis" MAP 0x87b28 RL_ETCM_NU_HYST_Z 2.000000 CU_ETCM_NU_HYST_Z -1.000000 1.000000
 /begin AXIS_DESCR COM_AXIS NO_INPUT_QUANTITY CU_ETCM_NU_HYST_X 10 -1000.000000 1000.000000 AXIS_PTS_REF APD_ETCM_NU_HYST_X /end AXIS_DESCR
 /begin AXIS_DESCR COM_AXIS NO_INPUT_QUANTITY CU_ETCM_NU_HYST_Y 13 -50.000000 100.000000 AXIS_PTS_REF APD_ETCM_NU_HYST_Y /end AXIS_DESCR
 BYTE_ORDER MSB_FIRST /end CHARACTERISTIC
/begin RECORD_LAYOUT RL_ETCM_NU_HYST_Z FNC_VALUES 1 FLOAT32_IEEE COLUMN_DIR DIRECT /end RECORD_LAYOUT
/begin COMPU_METHOD CU_ETCM_NU_HYST_Z "Conversion method for ETCm_NU_Hyst_z" RAT_FUNC "%10.3" "pct" COEFFS 0.000000 1.000000 0.000000 0.000000 0.000000 1.000000 /end COMPU_METHOD
/begin AXIS_PTS APD_ETCM_NU_HYST_X "(gps MAF) ETC FF Term x-axis" 0x87acc NO_INPUT_QUANTITY RL_ETCM_NU_HYST_X 2000.000000 CU_ETCM_NU_HYST_X 10 -1000.0 1000.0 BYTE_ORDER MSB_FIRST /end AXIS_PTS
/begin RECORD_LAYOUT RL_ETCM_NU_HYST_X AXIS_PTS_X 1 FLOAT32_IEEE INDEX_INCR DIRECT /end RECORD_LAYOUT
/begin COMPU_METHOD CU_ETCM_NU_HYST_X "Conversion method for ETCm_NU_Hyst_x" RAT_FUNC "%10.0" "gps" COEFFS 0.000000 1.000000 0.000000 0.000000 0.000000 1.000000 /end COMPU_METHOD
/begin AXIS_PTS APD_ETCM_NU_HYST_Y "(deg RelativeThRqst) ETC FF Term y-axis" 0x87af4 NO_INPUT_QUANTITY RL_ETCM_NU_HYST_Y 150.000000 CU_ETCM_NU_HYST_Y 13 -50.0 100.0 BYTE_ORDER MSB_FIRST /end AXIS_PTS
/begin RECORD_LAYOUT RL_ETCM_NU_HYST_Y AXIS_PTS_X 1 FLOAT32_IEEE INDEX_INCR DIRECT /end RECORD_LAYOUT
/begin COMPU_METHOD CU_ETCM_NU_HYST_Y "Conversion method for ETCm_NU_Hyst_y" RAT_FUNC "%10.2" "deg" COEFFS 0.000000 1.000000 0.000000 0.000000 0.000000 1.000000 /end COMPU_METHOD
/* Map (2d) calibration for DDE 'ETCm_NU_IGain_z'. */
/begin CHARACTERISTIC ETCm_NU_IGain_z "(pct) ETC FF Term z-axis" MAP 0x89418 RL_ETCM_NU_IGAIN_Z 11.000000 CU_ETCM_NU_IGAIN_Z -1.000000 10.000000
 /begin AXIS_DESCR COM_AXIS NO_INPUT_QUANTITY CU_ETCM_NU_IGAIN_X 20 0.000000 10000.000000 AXIS_PTS_REF APD_ETCM_NU_IGAIN_X /end AXIS_DESCR
 /begin AXIS_DESCR COM_AXIS NO_INPUT_QUANTITY CU_ETCM_NU_IGAIN_Y 20 -50.000000 100.000000 AXIS_PTS_REF APD_ETCM_NU_IGAIN_Y /end AXIS_DESCR
 BYTE_ORDER MSB_FIRST /end CHARACTERISTIC
/begin RECORD_LAYOUT RL_ETCM_NU_IGAIN_Z FNC_VALUES 1 FLOAT32_IEEE COLUMN_DIR DIRECT /end RECORD_LAYOUT
/begin COMPU_METHOD CU_ETCM_NU_IGAIN_Z "Conversion method for ETCm_NU_IGain_z" RAT_FUNC "%10.2" "pct" COEFFS 0.000000 1.000000 0.000000 0.000000 0.000000 1.000000 /end COMPU_METHOD
/begin AXIS_PTS APD_ETCM_NU_IGAIN_X "(gps MAF) ETC FF Term x-axis" 0x89378 NO_INPUT_QUANTITY RL_ETCM_NU_IGAIN_X 10000.000000 CU_ETCM_NU_IGAIN_X 20 0.0 10000.0 BYTE_ORDER MSB_FIRST /end AXIS_PTS
/begin RECORD_LAYOUT RL_ETCM_NU_IGAIN_X AXIS_PTS_X 1 FLOAT32_IEEE INDEX_INCR DIRECT /end RECORD_LAYOUT
/begin COMPU_METHOD CU_ETCM_NU_IGAIN_X "Conversion method for ETCm_NU_IGain_x" RAT_FUNC "%10.0" "gps" COEFFS 0.000000 1.000000 0.000000 0.000000 0.000000 1.000000 /end COMPU_METHOD
/begin AXIS_PTS APD_ETCM_NU_IGAIN_Y "(deg RelativeThRqst) ETC FF Term y-axis" 0x893c8 NO_INPUT_QUANTITY RL_ETCM_NU_IGAIN_Y 150.000000 CU_ETCM_NU_IGAIN_Y 20 -50.0 100.0 BYTE_ORDER MSB_FIRST /end AXIS_PTS
/begin RECORD_LAYOUT RL_ETCM_NU_IGAIN_Y AXIS_PTS_X 1 FLOAT32_IEEE INDEX_INCR DIRECT /end RECORD_LAYOUT
/begin COMPU_METHOD CU_ETCM_NU_IGAIN_Y "Conversion method for ETCm_NU_IGain_y" RAT_FUNC "%10.2" "deg" COEFFS 0.000000 1.000000 0.000000 0.000000 0.000000 1.000000 /end COMPU_METHOD
/* Map (2d) calibration for DDE 'ETCm_NU_IRest_z'. */
/begin CHARACTERISTIC ETCm_NU_IRest_z "(pct) ETC FF Term z-axis" MAP 0x89af8 RL_ETCM_NU_IREST_Z 11.000000 CU_ETCM_NU_IREST_Z -1.000000 10.000000
 /begin AXIS_DESCR COM_AXIS NO_INPUT_QUANTITY CU_ETCM_NU_IREST_X 20 0.000000 10000.000000 AXIS_PTS_REF APD_ETCM_NU_IREST_X /end AXIS_DESCR
 /begin AXIS_DESCR COM_AXIS NO_INPUT_QUANTITY CU_ETCM_NU_IREST_Y 20 -50.000000 100.000000 AXIS_PTS_REF APD_ETCM_NU_IREST_Y /end AXIS_DESCR
 BYTE_ORDER MSB_FIRST /end CHARACTERISTIC
/begin RECORD_LAYOUT RL_ETCM_NU_IREST_Z FNC_VALUES 1 FLOAT32_IEEE COLUMN_DIR DIRECT /end RECORD_LAYOUT
/begin COMPU_METHOD CU_ETCM_NU_IREST_Z "Conversion method for ETCm_NU_IRest_z" RAT_FUNC "%10.2" "pct" COEFFS 0.000000 1.000000 0.000000 0.000000 0.000000 1.000000 /end COMPU_METHOD
/begin AXIS_PTS APD_ETCM_NU_IREST_X "(gps MAF) ETC FF Term x-axis" 0x89a58 NO_INPUT_QUANTITY RL_ETCM_NU_IREST_X 10000.000000 CU_ETCM_NU_IREST_X 20 0.0 10000.0 BYTE_ORDER MSB_FIRST /end AXIS_PTS
/begin RECORD_LAYOUT RL_ETCM_NU_IREST_X AXIS_PTS_X 1 FLOAT32_IEEE INDEX_INCR DIRECT /end RECORD_LAYOUT
/begin COMPU_METHOD CU_ETCM_NU_IREST_X "Conversion method for ETCm_NU_IRest_x" RAT_FUNC "%10.0" "gps" COEFFS 0.000000 1.000000 0.000000 0.000000 0.000000 1.000000 /end COMPU_METHOD
/begin AXIS_PTS APD_ETCM_NU_IREST_Y "(deg RelativeThRqst) ETC FF Term y-axis" 0x89aa8 NO_INPUT_QUANTITY RL_ETCM_NU_IREST_Y 150.000000 CU_ETCM_NU_IREST_Y 20 -50.0 100.0 BYTE_ORDER MSB_FIRST /end AXIS_PTS
/begin RECORD_LAYOUT RL_ETCM_NU_IREST_Y AXIS_PTS_X 1 FLOAT32_IEEE INDEX_INCR DIRECT /end RECORD_LAYOUT
/begin COMPU_METHOD CU_ETCM_NU_IREST_Y "Conversion method for ETCm_NU_IRest_y" RAT_FUNC "%10.2" "deg" COEFFS 0.000000 1.000000 0.000000 0.000000 0.000000 1.000000 /end COMPU_METHOD
/* Map (2d) calibration for DDE 'ETCm_NU_PGain_z'. */
/begin CHARACTERISTIC ETCm_NU_PGain_z "(pct) ETC FF Term z-axis" MAP 0x87f10 RL_ETCM_NU_PGAIN_Z 2.000000 CU_ETCM_NU_PGAIN_Z -1.000000 1.000000
 /begin AXIS_DESCR COM_AXIS NO_INPUT_QUANTITY CU_ETCM_NU_PGAIN_X 20 0.000000 10000.000000 AXIS_PTS_REF APD_ETCM_NU_PGAIN_X /end AXIS_DESCR
 /begin AXIS_DESCR COM_AXIS NO_INPUT_QUANTITY CU_ETCM_NU_PGAIN_Y 20 -50.000000 100.000000 AXIS_PTS_REF APD_ETCM_NU_PGAIN_Y /end AXIS_DESCR
 BYTE_ORDER MSB_FIRST /end CHARACTERISTIC
/begin RECORD_LAYOUT RL_ETCM_NU_PGAIN_Z FNC_VALUES 1 FLOAT32_IEEE COLUMN_DIR DIRECT /end RECORD_LAYOUT
/begin COMPU_METHOD CU_ETCM_NU_PGAIN_Z "Conversion method for ETCm_NU_PGain_z" RAT_FUNC "%10.2" "pct" COEFFS 0.000000 1.000000 0.000000 0.000000 0.000000 1.000000 /end COMPU_METHOD
/begin AXIS_PTS APD_ETCM_NU_PGAIN_X "(gps MAF) ETC FF Term x-axis" 0x87e70 NO_INPUT_QUANTITY RL_ETCM_NU_PGAIN_X 10000.000000 CU_ETCM_NU_PGAIN_X 20 0.0 10000.0 BYTE_ORDER MSB_FIRST /end AXIS_PTS
/begin RECORD_LAYOUT RL_ETCM_NU_PGAIN_X AXIS_PTS_X 1 FLOAT32_IEEE INDEX_INCR DIRECT /end RECORD_LAYOUT
/begin COMPU_METHOD CU_ETCM_NU_PGAIN_X "Conversion method for ETCm_NU_PGain_x" RAT_FUNC "%10.0" "gps" COEFFS 0.000000 1.000000 0.000000 0.000000 0.000000 1.000000 /end COMPU_METHOD
/begin AXIS_PTS APD_ETCM_NU_PGAIN_Y "(deg RelativeThRqst) ETC FF Term y-axis" 0x87ec0 NO_INPUT_QUANTITY RL_ETCM_NU_PGAIN_Y 150.000000 CU_ETCM_NU_PGAIN_Y 20 -50.0 100.0 BYTE_ORDER MSB_FIRST /end AXIS_PTS
/begin RECORD_LAYOUT RL_ETCM_NU_PGAIN_Y AXIS_PTS_X 1 FLOAT32_IEEE INDEX_INCR DIRECT /end RECORD_LAYOUT
/begin COMPU_METHOD CU_ETCM_NU_PGAIN_Y "Conversion method for ETCm_NU_PGain_y" RAT_FUNC "%10.2" "deg" COEFFS 0.000000 1.000000 0.000000 0.000000 0.000000 1.000000 /end COMPU_METHOD
/* Map (2d) calibration for DDE 'ETCm_NU_PRest_z'. */
/begin CHARACTERISTIC ETCm_NU_PRest_z "(pct) ETC FF Term z-axis" MAP 0x885f0 RL_ETCM_NU_PREST_Z 2.000000 CU_ETCM_NU_PREST_Z -1.000000 1.000000
 /begin AXIS_DESCR COM_AXIS NO_INPUT_QUANTITY CU_ETCM_NU_PREST_X 20 0.000000 10000.000000 AXIS_PTS_REF APD_ETCM_NU_PREST_X /end AXIS_DESCR
 /begin AXIS_DESCR COM_AXIS NO_INPUT_QUANTITY CU_ETCM_NU_PREST_Y 20 -50.000000 100.000000 AXIS_PTS_REF APD_ETCM_NU_PREST_Y /end AXIS_DESCR
 BYTE_ORDER MSB_FIRST /end CHARACTERISTIC
/begin RECORD_LAYOUT RL_ETCM_NU_PREST_Z FNC_VALUES 1 FLOAT32_IEEE COLUMN_DIR DIRECT /end RECORD_LAYOUT
/begin COMPU_METHOD CU_ETCM_NU_PREST_Z "Conversion method for ETCm_NU_PRest_z" RAT_FUNC "%10.2" "pct" COEFFS 0.000000 1.000000 0.000000 0.000000 0.000000 1.000000 /end COMPU_METHOD
/begin AXIS_PTS APD_ETCM_NU_PREST_X "(gps MAF) ETC FF Term x-axis" 0x88550 NO_INPUT_QUANTITY RL_ETCM_NU_PREST_X 10000.000000 CU_ETCM_NU_PREST_X 20 0.0 10000.0 BYTE_ORDER MSB_FIRST /end AXIS_PTS
/begin RECORD_LAYOUT RL_ETCM_NU_PREST_X AXIS_PTS_X 1 FLOAT32_IEEE INDEX_INCR DIRECT /end RECORD_LAYOUT
/begin COMPU_METHOD CU_ETCM_NU_PREST_X "Conversion method for ETCm_NU_PRest_x" RAT_FUNC "%10.0" "gps" COEFFS 0.000000 1.000000 0.000000 0.000000 0.000000 1.000000 /end COMPU_METHOD
/begin AXIS_PTS APD_ETCM_NU_PREST_Y "(deg RelativeThRqst) ETC FF Term y-axis" 0x885a0 NO_INPUT_QUANTITY RL_ETCM_NU_PREST_Y 150.000000 CU_ETCM_NU_PREST_Y 20 -50.0 100.0 BYTE_ORDER MSB_FIRST /end AXIS_PTS
/begin RECORD_LAYOUT RL_ETCM_NU_PREST_Y AXIS_PTS_X 1 FLOAT32_IEEE INDEX_INCR DIRECT /end RECORD_LAYOUT
/begin COMPU_METHOD CU_ETCM_NU_PREST_Y "Conversion method for ETCm_NU_PRest_y" RAT_FUNC "%10.2" "deg" COEFFS 0.000000 1.000000 0.000000 0.000000 0.000000 1.000000 /end COMPU_METHOD
/* Map (1d) calibration for DDE 'ETCm_NU_VbCorr_z'. */
/begin CHARACTERISTIC ETCm_NU_VbCorr_z "ETC Duty Cycle z-axis" CURVE 0x87944 RL_ETCM_NU_VBCORR_Z 2.000000 CU_ETCM_NU_VBCORR_Z 0.000000 2.000000
 /begin AXIS_DESCR COM_AXIS NO_INPUT_QUANTITY CU_ETCM_NU_VBCORR_X 21 8.000000 33.000000 AXIS_PTS_REF APD_ETCM_NU_VBCORR_X /end AXIS_DESCR
 BYTE_ORDER MSB_FIRST /end CHARACTERISTIC
/begin RECORD_LAYOUT RL_ETCM_NU_VBCORR_Z FNC_VALUES 1 FLOAT32_IEEE COLUMN_DIR DIRECT /end RECORD_LAYOUT
/begin COMPU_METHOD CU_ETCM_NU_VBCORR_Z "Conversion method for ETCm_NU_VbCorr_z" RAT_FUNC "%10.3" "NU" COEFFS 0.000000 1.000000 0.000000 0.000000 0.000000 1.000000 /end COMPU_METHOD
/begin AXIS_PTS APD_ETCM_NU_VBCORR_X "ETC Duty Cycle x-axis" 0x878f0 NO_INPUT_QUANTITY RL_ETCM_NU_VBCORR_X 25.000000 CU_ETCM_NU_VBCORR_X 21 8.0 33.0 BYTE_ORDER MSB_FIRST /end AXIS_PTS
/begin RECORD_LAYOUT RL_ETCM_NU_VBCORR_X AXIS_PTS_X 1 FLOAT32_IEEE INDEX_INCR DIRECT /end RECORD_LAYOUT
/begin COMPU_METHOD CU_ETCM_NU_VBCORR_X "Conversion method for ETCm_NU_VbCorr_x" RAT_FUNC "%10.2" "NU" COEFFS 0.000000 1.000000 0.000000 0.000000 0.000000 1.000000 /end COMPU_METHOD
/* Map (1d) calibration for DDE 'ETCm_deg_CrankAmbTemp_z'. */
/begin CHARACTERISTIC ETCm_deg_CrankAmbTemp_z "Throttle position setpoint during cranking when CrankingPos is enabled" CURVE 0x87a64 RL_ETCM_DEG_CRANKAMBTEMP_Z 90.000000 CU_ETCM_DEG_CRANKAMBTEMP_Z 0.000000 90.000000
 /begin AXIS_DESCR COM_AXIS NO_INPUT_QUANTITY CU_ETCM_DEG_CRANKAMBTEMP_X 9 -40.000000 100.000000 AXIS_PTS_REF APD_ETCM_DEG_CRANKAMBTEMP_X /end AXIS_DESCR
 BYTE_ORDER MSB_FIRST /end CHARACTERISTIC
/begin RECORD_LAYOUT RL_ETCM_DEG_CRANKAMBTEMP_Z FNC_VALUES 1 FLOAT32_IEEE COLUMN_DIR DIRECT /end RECORD_LAYOUT
/begin COMPU_METHOD CU_ETCM_DEG_CRANKAMBTEMP_Z "Conversion method for ETCm_deg_CrankAmbTemp_z" RAT_FUNC "%10.1" "deg" COEFFS 0.000000 1.000000 0.000000 0.000000 0.000000 1.000000 /end COMPU_METHOD
/begin AXIS_PTS APD_ETCM_DEG_CRANKAMBTEMP_X "ETC Ambient Temperature" 0x87a40 NO_INPUT_QUANTITY RL_ETCM_DEG_CRANKAMBTEMP_X 140.000000 CU_ETCM_DEG_CRANKAMBTEMP_X 9 -40.0 100.0 BYTE_ORDER MSB_FIRST /end AXIS_PTS
/begin RECORD_LAYOUT RL_ETCM_DEG_CRANKAMBTEMP_X AXIS_PTS_X 1 FLOAT32_IEEE INDEX_INCR DIRECT /end RECORD_LAYOUT
/begin COMPU_METHOD CU_ETCM_DEG_CRANKAMBTEMP_X "Conversion method for ETCm_deg_CrankAmbTemp_x" RAT_FUNC "%10.1" "deg" COEFFS 0.000000 1.000000 0.000000 0.000000 0.000000 1.000000 /end COMPU_METHOD
/* Scalar calibration for DDE 'FCAc_L_AcumFuelConsumption'. */
/begin CHARACTERISTIC FCAc_L_AcumFuelConsumption "Full pedal learn default value for fuel consumption calculation" VALUE 0x91d00 RL_FCAC_L_ACUMFUELCONSUMPTION 999999.000000 CU_FCAC_L_ACUMFUELCONSUMPTION 0.000000 999999.000000 BYTE_ORDER MSB_FIRST /end CHARACTERISTIC
/begin RECORD_LAYOUT RL_FCAC_L_ACUMFUELCONSUMPTION FNC_VALUES 1 FLOAT32_IEEE COLUMN_DIR DIRECT /end RECORD_LAYOUT
/begin COMPU_METHOD CU_FCAC_L_ACUMFUELCONSUMPTION "Conversion method for FCAc_L_AcumFuelConsumption" RAT_FUNC "%10.1" "L" COEFFS 0.000000 1.000000 0.000000 0.000000 0.000000 1.000000 /end COMPU_METHOD
/* Scalar calibration for DDE 'FCAc_b_ResetFuelAcum'. */
/begin CHARACTERISTIC FCAc_b_ResetFuelAcum "Reset learned values to defaults" VALUE 0x8bf72 RL_FCAC_B_RESETFUELACUM 1.000000 CU_FCAC_B_RESETFUELACUM 0.000000 1.000000 BYTE_ORDER MSB_FIRST /end CHARACTERISTIC
/begin RECORD_LAYOUT RL_FCAC_B_RESETFUELACUM FNC_VALUES 1 UBYTE COLUMN_DIR DIRECT /end RECORD_LAYOUT
/begin COMPU_METHOD CU_FCAC_B_RESETFUELACUM "Conversion method for FCAc_b_ResetFuelAcum" RAT_FUNC "%10.0" "b" COEFFS 0.000000 1.000000 0.000000 0.000000 0.000000 1.000000 /end COMPU_METHOD
/* Scalar calibration for DDE 'FCAc_b_ResetKmAcum'. */
/begin CHARACTERISTIC FCAc_b_ResetKmAcum "Reset learned values to defaults" VALUE 0x8bf71 RL_FCAC_B_RESETKMACUM 1.000000 CU_FCAC_B_RESETKMACUM 0.000000 1.000000 BYTE_ORDER MSB_FIRST /end CHARACTERISTIC
/begin RECORD_LAYOUT RL_FCAC_B_RESETKMACUM FNC_VALUES 1 UBYTE COLUMN_DIR DIRECT /end RECORD_LAYOUT
/begin COMPU_METHOD CU_FCAC_B_RESETKMACUM "Conversion method for FCAc_b_ResetKmAcum" RAT_FUNC "%10.0" "b" COEFFS 0.000000 1.000000 0.000000 0.000000 0.000000 1.000000 /end COMPU_METHOD
/* Scalar calibration for DDE 'FCAc_km_AcumDistance'. */
/begin CHARACTERISTIC FCAc_km_AcumDistance "Distance driven learn default value for fuel consumption calculation" VALUE 0x91cfc RL_FCAC_KM_ACUMDISTANCE 999999.000000 CU_FCAC_KM_ACUMDISTANCE 0.000000 999999.000000 BYTE_ORDER MSB_FIRST /end CHARACTERISTIC
/begin RECORD_LAYOUT RL_FCAC_KM_ACUMDISTANCE FNC_VALUES 1 FLOAT32_IEEE COLUMN_DIR DIRECT /end RECORD_LAYOUT
/begin COMPU_METHOD CU_FCAC_KM_ACUMDISTANCE "Conversion method for FCAc_km_AcumDistance" RAT_FUNC "%10.0" "km" COEFFS 0.000000 1.000000 0.000000 0.000000 0.000000 1.000000 /end COMPU_METHOD
/* Scalar calibration for DDE 'FCAc_lpk_AverageFuelConsumption'. */
/begin CHARACTERISTIC FCAc_lpk_AverageFuelConsumption "Overide value of Fuel consumption in Liters per 100km" VALUE 0x8be48 RL_FCAC_LPK_AVERAGEFUELCONSUMP0 0.000000 CU_FCAC_LPK_AVERAGEFUELCONSUMP0 0.000000 0.000000 BYTE_ORDER MSB_FIRST /end CHARACTERISTIC
/begin RECORD_LAYOUT RL_FCAC_LPK_AVERAGEFUELCONSUMP0 FNC_VALUES 1 FLOAT32_IEEE COLUMN_DIR DIRECT /end RECORD_LAYOUT
/begin COMPU_METHOD CU_FCAC_LPK_AVERAGEFUELCONSUMP0 "Conversion method for FCAc_lpk_AverageFuelConsumption" RAT_FUNC "%10.1" "lpk" COEFFS 0.000000 1.000000 0.000000 0.000000 0.000000 1.000000 /end COMPU_METHOD
/* Scalar calibration for DDE 'FCAc_o_AverageFuelConsumption'. */
/begin CHARACTERISTIC FCAc_o_AverageFuelConsumption "Override flag" VALUE 0x8be44 RL_FCAC_O_AVERAGEFUELCONSUMPTI0 1.000000 CU_FCAC_O_AVERAGEFUELCONSUMPTI0 0.000000 1.000000 BYTE_ORDER MSB_FIRST /end CHARACTERISTIC
/begin RECORD_LAYOUT RL_FCAC_O_AVERAGEFUELCONSUMPTI0 FNC_VALUES 1 UBYTE COLUMN_DIR DIRECT /end RECORD_LAYOUT
/begin COMPU_METHOD CU_FCAC_O_AVERAGEFUELCONSUMPTI0 "Conversion method for FCAc_o_AverageFuelConsumption" RAT_FUNC "%10.0" "o" COEFFS 0.000000 1.000000 0.000000 0.000000 0.000000 1.000000 /end COMPU_METHOD
/* Scalar calibration for DDE 'FCAca_L_AcumFuelConsumption'. */
/begin CHARACTERISTIC FCAca_L_AcumFuelConsumption "Full pedal learn default value for fuel consumption calculation" VALUE 0x4000f88c RL_FCACA_L_ACUMFUELCONSUMPTION 999999.000000 CU_FCACA_L_ACUMFUELCONSUMPTION 0.000000 999999.000000 BYTE_ORDER MSB_FIRST /end CHARACTERISTIC
/begin RECORD_LAYOUT RL_FCACA_L_ACUMFUELCONSUMPTION FNC_VALUES 1 FLOAT32_IEEE COLUMN_DIR DIRECT /end RECORD_LAYOUT
/begin COMPU_METHOD CU_FCACA_L_ACUMFUELCONSUMPTION "Conversion method for FCAca_L_AcumFuelConsumption" RAT_FUNC "%10.1" "L" COEFFS 0.000000 1.000000 0.000000 0.000000 0.000000 1.000000 /end COMPU_METHOD
/* Scalar calibration for DDE 'FCAca_km_AcumDistance'. */
/begin CHARACTERISTIC FCAca_km_AcumDistance "Distance driven learn default value for fuel consumption calculation" VALUE 0x4000f888 RL_FCACA_KM_ACUMDISTANCE 999999.000000 CU_FCACA_KM_ACUMDISTANCE 0.000000 999999.000000 BYTE_ORDER MSB_FIRST /end CHARACTERISTIC
/begin RECORD_LAYOUT RL_FCACA_KM_ACUMDISTANCE FNC_VALUES 1 FLOAT32_IEEE COLUMN_DIR DIRECT /end RECORD_LAYOUT
/begin COMPU_METHOD CU_FCACA_KM_ACUMDISTANCE "Conversion method for FCAca_km_AcumDistance" RAT_FUNC "%10.0" "km" COEFFS 0.000000 1.000000 0.000000 0.000000 0.000000 1.000000 /end COMPU_METHOD
/* Scalar calibration for DDE 'FMGc_b_ForceFltReset'. */
/begin CHARACTERISTIC FMGc_b_ForceFltReset "Manual reset-all-faults flag" VALUE 0x8d2a2 RL_FMGC_B_FORCEFLTRESET 1.000000 CU_FMGC_B_FORCEFLTRESET 0.000000 1.000000 BYTE_ORDER MSB_FIRST /end CHARACTERISTIC
/begin RECORD_LAYOUT RL_FMGC_B_FORCEFLTRESET FNC_VALUES 1 UBYTE COLUMN_DIR DIRECT /end RECORD_LAYOUT
/begin COMPU_METHOD CU_FMGC_B_FORCEFLTRESET "Conversion method for FMGc_b_ForceFltReset" RAT_FUNC "%10.0" "b" COEFFS 0.000000 1.000000 0.000000 0.000000 0.000000 1.000000 /end COMPU_METHOD
/* Scalar calibration for DDE 'FMGc_e_FltReset'. */
/begin CHARACTERISTIC FMGc_e_FltReset "Override value" VALUE 0x8d2a1 RL_FMGC_E_FLTRESET 255.000000 CU_FMGC_E_FLTRESET 0.000000 255.000000 BYTE_ORDER MSB_FIRST /end CHARACTERISTIC
/begin RECORD_LAYOUT RL_FMGC_E_FLTRESET FNC_VALUES 1 UBYTE COLUMN_DIR DIRECT /end RECORD_LAYOUT
/begin COMPU_METHOD CU_FMGC_E_FLTRESET "Conversion method for FMGc_e_FltReset" RAT_FUNC "%10.0" "e" COEFFS 0.000000 1.000000 0.000000 0.000000 0.000000 1.000000 /end COMPU_METHOD
/* Scalar calibration for DDE 'FMGc_o_FltReset'. */
/begin CHARACTERISTIC FMGc_o_FltReset "Override flag" VALUE 0x8d2a0 RL_FMGC_O_FLTRESET 1.000000 CU_FMGC_O_FLTRESET 0.000000 1.000000 BYTE_ORDER MSB_FIRST /end CHARACTERISTIC
/begin RECORD_LAYOUT RL_FMGC_O_FLTRESET FNC_VALUES 1 UBYTE COLUMN_DIR DIRECT /end RECORD_LAYOUT
/begin COMPU_METHOD CU_FMGC_O_FLTRESET "Conversion method for FMGc_o_FltReset" RAT_FUNC "%10.0" "o" COEFFS 0.000000 1.000000 0.000000 0.000000 0.000000 1.000000 /end COMPU_METHOD
/* Map (1d) calibration for DDE 'FRPm_NU_DutyCycle_z'. */
/begin CHARACTERISTIC FRPm_NU_DutyCycle_z "FRP Duty Cycle z-axis" CURVE 0x8d04c RL_FRPM_NU_DUTYCYCLE_Z 4.000000 CU_FRPM_NU_DUTYCYCLE_Z -2.000000 2.000000
 /begin AXIS_DESCR COM_AXIS NO_INPUT_QUANTITY CU_FRPM_NU_DUTYCYCLE_X 7 -2.000000 2.000000 AXIS_PTS_REF APD_FRPM_NU_DUTYCYCLE_X /end AXIS_DESCR
 BYTE_ORDER MSB_FIRST /end CHARACTERISTIC
/begin RECORD_LAYOUT RL_FRPM_NU_DUTYCYCLE_Z FNC_VALUES 1 FLOAT32_IEEE COLUMN_DIR DIRECT /end RECORD_LAYOUT
/begin COMPU_METHOD CU_FRPM_NU_DUTYCYCLE_Z "Conversion method for FRPm_NU_DutyCycle_z" RAT_FUNC "%10.2" "pct" COEFFS 0.000000 1.000000 0.000000 0.000000 0.000000 1.000000 /end COMPU_METHOD
/begin AXIS_PTS APD_FRPM_NU_DUTYCYCLE_X "FRP Duty Cycle x-axis" 0x8d030 NO_INPUT_QUANTITY RL_FRPM_NU_DUTYCYCLE_X 4.000000 CU_FRPM_NU_DUTYCYCLE_X 7 -2.0 2.0 BYTE_ORDER MSB_FIRST /end AXIS_PTS
/begin RECORD_LAYOUT RL_FRPM_NU_DUTYCYCLE_X AXIS_PTS_X 1 FLOAT32_IEEE INDEX_INCR DIRECT /end RECORD_LAYOUT
/begin COMPU_METHOD CU_FRPM_NU_DUTYCYCLE_X "Conversion method for FRPm_NU_DutyCycle_x" RAT_FUNC "%10.2" "pct" COEFFS 0.000000 1.000000 0.000000 0.000000 0.000000 1.000000 /end COMPU_METHOD
/* Scalar calibration for DDE 'HHTc_o_EGO11_HeaterDuty'. */
/begin CHARACTERISTIC HHTc_o_EGO11_HeaterDuty "Override flag" VALUE 0x8d088 RL_HHTC_O_EGO11_HEATERDUTY 1.000000 CU_HHTC_O_EGO11_HEATERDUTY 0.000000 1.000000 BYTE_ORDER MSB_FIRST /end CHARACTERISTIC
/begin RECORD_LAYOUT RL_HHTC_O_EGO11_HEATERDUTY FNC_VALUES 1 UBYTE COLUMN_DIR DIRECT /end RECORD_LAYOUT
/begin COMPU_METHOD CU_HHTC_O_EGO11_HEATERDUTY "Conversion method for HHTc_o_EGO11_HeaterDuty" RAT_FUNC "%10.0" "o" COEFFS 0.000000 1.000000 0.000000 0.000000 0.000000 1.000000 /end COMPU_METHOD
/* Scalar calibration for DDE 'HHTc_o_EGO12_HeaterDuty'. */
/begin CHARACTERISTIC HHTc_o_EGO12_HeaterDuty "Override flag" VALUE 0x8d09a RL_HHTC_O_EGO12_HEATERDUTY 1.000000 CU_HHTC_O_EGO12_HEATERDUTY 0.000000 1.000000 BYTE_ORDER MSB_FIRST /end CHARACTERISTIC
/begin RECORD_LAYOUT RL_HHTC_O_EGO12_HEATERDUTY FNC_VALUES 1 UBYTE COLUMN_DIR DIRECT /end RECORD_LAYOUT
/begin COMPU_METHOD CU_HHTC_O_EGO12_HEATERDUTY "Conversion method for HHTc_o_EGO12_HeaterDuty" RAT_FUNC "%10.0" "o" COEFFS 0.000000 1.000000 0.000000 0.000000 0.000000 1.000000 /end COMPU_METHOD
/* Scalar calibration for DDE 'HHTc_o_EGO21_HeaterDuty'. */
/begin CHARACTERISTIC HHTc_o_EGO21_HeaterDuty "Override flag" VALUE 0x8d090 RL_HHTC_O_EGO21_HEATERDUTY 1.000000 CU_HHTC_O_EGO21_HEATERDUTY 0.000000 1.000000 BYTE_ORDER MSB_FIRST /end CHARACTERISTIC
/begin RECORD_LAYOUT RL_HHTC_O_EGO21_HEATERDUTY FNC_VALUES 1 UBYTE COLUMN_DIR DIRECT /end RECORD_LAYOUT
/begin COMPU_METHOD CU_HHTC_O_EGO21_HEATERDUTY "Conversion method for HHTc_o_EGO21_HeaterDuty" RAT_FUNC "%10.0" "o" COEFFS 0.000000 1.000000 0.000000 0.000000 0.000000 1.000000 /end COMPU_METHOD
/* Scalar calibration for DDE 'HHTc_o_EGO22_HeaterDuty'. */
/begin CHARACTERISTIC HHTc_o_EGO22_HeaterDuty "Override flag" VALUE 0x8d0a0 RL_HHTC_O_EGO22_HEATERDUTY 1.000000 CU_HHTC_O_EGO22_HEATERDUTY 0.000000 1.000000 BYTE_ORDER MSB_FIRST /end CHARACTERISTIC
/begin RECORD_LAYOUT RL_HHTC_O_EGO22_HEATERDUTY FNC_VALUES 1 UBYTE COLUMN_DIR DIRECT /end RECORD_LAYOUT
/begin COMPU_METHOD CU_HHTC_O_EGO22_HEATERDUTY "Conversion method for HHTc_o_EGO22_HeaterDuty" RAT_FUNC "%10.0" "o" COEFFS 0.000000 1.000000 0.000000 0.000000 0.000000 1.000000 /end COMPU_METHOD
/* Scalar calibration for DDE 'HHTc_pct_EGO11_HeaterDuty'. */
/begin CHARACTERISTIC HHTc_pct_EGO11_HeaterDuty "Override value" VALUE 0x8d08c RL_HHTC_PCT_EGO11_HEATERDUTY 1.000000 CU_HHTC_PCT_EGO11_HEATERDUTY 0.000000 1.000000 BYTE_ORDER MSB_FIRST /end CHARACTERISTIC
/begin RECORD_LAYOUT RL_HHTC_PCT_EGO11_HEATERDUTY FNC_VALUES 1 FLOAT32_IEEE COLUMN_DIR DIRECT /end RECORD_LAYOUT
/begin COMPU_METHOD CU_HHTC_PCT_EGO11_HEATERDUTY "Conversion method for HHTc_pct_EGO11_HeaterDuty" RAT_FUNC "%10.2" "pct" COEFFS 0.000000 1.000000 0.000000 0.000000 0.000000 1.000000 /end COMPU_METHOD
/* Scalar calibration for DDE 'HHTc_pct_EGO12_HeaterDuty'. */
/begin CHARACTERISTIC HHTc_pct_EGO12_HeaterDuty "Override value" VALUE 0x8d09c RL_HHTC_PCT_EGO12_HEATERDUTY 1.000000 CU_HHTC_PCT_EGO12_HEATERDUTY 0.000000 1.000000 BYTE_ORDER MSB_FIRST /end CHARACTERISTIC
/begin RECORD_LAYOUT RL_HHTC_PCT_EGO12_HEATERDUTY FNC_VALUES 1 FLOAT32_IEEE COLUMN_DIR DIRECT /end RECORD_LAYOUT
/begin COMPU_METHOD CU_HHTC_PCT_EGO12_HEATERDUTY "Conversion method for HHTc_pct_EGO12_HeaterDuty" RAT_FUNC "%10.2" "pct" COEFFS 0.000000 1.000000 0.000000 0.000000 0.000000 1.000000 /end COMPU_METHOD
/* Scalar calibration for DDE 'HHTc_pct_EGO21_HeaterDuty'. */
/begin CHARACTERISTIC HHTc_pct_EGO21_HeaterDuty "Override value" VALUE 0x8d094 RL_HHTC_PCT_EGO21_HEATERDUTY 1.000000 CU_HHTC_PCT_EGO21_HEATERDUTY 0.000000 1.000000 BYTE_ORDER MSB_FIRST /end CHARACTERISTIC
/begin RECORD_LAYOUT RL_HHTC_PCT_EGO21_HEATERDUTY FNC_VALUES 1 FLOAT32_IEEE COLUMN_DIR DIRECT /end RECORD_LAYOUT
/begin COMPU_METHOD CU_HHTC_PCT_EGO21_HEATERDUTY "Conversion method for HHTc_pct_EGO21_HeaterDuty" RAT_FUNC "%10.2" "pct" COEFFS 0.000000 1.000000 0.000000 0.000000 0.000000 1.000000 /end COMPU_METHOD
/* Scalar calibration for DDE 'HHTc_pct_EGO22_HeaterDuty'. */
/begin CHARACTERISTIC HHTc_pct_EGO22_HeaterDuty "Override value" VALUE 0x8d0a4 RL_HHTC_PCT_EGO22_HEATERDUTY 1.000000 CU_HHTC_PCT_EGO22_HEATERDUTY 0.000000 1.000000 BYTE_ORDER MSB_FIRST /end CHARACTERISTIC
/begin RECORD_LAYOUT RL_HHTC_PCT_EGO22_HEATERDUTY FNC_VALUES 1 FLOAT32_IEEE COLUMN_DIR DIRECT /end RECORD_LAYOUT
/begin COMPU_METHOD CU_HHTC_PCT_EGO22_HEATERDUTY "Conversion method for HHTc_pct_EGO22_HeaterDuty" RAT_FUNC "%10.2" "pct" COEFFS 0.000000 1.000000 0.000000 0.000000 0.000000 1.000000 /end COMPU_METHOD
/* Scalar calibration for DDE 'HHTc_pct_RunningDuty'. */
/begin CHARACTERISTIC HHTc_pct_RunningDuty "Contant heater command during engine-running" VALUE 0x8d078 RL_HHTC_PCT_RUNNINGDUTY 0.950000 CU_HHTC_PCT_RUNNINGDUTY 0.000000 0.950000 BYTE_ORDER MSB_FIRST /end CHARACTERISTIC
/begin RECORD_LAYOUT RL_HHTC_PCT_RUNNINGDUTY FNC_VALUES 1 FLOAT32_IEEE COLUMN_DIR DIRECT /end RECORD_LAYOUT
/begin COMPU_METHOD CU_HHTC_PCT_RUNNINGDUTY "Conversion method for HHTc_pct_RunningDuty" RAT_FUNC "%10.2" "pct" COEFFS 0.000000 1.000000 0.000000 0.000000 0.000000 1.000000 /end COMPU_METHOD
/* Scalar calibration for DDE 'HHTc_pct_WarmupDuty'. */
/begin CHARACTERISTIC HHTc_pct_WarmupDuty "Heater output during warmup period" VALUE 0x8d07c RL_HHTC_PCT_WARMUPDUTY 0.500000 CU_HHTC_PCT_WARMUPDUTY 0.000000 0.500000 BYTE_ORDER MSB_FIRST /end CHARACTERISTIC
/begin RECORD_LAYOUT RL_HHTC_PCT_WARMUPDUTY FNC_VALUES 1 FLOAT32_IEEE COLUMN_DIR DIRECT /end RECORD_LAYOUT
/begin COMPU_METHOD CU_HHTC_PCT_WARMUPDUTY "Conversion method for HHTc_pct_WarmupDuty" RAT_FUNC "%10.2" "pct" COEFFS 0.000000 1.000000 0.000000 0.000000 0.000000 1.000000 /end COMPU_METHOD
/* Scalar calibration for DDE 'HHTc_s_Warmup'. */
/begin CHARACTERISTIC HHTc_s_Warmup "HEGO heater will remain at the low (warmup) duty for this duration after engine-start" VALUE 0x8d074 RL_HHTC_S_WARMUP 20.000000 CU_HHTC_S_WARMUP 0.000000 20.000000 BYTE_ORDER MSB_FIRST /end CHARACTERISTIC
/begin RECORD_LAYOUT RL_HHTC_S_WARMUP FNC_VALUES 1 FLOAT32_IEEE COLUMN_DIR DIRECT /end RECORD_LAYOUT
/begin COMPU_METHOD CU_HHTC_S_WARMUP "Conversion method for HHTc_s_Warmup" RAT_FUNC "%10.2" "s" COEFFS 0.000000 1.000000 0.000000 0.000000 0.000000 1.000000 /end COMPU_METHOD
/* Scalar calibration for DDE 'HRWc_NU_VehSpeed_Gain'. */
/begin CHARACTERISTIC HRWc_NU_VehSpeed_Gain "factor de conversion" VALUE 0x8bdd4 RL_HRWC_NU_VEHSPEED_GAIN 1000.000000 CU_HRWC_NU_VEHSPEED_GAIN 0.000000 1000.000000 BYTE_ORDER MSB_FIRST /end CHARACTERISTIC
/begin RECORD_LAYOUT RL_HRWC_NU_VEHSPEED_GAIN FNC_VALUES 1 FLOAT32_IEEE COLUMN_DIR DIRECT /end RECORD_LAYOUT
/begin COMPU_METHOD CU_HRWC_NU_VEHSPEED_GAIN "Conversion method for HRWc_NU_VehSpeed_Gain" RAT_FUNC "%10.3" "NU" COEFFS 0.000000 1.000000 0.000000 0.000000 0.000000 1.000000 /end COMPU_METHOD
/* Scalar calibration for DDE 'HRWc_NU_VehSpeed_Ofst'. */
/begin CHARACTERISTIC HRWc_NU_VehSpeed_Ofst "factor de conversion" VALUE 0x8bdd8 RL_HRWC_NU_VEHSPEED_OFST 1000.000000 CU_HRWC_NU_VEHSPEED_OFST 0.000000 1000.000000 BYTE_ORDER MSB_FIRST /end CHARACTERISTIC
/begin RECORD_LAYOUT RL_HRWC_NU_VEHSPEED_OFST FNC_VALUES 1 FLOAT32_IEEE COLUMN_DIR DIRECT /end RECORD_LAYOUT
/begin COMPU_METHOD CU_HRWC_NU_VEHSPEED_OFST "Conversion method for HRWc_NU_VehSpeed_Ofst" RAT_FUNC "%10.3" "NU" COEFFS 0.000000 1.000000 0.000000 0.000000 0.000000 1.000000 /end COMPU_METHOD
/* Scalar calibration for DDE 'HTRc_C_OptimalSensorTemp_A'. */
/begin CHARACTERISTIC HTRc_C_OptimalSensorTemp_A "Temperature threshold which open loop heater control ends and closed loop begins - also the closed loop set point" VALUE 0x8d8fc RL_HTRC_C_OPTIMALSENSORTEMP_A 1000.000000 CU_HTRC_C_OPTIMALSENSORTEMP_A 0.000000 1000.000000 BYTE_ORDER MSB_FIRST /end CHARACTERISTIC
/begin RECORD_LAYOUT RL_HTRC_C_OPTIMALSENSORTEMP_A FNC_VALUES 1 FLOAT32_IEEE COLUMN_DIR DIRECT /end RECORD_LAYOUT
/begin COMPU_METHOD CU_HTRC_C_OPTIMALSENSORTEMP_A "Conversion method for HTRc_C_OptimalSensorTemp_A" RAT_FUNC "%10.1" "C" COEFFS 0.000000 1.000000 0.000000 0.000000 0.000000 1.000000 /end COMPU_METHOD
/* Scalar calibration for DDE 'HTRc_C_OptimalSensorTemp_B'. */
/begin CHARACTERISTIC HTRc_C_OptimalSensorTemp_B "Temperature threshold which open loop heater control ends and closed loop begins - also the closed loop set point" VALUE 0x8d8f8 RL_HTRC_C_OPTIMALSENSORTEMP_B 1000.000000 CU_HTRC_C_OPTIMALSENSORTEMP_B 0.000000 1000.000000 BYTE_ORDER MSB_FIRST /end CHARACTERISTIC
/begin RECORD_LAYOUT RL_HTRC_C_OPTIMALSENSORTEMP_B FNC_VALUES 1 FLOAT32_IEEE COLUMN_DIR DIRECT /end RECORD_LAYOUT
/begin COMPU_METHOD CU_HTRC_C_OPTIMALSENSORTEMP_B "Conversion method for HTRc_C_OptimalSensorTemp_B" RAT_FUNC "%10.1" "C" COEFFS 0.000000 1.000000 0.000000 0.000000 0.000000 1.000000 /end COMPU_METHOD
/* Scalar calibration for DDE 'HTRc_C_WaterCondensTemp_A'. */
/begin CHARACTERISTIC HTRc_C_WaterCondensTemp_A "Temperature threshold which open loop heater control enters linear dutycycle ramp up" VALUE 0x8d8f4 RL_HTRC_C_WATERCONDENSTEMP_A 1000.000000 CU_HTRC_C_WATERCONDENSTEMP_A 0.000000 1000.000000 BYTE_ORDER MSB_FIRST /end CHARACTERISTIC
/begin RECORD_LAYOUT RL_HTRC_C_WATERCONDENSTEMP_A FNC_VALUES 1 FLOAT32_IEEE COLUMN_DIR DIRECT /end RECORD_LAYOUT
/begin COMPU_METHOD CU_HTRC_C_WATERCONDENSTEMP_A "Conversion method for HTRc_C_WaterCondensTemp_A" RAT_FUNC "%10.1" "C" COEFFS 0.000000 1.000000 0.000000 0.000000 0.000000 1.000000 /end COMPU_METHOD
/* Scalar calibration for DDE 'HTRc_C_WaterCondensTemp_B'. */
/begin CHARACTERISTIC HTRc_C_WaterCondensTemp_B "Temperature threshold which open loop heater control enters linear dutycycle ramp up" VALUE 0x8d8f0 RL_HTRC_C_WATERCONDENSTEMP_B 1000.000000 CU_HTRC_C_WATERCONDENSTEMP_B 0.000000 1000.000000 BYTE_ORDER MSB_FIRST /end CHARACTERISTIC
/begin RECORD_LAYOUT RL_HTRC_C_WATERCONDENSTEMP_B FNC_VALUES 1 FLOAT32_IEEE COLUMN_DIR DIRECT /end RECORD_LAYOUT
/begin COMPU_METHOD CU_HTRC_C_WATERCONDENSTEMP_B "Conversion method for HTRc_C_WaterCondensTemp_B" RAT_FUNC "%10.1" "C" COEFFS 0.000000 1.000000 0.000000 0.000000 0.000000 1.000000 /end COMPU_METHOD
/* Scalar calibration for DDE 'HTRc_NU_IGain_A'. */
/begin CHARACTERISTIC HTRc_NU_IGain_A "I gain for closed loop heater PID controller" VALUE 0x8d8ec RL_HTRC_NU_IGAIN_A 100.000000 CU_HTRC_NU_IGAIN_A 0.000000 100.000000 BYTE_ORDER MSB_FIRST /end CHARACTERISTIC
/begin RECORD_LAYOUT RL_HTRC_NU_IGAIN_A FNC_VALUES 1 FLOAT32_IEEE COLUMN_DIR DIRECT /end RECORD_LAYOUT
/begin COMPU_METHOD CU_HTRC_NU_IGAIN_A "Conversion method for HTRc_NU_IGain_A" RAT_FUNC "%10.2" "NU" COEFFS 0.000000 1.000000 0.000000 0.000000 0.000000 1.000000 /end COMPU_METHOD
/* Scalar calibration for DDE 'HTRc_NU_IGain_B'. */
/begin CHARACTERISTIC HTRc_NU_IGain_B "I gain for closed loop heater PID controller" VALUE 0x8d8e8 RL_HTRC_NU_IGAIN_B 100.000000 CU_HTRC_NU_IGAIN_B 0.000000 100.000000 BYTE_ORDER MSB_FIRST /end CHARACTERISTIC
/begin RECORD_LAYOUT RL_HTRC_NU_IGAIN_B FNC_VALUES 1 FLOAT32_IEEE COLUMN_DIR DIRECT /end RECORD_LAYOUT
/begin COMPU_METHOD CU_HTRC_NU_IGAIN_B "Conversion method for HTRc_NU_IGain_B" RAT_FUNC "%10.2" "NU" COEFFS 0.000000 1.000000 0.000000 0.000000 0.000000 1.000000 /end COMPU_METHOD
/* Scalar calibration for DDE 'HTRc_NU_PGain_A'. */
/begin CHARACTERISTIC HTRc_NU_PGain_A "P gain for closed loop heater PID controller" VALUE 0x8d8e4 RL_HTRC_NU_PGAIN_A 100.000000 CU_HTRC_NU_PGAIN_A 0.000000 100.000000 BYTE_ORDER MSB_FIRST /end CHARACTERISTIC
/begin RECORD_LAYOUT RL_HTRC_NU_PGAIN_A FNC_VALUES 1 FLOAT32_IEEE COLUMN_DIR DIRECT /end RECORD_LAYOUT
/begin COMPU_METHOD CU_HTRC_NU_PGAIN_A "Conversion method for HTRc_NU_PGain_A" RAT_FUNC "%10.2" "NU" COEFFS 0.000000 1.000000 0.000000 0.000000 0.000000 1.000000 /end COMPU_METHOD
/* Scalar calibration for DDE 'HTRc_NU_PGain_B'. */
/begin CHARACTERISTIC HTRc_NU_PGain_B "P gain for closed loop heater PID controller" VALUE 0x8d8e0 RL_HTRC_NU_PGAIN_B 100.000000 CU_HTRC_NU_PGAIN_B 0.000000 100.000000 BYTE_ORDER MSB_FIRST /end CHARACTERISTIC
/begin RECORD_LAYOUT RL_HTRC_NU_PGAIN_B FNC_VALUES 1 FLOAT32_IEEE COLUMN_DIR DIRECT /end RECORD_LAYOUT
/begin COMPU_METHOD CU_HTRC_NU_PGAIN_B "Conversion method for HTRc_NU_PGain_B" RAT_FUNC "%10.2" "NU" COEFFS 0.000000 1.000000 0.000000 0.000000 0.000000 1.000000 /end COMPU_METHOD
/* Scalar calibration for DDE 'HTRc_NU_RefCurrEnum_A'. */
/begin CHARACTERISTIC HTRc_NU_RefCurrEnum_A "Temporary calibration for reference current enumeration input to cj125 OE block" VALUE 0x8d509 RL_HTRC_NU_REFCURRENUM_A 255.000000 CU_HTRC_NU_REFCURRENUM_A 0.000000 255.000000 BYTE_ORDER MSB_FIRST /end CHARACTERISTIC
/begin RECORD_LAYOUT RL_HTRC_NU_REFCURRENUM_A FNC_VALUES 1 UBYTE COLUMN_DIR DIRECT /end RECORD_LAYOUT
/begin COMPU_METHOD CU_HTRC_NU_REFCURRENUM_A "Conversion method for HTRc_NU_RefCurrEnum_A" RAT_FUNC "%10.0" "NU" COEFFS 0.000000 1.000000 0.000000 0.000000 0.000000 1.000000 /end COMPU_METHOD
/* Scalar calibration for DDE 'HTRc_NU_RefCurrEnum_B'. */
/begin CHARACTERISTIC HTRc_NU_RefCurrEnum_B "Temporary calibration for reference current enumeration input to cj125 OE block" VALUE 0x8d508 RL_HTRC_NU_REFCURRENUM_B 255.000000 CU_HTRC_NU_REFCURRENUM_B 0.000000 255.000000 BYTE_ORDER MSB_FIRST /end CHARACTERISTIC
/begin RECORD_LAYOUT RL_HTRC_NU_REFCURRENUM_B FNC_VALUES 1 UBYTE COLUMN_DIR DIRECT /end RECORD_LAYOUT
/begin COMPU_METHOD CU_HTRC_NU_REFCURRENUM_B "Conversion method for HTRc_NU_RefCurrEnum_B" RAT_FUNC "%10.0" "NU" COEFFS 0.000000 1.000000 0.000000 0.000000 0.000000 1.000000 /end COMPU_METHOD
/* Scalar calibration for DDE 'HTRc_b_EnblHeater_A'. */
/begin CHARACTERISTIC HTRc_b_EnblHeater_A "Temporary calibration enable to enable the heater" VALUE 0x8d50d RL_HTRC_B_ENBLHEATER_A 1.000000 CU_HTRC_B_ENBLHEATER_A 0.000000 1.000000 BYTE_ORDER MSB_FIRST /end CHARACTERISTIC
/begin RECORD_LAYOUT RL_HTRC_B_ENBLHEATER_A FNC_VALUES 1 UBYTE COLUMN_DIR DIRECT /end RECORD_LAYOUT
/begin COMPU_METHOD CU_HTRC_B_ENBLHEATER_A "Conversion method for HTRc_b_EnblHeater_A" RAT_FUNC "%10.0" "b" COEFFS 0.000000 1.000000 0.000000 0.000000 0.000000 1.000000 /end COMPU_METHOD
/* Scalar calibration for DDE 'HTRc_b_EnblHeater_B'. */
/begin CHARACTERISTIC HTRc_b_EnblHeater_B "Temporary calibration enable to enable the heater" VALUE 0x8d50c RL_HTRC_B_ENBLHEATER_B 1.000000 CU_HTRC_B_ENBLHEATER_B 0.000000 1.000000 BYTE_ORDER MSB_FIRST /end CHARACTERISTIC
/begin RECORD_LAYOUT RL_HTRC_B_ENBLHEATER_B FNC_VALUES 1 UBYTE COLUMN_DIR DIRECT /end RECORD_LAYOUT
/begin COMPU_METHOD CU_HTRC_B_ENBLHEATER_B "Conversion method for HTRc_b_EnblHeater_B" RAT_FUNC "%10.0" "b" COEFFS 0.000000 1.000000 0.000000 0.000000 0.000000 1.000000 /end COMPU_METHOD
/* Scalar calibration for DDE 'HTRc_b_EnblTempSensor_A'. */
/begin CHARACTERISTIC HTRc_b_EnblTempSensor_A "Boolean to enable the temperature sensor" VALUE 0x8d50b RL_HTRC_B_ENBLTEMPSENSOR_A 1.000000 CU_HTRC_B_ENBLTEMPSENSOR_A 0.000000 1.000000 BYTE_ORDER MSB_FIRST /end CHARACTERISTIC
/begin RECORD_LAYOUT RL_HTRC_B_ENBLTEMPSENSOR_A FNC_VALUES 1 UBYTE COLUMN_DIR DIRECT /end RECORD_LAYOUT
/begin COMPU_METHOD CU_HTRC_B_ENBLTEMPSENSOR_A "Conversion method for HTRc_b_EnblTempSensor_A" RAT_FUNC "%10.0" "b" COEFFS 0.000000 1.000000 0.000000 0.000000 0.000000 1.000000 /end COMPU_METHOD
/* Scalar calibration for DDE 'HTRc_b_EnblTempSensor_B'. */
/begin CHARACTERISTIC HTRc_b_EnblTempSensor_B "Boolean to enable the temperature sensor" VALUE 0x8d50a RL_HTRC_B_ENBLTEMPSENSOR_B 1.000000 CU_HTRC_B_ENBLTEMPSENSOR_B 0.000000 1.000000 BYTE_ORDER MSB_FIRST /end CHARACTERISTIC
/begin RECORD_LAYOUT RL_HTRC_B_ENBLTEMPSENSOR_B FNC_VALUES 1 UBYTE COLUMN_DIR DIRECT /end RECORD_LAYOUT
/begin COMPU_METHOD CU_HTRC_B_ENBLTEMPSENSOR_B "Conversion method for HTRc_b_EnblTempSensor_B" RAT_FUNC "%10.0" "b" COEFFS 0.000000 1.000000 0.000000 0.000000 0.000000 1.000000 /end COMPU_METHOD
/* Scalar calibration for DDE 'HTRc_pct_HeaterLimitCLPWMCmd_A'. */
/begin CHARACTERISTIC HTRc_pct_HeaterLimitCLPWMCmd_A "Max closed loop heater PWM command when a cj125 fault exists" VALUE 0x8d8dc RL_HTRC_PCT_HEATERLIMITCLPWMCM1 1.000000 CU_HTRC_PCT_HEATERLIMITCLPWMCM1 0.000000 1.000000 BYTE_ORDER MSB_FIRST /end CHARACTERISTIC
/begin RECORD_LAYOUT RL_HTRC_PCT_HEATERLIMITCLPWMCM1 FNC_VALUES 1 FLOAT32_IEEE COLUMN_DIR DIRECT /end RECORD_LAYOUT
/begin COMPU_METHOD CU_HTRC_PCT_HEATERLIMITCLPWMCM1 "Conversion method for HTRc_pct_HeaterLimitCLPWMCmd_A" RAT_FUNC "%10.2" "pct" COEFFS 0.000000 1.000000 0.000000 0.000000 0.000000 1.000000 /end COMPU_METHOD
/* Scalar calibration for DDE 'HTRc_pct_HeaterLimitCLPWMCmd_B'. */
/begin CHARACTERISTIC HTRc_pct_HeaterLimitCLPWMCmd_B "Max closed loop heater PWM command when a cj125 fault exists" VALUE 0x8d8d8 RL_HTRC_PCT_HEATERLIMITCLPWMCM0 1.000000 CU_HTRC_PCT_HEATERLIMITCLPWMCM0 0.000000 1.000000 BYTE_ORDER MSB_FIRST /end CHARACTERISTIC
/begin RECORD_LAYOUT RL_HTRC_PCT_HEATERLIMITCLPWMCM0 FNC_VALUES 1 FLOAT32_IEEE COLUMN_DIR DIRECT /end RECORD_LAYOUT
/begin COMPU_METHOD CU_HTRC_PCT_HEATERLIMITCLPWMCM0 "Conversion method for HTRc_pct_HeaterLimitCLPWMCmd_B" RAT_FUNC "%10.2" "pct" COEFFS 0.000000 1.000000 0.000000 0.000000 0.000000 1.000000 /end COMPU_METHOD
/* Scalar calibration for DDE 'HTRc_pct_HeaterLimitOLPWMCmd_A'. */
/begin CHARACTERISTIC HTRc_pct_HeaterLimitOLPWMCmd_A "Max open loop heater PWM command when a cj125 fault exists" VALUE 0x8d8d4 RL_HTRC_PCT_HEATERLIMITOLPWMCM1 1.000000 CU_HTRC_PCT_HEATERLIMITOLPWMCM1 0.000000 1.000000 BYTE_ORDER MSB_FIRST /end CHARACTERISTIC
/begin RECORD_LAYOUT RL_HTRC_PCT_HEATERLIMITOLPWMCM1 FNC_VALUES 1 FLOAT32_IEEE COLUMN_DIR DIRECT /end RECORD_LAYOUT
/begin COMPU_METHOD CU_HTRC_PCT_HEATERLIMITOLPWMCM1 "Conversion method for HTRc_pct_HeaterLimitOLPWMCmd_A" RAT_FUNC "%10.2" "pct" COEFFS 0.000000 1.000000 0.000000 0.000000 0.000000 1.000000 /end COMPU_METHOD
/* Scalar calibration for DDE 'HTRc_pct_HeaterLimitOLPWMCmd_B'. */
/begin CHARACTERISTIC HTRc_pct_HeaterLimitOLPWMCmd_B "Max open loop heater PWM command when a cj125 fault exists" VALUE 0x8d8d0 RL_HTRC_PCT_HEATERLIMITOLPWMCM0 1.000000 CU_HTRC_PCT_HEATERLIMITOLPWMCM0 0.000000 1.000000 BYTE_ORDER MSB_FIRST /end CHARACTERISTIC
/begin RECORD_LAYOUT RL_HTRC_PCT_HEATERLIMITOLPWMCM0 FNC_VALUES 1 FLOAT32_IEEE COLUMN_DIR DIRECT /end RECORD_LAYOUT
/begin COMPU_METHOD CU_HTRC_PCT_HEATERLIMITOLPWMCM0 "Conversion method for HTRc_pct_HeaterLimitOLPWMCmd_B" RAT_FUNC "%10.2" "pct" COEFFS 0.000000 1.000000 0.000000 0.000000 0.000000 1.000000 /end COMPU_METHOD
/* Scalar calibration for DDE 'HTRc_pct_LinRampPWMCmd_A'. */
/begin CHARACTERISTIC HTRc_pct_LinRampPWMCmd_A "PWM command for start of linear ramp out in Open Loop heater control" VALUE 0x8d8cc RL_HTRC_PCT_LINRAMPPWMCMD_A 1.000000 CU_HTRC_PCT_LINRAMPPWMCMD_A 0.000000 1.000000 BYTE_ORDER MSB_FIRST /end CHARACTERISTIC
/begin RECORD_LAYOUT RL_HTRC_PCT_LINRAMPPWMCMD_A FNC_VALUES 1 FLOAT32_IEEE COLUMN_DIR DIRECT /end RECORD_LAYOUT
/begin COMPU_METHOD CU_HTRC_PCT_LINRAMPPWMCMD_A "Conversion method for HTRc_pct_LinRampPWMCmd_A" RAT_FUNC "%10.2" "pct" COEFFS 0.000000 1.000000 0.000000 0.000000 0.000000 1.000000 /end COMPU_METHOD
/* Scalar calibration for DDE 'HTRc_pct_LinRampPWMCmd_B'. */
/begin CHARACTERISTIC HTRc_pct_LinRampPWMCmd_B "PWM command for start of linear ramp out in Open Loop heater control" VALUE 0x8d8c8 RL_HTRC_PCT_LINRAMPPWMCMD_B 1.000000 CU_HTRC_PCT_LINRAMPPWMCMD_B 0.000000 1.000000 BYTE_ORDER MSB_FIRST /end CHARACTERISTIC
/begin RECORD_LAYOUT RL_HTRC_PCT_LINRAMPPWMCMD_B FNC_VALUES 1 FLOAT32_IEEE COLUMN_DIR DIRECT /end RECORD_LAYOUT
/begin COMPU_METHOD CU_HTRC_PCT_LINRAMPPWMCMD_B "Conversion method for HTRc_pct_LinRampPWMCmd_B" RAT_FUNC "%10.2" "pct" COEFFS 0.000000 1.000000 0.000000 0.000000 0.000000 1.000000 /end COMPU_METHOD
/* Scalar calibration for DDE 'HTRc_pct_MaxDutyCyc'. */
/begin CHARACTERISTIC HTRc_pct_MaxDutyCyc "Min/Max dutycycle from I-term PID controller" VALUE 0x8d8c4 RL_HTRC_PCT_MAXDUTYCYC 1.000000 CU_HTRC_PCT_MAXDUTYCYC 0.000000 1.000000 BYTE_ORDER MSB_FIRST /end CHARACTERISTIC
/begin RECORD_LAYOUT RL_HTRC_PCT_MAXDUTYCYC FNC_VALUES 1 FLOAT32_IEEE COLUMN_DIR DIRECT /end RECORD_LAYOUT
/begin COMPU_METHOD CU_HTRC_PCT_MAXDUTYCYC "Conversion method for HTRc_pct_MaxDutyCyc" RAT_FUNC "%10.2" "pct" COEFFS 0.000000 1.000000 0.000000 0.000000 0.000000 1.000000 /end COMPU_METHOD
/* Scalar calibration for DDE 'HTRc_pct_OpenLoopLinRamp_A'. */
/begin CHARACTERISTIC HTRc_pct_OpenLoopLinRamp_A "Open loop linear ramp rate after the Water Condensation warming period" VALUE 0x8d8c0 RL_HTRC_PCT_OPENLOOPLINRAMP_A 1.000000 CU_HTRC_PCT_OPENLOOPLINRAMP_A 0.000000 1.000000 BYTE_ORDER MSB_FIRST /end CHARACTERISTIC
/begin RECORD_LAYOUT RL_HTRC_PCT_OPENLOOPLINRAMP_A FNC_VALUES 1 FLOAT32_IEEE COLUMN_DIR DIRECT /end RECORD_LAYOUT
/begin COMPU_METHOD CU_HTRC_PCT_OPENLOOPLINRAMP_A "Conversion method for HTRc_pct_OpenLoopLinRamp_A" RAT_FUNC "%10.4" "pct" COEFFS 0.000000 1.000000 0.000000 0.000000 0.000000 1.000000 /end COMPU_METHOD
/* Scalar calibration for DDE 'HTRc_pct_OpenLoopLinRamp_B'. */
/begin CHARACTERISTIC HTRc_pct_OpenLoopLinRamp_B "Open loop linear ramp rate after the Water Condensation warming period" VALUE 0x8d8bc RL_HTRC_PCT_OPENLOOPLINRAMP_B 1.000000 CU_HTRC_PCT_OPENLOOPLINRAMP_B 0.000000 1.000000 BYTE_ORDER MSB_FIRST /end CHARACTERISTIC
/begin RECORD_LAYOUT RL_HTRC_PCT_OPENLOOPLINRAMP_B FNC_VALUES 1 FLOAT32_IEEE COLUMN_DIR DIRECT /end RECORD_LAYOUT
/begin COMPU_METHOD CU_HTRC_PCT_OPENLOOPLINRAMP_B "Conversion method for HTRc_pct_OpenLoopLinRamp_B" RAT_FUNC "%10.4" "pct" COEFFS 0.000000 1.000000 0.000000 0.000000 0.000000 1.000000 /end COMPU_METHOD
/* Scalar calibration for DDE 'HTRc_pct_PID_OutputMax_A'. */
/begin CHARACTERISTIC HTRc_pct_PID_OutputMax_A "Max heater PWM command" VALUE 0x8d8b8 RL_HTRC_PCT_PID_OUTPUTMAX_A 1.000000 CU_HTRC_PCT_PID_OUTPUTMAX_A 0.000000 1.000000 BYTE_ORDER MSB_FIRST /end CHARACTERISTIC
/begin RECORD_LAYOUT RL_HTRC_PCT_PID_OUTPUTMAX_A FNC_VALUES 1 FLOAT32_IEEE COLUMN_DIR DIRECT /end RECORD_LAYOUT
/begin COMPU_METHOD CU_HTRC_PCT_PID_OUTPUTMAX_A "Conversion method for HTRc_pct_PID_OutputMax_A" RAT_FUNC "%10.2" "pct" COEFFS 0.000000 1.000000 0.000000 0.000000 0.000000 1.000000 /end COMPU_METHOD
/* Scalar calibration for DDE 'HTRc_pct_PID_OutputMax_B'. */
/begin CHARACTERISTIC HTRc_pct_PID_OutputMax_B "Max heater PWM command" VALUE 0x8d8b4 RL_HTRC_PCT_PID_OUTPUTMAX_B 1.000000 CU_HTRC_PCT_PID_OUTPUTMAX_B 0.000000 1.000000 BYTE_ORDER MSB_FIRST /end CHARACTERISTIC
/begin RECORD_LAYOUT RL_HTRC_PCT_PID_OUTPUTMAX_B FNC_VALUES 1 FLOAT32_IEEE COLUMN_DIR DIRECT /end RECORD_LAYOUT
/begin COMPU_METHOD CU_HTRC_PCT_PID_OUTPUTMAX_B "Conversion method for HTRc_pct_PID_OutputMax_B" RAT_FUNC "%10.2" "pct" COEFFS 0.000000 1.000000 0.000000 0.000000 0.000000 1.000000 /end COMPU_METHOD
/* Scalar calibration for DDE 'HTRc_pct_WaterCondensPWMCmd_A'. */
/begin CHARACTERISTIC HTRc_pct_WaterCondensPWMCmd_A "PWM command for water condensation warm up period" VALUE 0x8d8b0 RL_HTRC_PCT_WATERCONDENSPWMCMD1 1.000000 CU_HTRC_PCT_WATERCONDENSPWMCMD1 0.000000 1.000000 BYTE_ORDER MSB_FIRST /end CHARACTERISTIC
/begin RECORD_LAYOUT RL_HTRC_PCT_WATERCONDENSPWMCMD1 FNC_VALUES 1 FLOAT32_IEEE COLUMN_DIR DIRECT /end RECORD_LAYOUT
/begin COMPU_METHOD CU_HTRC_PCT_WATERCONDENSPWMCMD1 "Conversion method for HTRc_pct_WaterCondensPWMCmd_A" RAT_FUNC "%10.2" "pct" COEFFS 0.000000 1.000000 0.000000 0.000000 0.000000 1.000000 /end COMPU_METHOD
/* Scalar calibration for DDE 'HTRc_pct_WaterCondensPWMCmd_B'. */
/begin CHARACTERISTIC HTRc_pct_WaterCondensPWMCmd_B "PWM command for water condensation warm up period" VALUE 0x8d8ac RL_HTRC_PCT_WATERCONDENSPWMCMD0 1.000000 CU_HTRC_PCT_WATERCONDENSPWMCMD0 0.000000 1.000000 BYTE_ORDER MSB_FIRST /end CHARACTERISTIC
/begin RECORD_LAYOUT RL_HTRC_PCT_WATERCONDENSPWMCMD0 FNC_VALUES 1 FLOAT32_IEEE COLUMN_DIR DIRECT /end RECORD_LAYOUT
/begin COMPU_METHOD CU_HTRC_PCT_WATERCONDENSPWMCMD0 "Conversion method for HTRc_pct_WaterCondensPWMCmd_B" RAT_FUNC "%10.2" "pct" COEFFS 0.000000 1.000000 0.000000 0.000000 0.000000 1.000000 /end COMPU_METHOD
/* Scalar calibration for DDE 'HTRc_s_EngineStopTimeout'. */
/begin CHARACTERISTIC HTRc_s_EngineStopTimeout "Automatically turn off the UEGO heater this duration after engine-stop" VALUE 0x8d070 RL_HTRC_S_ENGINESTOPTIMEOUT 7200.000000 CU_HTRC_S_ENGINESTOPTIMEOUT 0.000000 7200.000000 BYTE_ORDER MSB_FIRST /end CHARACTERISTIC
/begin RECORD_LAYOUT RL_HTRC_S_ENGINESTOPTIMEOUT FNC_VALUES 1 FLOAT32_IEEE COLUMN_DIR DIRECT /end RECORD_LAYOUT
/begin COMPU_METHOD CU_HTRC_S_ENGINESTOPTIMEOUT "Conversion method for HTRc_s_EngineStopTimeout" RAT_FUNC "%10.1" "s" COEFFS 0.000000 1.000000 0.000000 0.000000 0.000000 1.000000 /end COMPU_METHOD
/* Scalar calibration for DDE 'HTRc_s_FaultFlagDbnc'. */
/begin CHARACTERISTIC HTRc_s_FaultFlagDbnc "Debounce time for cj125 fault flags used in heater" VALUE 0x8d8a8 RL_HTRC_S_FAULTFLAGDBNC 100.000000 CU_HTRC_S_FAULTFLAGDBNC 0.000000 100.000000 BYTE_ORDER MSB_FIRST /end CHARACTERISTIC
/begin RECORD_LAYOUT RL_HTRC_S_FAULTFLAGDBNC FNC_VALUES 1 FLOAT32_IEEE COLUMN_DIR DIRECT /end RECORD_LAYOUT
/begin COMPU_METHOD CU_HTRC_S_FAULTFLAGDBNC "Conversion method for HTRc_s_FaultFlagDbnc" RAT_FUNC "%10.2" "s" COEFFS 0.000000 1.000000 0.000000 0.000000 0.000000 1.000000 /end COMPU_METHOD
/* Scalar calibration for DDE 'HTRc_s_OpenLoopWatrCondnsDbnc_A'. */
/begin CHARACTERISTIC HTRc_s_OpenLoopWatrCondnsDbnc_A "Debounce time for constant 10% dutycycle open loop heater control - Water Condensation warm up period" VALUE 0x8d8a4 RL_HTRC_S_OPENLOOPWATRCONDNSDB0 100.000000 CU_HTRC_S_OPENLOOPWATRCONDNSDB0 0.000000 100.000000 BYTE_ORDER MSB_FIRST /end CHARACTERISTIC
/begin RECORD_LAYOUT RL_HTRC_S_OPENLOOPWATRCONDNSDB0 FNC_VALUES 1 FLOAT32_IEEE COLUMN_DIR DIRECT /end RECORD_LAYOUT
/begin COMPU_METHOD CU_HTRC_S_OPENLOOPWATRCONDNSDB0 "Conversion method for HTRc_s_OpenLoopWatrCondnsDbnc_A" RAT_FUNC "%10.0" "s" COEFFS 0.000000 1.000000 0.000000 0.000000 0.000000 1.000000 /end COMPU_METHOD
/* Scalar calibration for DDE 'HTRc_s_OpenLoopWatrCondnsDbnc_B'. */
/begin CHARACTERISTIC HTRc_s_OpenLoopWatrCondnsDbnc_B "Debounce time for constant 10% dutycycle open loop heater control - Water Condensation warm up period" VALUE 0x8d8a0 RL_HTRC_S_OPENLOOPWATRCONDNSDB1 100.000000 CU_HTRC_S_OPENLOOPWATRCONDNSDB1 0.000000 100.000000 BYTE_ORDER MSB_FIRST /end CHARACTERISTIC
/begin RECORD_LAYOUT RL_HTRC_S_OPENLOOPWATRCONDNSDB1 FNC_VALUES 1 FLOAT32_IEEE COLUMN_DIR DIRECT /end RECORD_LAYOUT
/begin COMPU_METHOD CU_HTRC_S_OPENLOOPWATRCONDNSDB1 "Conversion method for HTRc_s_OpenLoopWatrCondnsDbnc_B" RAT_FUNC "%10.0" "s" COEFFS 0.000000 1.000000 0.000000 0.000000 0.000000 1.000000 /end COMPU_METHOD
/* Map (1d) calibration for DDE 'HTRm_C_SensorTempA_z'. */
/begin CHARACTERISTIC HTRm_C_SensorTempA_z "Sensor temperature" CURVE 0x8d858 RL_HTRM_C_SENSORTEMPA_Z 1250.000000 CU_HTRM_C_SENSORTEMPA_Z -50.000000 1200.000000
 /begin AXIS_DESCR COM_AXIS AIN_V_FiltUR_A CU_HTRM_C_SENSORTEMPA_X 9 0.000000 5.000000 AXIS_PTS_REF APD_HTRM_C_SENSORTEMPA_X /end AXIS_DESCR
 BYTE_ORDER MSB_FIRST /end CHARACTERISTIC
/begin RECORD_LAYOUT RL_HTRM_C_SENSORTEMPA_Z FNC_VALUES 1 FLOAT32_IEEE COLUMN_DIR DIRECT /end RECORD_LAYOUT
/begin COMPU_METHOD CU_HTRM_C_SENSORTEMPA_Z "Conversion method for HTRm_C_SensorTempA_z" RAT_FUNC "%10.1" "C" COEFFS 0.000000 1.000000 0.000000 0.000000 0.000000 1.000000 /end COMPU_METHOD
/begin AXIS_PTS APD_HTRM_C_SENSORTEMPA_X "UR voltage index for sensor temperature" 0x8d87c AIN_V_FiltUR_A RL_HTRM_C_SENSORTEMPA_X 5.000000 CU_HTRM_C_SENSORTEMPA_X 9 0.0 5.0 BYTE_ORDER MSB_FIRST /end AXIS_PTS
/begin RECORD_LAYOUT RL_HTRM_C_SENSORTEMPA_X AXIS_PTS_X 1 FLOAT32_IEEE INDEX_INCR DIRECT /end RECORD_LAYOUT
/begin COMPU_METHOD CU_HTRM_C_SENSORTEMPA_X "Conversion method for HTRm_C_SensorTempA_x" RAT_FUNC "%10.2" "C" COEFFS 0.000000 1.000000 0.000000 0.000000 0.000000 1.000000 /end COMPU_METHOD
/* Map (1d) calibration for DDE 'HTRm_C_SensorTempB_z'. */
/begin CHARACTERISTIC HTRm_C_SensorTempB_z "Sensor temperature" CURVE 0x8d810 RL_HTRM_C_SENSORTEMPB_Z 1250.000000 CU_HTRM_C_SENSORTEMPB_Z -50.000000 1200.000000
 /begin AXIS_DESCR COM_AXIS AIN_V_FiltUR_B CU_HTRM_C_SENSORTEMPB_X 9 0.000000 5.000000 AXIS_PTS_REF APD_HTRM_C_SENSORTEMPB_X /end AXIS_DESCR
 BYTE_ORDER MSB_FIRST /end CHARACTERISTIC
/begin RECORD_LAYOUT RL_HTRM_C_SENSORTEMPB_Z FNC_VALUES 1 FLOAT32_IEEE COLUMN_DIR DIRECT /end RECORD_LAYOUT
/begin COMPU_METHOD CU_HTRM_C_SENSORTEMPB_Z "Conversion method for HTRm_C_SensorTempB_z" RAT_FUNC "%10.1" "C" COEFFS 0.000000 1.000000 0.000000 0.000000 0.000000 1.000000 /end COMPU_METHOD
/begin AXIS_PTS APD_HTRM_C_SENSORTEMPB_X "UR voltage index for sensor temperature" 0x8d834 AIN_V_FiltUR_B RL_HTRM_C_SENSORTEMPB_X 5.000000 CU_HTRM_C_SENSORTEMPB_X 9 0.0 5.0 BYTE_ORDER MSB_FIRST /end AXIS_PTS
/begin RECORD_LAYOUT RL_HTRM_C_SENSORTEMPB_X AXIS_PTS_X 1 FLOAT32_IEEE INDEX_INCR DIRECT /end RECORD_LAYOUT
/begin COMPU_METHOD CU_HTRM_C_SENSORTEMPB_X "Conversion method for HTRm_C_SensorTempB_x" RAT_FUNC "%10.2" "C" COEFFS 0.000000 1.000000 0.000000 0.000000 0.000000 1.000000 /end COMPU_METHOD
/* Map (1d) calibration for DDE 'HTRm_NU_SysVoltageCompA_z'. */
/begin CHARACTERISTIC HTRm_NU_SysVoltageCompA_z "Gain for PWM command based on system voltage" CURVE 0x8d7d0 RL_HTRM_NU_SYSVOLTAGECOMPA_Z 110.000000 CU_HTRM_NU_SYSVOLTAGECOMPA_Z -10.000000 100.000000
 /begin AXIS_DESCR COM_AXIS NO_INPUT_QUANTITY CU_HTRM_NU_SYSVOLTAGECOMPA_X 8 0.000000 50.000000 AXIS_PTS_REF APD_HTRM_NU_SYSVOLTAGECOMPA_X /end AXIS_DESCR
 BYTE_ORDER MSB_FIRST /end CHARACTERISTIC
/begin RECORD_LAYOUT RL_HTRM_NU_SYSVOLTAGECOMPA_Z FNC_VALUES 1 FLOAT32_IEEE COLUMN_DIR DIRECT /end RECORD_LAYOUT
/begin COMPU_METHOD CU_HTRM_NU_SYSVOLTAGECOMPA_Z "Conversion method for HTRm_NU_SysVoltageCompA_z" RAT_FUNC "%10.3" "V" COEFFS 0.000000 1.000000 0.000000 0.000000 0.000000 1.000000 /end COMPU_METHOD
/begin AXIS_PTS APD_HTRM_NU_SYSVOLTAGECOMPA_X "Vbatt voltage index for system voltage compensation" 0x8d7f0 NO_INPUT_QUANTITY RL_HTRM_NU_SYSVOLTAGECOMPA_X 50.000000 CU_HTRM_NU_SYSVOLTAGECOMPA_X 8 0.0 50.0 BYTE_ORDER MSB_FIRST /end AXIS_PTS
/begin RECORD_LAYOUT RL_HTRM_NU_SYSVOLTAGECOMPA_X AXIS_PTS_X 1 FLOAT32_IEEE INDEX_INCR DIRECT /end RECORD_LAYOUT
/begin COMPU_METHOD CU_HTRM_NU_SYSVOLTAGECOMPA_X "Conversion method for HTRm_NU_SysVoltageCompA_x" RAT_FUNC "%10.2" "V" COEFFS 0.000000 1.000000 0.000000 0.000000 0.000000 1.000000 /end COMPU_METHOD
/* Map (1d) calibration for DDE 'HTRm_NU_SysVoltageCompB_z'. */
/begin CHARACTERISTIC HTRm_NU_SysVoltageCompB_z "Gain for PWM command based on system voltage" CURVE 0x8d790 RL_HTRM_NU_SYSVOLTAGECOMPB_Z 110.000000 CU_HTRM_NU_SYSVOLTAGECOMPB_Z -10.000000 100.000000
 /begin AXIS_DESCR COM_AXIS NO_INPUT_QUANTITY CU_HTRM_NU_SYSVOLTAGECOMPB_X 8 0.000000 50.000000 AXIS_PTS_REF APD_HTRM_NU_SYSVOLTAGECOMPB_X /end AXIS_DESCR
 BYTE_ORDER MSB_FIRST /end CHARACTERISTIC
/begin RECORD_LAYOUT RL_HTRM_NU_SYSVOLTAGECOMPB_Z FNC_VALUES 1 FLOAT32_IEEE COLUMN_DIR DIRECT /end RECORD_LAYOUT
/begin COMPU_METHOD CU_HTRM_NU_SYSVOLTAGECOMPB_Z "Conversion method for HTRm_NU_SysVoltageCompB_z" RAT_FUNC "%10.3" "V" COEFFS 0.000000 1.000000 0.000000 0.000000 0.000000 1.000000 /end COMPU_METHOD
/begin AXIS_PTS APD_HTRM_NU_SYSVOLTAGECOMPB_X "Vbatt voltage index for system voltage compensation" 0x8d7b0 NO_INPUT_QUANTITY RL_HTRM_NU_SYSVOLTAGECOMPB_X 50.000000 CU_HTRM_NU_SYSVOLTAGECOMPB_X 8 0.0 50.0 BYTE_ORDER MSB_FIRST /end AXIS_PTS
/begin RECORD_LAYOUT RL_HTRM_NU_SYSVOLTAGECOMPB_X AXIS_PTS_X 1 FLOAT32_IEEE INDEX_INCR DIRECT /end RECORD_LAYOUT
/begin COMPU_METHOD CU_HTRM_NU_SYSVOLTAGECOMPB_X "Conversion method for HTRm_NU_SysVoltageCompB_x" RAT_FUNC "%10.2" "V" COEFFS 0.000000 1.000000 0.000000 0.000000 0.000000 1.000000 /end COMPU_METHOD
/* Scalar calibration for DDE 'IDLc_C_AmbTemp'. */
/begin CHARACTERISTIC IDLc_C_AmbTemp "Idle shot for alternator stabilisation in cold temperature" VALUE 0x824b0 RL_IDLC_C_AMBTEMP 100.000000 CU_IDLC_C_AMBTEMP -20.000000 80.000000 BYTE_ORDER MSB_FIRST /end CHARACTERISTIC
/begin RECORD_LAYOUT RL_IDLC_C_AMBTEMP FNC_VALUES 1 FLOAT32_IEEE COLUMN_DIR DIRECT /end RECORD_LAYOUT
/begin COMPU_METHOD CU_IDLC_C_AMBTEMP "Conversion method for IDLc_C_AmbTemp" RAT_FUNC "%10.0" "NU" COEFFS 0.000000 1.000000 0.000000 0.000000 0.000000 1.000000 /end COMPU_METHOD
/* Scalar calibration for DDE 'IDLc_Hz_AlternatorTermLPF'. */
/begin CHARACTERISTIC IDLc_Hz_AlternatorTermLPF "Filter cutoff frequency" VALUE 0x82574 RL_IDLC_HZ_ALTERNATORTERMLPF 199.900000 CU_IDLC_HZ_ALTERNATORTERMLPF 0.100000 200.000000 BYTE_ORDER MSB_FIRST /end CHARACTERISTIC
/begin RECORD_LAYOUT RL_IDLC_HZ_ALTERNATORTERMLPF FNC_VALUES 1 FLOAT32_IEEE COLUMN_DIR DIRECT /end RECORD_LAYOUT
/begin COMPU_METHOD CU_IDLC_HZ_ALTERNATORTERMLPF "Conversion method for IDLc_Hz_AlternatorTermLPF" RAT_FUNC "%10.1" "Hz" COEFFS 0.000000 1.000000 0.000000 0.000000 0.000000 1.000000 /end COMPU_METHOD
/* Scalar calibration for DDE 'IDLc_Hz_ErrorLPF'. */
/begin CHARACTERISTIC IDLc_Hz_ErrorLPF "FB DTerm LPF" VALUE 0x84e8c RL_IDLC_HZ_ERRORLPF 99.900000 CU_IDLC_HZ_ERRORLPF 0.100000 100.000000 BYTE_ORDER MSB_FIRST /end CHARACTERISTIC
/begin RECORD_LAYOUT RL_IDLC_HZ_ERRORLPF FNC_VALUES 1 FLOAT32_IEEE COLUMN_DIR DIRECT /end RECORD_LAYOUT
/begin COMPU_METHOD CU_IDLC_HZ_ERRORLPF "Conversion method for IDLc_Hz_ErrorLPF" RAT_FUNC "%10.1" "Hz" COEFFS 0.000000 1.000000 0.000000 0.000000 0.000000 1.000000 /end COMPU_METHOD
/* Scalar calibration for DDE 'IDLc_NU_AirErrorROCThrsh'. */
/begin CHARACTERISTIC IDLc_NU_AirErrorROCThrsh "RPM error rate of change threshold for derivative control" VALUE 0x85238 RL_IDLC_NU_AIRERRORROCTHRSH 2000.000000 CU_IDLC_NU_AIRERRORROCTHRSH -1000.000000 1000.000000 BYTE_ORDER MSB_FIRST /end CHARACTERISTIC
/begin RECORD_LAYOUT RL_IDLC_NU_AIRERRORROCTHRSH FNC_VALUES 1 FLOAT32_IEEE COLUMN_DIR DIRECT /end RECORD_LAYOUT
/begin COMPU_METHOD CU_IDLC_NU_AIRERRORROCTHRSH "Conversion method for IDLc_NU_AirErrorROCThrsh" RAT_FUNC "%10.3" "NU" COEFFS 0.000000 1.000000 0.000000 0.000000 0.000000 1.000000 /end COMPU_METHOD
/* Scalar calibration for DDE 'IDLc_NU_AirIMax'. */
/begin CHARACTERISTIC IDLc_NU_AirIMax "Air control ITerm is limited to this range" VALUE 0x85234 RL_IDLC_NU_AIRIMAX 1.000000 CU_IDLC_NU_AIRIMAX 0.000000 1.000000 BYTE_ORDER MSB_FIRST /end CHARACTERISTIC
/begin RECORD_LAYOUT RL_IDLC_NU_AIRIMAX FNC_VALUES 1 FLOAT32_IEEE COLUMN_DIR DIRECT /end RECORD_LAYOUT
/begin COMPU_METHOD CU_IDLC_NU_AIRIMAX "Conversion method for IDLc_NU_AirIMax" RAT_FUNC "%10.2" "NU" COEFFS 0.000000 1.000000 0.000000 0.000000 0.000000 1.000000 /end COMPU_METHOD
/* Scalar calibration for DDE 'IDLc_NU_AirIMin'. */
/begin CHARACTERISTIC IDLc_NU_AirIMin "Air control ITerm is limited to this range" VALUE 0x85230 RL_IDLC_NU_AIRIMIN 1.000000 CU_IDLC_NU_AIRIMIN -1.000000 0.000000 BYTE_ORDER MSB_FIRST /end CHARACTERISTIC
/begin RECORD_LAYOUT RL_IDLC_NU_AIRIMIN FNC_VALUES 1 FLOAT32_IEEE COLUMN_DIR DIRECT /end RECORD_LAYOUT
/begin COMPU_METHOD CU_IDLC_NU_AIRIMIN "Conversion method for IDLc_NU_AirIMin" RAT_FUNC "%10.2" "NU" COEFFS 0.000000 1.000000 0.000000 0.000000 0.000000 1.000000 /end COMPU_METHOD
/* Scalar calibration for DDE 'IDLc_NU_AirPID_Dbnd'. */
/begin CHARACTERISTIC IDLc_NU_AirPID_Dbnd "Deadband on PID for Air output" VALUE 0x8523c RL_IDLC_NU_AIRPID_DBND 2.000000 CU_IDLC_NU_AIRPID_DBND -1.000000 1.000000 BYTE_ORDER MSB_FIRST /end CHARACTERISTIC
/begin RECORD_LAYOUT RL_IDLC_NU_AIRPID_DBND FNC_VALUES 1 FLOAT32_IEEE COLUMN_DIR DIRECT /end RECORD_LAYOUT
/begin COMPU_METHOD CU_IDLC_NU_AIRPID_DBND "Conversion method for IDLc_NU_AirPID_Dbnd" RAT_FUNC "%10.2" "NU" COEFFS 0.000000 1.000000 0.000000 0.000000 0.000000 1.000000 /end COMPU_METHOD
/* Scalar calibration for DDE 'IDLc_NU_AirPID_Max'. */
/begin CHARACTERISTIC IDLc_NU_AirPID_Max "PID High Saturation for Air output" VALUE 0x85240 RL_IDLC_NU_AIRPID_MAX 2.000000 CU_IDLC_NU_AIRPID_MAX 0.000000 2.000000 BYTE_ORDER MSB_FIRST /end CHARACTERISTIC
/begin RECORD_LAYOUT RL_IDLC_NU_AIRPID_MAX FNC_VALUES 1 FLOAT32_IEEE COLUMN_DIR DIRECT /end RECORD_LAYOUT
/begin COMPU_METHOD CU_IDLC_NU_AIRPID_MAX "Conversion method for IDLc_NU_AirPID_Max" RAT_FUNC "%10.2" "NU" COEFFS 0.000000 1.000000 0.000000 0.000000 0.000000 1.000000 /end COMPU_METHOD
/* Scalar calibration for DDE 'IDLc_NU_AirPID_Min'. */
/begin CHARACTERISTIC IDLc_NU_AirPID_Min "PID Low Saturation for Air output" VALUE 0x85244 RL_IDLC_NU_AIRPID_MIN 2.000000 CU_IDLC_NU_AIRPID_MIN -2.000000 0.000000 BYTE_ORDER MSB_FIRST /end CHARACTERISTIC
/begin RECORD_LAYOUT RL_IDLC_NU_AIRPID_MIN FNC_VALUES 1 FLOAT32_IEEE COLUMN_DIR DIRECT /end RECORD_LAYOUT
/begin COMPU_METHOD CU_IDLC_NU_AIRPID_MIN "Conversion method for IDLc_NU_AirPID_Min" RAT_FUNC "%10.2" "NU" COEFFS 0.000000 1.000000 0.000000 0.000000 0.000000 1.000000 /end COMPU_METHOD
/* Scalar calibration for DDE 'IDLc_NU_AlternatorFallRate'. */
/begin CHARACTERISTIC IDLc_NU_AlternatorFallRate "(RPM/s) Alternator term rate limit" VALUE 0x82578 RL_IDLC_NU_ALTERNATORFALLRATE 10000.000000 CU_IDLC_NU_ALTERNATORFALLRATE -10000.000000 0.000000 BYTE_ORDER MSB_FIRST /end CHARACTERISTIC
/begin RECORD_LAYOUT RL_IDLC_NU_ALTERNATORFALLRATE FNC_VALUES 1 FLOAT32_IEEE COLUMN_DIR DIRECT /end RECORD_LAYOUT
/begin COMPU_METHOD CU_IDLC_NU_ALTERNATORFALLRATE "Conversion method for IDLc_NU_AlternatorFallRate" RAT_FUNC "%10.0" "NU" COEFFS 0.000000 1.000000 0.000000 0.000000 0.000000 1.000000 /end COMPU_METHOD
/* Scalar calibration for DDE 'IDLc_NU_AlternatorRiseRate'. */
/begin CHARACTERISTIC IDLc_NU_AlternatorRiseRate "(RPM/s) Alternator term rate limit" VALUE 0x8257c RL_IDLC_NU_ALTERNATORRISERATE 10000.000000 CU_IDLC_NU_ALTERNATORRISERATE 0.000000 10000.000000 BYTE_ORDER MSB_FIRST /end CHARACTERISTIC
/begin RECORD_LAYOUT RL_IDLC_NU_ALTERNATORRISERATE FNC_VALUES 1 FLOAT32_IEEE COLUMN_DIR DIRECT /end RECORD_LAYOUT
/begin COMPU_METHOD CU_IDLC_NU_ALTERNATORRISERATE "Conversion method for IDLc_NU_AlternatorRiseRate" RAT_FUNC "%10.0" "NU" COEFFS 0.000000 1.000000 0.000000 0.000000 0.000000 1.000000 /end COMPU_METHOD
/* Scalar calibration for DDE 'IDLc_NU_SparkErrorROCThrsh'. */
/begin CHARACTERISTIC IDLc_NU_SparkErrorROCThrsh "RPM error rate of change threshold for derivative control" VALUE 0x84e90 RL_IDLC_NU_SPARKERRORROCTHRSH 2000.000000 CU_IDLC_NU_SPARKERRORROCTHRSH -1000.000000 1000.000000 BYTE_ORDER MSB_FIRST /end CHARACTERISTIC
/begin RECORD_LAYOUT RL_IDLC_NU_SPARKERRORROCTHRSH FNC_VALUES 1 FLOAT32_IEEE COLUMN_DIR DIRECT /end RECORD_LAYOUT
/begin COMPU_METHOD CU_IDLC_NU_SPARKERRORROCTHRSH "Conversion method for IDLc_NU_SparkErrorROCThrsh" RAT_FUNC "%10.3" "NU" COEFFS 0.000000 1.000000 0.000000 0.000000 0.000000 1.000000 /end COMPU_METHOD
/* Scalar calibration for DDE 'IDLc_NU_SparkIMax'. */
/begin CHARACTERISTIC IDLc_NU_SparkIMax "Integral Term Maximum for Spark output" VALUE 0x84e88 RL_IDLC_NU_SPARKIMAX 1.000000 CU_IDLC_NU_SPARKIMAX 0.000000 1.000000 BYTE_ORDER MSB_FIRST /end CHARACTERISTIC
/begin RECORD_LAYOUT RL_IDLC_NU_SPARKIMAX FNC_VALUES 1 FLOAT32_IEEE COLUMN_DIR DIRECT /end RECORD_LAYOUT
/begin COMPU_METHOD CU_IDLC_NU_SPARKIMAX "Conversion method for IDLc_NU_SparkIMax" RAT_FUNC "%10.2" "NU" COEFFS 0.000000 1.000000 0.000000 0.000000 0.000000 1.000000 /end COMPU_METHOD
/* Scalar calibration for DDE 'IDLc_NU_SparkIMin'. */
/begin CHARACTERISTIC IDLc_NU_SparkIMin "Integral Term Minimum for Spark output" VALUE 0x84e84 RL_IDLC_NU_SPARKIMIN 1.000000 CU_IDLC_NU_SPARKIMIN -1.000000 0.000000 BYTE_ORDER MSB_FIRST /end CHARACTERISTIC
/begin RECORD_LAYOUT RL_IDLC_NU_SPARKIMIN FNC_VALUES 1 FLOAT32_IEEE COLUMN_DIR DIRECT /end RECORD_LAYOUT
/begin COMPU_METHOD CU_IDLC_NU_SPARKIMIN "Conversion method for IDLc_NU_SparkIMin" RAT_FUNC "%10.2" "NU" COEFFS 0.000000 1.000000 0.000000 0.000000 0.000000 1.000000 /end COMPU_METHOD
/* Scalar calibration for DDE 'IDLc_NU_SparkPID_Dbnd'. */
/begin CHARACTERISTIC IDLc_NU_SparkPID_Dbnd "Deadband on PID for Spark output" VALUE 0x84e94 RL_IDLC_NU_SPARKPID_DBND 2.000000 CU_IDLC_NU_SPARKPID_DBND -1.000000 1.000000 BYTE_ORDER MSB_FIRST /end CHARACTERISTIC
/begin RECORD_LAYOUT RL_IDLC_NU_SPARKPID_DBND FNC_VALUES 1 FLOAT32_IEEE COLUMN_DIR DIRECT /end RECORD_LAYOUT
/begin COMPU_METHOD CU_IDLC_NU_SPARKPID_DBND "Conversion method for IDLc_NU_SparkPID_Dbnd" RAT_FUNC "%10.2" "NU" COEFFS 0.000000 1.000000 0.000000 0.000000 0.000000 1.000000 /end COMPU_METHOD
/* Scalar calibration for DDE 'IDLc_NU_SparkPID_Max'. */
/begin CHARACTERISTIC IDLc_NU_SparkPID_Max "PID High Saturation for Spark output" VALUE 0x84e98 RL_IDLC_NU_SPARKPID_MAX 2.000000 CU_IDLC_NU_SPARKPID_MAX 0.000000 2.000000 BYTE_ORDER MSB_FIRST /end CHARACTERISTIC
/begin RECORD_LAYOUT RL_IDLC_NU_SPARKPID_MAX FNC_VALUES 1 FLOAT32_IEEE COLUMN_DIR DIRECT /end RECORD_LAYOUT
/begin COMPU_METHOD CU_IDLC_NU_SPARKPID_MAX "Conversion method for IDLc_NU_SparkPID_Max" RAT_FUNC "%10.2" "NU" COEFFS 0.000000 1.000000 0.000000 0.000000 0.000000 1.000000 /end COMPU_METHOD
/* Scalar calibration for DDE 'IDLc_NU_SparkPID_Min'. */
/begin CHARACTERISTIC IDLc_NU_SparkPID_Min "PID Low Saturation for Spark output" VALUE 0x84e9c RL_IDLC_NU_SPARKPID_MIN 2.000000 CU_IDLC_NU_SPARKPID_MIN -2.000000 0.000000 BYTE_ORDER MSB_FIRST /end CHARACTERISTIC
/begin RECORD_LAYOUT RL_IDLC_NU_SPARKPID_MIN FNC_VALUES 1 FLOAT32_IEEE COLUMN_DIR DIRECT /end RECORD_LAYOUT
/begin COMPU_METHOD CU_IDLC_NU_SPARKPID_MIN "Conversion method for IDLc_NU_SparkPID_Min" RAT_FUNC "%10.2" "NU" COEFFS 0.000000 1.000000 0.000000 0.000000 0.000000 1.000000 /end COMPU_METHOD
/* Scalar calibration for DDE 'IDLc_RPM_AC_Adder'. */
/begin CHARACTERISTIC IDLc_RPM_AC_Adder "The increase in desired idle speed whilst AC compressor is engaged" VALUE 0x82584 RL_IDLC_RPM_AC_ADDER 1000.000000 CU_IDLC_RPM_AC_ADDER 0.000000 1000.000000 BYTE_ORDER MSB_FIRST /end CHARACTERISTIC
/begin RECORD_LAYOUT RL_IDLC_RPM_AC_ADDER FNC_VALUES 1 FLOAT32_IEEE COLUMN_DIR DIRECT /end RECORD_LAYOUT
/begin COMPU_METHOD CU_IDLC_RPM_AC_ADDER "Conversion method for IDLc_RPM_AC_Adder" RAT_FUNC "%10.0" "RPM" COEFFS 0.000000 1.000000 0.000000 0.000000 0.000000 1.000000 /end COMPU_METHOD
/* Scalar calibration for DDE 'IDLc_RPM_AirErrorDbnd'. */
/begin CHARACTERISTIC IDLc_RPM_AirErrorDbnd "Deadband on RPM error for integral control" VALUE 0x8522c RL_IDLC_RPM_AIRERRORDBND 100.000000 CU_IDLC_RPM_AIRERRORDBND 0.000000 100.000000 BYTE_ORDER MSB_FIRST /end CHARACTERISTIC
/begin RECORD_LAYOUT RL_IDLC_RPM_AIRERRORDBND FNC_VALUES 1 FLOAT32_IEEE COLUMN_DIR DIRECT /end RECORD_LAYOUT
/begin COMPU_METHOD CU_IDLC_RPM_AIRERRORDBND "Conversion method for IDLc_RPM_AirErrorDbnd" RAT_FUNC "%10.2" "RPM" COEFFS 0.000000 1.000000 0.000000 0.000000 0.000000 1.000000 /end COMPU_METHOD
/* Scalar calibration for DDE 'IDLc_RPM_DrivingAdder'. */
/begin CHARACTERISTIC IDLc_RPM_DrivingAdder "Raise idle by this amount when vehicle moving" VALUE 0x8258c RL_IDLC_RPM_DRIVINGADDER 1000.000000 CU_IDLC_RPM_DRIVINGADDER 0.000000 1000.000000 BYTE_ORDER MSB_FIRST /end CHARACTERISTIC
/begin RECORD_LAYOUT RL_IDLC_RPM_DRIVINGADDER FNC_VALUES 1 FLOAT32_IEEE COLUMN_DIR DIRECT /end RECORD_LAYOUT
/begin COMPU_METHOD CU_IDLC_RPM_DRIVINGADDER "Conversion method for IDLc_RPM_DrivingAdder" RAT_FUNC "%10.0" "RPM" COEFFS 0.000000 1.000000 0.000000 0.000000 0.000000 1.000000 /end COMPU_METHOD
/* Scalar calibration for DDE 'IDLc_RPM_ErrorActivationThrsh'. */
/begin CHARACTERISTIC IDLc_RPM_ErrorActivationThrsh "IDL will become active if speed error (vs idle speed target) exceeds this amount (positive error implies speed is too low)" VALUE 0x825b4 RL_IDLC_RPM_ERRORACTIVATIONTHR0 1000.000000 CU_IDLC_RPM_ERRORACTIVATIONTHR0 -1000.000000 0.000000 BYTE_ORDER MSB_FIRST /end CHARACTERISTIC
/begin RECORD_LAYOUT RL_IDLC_RPM_ERRORACTIVATIONTHR0 FNC_VALUES 1 FLOAT32_IEEE COLUMN_DIR DIRECT /end RECORD_LAYOUT
/begin COMPU_METHOD CU_IDLC_RPM_ERRORACTIVATIONTHR0 "Conversion method for IDLc_RPM_ErrorActivationThrsh" RAT_FUNC "%10.0" "RPM" COEFFS 0.000000 1.000000 0.000000 0.000000 0.000000 1.000000 /end COMPU_METHOD
/* Scalar calibration for DDE 'IDLc_RPM_ExitRPMAdder'. */
/begin CHARACTERISTIC IDLc_RPM_ExitRPMAdder "(not defined)" VALUE 0x825a0 RL_IDLC_RPM_EXITRPMADDER 1000.000000 CU_IDLC_RPM_EXITRPMADDER 0.000000 1000.000000 BYTE_ORDER MSB_FIRST /end CHARACTERISTIC
/begin RECORD_LAYOUT RL_IDLC_RPM_EXITRPMADDER FNC_VALUES 1 FLOAT32_IEEE COLUMN_DIR DIRECT /end RECORD_LAYOUT
/begin COMPU_METHOD CU_IDLC_RPM_EXITRPMADDER "Conversion method for IDLc_RPM_ExitRPMAdder" RAT_FUNC "%10.2" "RPM" COEFFS 0.000000 1.000000 0.000000 0.000000 0.000000 1.000000 /end COMPU_METHOD
/* Scalar calibration for DDE 'IDLc_RPM_ITermMaxError'. */
/begin CHARACTERISTIC IDLc_RPM_ITermMaxError "ITerm will freeze when Error exceeds this range" VALUE 0x85228 RL_IDLC_RPM_ITERMMAXERROR 3000.000000 CU_IDLC_RPM_ITERMMAXERROR 0.000000 3000.000000 BYTE_ORDER MSB_FIRST /end CHARACTERISTIC
/begin RECORD_LAYOUT RL_IDLC_RPM_ITERMMAXERROR FNC_VALUES 1 FLOAT32_IEEE COLUMN_DIR DIRECT /end RECORD_LAYOUT
/begin COMPU_METHOD CU_IDLC_RPM_ITERMMAXERROR "Conversion method for IDLc_RPM_ITermMaxError" RAT_FUNC "%10.0" "RPM" COEFFS 0.000000 1.000000 0.000000 0.000000 0.000000 1.000000 /end COMPU_METHOD
/* Scalar calibration for DDE 'IDLc_RPM_ITermMinError'. */
/begin CHARACTERISTIC IDLc_RPM_ITermMinError "ITerm will freeze when Error exceeds this range" VALUE 0x85224 RL_IDLC_RPM_ITERMMINERROR 3000.000000 CU_IDLC_RPM_ITERMMINERROR -3000.000000 0.000000 BYTE_ORDER MSB_FIRST /end CHARACTERISTIC
/begin RECORD_LAYOUT RL_IDLC_RPM_ITERMMINERROR FNC_VALUES 1 FLOAT32_IEEE COLUMN_DIR DIRECT /end RECORD_LAYOUT
/begin COMPU_METHOD CU_IDLC_RPM_ITERMMINERROR "Conversion method for IDLc_RPM_ITermMinError" RAT_FUNC "%10.0" "RPM" COEFFS 0.000000 1.000000 0.000000 0.000000 0.000000 1.000000 /end COMPU_METHOD
/* Scalar calibration for DDE 'IDLc_RPM_LimitErrorActThrsh'. */
/begin CHARACTERISTIC IDLc_RPM_LimitErrorActThrsh "(not defined)" VALUE 0x825b8 RL_IDLC_RPM_LIMITERRORACTTHRSH 2000.000000 CU_IDLC_RPM_LIMITERRORACTTHRSH -1000.000000 1000.000000 BYTE_ORDER MSB_FIRST /end CHARACTERISTIC
/begin RECORD_LAYOUT RL_IDLC_RPM_LIMITERRORACTTHRSH FNC_VALUES 1 FLOAT32_IEEE COLUMN_DIR DIRECT /end RECORD_LAYOUT
/begin COMPU_METHOD CU_IDLC_RPM_LIMITERRORACTTHRSH "Conversion method for IDLc_RPM_LimitErrorActThrsh" RAT_FUNC "%10.2" "RPM" COEFFS 0.000000 1.000000 0.000000 0.000000 0.000000 1.000000 /end COMPU_METHOD
/* Scalar calibration for DDE 'IDLc_RPM_MaxIdlSpd'. */
/begin CHARACTERISTIC IDLc_RPM_MaxIdlSpd "Idle speed target will be limited to this value" VALUE 0x82598 RL_IDLC_RPM_MAXIDLSPD 10000.000000 CU_IDLC_RPM_MAXIDLSPD 0.000000 10000.000000 BYTE_ORDER MSB_FIRST /end CHARACTERISTIC
/begin RECORD_LAYOUT RL_IDLC_RPM_MAXIDLSPD FNC_VALUES 1 FLOAT32_IEEE COLUMN_DIR DIRECT /end RECORD_LAYOUT
/begin COMPU_METHOD CU_IDLC_RPM_MAXIDLSPD "Conversion method for IDLc_RPM_MaxIdlSpd" RAT_FUNC "%10.0" "RPM" COEFFS 0.000000 1.000000 0.000000 0.000000 0.000000 1.000000 /end COMPU_METHOD
/* Scalar calibration for DDE 'IDLc_RPM_SparkErrorDbnd'. */
/begin CHARACTERISTIC IDLc_RPM_SparkErrorDbnd "Deadband on RPM error for integral control" VALUE 0x84e80 RL_IDLC_RPM_SPARKERRORDBND 100.000000 CU_IDLC_RPM_SPARKERRORDBND 0.000000 100.000000 BYTE_ORDER MSB_FIRST /end CHARACTERISTIC
/begin RECORD_LAYOUT RL_IDLC_RPM_SPARKERRORDBND FNC_VALUES 1 FLOAT32_IEEE COLUMN_DIR DIRECT /end RECORD_LAYOUT
/begin COMPU_METHOD CU_IDLC_RPM_SPARKERRORDBND "Conversion method for IDLc_RPM_SparkErrorDbnd" RAT_FUNC "%10.2" "RPM" COEFFS 0.000000 1.000000 0.000000 0.000000 0.000000 1.000000 /end COMPU_METHOD
/* Scalar calibration for DDE 'IDLc_RPM_SparkITermMaxError'. */
/begin CHARACTERISTIC IDLc_RPM_SparkITermMaxError "ITerm will freeze when Error exceeds this range" VALUE 0x84e7c RL_IDLC_RPM_SPARKITERMMAXERROR 3000.000000 CU_IDLC_RPM_SPARKITERMMAXERROR 0.000000 3000.000000 BYTE_ORDER MSB_FIRST /end CHARACTERISTIC
/begin RECORD_LAYOUT RL_IDLC_RPM_SPARKITERMMAXERROR FNC_VALUES 1 FLOAT32_IEEE COLUMN_DIR DIRECT /end RECORD_LAYOUT
/begin COMPU_METHOD CU_IDLC_RPM_SPARKITERMMAXERROR "Conversion method for IDLc_RPM_SparkITermMaxError" RAT_FUNC "%10.0" "RPM" COEFFS 0.000000 1.000000 0.000000 0.000000 0.000000 1.000000 /end COMPU_METHOD
/* Scalar calibration for DDE 'IDLc_RPM_SparkITermMinError'. */
/begin CHARACTERISTIC IDLc_RPM_SparkITermMinError "ITerm will freeze when Error exceeds this range" VALUE 0x84e78 RL_IDLC_RPM_SPARKITERMMINERROR 3000.000000 CU_IDLC_RPM_SPARKITERMMINERROR -3000.000000 0.000000 BYTE_ORDER MSB_FIRST /end CHARACTERISTIC
/begin RECORD_LAYOUT RL_IDLC_RPM_SPARKITERMMINERROR FNC_VALUES 1 FLOAT32_IEEE COLUMN_DIR DIRECT /end RECORD_LAYOUT
/begin COMPU_METHOD CU_IDLC_RPM_SPARKITERMMINERROR "Conversion method for IDLc_RPM_SparkITermMinError" RAT_FUNC "%10.0" "RPM" COEFFS 0.000000 1.000000 0.000000 0.000000 0.000000 1.000000 /end COMPU_METHOD
/* Scalar calibration for DDE 'IDLc_RPM_Trgt'. */
/begin CHARACTERISTIC IDLc_RPM_Trgt "Override value" VALUE 0x82594 RL_IDLC_RPM_TRGT 4000.000000 CU_IDLC_RPM_TRGT 0.000000 4000.000000 BYTE_ORDER MSB_FIRST /end CHARACTERISTIC
/begin RECORD_LAYOUT RL_IDLC_RPM_TRGT FNC_VALUES 1 FLOAT32_IEEE COLUMN_DIR DIRECT /end RECORD_LAYOUT
/begin COMPU_METHOD CU_IDLC_RPM_TRGT "Conversion method for IDLc_RPM_Trgt" RAT_FUNC "%10.0" "RPM" COEFFS 0.000000 1.000000 0.000000 0.000000 0.000000 1.000000 /end COMPU_METHOD
/* Scalar calibration for DDE 'IDLc_b_Actv'. */
/begin CHARACTERISTIC IDLc_b_Actv "Override value" VALUE 0x825c5 RL_IDLC_B_ACTV 1.000000 CU_IDLC_B_ACTV 0.000000 1.000000 BYTE_ORDER MSB_FIRST /end CHARACTERISTIC
/begin RECORD_LAYOUT RL_IDLC_B_ACTV FNC_VALUES 1 UBYTE COLUMN_DIR DIRECT /end RECORD_LAYOUT
/begin COMPU_METHOD CU_IDLC_B_ACTV "Conversion method for IDLc_b_Actv" RAT_FUNC "%10.0" "b" COEFFS 0.000000 1.000000 0.000000 0.000000 0.000000 1.000000 /end COMPU_METHOD
/* Scalar calibration for DDE 'IDLc_b_ITermAutoReset'. */
/begin CHARACTERISTIC IDLc_b_ITermAutoReset "Configures the ITerm to clear whenever the PID is inactive" VALUE 0x85220 RL_IDLC_B_ITERMAUTORESET 1.000000 CU_IDLC_B_ITERMAUTORESET 0.000000 1.000000 BYTE_ORDER MSB_FIRST /end CHARACTERISTIC
/begin RECORD_LAYOUT RL_IDLC_B_ITERMAUTORESET FNC_VALUES 1 UBYTE COLUMN_DIR DIRECT /end RECORD_LAYOUT
/begin COMPU_METHOD CU_IDLC_B_ITERMAUTORESET "Conversion method for IDLc_b_ITermAutoReset" RAT_FUNC "%10.0" "b" COEFFS 0.000000 1.000000 0.000000 0.000000 0.000000 1.000000 /end COMPU_METHOD
/* Scalar calibration for DDE 'IDLc_b_IgnoreTransGear'. */
/begin CHARACTERISTIC IDLc_b_IgnoreTransGear "If this is zero the DTerms will remain active when the trans is in neutral" VALUE 0x84e70 RL_IDLC_B_IGNORETRANSGEAR 1.000000 CU_IDLC_B_IGNORETRANSGEAR 0.000000 1.000000 BYTE_ORDER MSB_FIRST /end CHARACTERISTIC
/begin RECORD_LAYOUT RL_IDLC_B_IGNORETRANSGEAR FNC_VALUES 1 UBYTE COLUMN_DIR DIRECT /end RECORD_LAYOUT
/begin COMPU_METHOD CU_IDLC_B_IGNORETRANSGEAR "Conversion method for IDLc_b_IgnoreTransGear" RAT_FUNC "%10.0" "b" COEFFS 0.000000 1.000000 0.000000 0.000000 0.000000 1.000000 /end COMPU_METHOD
/* Scalar calibration for DDE 'IDLc_gps_Air'. */
/begin CHARACTERISTIC IDLc_gps_Air "Override value" VALUE 0x855a0 RL_IDLC_GPS_AIR 200.000000 CU_IDLC_GPS_AIR -100.000000 100.000000 BYTE_ORDER MSB_FIRST /end CHARACTERISTIC
/begin RECORD_LAYOUT RL_IDLC_GPS_AIR FNC_VALUES 1 FLOAT32_IEEE COLUMN_DIR DIRECT /end RECORD_LAYOUT
/begin COMPU_METHOD CU_IDLC_GPS_AIR "Conversion method for IDLc_gps_Air" RAT_FUNC "%10.3" "gps" COEFFS 0.000000 1.000000 0.000000 0.000000 0.000000 1.000000 /end COMPU_METHOD
/* Scalar calibration for DDE 'IDLc_kph_DrivingThrsh'. */
/begin CHARACTERISTIC IDLc_kph_DrivingThrsh "Use driving adder above this speed" VALUE 0x82588 RL_IDLC_KPH_DRIVINGTHRSH 200.000000 CU_IDLC_KPH_DRIVINGTHRSH 0.000000 200.000000 BYTE_ORDER MSB_FIRST /end CHARACTERISTIC
/begin RECORD_LAYOUT RL_IDLC_KPH_DRIVINGTHRSH FNC_VALUES 1 FLOAT32_IEEE COLUMN_DIR DIRECT /end RECORD_LAYOUT
/begin COMPU_METHOD CU_IDLC_KPH_DRIVINGTHRSH "Conversion method for IDLc_kph_DrivingThrsh" RAT_FUNC "%10.0" "kph" COEFFS 0.000000 1.000000 0.000000 0.000000 0.000000 1.000000 /end COMPU_METHOD
/* Scalar calibration for DDE 'IDLc_o_Actv'. */
/begin CHARACTERISTIC IDLc_o_Actv "Override flag" VALUE 0x825c4 RL_IDLC_O_ACTV 1.000000 CU_IDLC_O_ACTV 0.000000 1.000000 BYTE_ORDER MSB_FIRST /end CHARACTERISTIC
/begin RECORD_LAYOUT RL_IDLC_O_ACTV FNC_VALUES 1 UBYTE COLUMN_DIR DIRECT /end RECORD_LAYOUT
/begin COMPU_METHOD CU_IDLC_O_ACTV "Conversion method for IDLc_o_Actv" RAT_FUNC "%10.0" "o" COEFFS 0.000000 1.000000 0.000000 0.000000 0.000000 1.000000 /end COMPU_METHOD
/* Scalar calibration for DDE 'IDLc_o_Air'. */
/begin CHARACTERISTIC IDLc_o_Air "Override flag" VALUE 0x8559c RL_IDLC_O_AIR 1.000000 CU_IDLC_O_AIR 0.000000 1.000000 BYTE_ORDER MSB_FIRST /end CHARACTERISTIC
/begin RECORD_LAYOUT RL_IDLC_O_AIR FNC_VALUES 1 UBYTE COLUMN_DIR DIRECT /end RECORD_LAYOUT
/begin COMPU_METHOD CU_IDLC_O_AIR "Conversion method for IDLc_o_Air" RAT_FUNC "%10.0" "o" COEFFS 0.000000 1.000000 0.000000 0.000000 0.000000 1.000000 /end COMPU_METHOD
/* Scalar calibration for DDE 'IDLc_o_Spark'. */
/begin CHARACTERISTIC IDLc_o_Spark "Override flag" VALUE 0x84ee8 RL_IDLC_O_SPARK 1.000000 CU_IDLC_O_SPARK 0.000000 1.000000 BYTE_ORDER MSB_FIRST /end CHARACTERISTIC
/begin RECORD_LAYOUT RL_IDLC_O_SPARK FNC_VALUES 1 UBYTE COLUMN_DIR DIRECT /end RECORD_LAYOUT
/begin COMPU_METHOD CU_IDLC_O_SPARK "Conversion method for IDLc_o_Spark" RAT_FUNC "%10.0" "o" COEFFS 0.000000 1.000000 0.000000 0.000000 0.000000 1.000000 /end COMPU_METHOD
/* Scalar calibration for DDE 'IDLc_o_Trgt'. */
/begin CHARACTERISTIC IDLc_o_Trgt "Override flag" VALUE 0x82590 RL_IDLC_O_TRGT 1.000000 CU_IDLC_O_TRGT 0.000000 1.000000 BYTE_ORDER MSB_FIRST /end CHARACTERISTIC
/begin RECORD_LAYOUT RL_IDLC_O_TRGT FNC_VALUES 1 UBYTE COLUMN_DIR DIRECT /end RECORD_LAYOUT
/begin COMPU_METHOD CU_IDLC_O_TRGT "Conversion method for IDLc_o_Trgt" RAT_FUNC "%10.0" "o" COEFFS 0.000000 1.000000 0.000000 0.000000 0.000000 1.000000 /end COMPU_METHOD
/* Scalar calibration for DDE 'IDLc_pct_AirGainScale'. */
/begin CHARACTERISTIC IDLc_pct_AirGainScale "Shifts the decimal place of the gain cals to a convenient order of magnitude" VALUE 0x8521c RL_IDLC_PCT_AIRGAINSCALE 9.999990 CU_IDLC_PCT_AIRGAINSCALE 0.000010 10.000000 BYTE_ORDER MSB_FIRST /end CHARACTERISTIC
/begin RECORD_LAYOUT RL_IDLC_PCT_AIRGAINSCALE FNC_VALUES 1 FLOAT32_IEEE COLUMN_DIR DIRECT /end RECORD_LAYOUT
/begin COMPU_METHOD CU_IDLC_PCT_AIRGAINSCALE "Conversion method for IDLc_pct_AirGainScale" RAT_FUNC "%10.5" "pct" COEFFS 0.000000 1.000000 0.000000 0.000000 0.000000 1.000000 /end COMPU_METHOD
/* Scalar calibration for DDE 'IDLc_pct_SparkGainScale'. */
/begin CHARACTERISTIC IDLc_pct_SparkGainScale "Shifts the decimal place of the gain cals to a convenient order of magnitude" VALUE 0x84e74 RL_IDLC_PCT_SPARKGAINSCALE 9.999990 CU_IDLC_PCT_SPARKGAINSCALE 0.000010 10.000000 BYTE_ORDER MSB_FIRST /end CHARACTERISTIC
/begin RECORD_LAYOUT RL_IDLC_PCT_SPARKGAINSCALE FNC_VALUES 1 FLOAT32_IEEE COLUMN_DIR DIRECT /end RECORD_LAYOUT
/begin COMPU_METHOD CU_IDLC_PCT_SPARKGAINSCALE "Conversion method for IDLc_pct_SparkGainScale" RAT_FUNC "%10.5" "pct" COEFFS 0.000000 1.000000 0.000000 0.000000 0.000000 1.000000 /end COMPU_METHOD
/* Scalar calibration for DDE 'IDLc_ret_Spark'. */
/begin CHARACTERISTIC IDLc_ret_Spark "Override value" VALUE 0x84eec RL_IDLC_RET_SPARK 40.000000 CU_IDLC_RET_SPARK 0.000000 40.000000 BYTE_ORDER MSB_FIRST /end CHARACTERISTIC
/begin RECORD_LAYOUT RL_IDLC_RET_SPARK FNC_VALUES 1 FLOAT32_IEEE COLUMN_DIR DIRECT /end RECORD_LAYOUT
/begin COMPU_METHOD CU_IDLC_RET_SPARK "Conversion method for IDLc_ret_Spark" RAT_FUNC "%10.0" "ret" COEFFS 0.000000 1.000000 0.000000 0.000000 0.000000 1.000000 /end COMPU_METHOD
/* Scalar calibration for DDE 'IDLc_s_AC_Dbnc'. */
/begin CHARACTERISTIC IDLc_s_AC_Dbnc "Hold timer for AC compressor status" VALUE 0x82580 RL_IDLC_S_AC_DBNC 1000.000000 CU_IDLC_S_AC_DBNC 0.000000 1000.000000 BYTE_ORDER MSB_FIRST /end CHARACTERISTIC
/begin RECORD_LAYOUT RL_IDLC_S_AC_DBNC FNC_VALUES 1 FLOAT32_IEEE COLUMN_DIR DIRECT /end RECORD_LAYOUT
/begin COMPU_METHOD CU_IDLC_S_AC_DBNC "Conversion method for IDLc_s_AC_Dbnc" RAT_FUNC "%10.2" "s" COEFFS 0.000000 1.000000 0.000000 0.000000 0.000000 1.000000 /end COMPU_METHOD
/* Scalar calibration for DDE 'IDLc_s_Hold'. */
/begin CHARACTERISTIC IDLc_s_Hold "Hold timer on activation flag" VALUE 0x825bc RL_IDLC_S_HOLD 1.000000 CU_IDLC_S_HOLD 0.000000 1.000000 BYTE_ORDER MSB_FIRST /end CHARACTERISTIC
/begin RECORD_LAYOUT RL_IDLC_S_HOLD FNC_VALUES 1 FLOAT32_IEEE COLUMN_DIR DIRECT /end RECORD_LAYOUT
/begin COMPU_METHOD CU_IDLC_S_HOLD "Conversion method for IDLc_s_Hold" RAT_FUNC "%10.2" "s" COEFFS 0.000000 1.000000 0.000000 0.000000 0.000000 1.000000 /end COMPU_METHOD
/* Scalar calibration for DDE 'IDLc_s_HoldRPMAdder'. */
/begin CHARACTERISTIC IDLc_s_HoldRPMAdder "(not defined)" VALUE 0x8259c RL_IDLC_S_HOLDRPMADDER 100.000000 CU_IDLC_S_HOLDRPMADDER 0.000000 100.000000 BYTE_ORDER MSB_FIRST /end CHARACTERISTIC
/begin RECORD_LAYOUT RL_IDLC_S_HOLDRPMADDER FNC_VALUES 1 FLOAT32_IEEE COLUMN_DIR DIRECT /end RECORD_LAYOUT
/begin COMPU_METHOD CU_IDLC_S_HOLDRPMADDER "Conversion method for IDLc_s_HoldRPMAdder" RAT_FUNC "%10.2" "s" COEFFS 0.000000 1.000000 0.000000 0.000000 0.000000 1.000000 /end COMPU_METHOD
/* Scalar calibration for DDE 'IDLc_s_StartupDelay'. */
/begin CHARACTERISTIC IDLc_s_StartupDelay "IDL will remain inactive for this duration after startup (allows flare)" VALUE 0x825c0 RL_IDLC_S_STARTUPDELAY 1.000000 CU_IDLC_S_STARTUPDELAY 0.000000 1.000000 BYTE_ORDER MSB_FIRST /end CHARACTERISTIC
/begin RECORD_LAYOUT RL_IDLC_S_STARTUPDELAY FNC_VALUES 1 FLOAT32_IEEE COLUMN_DIR DIRECT /end RECORD_LAYOUT
/begin COMPU_METHOD CU_IDLC_S_STARTUPDELAY "Conversion method for IDLc_s_StartupDelay" RAT_FUNC "%10.2" "s" COEFFS 0.000000 1.000000 0.000000 0.000000 0.000000 1.000000 /end COMPU_METHOD
/* Map (1d) calibration for DDE 'IDLm_NU_AirDGainNeg_z'. */
/begin CHARACTERISTIC IDLm_NU_AirDGainNeg_z "Derivative Gain for Air output" CURVE 0x851fc RL_IDLM_NU_AIRDGAINNEG_Z 1000.000000 CU_IDLM_NU_AIRDGAINNEG_Z 0.000000 1000.000000
 /begin AXIS_DESCR COM_AXIS IDL_RPM_Error CU_IDLM_NU_AIRDGAINNEG_X 8 -1000.000000 1000.000000 AXIS_PTS_REF APD_IDLM_NU_AIRDGAINNEG_X /end AXIS_DESCR
 BYTE_ORDER MSB_FIRST /end CHARACTERISTIC
/begin RECORD_LAYOUT RL_IDLM_NU_AIRDGAINNEG_Z FNC_VALUES 1 FLOAT32_IEEE COLUMN_DIR DIRECT /end RECORD_LAYOUT
/begin COMPU_METHOD CU_IDLM_NU_AIRDGAINNEG_Z "Conversion method for IDLm_NU_AirDGainNeg_z" RAT_FUNC "%10.2" "NU" COEFFS 0.000000 1.000000 0.000000 0.000000 0.000000 1.000000 /end COMPU_METHOD
/begin AXIS_PTS APD_IDLM_NU_AIRDGAINNEG_X "(pct load) Map index" 0x851dc IDL_RPM_Error RL_IDLM_NU_AIRDGAINNEG_X 2000.000000 CU_IDLM_NU_AIRDGAINNEG_X 8 -1000.0 1000.0 BYTE_ORDER MSB_FIRST /end AXIS_PTS
/begin RECORD_LAYOUT RL_IDLM_NU_AIRDGAINNEG_X AXIS_PTS_X 1 FLOAT32_IEEE INDEX_INCR DIRECT /end RECORD_LAYOUT
/begin COMPU_METHOD CU_IDLM_NU_AIRDGAINNEG_X "Conversion method for IDLm_NU_AirDGainNeg_x" RAT_FUNC "%10.2" "pct" COEFFS 0.000000 1.000000 0.000000 0.000000 0.000000 1.000000 /end COMPU_METHOD
/end MODULE
/end PROJECT
